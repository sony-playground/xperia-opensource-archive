// SW: Core/Uefi/cfg/

&sw {
    uefi {
         uefiplat {
                size = <8342>;
                payload = [5b436f6e6669675d0a56657273696f6e203d20330a4d61784d656d6f7279526567696f6e73203d2037340a0a5b4d656d6f72794d61705d0a23202020202020202020202020202020202020202020202020202020202020202020202020202020202020202020202020202020204546495f5245534f555243455f204546495f5245534f555243455f4154545249425554455f204546495f4d454d4f52595f545950452041524d5f524547494f4e5f4154545249425554455f0a234d656d426173652c2020204d656d53697a652c2020204d656d4c6162656c28333220436861722e292c204275696c64486f622c205265736f75726365547970652c205265736f757263654174747269627574652c204d656d6f7279547970652c204361636865417474726962757465730a232d2d2d2d2d2d2d2d2d2d2d2d2d2d2d2d2d2d2d2d2d2044445220202d2d2d2d2d0a307838303030303030302c20307830313230303030302c20224e4f4d4150222c202020202020202020202020204e6f4d61702c20204d454d5f5245532c20554e434143484541424c452c205265736572762c20554e4341434845445f554e42554646455245445f584e0a307838313230303030302c20307830303830303030302c20225253525630222c202020202020202020202020204164644d656d2c205359535f4d454d2c205359535f4d454d5f4341502c205265736572762c2057524954455f4241434b5f584e0a307838314130303030302c20307830303034303030302c202258424c204454222c2020202020202020202020204164644d656d2c205359535f4d454d2c205359535f4d454d5f4341502c205265736572762c2057524954455f4241434b5f584e0a307838314134303030302c20307830303143303030302c202258424c2052616d64756d70222c202020202020204164644d656d2c204d454d5f5245532c20554e434143484541424c452c205265736572762c20554e4341434845445f554e42554646455245445f584e0a307838314330303030302c20307830303041303030302c2022414f50222c2020202020202020202020202020204164644d656d2c204d454d5f5245532c20554e434143484541424c452c205265736572762c20554e4341434845445f554e42554646455245445f584e0a307838314430303030302c20307830303230303030302c2022534d454d222c20202020202020202020202020204164644d656d2c204d454d5f5245532c20554e434143484541424c452c205265736572762c20554e4341434845445f554e42554646455245445f584e0a307838364530303030302c20307830324130303030302c20225253525631222c202020202020202020202020204164644d656d2c204d454d5f5245532c205359535f4d454d5f4341502c205265736572762c2057524954455f4241434b5f584e0a307838393830303030302c20307831393238303030302c202250494c205265736572766564222c2020202020204164644d656d2c204d454d5f5245532c20554e434143484541424c452c205265736572762c20554e4341434845445f554e42554646455245445f584e0a307841324138303030302c20307830324230303030302c2022446973706c61792044656d757261222c202020204164644d656d2c204d454d5f5245532c205359535f4d454d5f4341502c205265736572762c2057524954455f5448524f5547485f584e0a307841353538303030302c20307830304238303030302c20225253525632222c202020202020202020202020204164644d656d2c204d454d5f5245532c205359535f4d454d5f4341502c205265736572762c2057524954455f4241434b5f584e0a307841363130303030302c20307830304630303030302c20224442492044756d70222c202020202020202020204e6f486f622c20204d4d41505f494f2c20494e495449414c495a45442c20436f6e762c202020554e4341434845445f554e42554646455245445f584e0a307841373030303030302c20307830303430303030302c202255454649204644222c20202020202020202020204164644d656d2c205359535f4d454d2c205359535f4d454d5f4341502c204273446174612c2057524954455f4241434b0a307841373430303030302c20307830303230303030302c202255454649204644205265736572766564222c20204164644d656d2c205359535f4d454d2c205359535f4d454d5f4341502c204273446174612c2057524954455f4241434b0a307841373630303030302c20307830303030313030302c202243505520566563746f7273222c202020202020204164644d656d2c205359535f4d454d2c205359535f4d454d5f4341502c204273446174612c2057524954455f4241434b0a307841373630313030302c20307830303030313030302c2022496e666f20426c6b222c202020202020202020204164644d656d2c205359535f4d454d2c205359535f4d454d5f4341502c205274446174612c2057524954455f4241434b5f584e0a307841373630323030302c20307830303030333030302c20224d4d5520506167655461626c6573222c202020204164644d656d2c205359535f4d454d2c205359535f4d454d5f4341502c204273446174612c2057524954455f4241434b5f584e20200a307841373630353030302c20307830303030383030302c20224c6f6720427566666572222c20202020202020204164644d656d2c205359535f4d454d2c205359535f4d454d5f4341502c205274446174612c2057524954455f4241434b5f584e2020202020200a307841373630443030302c20307830303034303030302c20225545464920537461636b222c20202020202020204164644d656d2c205359535f4d454d2c205359535f4d454d5f4341502c204273446174612c2057524954455f4241434b5f584e0a307841373634443030302c20307830303038433030302c20225345432048656170222c202020202020202020204164644d656d2c205359535f4d454d2c205359535f4d454d5f4341502c204273446174612c2057524954455f4241434b5f584e0a307841373644393030302c20307830303430303030302c202253636865642048656170222c20202020202020204164644d656d2c205359535f4d454d2c205359535f4d454d5f4341502c204273446174612c2057524954455f4241434b5f584e0a307841374144393030302c20307830303430303030302c2022465620526567696f6e222c2020202020202020204164644d656d2c205359535f4d454d2c205359535f4d454d5f4341502c204273446174612c2057524954455f4241434b5f584e0a307841374544393030302c20307830303132373030302c2022554546492052455356222c2020202020202020204164644d656d2c205359535f4d454d2c205359535f4d454d5f4341502c204273446174612c2057524954455f4241434b5f584e0a307841383030303030302c20307831303030303030302c20224b65726e656c222c2020202020202020202020204164644d656d2c205359535f4d454d2c205359535f4d454d5f4341502c205265736572762c2057524954455f4241434b5f584e0a307842383030303030302c20307830324230303030302c2022446973706c6179205265736572766564222c20204164644d656d2c204d454d5f5245532c205359535f4d454d5f4341502c205265736572762c2057524954455f5448524f5547485f584e0a307842414230303030302c20307830443143303030302c20224458452048656170222c202020202020202020204164644d656d2c205359535f4d454d2c205359535f4d454d5f4341502c20436f6e762c20202057524954455f4241434b5f584e0a307844383830303030302c20307830384130303030302c2022545a41707073205265736572766564222c20202041646444796e616d69634d656d2c204d454d5f5245532c20554e434143484541424c452c205265736572762c20554e4341434845445f554e42554646455245445f584e0a307845454230303030302c20307830344230303030302c20225253525633222c202020202020202020202020204164644d656d2c204d454d5f5245532c205359535f4d454d5f4341502c205265736572762c2057524954455f4241434b5f584e0a307846463830303030302c20307830303830303030302c20224e4f4d4150222c202020202020202020202020204e6f4d61702c20204d454d5f5245532c20554e434143484541424c452c205265736572762c20554e4341434845445f554e42554646455245445f584e0a0a5b52656769737465724d61705d0a232d2d2d2d2d2d2d2d2d2d2d2d2d2d2d2d2d2d2d2d2d204f74686572202d2d2d2d2d0a307831343638303030302c20307830303032413030302c2022494d454d2042617365222c202020202020202020204e6f486f622c20204d4d41505f494f2c20494e495449414c495a45442c20436f6e762c2020204e535f4445564943450a307831343641413030302c20307830303031363030302c2022494d454d20436f6f6b69652042617365222c2020204164644465762c204d4d41505f494f2c20494e495449414c495a45442c20436f6e762c2020204e535f4445564943450a232d2d2d2d2d2d2d2d2d2d2d2d2d2d2d2d2d2d2d2d2d205265676973746572202d2d0a307830303430303030302c20307830303130303030302c20224950435f524f555445525f544f50222c20202020204164644465762c204d4d41505f494f2c20554e434143484541424c452c204d6d494f2c2020204e535f4445564943450a307830303738303030302c20307830303030373030302c2022534543555249545920434f4e54524f4c222c2020204164644465762c204d4d41505f494f2c20554e434143484541424c452c204d6d494f2c2020204e535f4445564943450a307830303830303030302c20307830303330303030302c2022515550222c202020202020202020202020202020204164644465762c204d4d41505f494f2c20554e434143484541424c452c204d6d494f2c2020204e535f4445564943450a307830313043303030302c20307830303030433030302c202250524e475f4346475f50524e47222c2020202020204164644465762c204d4d41505f494f2c20554e434143484541424c452c204d6d494f2c2020204e535f4445564943450a307830314443303030302c20307830303034303030302c202243525950544f302043525950544f222c20202020204164644465762c204d4d41505f494f2c20554e434143484541424c452c204d6d494f2c2020204e535f4445564943450a307830314630303030302c20307830303130303030302c2022434f52455f544f505f435352222c202020202020204164644465762c204d4d41505f494f2c20554e434143484541424c452c204d6d494f2c2020204e535f4445564943450a307830383830303030302c20307830303130303030302c20225045524950485f5353222c202020202020202020204164644465762c204d4d41505f494f2c20554e434143484541424c452c204d6d494f2c2020204e535f4445564943450a307830413630303030302c20307830303230303030302c2022555342222c202020202020202020202020202020204164644465762c204d4d41505f494f2c20554e434143484541424c452c204d6d494f2c2020204e535f4445564943450a307830423030303030302c20307830343030303030302c2022414f5353222c2020202020202020202020202020204164644465762c204d4d41505f494f2c20554e434143484541424c452c204d6d494f2c2020204e535f4445564943450a307830463030303030302c20307830313030303030302c2022544c4d4d222c2020202020202020202020202020204164644465762c204d4d41505f494f2c20554e434143484541424c452c204d6d494f2c2020204e535f4445564943450a307831353030303030302c20307830303230303030302c2022534d4d55222c2020202020202020202020202020204164644465762c204d4d41505f494f2c20554e434143484541424c452c204d6d494f2c2020204e535f4445564943450a307831373030303030302c20307830323030303030302c2022415053535f484d222c2020202020202020202020204164644465762c204d4d41505f494f2c20554e434143484541424c452c204d6d494f2c2020204e535f4445564943450a0a5b436f6e666967506172616d65746572735d0a232055706461746520636f756e74206966206d6f7265207468616e2064656661756c7420333020656e74726965730a436f6e666967506172616d65746572436f756e74203d2036340a0a2323205545464920434f52450a506c6174436f6e66696746696c654e616d65203d202275656669706c61744c412e636667220a4f7354797065537472696e67203d20224c41220a0a2320466f72636520626f6f74696e6720746f207368656c6c207768696c737420696e207072652d73696c69636f6e2070686173650a456e61626c655368656c6c203d203078310a0a232054756e65206261736564206f6e205365632068656170206e6565647320666f72204656206465636f6d7072657373696f6e20616e64204d4d55207461626c6573207468726f756768204478652f4244530a53656350616765506f6f6c436f756e74203d2030783830300a0a232053686172656420494d454d2028436f6f6b6965732c204f666673657473290a536861726564494d454d4261736541646472202020203d20307831343641413030300a446c6f6164436f6f6b696541646472203d20307830314644393030300a2320666f722066756c6c2064756d7020307831302c20666f72206d696e6964756d7020307832300a446c6f6164436f6f6b696556616c7565203d20307831300a0a2320646562756720636f6f6b6965206f662050494c2073756273797374656d2c20646566696e656420696e20464243207363726970740a50696c537562737973446267436f6f6b696541646472203d20307831343641413644430a50696c537562737973446267436f6f6b696556616c203d20307835333434343234370a0a23204e756d43707573202d206d6178206e756d626572206f6620636f7265730a4e756d43707573203d20380a23204e756d416374697665436f726573202d206e756d626572206f6620636f72657320757365640a4e756d416374697665436f726573203d20380a0a232320554c6f6746696c650a5370656369616c4c6f67506172746974696f6e203d20224c4f4746533a5c220a4d61784c6f6746696c6553697a65203d2030783430303030300a0a232055454649206d656d6f7279207573650a556566694d656d5573655468726573686f6c64203d20307845310a0a2323205553422023230a5553424853315f436f6e666967203d203078300a557362466e496f5265764e756d203d20307830303031303030310a0a232320427574746f6e73202f204b65795061642023230a50777242746e53687574646f776e466c6167203d203078300a0a232320534443432023230a536463314770696f436f6e6669674f6e203d203078314539320a536463324770696f436f6e6669674f6e203d203078314539320a536463314770696f436f6e6669674f6666203d2030784130300a536463324770696f436f6e6669674f6666203d2030784130300a0a23232053444843204d6f646520303a4c6567616379204d6f64652c204e6f6e2d7a65726f3a2053444843204d6f64652023230a456e61626c6553444843537769746368203d203078310a0a2323205546530a456e61626c65556673494f43203d20310a556673536d6d75436f6e666967466f724f74686572426f6f74446576203d20310a0a232320504349450a2323205043496552504e756d6265722042495420373a3020202d3e206e756d626572206f662052507320746f20626520656e61626c65640a2323205043496552504e756d626572204249542031353a38202d3e20424954206d61736b20746f206964656e74696679207768696368205250732061726520656e61626c65640a23232045672e2076616c75653a2030783035303220202020202d3e20546f74616c2074776f206e756d62657273206f66205250732c2052503020616e64205250322061726520656e61626c65640a232320546f74616c2052507320737570706f727465642038206e756d6265727320616e64206269747320616c6c6f63617465642061726520313620626974730a235043496552504e756d6265723d3078303130310a0a232320536563757269747920666c61672023230a5365637572697479466c6167203d20307843340a2320536563426f6f74456e61626c65466c6167203d20307831202020202020202020202020202020692e652e20306230303030303030310a23205472656554706d456e61626c65466c6167203d20307832202020202020202020202020202020692e652e20306230303030303031300a2320436f6d6d6f6e4d626e4c6f6164466c6167203d20307834202020202020202020202020202020692e652e20306230303030303130300a2320447848646370324c6f6164466c6167203d203078382020202020202020202020202020202020692e652e20306230303030313030300a23205661726961626c655365727669636573466c6167203d20307831302020202020202020202020692e652e20306230303031303030300a232057696e736563617070466c6167203d2030783230202020202020202020202020202020202020692e652e20306230303130303030300a23204c6f6164536563417070466c6167203d20307834302020202020202020202020202020202020692e652e20306230313030303030300a23204c6f61644b65796d6173746572466c6167203d20307838302020202020202020202020202020692e652e20306231303030303030300a2320456e61626c65517365654c6f6773466c6167203d203078313030202020202020202020202020692e652e2030622030303030303030312030303030303030300a0a23232044656661756c742061707020746f20626f6f7420696e20706c6174666f726d2042445320696e69740a44656661756c7443686172676572417070203d202251636f6d43686172676572417070220a44656661756c74424453426f6f74417070203d20224c696e75784c6f61646572220a0a232320456e61626c6520486f744b657920646574656374696f6e20696e2052455441494c20646576696365730a44657465637452657461696c55736572417474656e74696f6e486f746b6579203d20307830300a23232030783137206973205343414e5f4553430a44657465637452657461696c55736572417474656e74696f6e486f746b6579436f6465203d20307831370a232320456e61626c65204f454d20536574757020417070206c61756e636820696e2052657461696c2023230a456e61626c654f454d5365747570417070496e52657461696c203d203078300a0a0a2323204c6f67467320706172746974696f6e0a2323204e4f54453a20456e73757265206c6f6766732062696e20697320666c61736865642066726f6d202f546f6f6c732f62696e61726965732023230a456e61626c654c6f67467353796e63496e52657461696c203d203078300a0a23232053686d427269646765204d656d6f72792053697a650a53686d4272696467656d656d53697a65203d2030784130303030300a0a232320204d756c7469746872656164696e67206f7074696f6e730a456e61626c654d756c7469546872656164696e67203d20310a4d6178436f7265436e74203d20380a23204b6565702074686520666f6c6c6f77696e67206e756d626572206f6620636f726573206163746976652c20696e636c7564696e672074686520626f6f7420636f72650a2320466f72204561726c792070726573696c69636f6e2073746167652c207468697320636e612062652073657420746f20312073696e63652077652077616e7420746f20656e61626c65200a23203120636f726520696520626f6f7420636f72650a4561726c79496e6974436f7265436e74203d20310a0a23232047657420545a20417070204c6f67732023230a456e61626c655565666953656341707044656275674c6f6744756d70203d203078300a0a232320416c6c6f77204e6f6e2050657273697374656e742056617269616c62657320696e2052657461696c2023230a2323204e4f54453a205265636f6d6d656e642064697361626c696e67206665617475726520666f722052657461696c20646576696365730a416c6c6f774e6f6e50657273697374656e7456617273496e52657461696c203d203078310a0a2320496e697469616c697a6520446973706c61792070616e656c20696e20697473206f776e2074687265616420746f2072756e20696e20706172616c6c656c20746f20626f6f74696e670a456e61626c65446973706c6179546872656164203d203078310a0a23205573696e6720696d616765667620746f206c6f616420646973706c6179206c6f676f0a456e61626c65446973706c6179496d6167654676203d203078300a0a23232044796e616d69632055415254204c6f67204275666665722053697a650a232320526566657220746f2051636f6d506b672f446f63732f556566694c6f6742756666657253697a65436f6e666967526561646d652e74787420666f722075736167650a23554152544c6f6742756666657253697a65203d20307831393030300a0a23444452496e666f44786520456e76447865206576656e742063616c6c6261636b20666c61670a444452496e666f4e6f74696679466c6167203d203078300a0a2320204656204465636f6d7072657373696f6e206f6e206d756c7469636f7265206f7074696f6e0a23202056616c7565206973203020666f72206561726c792070726573696c69636f6e2073746167650a456e61626c654d756c7469436f726546764465636f6d7072657373696f6e203d20300a0a232320456e61626c652f44697361626c65205661726961626c6520506f6c69637920456e67696e652023230a456e61626c655661726961626c65506f6c696379456e67696e65203d20300a0a232320416c6c6f7720696e646976696475616c2041435049207461626c6573206c6f6164696e67202323200a456e61626c654143504946616c6c6261636b203d203078300a0a2323204164647265737320746f206765742056616c7565206f66204452414d20636c6f636b20706572696f64204d4343435f434c4b5f504552494f440a4452414d5f434c4b5f504552494f445f41444452203d20307832343042413035300a2323204e4f54453a20446f206e6f742072656d6f7665206c617374206e65776c696e652c207265717569726564206279207061727365722023230a0a];                    
         };
         uefipil {
                size = <6766>;
                payload = [5b50494c5d0a43666756657273696f6e203d20310a0a2323232323232323232323232323232323232323232323232323232323232323232323232323232323232323232323232323232323232323232323232323232323232323232323230a2323200a232320202050494c20636f6e66696775726174696f6e2c20636f6e7461696e73207468652062617365206164647265737320616e642073697a65206f6620696d616765206c6f61640a2323202020696e666f726d6174696f6e20726567696f6e20696e20494d454d0a23230a2323232323232323232323232323232323232323232323232323232323232323232323232323232323232323232323232323232323232323232323232323232323232323232323235c0a0a5b494d4147455f4c4f41445f494e464f5f524547494f4e5d0a496d6167654c6f6164496e666f42617365203d20307831343641413934430a496d6167654c6f6164496e666f53697a65203d203230300a0a2323232323232323232323232323232323232323232323232323232323232323232323232323232323232323232323232323232323232323232323232323232323232323232323230a2323200a232320202050494c20636f6e66696775726174696f6e2c20636f6e7461696e7320746865206c697374206f6620696d6167657320776869636820697320616c6c6f776564200a2323202020746f206265206c6f616465642062792050494c20696e2072657461696c2e2050494c20646f6573206e6f7420737570706f727420696d61676573206265796f6e640a2323202020746865206c6973740a23230a2323232323232323232323232323232323232323232323232323232323232323232323232323232323232323232323232323232323232323232323232323232323232323232323235c0a0a5b52455441494c5d0a41424c0a535053530a496d61676546760a46554c4c5f414453500a46554c4c5f414453505f4454420a0a2323232323232323232323232323232323232323232323232323232323232323232323232323232323232323232323232323232323232323232323232323232323232323232323230a2323200a232320202050494c20636f6e66696775726174696f6e2c20636f6e7461696e7320746865206c697374206f6620696d616765732077686963682077696c6c206265200a23232020206c6f616465642062792050494c2062792064656661756c740a23230a2323232323232323232323232323232323232323232323232323232323232323232323232323232323232323232323232323232323232323232323232323232323232323232323235c0a0a5b4155544f5d0a41424c0a0a2323232323232323232323232323232323232323232323232323232323232323232323232323232323232323232323232323232323232323232323232323232323232323232323230a2323200a232320202050494c20696d61676520636f6e66696775726174696f6e2c207570646174656420746f204b61696c7561205634206d656d6f7279206d61700a23230a2323232323232323232323232323232323232323232323232323232323232323232323232323232323232323232323232323232323232323232323232323232323232323232323235c0a2346657720706172616d657465722076616c7565732061726520636f6d6d656e74656420666f7220445442277320616e64207368616c6c2062652075706461746564206c617465720a5b46554c4c5f414453505f4454425d0a54797065203d20656c665f73706c69740a506172746947756964203d2022454244304130413220423945352034343333203837433020363842364237323639394337220a496d61676550617468203d205c696d6167655c616473705f6474620a5375627379734944203d2033360a526573764d656d6f72795374617274203d20307839453938303030300a526573764d656d6f727953697a65203d20307838303030300a496d6167654c6f6164496e666f203d204e6f0a4f76657272696465456c6641646472203d204e6f0a0a5b46554c4c5f414453505d0a507265496d616765203d202246554c4c5f414453505f445442220a54797065203d20656c665f73706c69740a2350617274694c6162656c203d206d6f64656d5f610a235061727469526f6f7447756964203d200a506172746947756964203d2022454244304130413220423945352034343333203837433020363842364237323639394337220a496d61676550617468203d205c696d6167655c616473700a5375627379734944203d20310a526573764d656d6f72795374617274203d20307839454130303030300a526573764d656d6f727953697a65203d203078343038303030300a496d6167654c6f6164496e666f203d205965730a4f76657272696465456c6641646472203d205965730a50726f787947756964203d2022333646453237453120333345392034354144203938444120433838343338434138383136220a0a235b46554c4c5f534c50495d0a2354797065203d20656c665f73706c69740a232350617274694c6162656c203d206d6f64656d5f610a23235061727469526f6f7447756964203d200a23506172746947756964203d2022454244304130413220423945352034343333203837433020363842364237323639394337220a23496d61676550617468203d205c696d6167655c736c70690a235375627379734944203d2031320a23526573764d656d6f72795374617274203d20307839454130303030300a23526573764d656d6f727953697a65203d203078343038303030300a23496d6167654c6f6164496e666f203d205965730a234f76657272696465456c6641646472203d205965730a2350726f787947756964203d2022423244434643333420423241302034424237204244423020333144423031453343433241220a0a5b46554c4c5f434453505f4454425d0a54797065203d20656c665f73706c69740a506172746947756964203d2022454244304130413220423945352034343333203837433020363842364237323639394337220a23496d61676550617468203d205c696d6167655c6465766963655f747265650a496d61676550617468203d205c696d6167655c636473705f6474620a5375627379734944203d2033370a526573764d656d6f72795374617274203d20307839453930303030300a526573764d656d6f727953697a65203d20307838303030300a496d6167654c6f6164496e666f203d204e6f0a4f76657272696465456c6641646472203d204e6f0a0a0a5b46554c4c5f434453505d0a507265496d616765203d202246554c4c5f434453505f445442220a54797065203d20656c665f73706c69740a2350617274694c6162656c203d206d6f64656d5f610a235061727469526f6f7447756964203d200a506172746947756964203d2022454244304130413220423945352034343333203837433020363842364237323639394337220a496d61676550617468203d205c696d6167655c636473700a5375627379734944203d2031380a526573764d656d6f72795374617274203d20307839433930303030300a526573764d656d6f727953697a65203d203078323030303030300a496d6167654c6f6164496e666f203d205965730a4f76657272696465456c6641646472203d205965730a50726f787947756964203d2022343545313443303420443133342034454534204143313320373039384630413946323631220a0a235b46554c4c5f4e50555d0a2354797065203d20656c665f73706c69740a232350617274694c6162656c203d206d6f64656d5f610a23235061727469526f6f7447756964203d200a23506172746947756964203d2022454244304130413220423945352034343333203837433020363842364237323639394337220a23496d61676550617468203d205c696d6167655c6e70750a235375627379734944203d2032330a23526573764d656d6f72795374617274203d20307838363930303030300a23526573764d656d6f727953697a65203d2030783530303030300a23496d6167654c6f6164496e666f203d205965730a234f76657272696465456c6641646472203d205965730a2350726f787947756964203d2022343536353431343020373738452034333834203845454320373033464441434533313732220a0a5b46554c4c5f4d4f44454d5f4454425d0a54797065203d20656c665f73706c69740a506172746947756964203d2022454244304130413220423945352034343333203837433020363842364237323639394337220a23496d61676550617468203d205c696d6167655c716473703673775f6474620a496d61676550617468203d205c696d6167655c6d6f64656d5f6474620a5375627379734944203d2033380a526573764d656d6f72795374617274203d20307839423030303030300a526573764d656d6f727953697a65203d20307838303030300a496d6167654c6f6164496e666f203d204e6f0a4f76657272696465456c6641646472203d204e6f0a0a0a5b46554c4c5f4d4f44454d5d0a507265496d616765203d202246554c4c5f4d4f44454d5f445442220a54797065203d20656c665f73706c69740a2350617274694c6162656c203d206d6f64656d5f610a235061727469526f6f7447756964203d200a506172746947756964203d2022454244304130413220423945352034343333203837433020363842364237323639394337220a496d61676550617468203d205c696d6167655c6d6f64656d0a5375627379734944203d20340a526573764d656d6f72795374617274203d20307838393830303030300a526573764d656d6f727953697a65203d203078313138303030303020200a496d6167654c6f6164496e666f203d205965730a4f76657272696465456c6641646472203d205965730a50726f787947756964203d2022363135313336393520453043362034463037204246343120413531413737373036343045220a0a5b434f52455f414453505f4454425d0a54797065203d20656c665f73706c69740a50617274694c6162656c203d20636f72655f6e686c6f735f610a23506172746947756964203d2022454244304130413220423945352034343333203837433020363842364237323639394337220a23496d61676550617468203d205c696d6167655c616473705f647462730a496d61676550617468203d205c696d6167655c616473705f6474620a5375627379734944203d2033360a526573764d656d6f72795374617274203d20307839453938303030300a526573764d656d6f727953697a65203d20307838303030300a496d6167654c6f6164496e666f203d204e6f0a4f76657272696465456c6641646472203d204e6f0a0a5b434f52455f414453505d0a507265496d616765203d2022434f52455f414453505f445442220a54797065203d20656c665f73706c69740a50617274694c6162656c203d20636f72655f6e686c6f735f610a235061727469526f6f7447756964203d200a23506172746947756964203d2022454244304130413220423945352034343333203837433020363842364237323639394337220a496d61676550617468203d205c696d6167655c616473700a5375627379734944203d20310a526573764d656d6f72795374617274203d20307839454130303030300a526573764d656d6f727953697a65203d203078343038303030300a496d6167654c6f6164496e666f203d205965730a4f76657272696465456c6641646472203d205965730a50726f787947756964203d2022333646453237453120333345392034354144203938444120433838343338434138383136220a0a235b434f52455f534c50495d0a2354797065203d20656c665f73706c69740a2350617274694c6162656c203d20636f72655f6e686c6f735f610a23235061727469526f6f7447756964203d200a2323506172746947756964203d2022454244304130413220423945352034343333203837433020363842364237323639394337220a23496d61676550617468203d205c696d6167655c736c70690a235375627379734944203d2031320a23526573764d656d6f72795374617274203d20307839454130303030300a23526573764d656d6f727953697a65203d20307834303830303030090a23496d6167654c6f6164496e666f203d205965730a234f76657272696465456c6641646472203d205965730a2350726f787947756964203d2022423244434643333420423241302034424237204244423020333144423031453343433241220a0a5b434f52455f434453505f4454425d0a54797065203d20656c665f73706c69740a50617274694c6162656c203d20636f72655f6e686c6f735f610a23506172746947756964203d2022454244304130413220423945352034343333203837433020363842364237323639394337220a23496d61676550617468203d205c696d6167655c6465766963655f747265650a496d61676550617468203d205c696d6167655c636473705f6474620a5375627379734944203d2033370a526573764d656d6f72795374617274203d20307839453930303030300a526573764d656d6f727953697a65203d20307838303030300a496d6167654c6f6164496e666f203d204e6f0a4f76657272696465456c6641646472203d204e6f0a0a5b434f52455f434453505d0a507265496d616765203d2022434f52455f434453505f445442220a54797065203d20656c665f73706c69740a50617274694c6162656c203d20636f72655f6e686c6f735f610a235061727469526f6f7447756964203d200a23506172746947756964203d2022454244304130413220423945352034343333203837433020363842364237323639394337220a496d61676550617468203d205c696d6167655c636473700a5375627379734944203d2031380a526573764d656d6f72795374617274203d20307839433930303030300a526573764d656d6f727953697a65203d203078323030303030300a496d6167654c6f6164496e666f203d205965730a4f76657272696465456c6641646472203d205965730a50726f787947756964203d2022343545313443303420443133342034454534204143313320373039384630413946323631220a0a235b434f52455f4e50555d0a2354797065203d20656c665f73706c69740a2350617274694c6162656c203d20636f72655f6e686c6f735f610a23235061727469526f6f7447756964203d200a2323506172746947756964203d2022454244304130413220423945352034343333203837433020363842364237323639394337220a23496d61676550617468203d205c696d6167655c6e70750a235375627379734944203d2032330a23526573764d656d6f72795374617274203d20307838363930303030300a23526573764d656d6f727953697a65203d2030783530303030300a23496d6167654c6f6164496e666f203d205965730a234f76657272696465456c6641646472203d205965730a2350726f787947756964203d2022343536353431343020373738452034333834203845454320373033464441434533313732220a0a5b434f52455f4d4f44454d5f4454425d0a54797065203d20656c665f73706c69740a50617274694c6162656c203d20636f72655f6e686c6f735f610a23496d61676550617468203d205c696d6167655c716473703673775f6474620a496d61676550617468203d205c696d6167655c6d6f64656d5f6474620a5375627379734944203d2033380a526573764d656d6f72795374617274203d20307839423030303030300a526573764d656d6f727953697a65203d2030783830303030200a496d6167654c6f6164496e666f203d204e6f0a4f76657272696465456c6641646472203d204e6f0a0a5b434f52455f4d4f44454d5d0a507265496d616765203d2022434f52455f4d4f44454d5f445442220a54797065203d20656c665f73706c69740a50617274694c6162656c203d20636f72655f6e686c6f735f610a235061727469526f6f7447756964203d200a23506172746947756964203d2022454244304130413220423945352034343333203837433020363842364237323639394337220a23496d61676550617468203d205c696d6167655c716473703673770a496d61676550617468203d205c696d6167655c6d6f64656d0a5375627379734944203d20340a526573764d656d6f72795374617274203d20307838393830303030300a526573764d656d6f727953697a65203d2030783131383030303030200a496d6167654c6f6164496e666f203d205965730a4f76657272696465456c6641646472203d205965730a50726f787947756964203d2022363135313336393520653063362034663037206266343120613531613737373036343065220a0a5b535053535d0a54797065203d20656c665f73706c69740a2350617274694c6162656c203d206d6f64656d5f610a235061727469526f6f7447756964203d200a506172746947756964203d2022454244304130413220423945352034343333203837433020363842364237323639394337220a496d61676550617468203d205c696d6167655c7370737331740a5375627379734944203d2031340a526573764d656d6f72795374617274203d20307839423130303030300a526573764d656d6f727953697a65203d2030783138303030300a496d6167654c6f6164496e666f203d205965730a4f76657272696465456c6641646472203d205965730a50726f787947756964203d2022324234444537453920423739362034464537204232313020343946313143364241424332220a0a5b41424c5d0a54797065203d20656c665f66760a2350617274694c6162656c203d2061626c5f610a235061727469526f6f7447756964203d200a506172746947756964203d2022424436393238413120344345302041303338203446334120313439354533454444464642220a5375627379734944203d2032310a496d6167654c6f6164496e666f203d204e6f0a556e6c6f636b203d205965730a0a5b496d61676546765d0a54797065203d20656c665f66760a2350617274694c6162656c203d20696d61676566765f610a235061727469526f6f7447756964203d200a506172746947756964203d2022313739313131373720433945362034333732203933334320383034423637384536363646220a5375627379734944203d2032300a496d6167654c6f6164496e666f203d204e6f0a556e6c6f636b203d205965730a0a];                    
         };
         
    };
};