
y.create.l HWIO_SPMI_GENI_CLK_CTRL_ADDR A:0xc40a000
y.create.l HWIO_SPMI_GENI_HW_VERSION_ADDR A:0xc40a004
y.create.l HWIO_SPMI_GENI_FW_REVISION_ADDR A:0xc40a008
y.create.l HWIO_SPMI_GENI_S_FW_REVISION_ADDR A:0xc40a00c
y.create.l HWIO_SPMI_GENI_FORCE_DEFAULT_REG_ADDR A:0xc40a010
y.create.l HWIO_SPMI_GENI_OUTPUT_CTRL_ADDR A:0xc40a014
y.create.l HWIO_SPMI_GENI_CGC_CTRL_ADDR A:0xc40a018
y.create.l HWIO_SPMI_GENI_CHAR_CFG_ADDR A:0xc40a01c
y.create.l HWIO_SPMI_GENI_CHAR_DATA_0_ADDR A:0xc40a020
y.create.l HWIO_SPMI_GENI_CHAR_DATA_1_ADDR A:0xc40a024
y.create.l HWIO_SPMI_GENI_CTRL_ADDR A:0xc40a028
y.create.l HWIO_SPMI_GENI_STATUS_ADDR A:0xc40a02c
y.create.l HWIO_SPMI_GENI_TEST_BUS_CTRL_ADDR A:0xc40a030
y.create.l HWIO_SPMI_GENI_SER_CLK_CFG_ADDR A:0xc40a034
y.create.l HWIO_SPMI_GENI_TX_WATERMARK_REG_ADDR A:0xc40a038
y.create.l HWIO_SPMI_GENI_RX_WATERMARK_REG_ADDR A:0xc40a03c
y.create.l HWIO_SPMI_GENI_STOP_REG_ADDR A:0xc40a040
y.create.l HWIO_SPMI_GENI_SW_COMP_REG_ADDR A:0xc40a044
y.create.l HWIO_SPMI_GENI_PROG_ROM_CTRL_REG_ADDR A:0xc40a048
y.create.l HWIO_SPMI_GENI_CFG_REG0_ADDR A:0xc40a100
y.create.l HWIO_SPMI_GENI_CFG_REG1_ADDR A:0xc40a104
y.create.l HWIO_SPMI_GENI_CFG_REG2_ADDR A:0xc40a108
y.create.l HWIO_SPMI_GENI_CFG_REG3_ADDR A:0xc40a10c
y.create.l HWIO_SPMI_GENI_CFG_REG4_ADDR A:0xc40a110
y.create.l HWIO_SPMI_GENI_CFG_REG5_ADDR A:0xc40a114
y.create.l HWIO_SPMI_GENI_CFG_REG6_ADDR A:0xc40a118
y.create.l HWIO_SPMI_GENI_CFG_REG7_ADDR A:0xc40a11c
y.create.l HWIO_SPMI_GENI_CFG_REG8_ADDR A:0xc40a120
y.create.l HWIO_SPMI_GENI_CFG_REG9_ADDR A:0xc40a124
y.create.l HWIO_SPMI_GENI_CFG_REG10_ADDR A:0xc40a128
y.create.l HWIO_SPMI_GENI_CFG_REG11_ADDR A:0xc40a12c
y.create.l HWIO_SPMI_GENI_CFG_REG12_ADDR A:0xc40a130
y.create.l HWIO_SPMI_GENI_CFG_REG13_ADDR A:0xc40a134
y.create.l HWIO_SPMI_GENI_CFG_REG14_ADDR A:0xc40a138
y.create.l HWIO_SPMI_GENI_CFG_REG15_ADDR A:0xc40a13c
y.create.l HWIO_SPMI_GENI_CFG_REG16_ADDR A:0xc40a140
y.create.l HWIO_SPMI_GENI_CFG_REG17_ADDR A:0xc40a144
y.create.l HWIO_SPMI_GENI_CFG_REG18_ADDR A:0xc40a148
y.create.l HWIO_SPMI_GENI_CFG_REG19_ADDR A:0xc40a14c
y.create.l HWIO_SPMI_GENI_CFG_REG20_ADDR A:0xc40a150
y.create.l HWIO_SPMI_GENI_CFG_REG21_ADDR A:0xc40a154
y.create.l HWIO_SPMI_GENI_CFG_REG22_ADDR A:0xc40a158
y.create.l HWIO_SPMI_GENI_CFG_REG23_ADDR A:0xc40a15c
y.create.l HWIO_SPMI_GENI_CFG_REG24_ADDR A:0xc40a160
y.create.l HWIO_SPMI_GENI_CFG_REG25_ADDR A:0xc40a164
y.create.l HWIO_SPMI_GENI_CFG_REG26_ADDR A:0xc40a168
y.create.l HWIO_SPMI_GENI_CFG_REG27_ADDR A:0xc40a16c
y.create.l HWIO_SPMI_GENI_CFG_REG28_ADDR A:0xc40a170
y.create.l HWIO_SPMI_GENI_CFG_REG29_ADDR A:0xc40a174
y.create.l HWIO_SPMI_GENI_CFG_REG30_ADDR A:0xc40a178
y.create.l HWIO_SPMI_GENI_CFG_RAM0_ADDR A:0xc40a200
y.create.l HWIO_SPMI_GENI_CFG_RAM1_ADDR A:0xc40a204
y.create.l HWIO_SPMI_GENI_CFG_RAM2_ADDR A:0xc40a208
y.create.l HWIO_SPMI_GENI_CFG_RAM3_ADDR A:0xc40a20c
y.create.l HWIO_SPMI_GENI_CFG_RAM4_ADDR A:0xc40a210
y.create.l HWIO_SPMI_GENI_CFG_RAM5_ADDR A:0xc40a214
y.create.l HWIO_SPMI_GENI_CFG_RAM6_ADDR A:0xc40a218
y.create.l HWIO_SPMI_GENI_CFG_RAM7_ADDR A:0xc40a21c
y.create.l HWIO_SPMI_GENI_CFG_RAM8_ADDR A:0xc40a220
y.create.l HWIO_SPMI_GENI_CFG_RAM9_ADDR A:0xc40a224
y.create.l HWIO_SPMI_PERIPH0_2OWNER_TABLE_REG_ADDR A:0xc40a700
y.create.l HWIO_SPMI_PERIPH1_2OWNER_TABLE_REG_ADDR A:0xc40a704
y.create.l HWIO_SPMI_PERIPH2_2OWNER_TABLE_REG_ADDR A:0xc40a708
y.create.l HWIO_SPMI_PERIPH3_2OWNER_TABLE_REG_ADDR A:0xc40a70c
y.create.l HWIO_SPMI_PERIPH4_2OWNER_TABLE_REG_ADDR A:0xc40a710
y.create.l HWIO_SPMI_PERIPH5_2OWNER_TABLE_REG_ADDR A:0xc40a714
y.create.l HWIO_SPMI_PERIPH6_2OWNER_TABLE_REG_ADDR A:0xc40a718
y.create.l HWIO_SPMI_PERIPH7_2OWNER_TABLE_REG_ADDR A:0xc40a71c
y.create.l HWIO_SPMI_PERIPH8_2OWNER_TABLE_REG_ADDR A:0xc40a720
y.create.l HWIO_SPMI_PERIPH9_2OWNER_TABLE_REG_ADDR A:0xc40a724
y.create.l HWIO_SPMI_MID_REG_ADDR A:0xc40af00
y.create.l HWIO_SPMI_CFG_REG_ADDR A:0xc40af04
y.create.l HWIO_SPMI_SEC_DISABLE_REG_ADDR A:0xc40af08
y.create.l HWIO_SPMI_HW_VERSION_ADDR A:0xc40af0c
y.create.l HWIO_SPMI_CGC_CTRL_ADDR A:0xc40af10
y.create.l HWIO_SPMI_MWB_ENABLE_REG_ADDR A:0xc40af14
y.create.l HWIO_SPMI_CHAR_CFG_ADDR A:0xc40af40
y.create.l HWIO_SPMI_CHAR_DATA_0_ADDR A:0xc40af44
y.create.l HWIO_SPMI_CHAR_DATA_1_ADDR A:0xc40af48
y.create.l HWIO_SPMI_CMPR_EN_REG_ADDR A:0xc40af54
y.create.l HWIO_SPMI_PIC_RCS_VIOCTL_ADDR A:0xc40af58
y.create.l HWIO_SPMI_PIC_RCS_VIOCTL_N_ADDR A:0xc40af5c
y.create.l HWIO_SPMI_PROTOCOL_IRQ_STATUS_ADDR A:0xc410000
y.create.l HWIO_SPMI_PROTOCOL_IRQ_ENABLE_ADDR A:0xc410004
y.create.l HWIO_SPMI_PROTOCOL_IRQ_CLEAR_ADDR A:0xc410008
y.create.l HWIO_SPMI_PROTOCOL_IRQ_EN_SET_ADDR A:0xc41000c
y.create.l HWIO_SPMI_PROTOCOL_IRQ_EN_CLEAR_ADDR A:0xc410010
y.create.l HWIO_SPMI_TEST_BUS_CTRL_ADDR A:0xc420000
y.create.l HWIO_SPMI_HW_SW_EVENTS_CTRL_ADDR A:0xc420004
y.create.l HWIO_SPMI_HW_SW_EVENTS_BITWISE_REG0_ADDR A:0xc420008
y.create.l HWIO_SPMI_HW_SW_EVENTS_BITWISE_REG1_ADDR A:0xc42000c
y.create.l HWIO_SPMI_HW_SW_EVENTS_BITWISE_REG2_ADDR A:0xc420010
y.create.l HWIO_SPMI_HW_SW_EVENTS_BITWISE_REG3_ADDR A:0xc420014
y.create.l HWIO_SPMI_HW_SW_EVENTS_BITWISE_REG4_ADDR A:0xc420018
y.create.l HWIO_SPMI_HW_SW_EVENTS_BITWISE_REG5_ADDR A:0xc42001c
y.create.l HWIO_SPMI_HW_SW_EVENTS_BITWISE_REG6_ADDR A:0xc420020
y.create.l HWIO_SPMI_HW_SW_EVENTS_BITWISE_REG7_ADDR A:0xc420024
y.create.l HWIO_SPMI_DEBUG_REG_ADDR A:0xc420028
y.create.l HWIO_SPMI_PIC_OWNER0_ACC_STATUS0_ADDR A:0xe700000
y.create.l HWIO_SPMI_PIC_OWNER0_ACC_STATUS1_ADDR A:0xe700004
y.create.l HWIO_SPMI_PIC_OWNER0_ACC_STATUS2_ADDR A:0xe700008
y.create.l HWIO_SPMI_PIC_OWNER0_ACC_STATUS3_ADDR A:0xe70000c
y.create.l HWIO_SPMI_PIC_OWNER1_ACC_STATUS0_ADDR A:0xe710000
y.create.l HWIO_SPMI_PIC_OWNER1_ACC_STATUS1_ADDR A:0xe710004
y.create.l HWIO_SPMI_PIC_OWNER1_ACC_STATUS2_ADDR A:0xe710008
y.create.l HWIO_SPMI_PIC_OWNER1_ACC_STATUS3_ADDR A:0xe71000c
y.create.l HWIO_SPMI_PIC_OWNER2_ACC_STATUS0_ADDR A:0xe720000
y.create.l HWIO_SPMI_PIC_OWNER2_ACC_STATUS1_ADDR A:0xe720004
y.create.l HWIO_SPMI_PIC_OWNER2_ACC_STATUS2_ADDR A:0xe720008
y.create.l HWIO_SPMI_PIC_OWNER2_ACC_STATUS3_ADDR A:0xe72000c
y.create.l HWIO_SPMI_PIC_OWNER3_ACC_STATUS0_ADDR A:0xe730000
y.create.l HWIO_SPMI_PIC_OWNER3_ACC_STATUS1_ADDR A:0xe730004
y.create.l HWIO_SPMI_PIC_OWNER3_ACC_STATUS2_ADDR A:0xe730008
y.create.l HWIO_SPMI_PIC_OWNER3_ACC_STATUS3_ADDR A:0xe73000c
y.create.l HWIO_SPMI_PIC_OWNER4_ACC_STATUS0_ADDR A:0xe740000
y.create.l HWIO_SPMI_PIC_OWNER4_ACC_STATUS1_ADDR A:0xe740004
y.create.l HWIO_SPMI_PIC_OWNER4_ACC_STATUS2_ADDR A:0xe740008
y.create.l HWIO_SPMI_PIC_OWNER4_ACC_STATUS3_ADDR A:0xe74000c
y.create.l HWIO_SPMI_PIC_OWNER5_ACC_STATUS0_ADDR A:0xe750000
y.create.l HWIO_SPMI_PIC_OWNER5_ACC_STATUS1_ADDR A:0xe750004
y.create.l HWIO_SPMI_PIC_OWNER5_ACC_STATUS2_ADDR A:0xe750008
y.create.l HWIO_SPMI_PIC_OWNER5_ACC_STATUS3_ADDR A:0xe75000c
y.create.l HWIO_SPMI_PIC_OWNER6_ACC_STATUS0_ADDR A:0xe760000
y.create.l HWIO_SPMI_PIC_OWNER6_ACC_STATUS1_ADDR A:0xe760004
y.create.l HWIO_SPMI_PIC_OWNER6_ACC_STATUS2_ADDR A:0xe760008
y.create.l HWIO_SPMI_PIC_OWNER6_ACC_STATUS3_ADDR A:0xe76000c
y.create.l HWIO_SPMI_PIC_OWNER7_ACC_STATUS0_ADDR A:0xe770000
y.create.l HWIO_SPMI_PIC_OWNER7_ACC_STATUS1_ADDR A:0xe770004
y.create.l HWIO_SPMI_PIC_OWNER7_ACC_STATUS2_ADDR A:0xe770008
y.create.l HWIO_SPMI_PIC_OWNER7_ACC_STATUS3_ADDR A:0xe77000c
y.create.l HWIO_SPMI_PIC_OWNER8_ACC_STATUS0_ADDR A:0xe780000
y.create.l HWIO_SPMI_PIC_OWNER8_ACC_STATUS1_ADDR A:0xe780004
y.create.l HWIO_SPMI_PIC_OWNER8_ACC_STATUS2_ADDR A:0xe780008
y.create.l HWIO_SPMI_PIC_OWNER8_ACC_STATUS3_ADDR A:0xe78000c
y.create.l HWIO_SPMI_PIC_OWNER9_ACC_STATUS0_ADDR A:0xe790000
y.create.l HWIO_SPMI_PIC_OWNER9_ACC_STATUS1_ADDR A:0xe790004
y.create.l HWIO_SPMI_PIC_OWNER9_ACC_STATUS2_ADDR A:0xe790008
y.create.l HWIO_SPMI_PIC_OWNER9_ACC_STATUS3_ADDR A:0xe79000c
y.create.l HWIO_PMIC_MGPI_TRIG_CONFIG0_ADDR A:0xc462000
y.create.l HWIO_PMIC_MGPI_TRIG_CONFIG1_ADDR A:0xc462008
y.create.l HWIO_PMIC_MGPI_TRIG_CONFIG2_ADDR A:0xc462010
y.create.l HWIO_PMIC_MGPI_TRIG_CONFIG3_ADDR A:0xc462018
y.create.l HWIO_PMIC_MGPI_TRIG_CONFIG_EN0_ADDR A:0xc462004
y.create.l HWIO_PMIC_MGPI_TRIG_CONFIG_EN1_ADDR A:0xc46200c
y.create.l HWIO_PMIC_MGPI_TRIG_CONFIG_EN2_ADDR A:0xc462014
y.create.l HWIO_PMIC_MGPI_TRIG_CONFIG_EN3_ADDR A:0xc46201c
y.create.l HWIO_PMIC_MGPI_MASTER_CSR_ADDR A:0xc462100
y.create.l HWIO_PMIC_MGPI_HW_VERSION_ADDR A:0xc462104
y.create.l HWIO_PMIC_MGPI_TRIG_STATUS0_ADDR A:0xc470000
y.create.l HWIO_PMIC_MGPI_TRIG_STATUS1_ADDR A:0xc480000
y.create.l HWIO_PMIC_MGPI_TRIG_STATUS2_ADDR A:0xc490000
y.create.l HWIO_PMIC_MGPI_TRIG_STATUS3_ADDR A:0xc4a0000
y.create.l HWIO_PMIC_ARB_XPU3_GCR0_ADDR A:0xc430000
y.create.l HWIO_PMIC_ARB_XPU3_SCR0_ADDR A:0xc430008
y.create.l HWIO_PMIC_ARB_XPU3_CR0_ADDR A:0xc430010
y.create.l HWIO_PMIC_ARB_XPU3_RPU_ACR0_ADDR A:0xc430020
y.create.l HWIO_PMIC_ARB_XPU3_UMR_RACR_ADDR A:0xc430040
y.create.l HWIO_PMIC_ARB_XPU3_UMR_WACR_ADDR A:0xc430060
y.create.l HWIO_PMIC_ARB_XPU3_QAD0_GCR0_ADDR A:0xc430080
y.create.l HWIO_PMIC_ARB_XPU3_QAD0_CR0_ADDR A:0xc430090
y.create.l HWIO_PMIC_ARB_XPU3_QAD1_GCR0_ADDR A:0xc430100
y.create.l HWIO_PMIC_ARB_XPU3_QAD1_CR0_ADDR A:0xc430110
y.create.l HWIO_PMIC_ARB_XPU3_UMR_GCR0_ADDR A:0xc430300
y.create.l HWIO_PMIC_ARB_XPU3_UMR_CR0_ADDR A:0xc430310
y.create.l HWIO_PMIC_ARB_XPU3_UMR_CR1_ADDR A:0xc430314
y.create.l HWIO_PMIC_ARB_XPU3_UMR_CR2_ADDR A:0xc430318
y.create.l HWIO_PMIC_ARB_XPU3_UMR_CR3_ADDR A:0xc43031c
y.create.l HWIO_PMIC_ARB_XPU3_IDR3_ADDR A:0xc4303ec
y.create.l HWIO_PMIC_ARB_XPU3_IDR2_ADDR A:0xc4303f0
y.create.l HWIO_PMIC_ARB_XPU3_IDR1_ADDR A:0xc4303f4
y.create.l HWIO_PMIC_ARB_XPU3_IDR0_ADDR A:0xc4303f8
y.create.l HWIO_PMIC_ARB_XPU3_REV_ADDR A:0xc4303fc
y.create.l HWIO_PMIC_ARB_XPU3_RGN_FREESTATUS0_ADDR A:0xc430500
y.create.l HWIO_PMIC_ARB_XPU3_SEAR0_ADDR A:0xc430800
y.create.l HWIO_PMIC_ARB_XPU3_SESR_ADDR A:0xc430808
y.create.l HWIO_PMIC_ARB_XPU3_SESRRESTORE_ADDR A:0xc43080c
y.create.l HWIO_PMIC_ARB_XPU3_SESYNR0_ADDR A:0xc430810
y.create.l HWIO_PMIC_ARB_XPU3_SESYNR1_ADDR A:0xc430814
y.create.l HWIO_PMIC_ARB_XPU3_SESYNR2_ADDR A:0xc430818
y.create.l HWIO_PMIC_ARB_XPU3_SEAR1_ADDR A:0xc430804
y.create.l HWIO_PMIC_ARB_XPU3_SESYNR3_ADDR A:0xc43081c
y.create.l HWIO_PMIC_ARB_XPU3_RGN_START0_SSHADOW_ADDR A:0xc430830
y.create.l HWIO_PMIC_ARB_XPU3_RGN_END0_SSHADOW_ADDR A:0xc430838
y.create.l HWIO_PMIC_ARB_XPU3_EAR0_ADDR A:0xc430880
y.create.l HWIO_PMIC_ARB_XPU3_ESR_ADDR A:0xc430888
y.create.l HWIO_PMIC_ARB_XPU3_ESRRESTORE_ADDR A:0xc43088c
y.create.l HWIO_PMIC_ARB_XPU3_ESYNR0_ADDR A:0xc430890
y.create.l HWIO_PMIC_ARB_XPU3_ESYNR1_ADDR A:0xc430894
y.create.l HWIO_PMIC_ARB_XPU3_ESYNR2_ADDR A:0xc430898
y.create.l HWIO_PMIC_ARB_XPU3_EAR1_ADDR A:0xc430884
y.create.l HWIO_PMIC_ARB_XPU3_ESYNR3_ADDR A:0xc43089c
y.create.l HWIO_PMIC_ARB_XPU3_RGN_START0_SHADOW_ADDR A:0xc4308b0
y.create.l HWIO_PMIC_ARB_XPU3_RGN_END0_SHADOW_ADDR A:0xc4308b8
y.create.l HWIO_PMIC_ARB_XPU3_QAD0_EAR0_ADDR A:0xc430880
y.create.l HWIO_PMIC_ARB_XPU3_QAD0_ESR_ADDR A:0xc430888
y.create.l HWIO_PMIC_ARB_XPU3_QAD0_ESRRESTORE_ADDR A:0xc43088c
y.create.l HWIO_PMIC_ARB_XPU3_QAD0_ESYNR0_ADDR A:0xc430890
y.create.l HWIO_PMIC_ARB_XPU3_QAD0_ESYNR1_ADDR A:0xc430894
y.create.l HWIO_PMIC_ARB_XPU3_QAD0_ESYNR2_ADDR A:0xc430898
y.create.l HWIO_PMIC_ARB_XPU3_QAD0_EAR1_ADDR A:0xc430884
y.create.l HWIO_PMIC_ARB_XPU3_QAD0_ESYNR3_ADDR A:0xc43089c
y.create.l HWIO_PMIC_ARB_XPU3_QAD0_RGN_START0_SHADOW_ADDR A:0xc4308b0
y.create.l HWIO_PMIC_ARB_XPU3_QAD0_RGN_END0_SHADOW_ADDR A:0xc4308b8
y.create.l HWIO_PMIC_ARB_XPU3_QAD1_EAR0_ADDR A:0xc430880
y.create.l HWIO_PMIC_ARB_XPU3_QAD1_ESR_ADDR A:0xc430888
y.create.l HWIO_PMIC_ARB_XPU3_QAD1_ESRRESTORE_ADDR A:0xc43088c
y.create.l HWIO_PMIC_ARB_XPU3_QAD1_ESYNR0_ADDR A:0xc430890
y.create.l HWIO_PMIC_ARB_XPU3_QAD1_ESYNR1_ADDR A:0xc430894
y.create.l HWIO_PMIC_ARB_XPU3_QAD1_ESYNR2_ADDR A:0xc430898
y.create.l HWIO_PMIC_ARB_XPU3_QAD1_EAR1_ADDR A:0xc430884
y.create.l HWIO_PMIC_ARB_XPU3_QAD1_ESYNR3_ADDR A:0xc43089c
y.create.l HWIO_PMIC_ARB_XPU3_QAD1_RGN_START0_SHADOW_ADDR A:0xc4308b0
y.create.l HWIO_PMIC_ARB_XPU3_QAD1_RGN_END0_SHADOW_ADDR A:0xc4308b8
y.create.l HWIO_PMIC_ARB_XPU3_RGN_OWNERSTATUS0_ADDR A:0xc430900
y.create.l HWIO_PMIC_ARB_XPU3_RG0_GCR0_ADDR A:0xc431000
y.create.l HWIO_PMIC_ARB_XPU3_RG1_GCR0_ADDR A:0xc431080
y.create.l HWIO_PMIC_ARB_XPU3_RG2_GCR0_ADDR A:0xc431100
y.create.l HWIO_PMIC_ARB_XPU3_RG3_GCR0_ADDR A:0xc431180
y.create.l HWIO_PMIC_ARB_XPU3_RG4_GCR0_ADDR A:0xc431200
y.create.l HWIO_PMIC_ARB_XPU3_RG5_GCR0_ADDR A:0xc431280
y.create.l HWIO_PMIC_ARB_XPU3_RG6_GCR0_ADDR A:0xc431300
y.create.l HWIO_PMIC_ARB_XPU3_RG7_GCR0_ADDR A:0xc431380
y.create.l HWIO_PMIC_ARB_XPU3_RG8_GCR0_ADDR A:0xc431400
y.create.l HWIO_PMIC_ARB_XPU3_RG9_GCR0_ADDR A:0xc431480
y.create.l HWIO_PMIC_ARB_XPU3_RG0_GCR1_ADDR A:0xc431004
y.create.l HWIO_PMIC_ARB_XPU3_RG1_GCR1_ADDR A:0xc431084
y.create.l HWIO_PMIC_ARB_XPU3_RG2_GCR1_ADDR A:0xc431104
y.create.l HWIO_PMIC_ARB_XPU3_RG3_GCR1_ADDR A:0xc431184
y.create.l HWIO_PMIC_ARB_XPU3_RG4_GCR1_ADDR A:0xc431204
y.create.l HWIO_PMIC_ARB_XPU3_RG5_GCR1_ADDR A:0xc431284
y.create.l HWIO_PMIC_ARB_XPU3_RG6_GCR1_ADDR A:0xc431304
y.create.l HWIO_PMIC_ARB_XPU3_RG7_GCR1_ADDR A:0xc431384
y.create.l HWIO_PMIC_ARB_XPU3_RG8_GCR1_ADDR A:0xc431404
y.create.l HWIO_PMIC_ARB_XPU3_RG9_GCR1_ADDR A:0xc431484
y.create.l HWIO_PMIC_ARB_XPU3_RG0_GCR2_ADDR A:0xc431008
y.create.l HWIO_PMIC_ARB_XPU3_RG1_GCR2_ADDR A:0xc431088
y.create.l HWIO_PMIC_ARB_XPU3_RG2_GCR2_ADDR A:0xc431108
y.create.l HWIO_PMIC_ARB_XPU3_RG3_GCR2_ADDR A:0xc431188
y.create.l HWIO_PMIC_ARB_XPU3_RG4_GCR2_ADDR A:0xc431208
y.create.l HWIO_PMIC_ARB_XPU3_RG5_GCR2_ADDR A:0xc431288
y.create.l HWIO_PMIC_ARB_XPU3_RG6_GCR2_ADDR A:0xc431308
y.create.l HWIO_PMIC_ARB_XPU3_RG7_GCR2_ADDR A:0xc431388
y.create.l HWIO_PMIC_ARB_XPU3_RG8_GCR2_ADDR A:0xc431408
y.create.l HWIO_PMIC_ARB_XPU3_RG9_GCR2_ADDR A:0xc431488
y.create.l HWIO_PMIC_ARB_XPU3_RG0_CR0_ADDR A:0xc431010
y.create.l HWIO_PMIC_ARB_XPU3_RG1_CR0_ADDR A:0xc431090
y.create.l HWIO_PMIC_ARB_XPU3_RG2_CR0_ADDR A:0xc431110
y.create.l HWIO_PMIC_ARB_XPU3_RG3_CR0_ADDR A:0xc431190
y.create.l HWIO_PMIC_ARB_XPU3_RG4_CR0_ADDR A:0xc431210
y.create.l HWIO_PMIC_ARB_XPU3_RG5_CR0_ADDR A:0xc431290
y.create.l HWIO_PMIC_ARB_XPU3_RG6_CR0_ADDR A:0xc431310
y.create.l HWIO_PMIC_ARB_XPU3_RG7_CR0_ADDR A:0xc431390
y.create.l HWIO_PMIC_ARB_XPU3_RG8_CR0_ADDR A:0xc431410
y.create.l HWIO_PMIC_ARB_XPU3_RG9_CR0_ADDR A:0xc431490
y.create.l HWIO_PMIC_ARB_XPU3_RG0_CR1_ADDR A:0xc431014
y.create.l HWIO_PMIC_ARB_XPU3_RG1_CR1_ADDR A:0xc431094
y.create.l HWIO_PMIC_ARB_XPU3_RG2_CR1_ADDR A:0xc431114
y.create.l HWIO_PMIC_ARB_XPU3_RG3_CR1_ADDR A:0xc431194
y.create.l HWIO_PMIC_ARB_XPU3_RG4_CR1_ADDR A:0xc431214
y.create.l HWIO_PMIC_ARB_XPU3_RG5_CR1_ADDR A:0xc431294
y.create.l HWIO_PMIC_ARB_XPU3_RG6_CR1_ADDR A:0xc431314
y.create.l HWIO_PMIC_ARB_XPU3_RG7_CR1_ADDR A:0xc431394
y.create.l HWIO_PMIC_ARB_XPU3_RG8_CR1_ADDR A:0xc431414
y.create.l HWIO_PMIC_ARB_XPU3_RG9_CR1_ADDR A:0xc431494
y.create.l HWIO_PMIC_ARB_XPU3_RG0_CR2_ADDR A:0xc431018
y.create.l HWIO_PMIC_ARB_XPU3_RG1_CR2_ADDR A:0xc431098
y.create.l HWIO_PMIC_ARB_XPU3_RG2_CR2_ADDR A:0xc431118
y.create.l HWIO_PMIC_ARB_XPU3_RG3_CR2_ADDR A:0xc431198
y.create.l HWIO_PMIC_ARB_XPU3_RG4_CR2_ADDR A:0xc431218
y.create.l HWIO_PMIC_ARB_XPU3_RG5_CR2_ADDR A:0xc431298
y.create.l HWIO_PMIC_ARB_XPU3_RG6_CR2_ADDR A:0xc431318
y.create.l HWIO_PMIC_ARB_XPU3_RG7_CR2_ADDR A:0xc431398
y.create.l HWIO_PMIC_ARB_XPU3_RG8_CR2_ADDR A:0xc431418
y.create.l HWIO_PMIC_ARB_XPU3_RG9_CR2_ADDR A:0xc431498
y.create.l HWIO_PMIC_ARB_XPU3_RG0_CR3_ADDR A:0xc43101c
y.create.l HWIO_PMIC_ARB_XPU3_RG1_CR3_ADDR A:0xc43109c
y.create.l HWIO_PMIC_ARB_XPU3_RG2_CR3_ADDR A:0xc43111c
y.create.l HWIO_PMIC_ARB_XPU3_RG3_CR3_ADDR A:0xc43119c
y.create.l HWIO_PMIC_ARB_XPU3_RG4_CR3_ADDR A:0xc43121c
y.create.l HWIO_PMIC_ARB_XPU3_RG5_CR3_ADDR A:0xc43129c
y.create.l HWIO_PMIC_ARB_XPU3_RG6_CR3_ADDR A:0xc43131c
y.create.l HWIO_PMIC_ARB_XPU3_RG7_CR3_ADDR A:0xc43139c
y.create.l HWIO_PMIC_ARB_XPU3_RG8_CR3_ADDR A:0xc43141c
y.create.l HWIO_PMIC_ARB_XPU3_RG9_CR3_ADDR A:0xc43149c
y.create.l HWIO_PMIC_ARB_XPU3_RG0_START0_ADDR A:0xc431030
y.create.l HWIO_PMIC_ARB_XPU3_RG1_START0_ADDR A:0xc4310b0
y.create.l HWIO_PMIC_ARB_XPU3_RG2_START0_ADDR A:0xc431130
y.create.l HWIO_PMIC_ARB_XPU3_RG3_START0_ADDR A:0xc4311b0
y.create.l HWIO_PMIC_ARB_XPU3_RG4_START0_ADDR A:0xc431230
y.create.l HWIO_PMIC_ARB_XPU3_RG5_START0_ADDR A:0xc4312b0
y.create.l HWIO_PMIC_ARB_XPU3_RG6_START0_ADDR A:0xc431330
y.create.l HWIO_PMIC_ARB_XPU3_RG7_START0_ADDR A:0xc4313b0
y.create.l HWIO_PMIC_ARB_XPU3_RG8_START0_ADDR A:0xc431430
y.create.l HWIO_PMIC_ARB_XPU3_RG9_START0_ADDR A:0xc4314b0
y.create.l HWIO_PMIC_ARB_XPU3_RG0_END0_ADDR A:0xc431038
y.create.l HWIO_PMIC_ARB_XPU3_RG1_END0_ADDR A:0xc4310b8
y.create.l HWIO_PMIC_ARB_XPU3_RG2_END0_ADDR A:0xc431138
y.create.l HWIO_PMIC_ARB_XPU3_RG3_END0_ADDR A:0xc4311b8
y.create.l HWIO_PMIC_ARB_XPU3_RG4_END0_ADDR A:0xc431238
y.create.l HWIO_PMIC_ARB_XPU3_RG5_END0_ADDR A:0xc4312b8
y.create.l HWIO_PMIC_ARB_XPU3_RG6_END0_ADDR A:0xc431338
y.create.l HWIO_PMIC_ARB_XPU3_RG7_END0_ADDR A:0xc4313b8
y.create.l HWIO_PMIC_ARB_XPU3_RG8_END0_ADDR A:0xc431438
y.create.l HWIO_PMIC_ARB_XPU3_RG9_END0_ADDR A:0xc4314b8
y.create.l HWIO_PMIC_ARB_XPU3_RG0_RACR_ADDR A:0xc431040
y.create.l HWIO_PMIC_ARB_XPU3_RG1_RACR_ADDR A:0xc4310c0
y.create.l HWIO_PMIC_ARB_XPU3_RG2_RACR_ADDR A:0xc431140
y.create.l HWIO_PMIC_ARB_XPU3_RG3_RACR_ADDR A:0xc4311c0
y.create.l HWIO_PMIC_ARB_XPU3_RG4_RACR_ADDR A:0xc431240
y.create.l HWIO_PMIC_ARB_XPU3_RG5_RACR_ADDR A:0xc4312c0
y.create.l HWIO_PMIC_ARB_XPU3_RG6_RACR_ADDR A:0xc431340
y.create.l HWIO_PMIC_ARB_XPU3_RG7_RACR_ADDR A:0xc4313c0
y.create.l HWIO_PMIC_ARB_XPU3_RG8_RACR_ADDR A:0xc431440
y.create.l HWIO_PMIC_ARB_XPU3_RG9_RACR_ADDR A:0xc4314c0
y.create.l HWIO_PMIC_ARB_XPU3_RG0_WACR_ADDR A:0xc431060
y.create.l HWIO_PMIC_ARB_XPU3_RG1_WACR_ADDR A:0xc4310e0
y.create.l HWIO_PMIC_ARB_XPU3_RG2_WACR_ADDR A:0xc431160
y.create.l HWIO_PMIC_ARB_XPU3_RG3_WACR_ADDR A:0xc4311e0
y.create.l HWIO_PMIC_ARB_XPU3_RG4_WACR_ADDR A:0xc431260
y.create.l HWIO_PMIC_ARB_XPU3_RG5_WACR_ADDR A:0xc4312e0
y.create.l HWIO_PMIC_ARB_XPU3_RG6_WACR_ADDR A:0xc431360
y.create.l HWIO_PMIC_ARB_XPU3_RG7_WACR_ADDR A:0xc4313e0
y.create.l HWIO_PMIC_ARB_XPU3_RG8_WACR_ADDR A:0xc431460
y.create.l HWIO_PMIC_ARB_XPU3_RG9_WACR_ADDR A:0xc4314e0
y.create.l HWIO_PMIC_ARB_HW_VERSION_ADDR A:0xc440000
y.create.l HWIO_PMIC_ARB_FEATURES_ADDR A:0xc440004
y.create.l HWIO_PMIC_ARB_MISC_CONFIG_ADDR A:0xc440010
y.create.l HWIO_PMIC_ARB_PRIORITIES0_ADDR A:0xc440100
y.create.l HWIO_PMIC_ARB_PRIORITIES1_ADDR A:0xc440104
y.create.l HWIO_PMIC_ARB_PRIORITIES2_ADDR A:0xc440108
y.create.l HWIO_PMIC_ARB_PRIORITIES3_ADDR A:0xc44010c
y.create.l HWIO_PMIC_ARB_PRIORITIES4_ADDR A:0xc440110
y.create.l HWIO_PMIC_ARB_PRIORITIES5_ADDR A:0xc440114
y.create.l HWIO_PMIC_ARB_PRIORITIES6_ADDR A:0xc440118
y.create.l HWIO_PMIC_ARB_PRIORITIES7_ADDR A:0xc44011c
y.create.l HWIO_PMIC_ARB_PRIORITIES8_ADDR A:0xc440120
y.create.l HWIO_PMIC_ARB_PRIORITIES9_ADDR A:0xc440124
y.create.l HWIO_PMIC_ARB_PVC_INTF_CTL_ADDR A:0xc440200
y.create.l HWIO_PMIC_ARB_PVC_INTF_STATUS_ADDR A:0xc440204
y.create.l HWIO_PMIC_ARB_PVC_PORT0_CTL_ADDR A:0xc440208
y.create.l HWIO_PMIC_ARB_PVC_PORT1_CTL_ADDR A:0xc44020c
y.create.l HWIO_PMIC_ARB_PVC_PORT2_CTL_ADDR A:0xc440210
y.create.l HWIO_PMIC_ARB_PVC_PORT3_CTL_ADDR A:0xc440214
y.create.l HWIO_PMIC_ARB_PVC_PORT4_CTL_ADDR A:0xc440218
y.create.l HWIO_PMIC_ARB_PVC_PORT5_CTL_ADDR A:0xc44021c
y.create.l HWIO_PMIC_ARB_PVC_PORT6_CTL_ADDR A:0xc440220
y.create.l HWIO_PMIC_ARB_PVC_PORT0_STATUS_ADDR A:0xc440288
y.create.l HWIO_PMIC_ARB_PVC_PORT1_STATUS_ADDR A:0xc44028c
y.create.l HWIO_PMIC_ARB_PVC_PORT2_STATUS_ADDR A:0xc440290
y.create.l HWIO_PMIC_ARB_PVC_PORT3_STATUS_ADDR A:0xc440294
y.create.l HWIO_PMIC_ARB_PVC_PORT4_STATUS_ADDR A:0xc440298
y.create.l HWIO_PMIC_ARB_PVC_PORT5_STATUS_ADDR A:0xc44029c
y.create.l HWIO_PMIC_ARB_PVC_PORT6_STATUS_ADDR A:0xc4402a0
y.create.l HWIO_PMIC_ARB_PVC0_ADDR0_ADDR A:0xc440400
y.create.l HWIO_PMIC_ARB_PVC0_ADDR1_ADDR A:0xc440404
y.create.l HWIO_PMIC_ARB_PVC0_ADDR2_ADDR A:0xc440408
y.create.l HWIO_PMIC_ARB_PVC0_ADDR3_ADDR A:0xc44040c
y.create.l HWIO_PMIC_ARB_PVC1_ADDR0_ADDR A:0xc440420
y.create.l HWIO_PMIC_ARB_PVC1_ADDR1_ADDR A:0xc440424
y.create.l HWIO_PMIC_ARB_PVC1_ADDR2_ADDR A:0xc440428
y.create.l HWIO_PMIC_ARB_PVC1_ADDR3_ADDR A:0xc44042c
y.create.l HWIO_PMIC_ARB_PVC2_ADDR0_ADDR A:0xc440440
y.create.l HWIO_PMIC_ARB_PVC2_ADDR1_ADDR A:0xc440444
y.create.l HWIO_PMIC_ARB_PVC2_ADDR2_ADDR A:0xc440448
y.create.l HWIO_PMIC_ARB_PVC2_ADDR3_ADDR A:0xc44044c
y.create.l HWIO_PMIC_ARB_PVC3_ADDR0_ADDR A:0xc440460
y.create.l HWIO_PMIC_ARB_PVC3_ADDR1_ADDR A:0xc440464
y.create.l HWIO_PMIC_ARB_PVC3_ADDR2_ADDR A:0xc440468
y.create.l HWIO_PMIC_ARB_PVC3_ADDR3_ADDR A:0xc44046c
y.create.l HWIO_PMIC_ARB_PVC4_ADDR0_ADDR A:0xc440480
y.create.l HWIO_PMIC_ARB_PVC4_ADDR1_ADDR A:0xc440484
y.create.l HWIO_PMIC_ARB_PVC4_ADDR2_ADDR A:0xc440488
y.create.l HWIO_PMIC_ARB_PVC4_ADDR3_ADDR A:0xc44048c
y.create.l HWIO_PMIC_ARB_PVC5_ADDR0_ADDR A:0xc4404a0
y.create.l HWIO_PMIC_ARB_PVC5_ADDR1_ADDR A:0xc4404a4
y.create.l HWIO_PMIC_ARB_PVC5_ADDR2_ADDR A:0xc4404a8
y.create.l HWIO_PMIC_ARB_PVC5_ADDR3_ADDR A:0xc4404ac
y.create.l HWIO_PMIC_ARB_PVC6_ADDR0_ADDR A:0xc4404c0
y.create.l HWIO_PMIC_ARB_PVC6_ADDR1_ADDR A:0xc4404c4
y.create.l HWIO_PMIC_ARB_PVC6_ADDR2_ADDR A:0xc4404c8
y.create.l HWIO_PMIC_ARB_PVC6_ADDR3_ADDR A:0xc4404cc
y.create.l HWIO_PMIC_ARB_REG_ADDR0_ADDR A:0xc440900
y.create.l HWIO_PMIC_ARB_REG_ADDR1_ADDR A:0xc440904
y.create.l HWIO_PMIC_ARB_REG_ADDR2_ADDR A:0xc440908
y.create.l HWIO_PMIC_ARB_REG_ADDR3_ADDR A:0xc44090c
y.create.l HWIO_PMIC_ARB_REG_ADDR4_ADDR A:0xc440910
y.create.l HWIO_PMIC_ARB_REG_ADDR5_ADDR A:0xc440914
y.create.l HWIO_PMIC_ARB_REG_ADDR6_ADDR A:0xc440918
y.create.l HWIO_PMIC_ARB_REG_ADDR7_ADDR A:0xc44091c
y.create.l HWIO_PMIC_ARB_REG_ADDR8_ADDR A:0xc440920
y.create.l HWIO_PMIC_ARB_REG_ADDR9_ADDR A:0xc440924
y.create.l HWIO_PMIC_ARB_VRM_S_INTF_CTL_ADDR A:0xc442200
y.create.l HWIO_PMIC_ARB_VRM_S_INTF_STATUS_ADDR A:0xc442204
y.create.l HWIO_PMIC_ARB_VRM_S_PORT_CTL_ADDR A:0xc442208
y.create.l HWIO_PMIC_ARB_VRM_S_PORT_STATUS_ADDR A:0xc44220c
y.create.l HWIO_PMIC_ARB_VRM_S_ADDR0_ADDR A:0xc442300
y.create.l HWIO_PMIC_ARB_VRM_S_ADDR1_ADDR A:0xc442304
y.create.l HWIO_PMIC_ARB_VRM_S_ADDR2_ADDR A:0xc442308
y.create.l HWIO_PMIC_ARB_VRM_S_ADDR3_ADDR A:0xc44230c
y.create.l HWIO_PMIC_ARB_VRM_S_ADDR4_ADDR A:0xc442310
y.create.l HWIO_PMIC_ARB_VRM_S_ADDR5_ADDR A:0xc442314
y.create.l HWIO_PMIC_ARB_VRM_S_ADDR6_ADDR A:0xc442318
y.create.l HWIO_PMIC_ARB_VRM_S_ADDR7_ADDR A:0xc44231c
y.create.l HWIO_PMIC_ARB_VRM_S_ADDR8_ADDR A:0xc442320
y.create.l HWIO_PMIC_ARB_VRM_S_ADDR9_ADDR A:0xc442324
y.create.l HWIO_PMIC_ARB_CHNL0_CMD_ADDR A:0xc600000
y.create.l HWIO_PMIC_ARB_CHNL1_CMD_ADDR A:0xc610000
y.create.l HWIO_PMIC_ARB_CHNL2_CMD_ADDR A:0xc620000
y.create.l HWIO_PMIC_ARB_CHNL3_CMD_ADDR A:0xc630000
y.create.l HWIO_PMIC_ARB_CHNL4_CMD_ADDR A:0xc640000
y.create.l HWIO_PMIC_ARB_CHNL5_CMD_ADDR A:0xc650000
y.create.l HWIO_PMIC_ARB_CHNL6_CMD_ADDR A:0xc660000
y.create.l HWIO_PMIC_ARB_CHNL7_CMD_ADDR A:0xc670000
y.create.l HWIO_PMIC_ARB_CHNL8_CMD_ADDR A:0xc680000
y.create.l HWIO_PMIC_ARB_CHNL9_CMD_ADDR A:0xc690000
y.create.l HWIO_PMIC_ARB_CHNL0_CONFIG_ADDR A:0xc600004
y.create.l HWIO_PMIC_ARB_CHNL1_CONFIG_ADDR A:0xc610004
y.create.l HWIO_PMIC_ARB_CHNL2_CONFIG_ADDR A:0xc620004
y.create.l HWIO_PMIC_ARB_CHNL3_CONFIG_ADDR A:0xc630004
y.create.l HWIO_PMIC_ARB_CHNL4_CONFIG_ADDR A:0xc640004
y.create.l HWIO_PMIC_ARB_CHNL5_CONFIG_ADDR A:0xc650004
y.create.l HWIO_PMIC_ARB_CHNL6_CONFIG_ADDR A:0xc660004
y.create.l HWIO_PMIC_ARB_CHNL7_CONFIG_ADDR A:0xc670004
y.create.l HWIO_PMIC_ARB_CHNL8_CONFIG_ADDR A:0xc680004
y.create.l HWIO_PMIC_ARB_CHNL9_CONFIG_ADDR A:0xc690004
y.create.l HWIO_PMIC_ARB_CHNL0_STATUS_ADDR A:0xc600008
y.create.l HWIO_PMIC_ARB_CHNL1_STATUS_ADDR A:0xc610008
y.create.l HWIO_PMIC_ARB_CHNL2_STATUS_ADDR A:0xc620008
y.create.l HWIO_PMIC_ARB_CHNL3_STATUS_ADDR A:0xc630008
y.create.l HWIO_PMIC_ARB_CHNL4_STATUS_ADDR A:0xc640008
y.create.l HWIO_PMIC_ARB_CHNL5_STATUS_ADDR A:0xc650008
y.create.l HWIO_PMIC_ARB_CHNL6_STATUS_ADDR A:0xc660008
y.create.l HWIO_PMIC_ARB_CHNL7_STATUS_ADDR A:0xc670008
y.create.l HWIO_PMIC_ARB_CHNL8_STATUS_ADDR A:0xc680008
y.create.l HWIO_PMIC_ARB_CHNL9_STATUS_ADDR A:0xc690008
y.create.l HWIO_PMIC_ARB_CHNL0_WDATA0_ADDR A:0xc600010
y.create.l HWIO_PMIC_ARB_CHNL1_WDATA0_ADDR A:0xc610010
y.create.l HWIO_PMIC_ARB_CHNL2_WDATA0_ADDR A:0xc620010
y.create.l HWIO_PMIC_ARB_CHNL3_WDATA0_ADDR A:0xc630010
y.create.l HWIO_PMIC_ARB_CHNL4_WDATA0_ADDR A:0xc640010
y.create.l HWIO_PMIC_ARB_CHNL5_WDATA0_ADDR A:0xc650010
y.create.l HWIO_PMIC_ARB_CHNL6_WDATA0_ADDR A:0xc660010
y.create.l HWIO_PMIC_ARB_CHNL7_WDATA0_ADDR A:0xc670010
y.create.l HWIO_PMIC_ARB_CHNL8_WDATA0_ADDR A:0xc680010
y.create.l HWIO_PMIC_ARB_CHNL9_WDATA0_ADDR A:0xc690010
y.create.l HWIO_PMIC_ARB_CHNL0_WDATA1_ADDR A:0xc600014
y.create.l HWIO_PMIC_ARB_CHNL1_WDATA1_ADDR A:0xc610014
y.create.l HWIO_PMIC_ARB_CHNL2_WDATA1_ADDR A:0xc620014
y.create.l HWIO_PMIC_ARB_CHNL3_WDATA1_ADDR A:0xc630014
y.create.l HWIO_PMIC_ARB_CHNL4_WDATA1_ADDR A:0xc640014
y.create.l HWIO_PMIC_ARB_CHNL5_WDATA1_ADDR A:0xc650014
y.create.l HWIO_PMIC_ARB_CHNL6_WDATA1_ADDR A:0xc660014
y.create.l HWIO_PMIC_ARB_CHNL7_WDATA1_ADDR A:0xc670014
y.create.l HWIO_PMIC_ARB_CHNL8_WDATA1_ADDR A:0xc680014
y.create.l HWIO_PMIC_ARB_CHNL9_WDATA1_ADDR A:0xc690014
y.create.l HWIO_PMIC_ARB_CHNL0_RDATA0_ADDR A:0xc600018
y.create.l HWIO_PMIC_ARB_CHNL1_RDATA0_ADDR A:0xc610018
y.create.l HWIO_PMIC_ARB_CHNL2_RDATA0_ADDR A:0xc620018
y.create.l HWIO_PMIC_ARB_CHNL3_RDATA0_ADDR A:0xc630018
y.create.l HWIO_PMIC_ARB_CHNL4_RDATA0_ADDR A:0xc640018
y.create.l HWIO_PMIC_ARB_CHNL5_RDATA0_ADDR A:0xc650018
y.create.l HWIO_PMIC_ARB_CHNL6_RDATA0_ADDR A:0xc660018
y.create.l HWIO_PMIC_ARB_CHNL7_RDATA0_ADDR A:0xc670018
y.create.l HWIO_PMIC_ARB_CHNL8_RDATA0_ADDR A:0xc680018
y.create.l HWIO_PMIC_ARB_CHNL9_RDATA0_ADDR A:0xc690018
y.create.l HWIO_PMIC_ARB_CHNL0_RDATA1_ADDR A:0xc60001c
y.create.l HWIO_PMIC_ARB_CHNL1_RDATA1_ADDR A:0xc61001c
y.create.l HWIO_PMIC_ARB_CHNL2_RDATA1_ADDR A:0xc62001c
y.create.l HWIO_PMIC_ARB_CHNL3_RDATA1_ADDR A:0xc63001c
y.create.l HWIO_PMIC_ARB_CHNL4_RDATA1_ADDR A:0xc64001c
y.create.l HWIO_PMIC_ARB_CHNL5_RDATA1_ADDR A:0xc65001c
y.create.l HWIO_PMIC_ARB_CHNL6_RDATA1_ADDR A:0xc66001c
y.create.l HWIO_PMIC_ARB_CHNL7_RDATA1_ADDR A:0xc67001c
y.create.l HWIO_PMIC_ARB_CHNL8_RDATA1_ADDR A:0xc68001c
y.create.l HWIO_PMIC_ARB_CHNL9_RDATA1_ADDR A:0xc69001c
y.create.l HWIO_PMIC_ARB_CHNL0_RDATA2_ADDR A:0xc600020
y.create.l HWIO_PMIC_ARB_CHNL1_RDATA2_ADDR A:0xc610020
y.create.l HWIO_PMIC_ARB_CHNL2_RDATA2_ADDR A:0xc620020
y.create.l HWIO_PMIC_ARB_CHNL3_RDATA2_ADDR A:0xc630020
y.create.l HWIO_PMIC_ARB_CHNL4_RDATA2_ADDR A:0xc640020
y.create.l HWIO_PMIC_ARB_CHNL5_RDATA2_ADDR A:0xc650020
y.create.l HWIO_PMIC_ARB_CHNL6_RDATA2_ADDR A:0xc660020
y.create.l HWIO_PMIC_ARB_CHNL7_RDATA2_ADDR A:0xc670020
y.create.l HWIO_PMIC_ARB_CHNL8_RDATA2_ADDR A:0xc680020
y.create.l HWIO_PMIC_ARB_CHNL9_RDATA2_ADDR A:0xc690020
y.create.l HWIO_SPMI_PIC_ACC_ENABLE0_ADDR A:0xc600100
y.create.l HWIO_SPMI_PIC_ACC_ENABLE1_ADDR A:0xc610100
y.create.l HWIO_SPMI_PIC_ACC_ENABLE2_ADDR A:0xc620100
y.create.l HWIO_SPMI_PIC_ACC_ENABLE3_ADDR A:0xc630100
y.create.l HWIO_SPMI_PIC_ACC_ENABLE4_ADDR A:0xc640100
y.create.l HWIO_SPMI_PIC_ACC_ENABLE5_ADDR A:0xc650100
y.create.l HWIO_SPMI_PIC_ACC_ENABLE6_ADDR A:0xc660100
y.create.l HWIO_SPMI_PIC_ACC_ENABLE7_ADDR A:0xc670100
y.create.l HWIO_SPMI_PIC_ACC_ENABLE8_ADDR A:0xc680100
y.create.l HWIO_SPMI_PIC_ACC_ENABLE9_ADDR A:0xc690100
y.create.l HWIO_SPMI_PIC_IRQ_STATUS0_ADDR A:0xc600104
y.create.l HWIO_SPMI_PIC_IRQ_STATUS1_ADDR A:0xc610104
y.create.l HWIO_SPMI_PIC_IRQ_STATUS2_ADDR A:0xc620104
y.create.l HWIO_SPMI_PIC_IRQ_STATUS3_ADDR A:0xc630104
y.create.l HWIO_SPMI_PIC_IRQ_STATUS4_ADDR A:0xc640104
y.create.l HWIO_SPMI_PIC_IRQ_STATUS5_ADDR A:0xc650104
y.create.l HWIO_SPMI_PIC_IRQ_STATUS6_ADDR A:0xc660104
y.create.l HWIO_SPMI_PIC_IRQ_STATUS7_ADDR A:0xc670104
y.create.l HWIO_SPMI_PIC_IRQ_STATUS8_ADDR A:0xc680104
y.create.l HWIO_SPMI_PIC_IRQ_STATUS9_ADDR A:0xc690104
y.create.l HWIO_SPMI_PIC_IRQ_CLEAR0_ADDR A:0xc600108
y.create.l HWIO_SPMI_PIC_IRQ_CLEAR1_ADDR A:0xc610108
y.create.l HWIO_SPMI_PIC_IRQ_CLEAR2_ADDR A:0xc620108
y.create.l HWIO_SPMI_PIC_IRQ_CLEAR3_ADDR A:0xc630108
y.create.l HWIO_SPMI_PIC_IRQ_CLEAR4_ADDR A:0xc640108
y.create.l HWIO_SPMI_PIC_IRQ_CLEAR5_ADDR A:0xc650108
y.create.l HWIO_SPMI_PIC_IRQ_CLEAR6_ADDR A:0xc660108
y.create.l HWIO_SPMI_PIC_IRQ_CLEAR7_ADDR A:0xc670108
y.create.l HWIO_SPMI_PIC_IRQ_CLEAR8_ADDR A:0xc680108
y.create.l HWIO_SPMI_PIC_IRQ_CLEAR9_ADDR A:0xc690108
y.create.l HWIO_SWCHAN_PROTOCOL_IRQ_STATUS0_ADDR A:0xc60010c
y.create.l HWIO_SWCHAN_PROTOCOL_IRQ_STATUS1_ADDR A:0xc61010c
y.create.l HWIO_SWCHAN_PROTOCOL_IRQ_STATUS2_ADDR A:0xc62010c
y.create.l HWIO_SWCHAN_PROTOCOL_IRQ_STATUS3_ADDR A:0xc63010c
y.create.l HWIO_SWCHAN_PROTOCOL_IRQ_STATUS4_ADDR A:0xc64010c
y.create.l HWIO_SWCHAN_PROTOCOL_IRQ_STATUS5_ADDR A:0xc65010c
y.create.l HWIO_SWCHAN_PROTOCOL_IRQ_STATUS6_ADDR A:0xc66010c
y.create.l HWIO_SWCHAN_PROTOCOL_IRQ_STATUS7_ADDR A:0xc67010c
y.create.l HWIO_SWCHAN_PROTOCOL_IRQ_STATUS8_ADDR A:0xc68010c
y.create.l HWIO_SWCHAN_PROTOCOL_IRQ_STATUS9_ADDR A:0xc69010c
y.create.l HWIO_PMIC_ARB_OBS0_CHNL0_CMD_ADDR A:0xe600000
y.create.l HWIO_PMIC_ARB_OBS0_CHNL1_CMD_ADDR A:0xe600080
y.create.l HWIO_PMIC_ARB_OBS0_CHNL2_CMD_ADDR A:0xe600100
y.create.l HWIO_PMIC_ARB_OBS0_CHNL3_CMD_ADDR A:0xe600180
y.create.l HWIO_PMIC_ARB_OBS1_CHNL0_CMD_ADDR A:0xe610000
y.create.l HWIO_PMIC_ARB_OBS1_CHNL1_CMD_ADDR A:0xe610080
y.create.l HWIO_PMIC_ARB_OBS1_CHNL2_CMD_ADDR A:0xe610100
y.create.l HWIO_PMIC_ARB_OBS1_CHNL3_CMD_ADDR A:0xe610180
y.create.l HWIO_PMIC_ARB_OBS2_CHNL0_CMD_ADDR A:0xe620000
y.create.l HWIO_PMIC_ARB_OBS2_CHNL1_CMD_ADDR A:0xe620080
y.create.l HWIO_PMIC_ARB_OBS2_CHNL2_CMD_ADDR A:0xe620100
y.create.l HWIO_PMIC_ARB_OBS2_CHNL3_CMD_ADDR A:0xe620180
y.create.l HWIO_PMIC_ARB_OBS3_CHNL0_CMD_ADDR A:0xe630000
y.create.l HWIO_PMIC_ARB_OBS3_CHNL1_CMD_ADDR A:0xe630080
y.create.l HWIO_PMIC_ARB_OBS3_CHNL2_CMD_ADDR A:0xe630100
y.create.l HWIO_PMIC_ARB_OBS3_CHNL3_CMD_ADDR A:0xe630180
y.create.l HWIO_PMIC_ARB_OBS4_CHNL0_CMD_ADDR A:0xe640000
y.create.l HWIO_PMIC_ARB_OBS4_CHNL1_CMD_ADDR A:0xe640080
y.create.l HWIO_PMIC_ARB_OBS4_CHNL2_CMD_ADDR A:0xe640100
y.create.l HWIO_PMIC_ARB_OBS4_CHNL3_CMD_ADDR A:0xe640180
y.create.l HWIO_PMIC_ARB_OBS5_CHNL0_CMD_ADDR A:0xe650000
y.create.l HWIO_PMIC_ARB_OBS5_CHNL1_CMD_ADDR A:0xe650080
y.create.l HWIO_PMIC_ARB_OBS5_CHNL2_CMD_ADDR A:0xe650100
y.create.l HWIO_PMIC_ARB_OBS5_CHNL3_CMD_ADDR A:0xe650180
y.create.l HWIO_PMIC_ARB_OBS6_CHNL0_CMD_ADDR A:0xe660000
y.create.l HWIO_PMIC_ARB_OBS6_CHNL1_CMD_ADDR A:0xe660080
y.create.l HWIO_PMIC_ARB_OBS6_CHNL2_CMD_ADDR A:0xe660100
y.create.l HWIO_PMIC_ARB_OBS6_CHNL3_CMD_ADDR A:0xe660180
y.create.l HWIO_PMIC_ARB_OBS0_CHNL0_CONFIG_ADDR A:0xe600004
y.create.l HWIO_PMIC_ARB_OBS0_CHNL1_CONFIG_ADDR A:0xe600084
y.create.l HWIO_PMIC_ARB_OBS0_CHNL2_CONFIG_ADDR A:0xe600104
y.create.l HWIO_PMIC_ARB_OBS0_CHNL3_CONFIG_ADDR A:0xe600184
y.create.l HWIO_PMIC_ARB_OBS1_CHNL0_CONFIG_ADDR A:0xe610004
y.create.l HWIO_PMIC_ARB_OBS1_CHNL1_CONFIG_ADDR A:0xe610084
y.create.l HWIO_PMIC_ARB_OBS1_CHNL2_CONFIG_ADDR A:0xe610104
y.create.l HWIO_PMIC_ARB_OBS1_CHNL3_CONFIG_ADDR A:0xe610184
y.create.l HWIO_PMIC_ARB_OBS2_CHNL0_CONFIG_ADDR A:0xe620004
y.create.l HWIO_PMIC_ARB_OBS2_CHNL1_CONFIG_ADDR A:0xe620084
y.create.l HWIO_PMIC_ARB_OBS2_CHNL2_CONFIG_ADDR A:0xe620104
y.create.l HWIO_PMIC_ARB_OBS2_CHNL3_CONFIG_ADDR A:0xe620184
y.create.l HWIO_PMIC_ARB_OBS3_CHNL0_CONFIG_ADDR A:0xe630004
y.create.l HWIO_PMIC_ARB_OBS3_CHNL1_CONFIG_ADDR A:0xe630084
y.create.l HWIO_PMIC_ARB_OBS3_CHNL2_CONFIG_ADDR A:0xe630104
y.create.l HWIO_PMIC_ARB_OBS3_CHNL3_CONFIG_ADDR A:0xe630184
y.create.l HWIO_PMIC_ARB_OBS4_CHNL0_CONFIG_ADDR A:0xe640004
y.create.l HWIO_PMIC_ARB_OBS4_CHNL1_CONFIG_ADDR A:0xe640084
y.create.l HWIO_PMIC_ARB_OBS4_CHNL2_CONFIG_ADDR A:0xe640104
y.create.l HWIO_PMIC_ARB_OBS4_CHNL3_CONFIG_ADDR A:0xe640184
y.create.l HWIO_PMIC_ARB_OBS5_CHNL0_CONFIG_ADDR A:0xe650004
y.create.l HWIO_PMIC_ARB_OBS5_CHNL1_CONFIG_ADDR A:0xe650084
y.create.l HWIO_PMIC_ARB_OBS5_CHNL2_CONFIG_ADDR A:0xe650104
y.create.l HWIO_PMIC_ARB_OBS5_CHNL3_CONFIG_ADDR A:0xe650184
y.create.l HWIO_PMIC_ARB_OBS6_CHNL0_CONFIG_ADDR A:0xe660004
y.create.l HWIO_PMIC_ARB_OBS6_CHNL1_CONFIG_ADDR A:0xe660084
y.create.l HWIO_PMIC_ARB_OBS6_CHNL2_CONFIG_ADDR A:0xe660104
y.create.l HWIO_PMIC_ARB_OBS6_CHNL3_CONFIG_ADDR A:0xe660184
y.create.l HWIO_PMIC_ARB_OBS0_CHNL0_STATUS_ADDR A:0xe600008
y.create.l HWIO_PMIC_ARB_OBS0_CHNL1_STATUS_ADDR A:0xe600088
y.create.l HWIO_PMIC_ARB_OBS0_CHNL2_STATUS_ADDR A:0xe600108
y.create.l HWIO_PMIC_ARB_OBS0_CHNL3_STATUS_ADDR A:0xe600188
y.create.l HWIO_PMIC_ARB_OBS1_CHNL0_STATUS_ADDR A:0xe610008
y.create.l HWIO_PMIC_ARB_OBS1_CHNL1_STATUS_ADDR A:0xe610088
y.create.l HWIO_PMIC_ARB_OBS1_CHNL2_STATUS_ADDR A:0xe610108
y.create.l HWIO_PMIC_ARB_OBS1_CHNL3_STATUS_ADDR A:0xe610188
y.create.l HWIO_PMIC_ARB_OBS2_CHNL0_STATUS_ADDR A:0xe620008
y.create.l HWIO_PMIC_ARB_OBS2_CHNL1_STATUS_ADDR A:0xe620088
y.create.l HWIO_PMIC_ARB_OBS2_CHNL2_STATUS_ADDR A:0xe620108
y.create.l HWIO_PMIC_ARB_OBS2_CHNL3_STATUS_ADDR A:0xe620188
y.create.l HWIO_PMIC_ARB_OBS3_CHNL0_STATUS_ADDR A:0xe630008
y.create.l HWIO_PMIC_ARB_OBS3_CHNL1_STATUS_ADDR A:0xe630088
y.create.l HWIO_PMIC_ARB_OBS3_CHNL2_STATUS_ADDR A:0xe630108
y.create.l HWIO_PMIC_ARB_OBS3_CHNL3_STATUS_ADDR A:0xe630188
y.create.l HWIO_PMIC_ARB_OBS4_CHNL0_STATUS_ADDR A:0xe640008
y.create.l HWIO_PMIC_ARB_OBS4_CHNL1_STATUS_ADDR A:0xe640088
y.create.l HWIO_PMIC_ARB_OBS4_CHNL2_STATUS_ADDR A:0xe640108
y.create.l HWIO_PMIC_ARB_OBS4_CHNL3_STATUS_ADDR A:0xe640188
y.create.l HWIO_PMIC_ARB_OBS5_CHNL0_STATUS_ADDR A:0xe650008
y.create.l HWIO_PMIC_ARB_OBS5_CHNL1_STATUS_ADDR A:0xe650088
y.create.l HWIO_PMIC_ARB_OBS5_CHNL2_STATUS_ADDR A:0xe650108
y.create.l HWIO_PMIC_ARB_OBS5_CHNL3_STATUS_ADDR A:0xe650188
y.create.l HWIO_PMIC_ARB_OBS6_CHNL0_STATUS_ADDR A:0xe660008
y.create.l HWIO_PMIC_ARB_OBS6_CHNL1_STATUS_ADDR A:0xe660088
y.create.l HWIO_PMIC_ARB_OBS6_CHNL2_STATUS_ADDR A:0xe660108
y.create.l HWIO_PMIC_ARB_OBS6_CHNL3_STATUS_ADDR A:0xe660188
y.create.l HWIO_PMIC_ARB_OBS0_CHNL0_RDATA0_ADDR A:0xe600018
y.create.l HWIO_PMIC_ARB_OBS0_CHNL1_RDATA0_ADDR A:0xe600098
y.create.l HWIO_PMIC_ARB_OBS0_CHNL2_RDATA0_ADDR A:0xe600118
y.create.l HWIO_PMIC_ARB_OBS0_CHNL3_RDATA0_ADDR A:0xe600198
y.create.l HWIO_PMIC_ARB_OBS1_CHNL0_RDATA0_ADDR A:0xe610018
y.create.l HWIO_PMIC_ARB_OBS1_CHNL1_RDATA0_ADDR A:0xe610098
y.create.l HWIO_PMIC_ARB_OBS1_CHNL2_RDATA0_ADDR A:0xe610118
y.create.l HWIO_PMIC_ARB_OBS1_CHNL3_RDATA0_ADDR A:0xe610198
y.create.l HWIO_PMIC_ARB_OBS2_CHNL0_RDATA0_ADDR A:0xe620018
y.create.l HWIO_PMIC_ARB_OBS2_CHNL1_RDATA0_ADDR A:0xe620098
y.create.l HWIO_PMIC_ARB_OBS2_CHNL2_RDATA0_ADDR A:0xe620118
y.create.l HWIO_PMIC_ARB_OBS2_CHNL3_RDATA0_ADDR A:0xe620198
y.create.l HWIO_PMIC_ARB_OBS3_CHNL0_RDATA0_ADDR A:0xe630018
y.create.l HWIO_PMIC_ARB_OBS3_CHNL1_RDATA0_ADDR A:0xe630098
y.create.l HWIO_PMIC_ARB_OBS3_CHNL2_RDATA0_ADDR A:0xe630118
y.create.l HWIO_PMIC_ARB_OBS3_CHNL3_RDATA0_ADDR A:0xe630198
y.create.l HWIO_PMIC_ARB_OBS4_CHNL0_RDATA0_ADDR A:0xe640018
y.create.l HWIO_PMIC_ARB_OBS4_CHNL1_RDATA0_ADDR A:0xe640098
y.create.l HWIO_PMIC_ARB_OBS4_CHNL2_RDATA0_ADDR A:0xe640118
y.create.l HWIO_PMIC_ARB_OBS4_CHNL3_RDATA0_ADDR A:0xe640198
y.create.l HWIO_PMIC_ARB_OBS5_CHNL0_RDATA0_ADDR A:0xe650018
y.create.l HWIO_PMIC_ARB_OBS5_CHNL1_RDATA0_ADDR A:0xe650098
y.create.l HWIO_PMIC_ARB_OBS5_CHNL2_RDATA0_ADDR A:0xe650118
y.create.l HWIO_PMIC_ARB_OBS5_CHNL3_RDATA0_ADDR A:0xe650198
y.create.l HWIO_PMIC_ARB_OBS6_CHNL0_RDATA0_ADDR A:0xe660018
y.create.l HWIO_PMIC_ARB_OBS6_CHNL1_RDATA0_ADDR A:0xe660098
y.create.l HWIO_PMIC_ARB_OBS6_CHNL2_RDATA0_ADDR A:0xe660118
y.create.l HWIO_PMIC_ARB_OBS6_CHNL3_RDATA0_ADDR A:0xe660198
y.create.l HWIO_PMIC_ARB_OBS0_CHNL0_RDATA1_ADDR A:0xe60001c
y.create.l HWIO_PMIC_ARB_OBS0_CHNL1_RDATA1_ADDR A:0xe60009c
y.create.l HWIO_PMIC_ARB_OBS0_CHNL2_RDATA1_ADDR A:0xe60011c
y.create.l HWIO_PMIC_ARB_OBS0_CHNL3_RDATA1_ADDR A:0xe60019c
y.create.l HWIO_PMIC_ARB_OBS1_CHNL0_RDATA1_ADDR A:0xe61001c
y.create.l HWIO_PMIC_ARB_OBS1_CHNL1_RDATA1_ADDR A:0xe61009c
y.create.l HWIO_PMIC_ARB_OBS1_CHNL2_RDATA1_ADDR A:0xe61011c
y.create.l HWIO_PMIC_ARB_OBS1_CHNL3_RDATA1_ADDR A:0xe61019c
y.create.l HWIO_PMIC_ARB_OBS2_CHNL0_RDATA1_ADDR A:0xe62001c
y.create.l HWIO_PMIC_ARB_OBS2_CHNL1_RDATA1_ADDR A:0xe62009c
y.create.l HWIO_PMIC_ARB_OBS2_CHNL2_RDATA1_ADDR A:0xe62011c
y.create.l HWIO_PMIC_ARB_OBS2_CHNL3_RDATA1_ADDR A:0xe62019c
y.create.l HWIO_PMIC_ARB_OBS3_CHNL0_RDATA1_ADDR A:0xe63001c
y.create.l HWIO_PMIC_ARB_OBS3_CHNL1_RDATA1_ADDR A:0xe63009c
y.create.l HWIO_PMIC_ARB_OBS3_CHNL2_RDATA1_ADDR A:0xe63011c
y.create.l HWIO_PMIC_ARB_OBS3_CHNL3_RDATA1_ADDR A:0xe63019c
y.create.l HWIO_PMIC_ARB_OBS4_CHNL0_RDATA1_ADDR A:0xe64001c
y.create.l HWIO_PMIC_ARB_OBS4_CHNL1_RDATA1_ADDR A:0xe64009c
y.create.l HWIO_PMIC_ARB_OBS4_CHNL2_RDATA1_ADDR A:0xe64011c
y.create.l HWIO_PMIC_ARB_OBS4_CHNL3_RDATA1_ADDR A:0xe64019c
y.create.l HWIO_PMIC_ARB_OBS5_CHNL0_RDATA1_ADDR A:0xe65001c
y.create.l HWIO_PMIC_ARB_OBS5_CHNL1_RDATA1_ADDR A:0xe65009c
y.create.l HWIO_PMIC_ARB_OBS5_CHNL2_RDATA1_ADDR A:0xe65011c
y.create.l HWIO_PMIC_ARB_OBS5_CHNL3_RDATA1_ADDR A:0xe65019c
y.create.l HWIO_PMIC_ARB_OBS6_CHNL0_RDATA1_ADDR A:0xe66001c
y.create.l HWIO_PMIC_ARB_OBS6_CHNL1_RDATA1_ADDR A:0xe66009c
y.create.l HWIO_PMIC_ARB_OBS6_CHNL2_RDATA1_ADDR A:0xe66011c
y.create.l HWIO_PMIC_ARB_OBS6_CHNL3_RDATA1_ADDR A:0xe66019c
y.create.l HWIO_OBSCHAN0_PROTOCOL_IRQ_STATUS0_ADDR A:0xe60002c
y.create.l HWIO_OBSCHAN0_PROTOCOL_IRQ_STATUS1_ADDR A:0xe6000ac
y.create.l HWIO_OBSCHAN0_PROTOCOL_IRQ_STATUS2_ADDR A:0xe60012c
y.create.l HWIO_OBSCHAN0_PROTOCOL_IRQ_STATUS3_ADDR A:0xe6001ac
y.create.l HWIO_OBSCHAN1_PROTOCOL_IRQ_STATUS0_ADDR A:0xe61002c
y.create.l HWIO_OBSCHAN1_PROTOCOL_IRQ_STATUS1_ADDR A:0xe6100ac
y.create.l HWIO_OBSCHAN1_PROTOCOL_IRQ_STATUS2_ADDR A:0xe61012c
y.create.l HWIO_OBSCHAN1_PROTOCOL_IRQ_STATUS3_ADDR A:0xe6101ac
y.create.l HWIO_OBSCHAN2_PROTOCOL_IRQ_STATUS0_ADDR A:0xe62002c
y.create.l HWIO_OBSCHAN2_PROTOCOL_IRQ_STATUS1_ADDR A:0xe6200ac
y.create.l HWIO_OBSCHAN2_PROTOCOL_IRQ_STATUS2_ADDR A:0xe62012c
y.create.l HWIO_OBSCHAN2_PROTOCOL_IRQ_STATUS3_ADDR A:0xe6201ac
y.create.l HWIO_OBSCHAN3_PROTOCOL_IRQ_STATUS0_ADDR A:0xe63002c
y.create.l HWIO_OBSCHAN3_PROTOCOL_IRQ_STATUS1_ADDR A:0xe6300ac
y.create.l HWIO_OBSCHAN3_PROTOCOL_IRQ_STATUS2_ADDR A:0xe63012c
y.create.l HWIO_OBSCHAN3_PROTOCOL_IRQ_STATUS3_ADDR A:0xe6301ac
y.create.l HWIO_OBSCHAN4_PROTOCOL_IRQ_STATUS0_ADDR A:0xe64002c
y.create.l HWIO_OBSCHAN4_PROTOCOL_IRQ_STATUS1_ADDR A:0xe6400ac
y.create.l HWIO_OBSCHAN4_PROTOCOL_IRQ_STATUS2_ADDR A:0xe64012c
y.create.l HWIO_OBSCHAN4_PROTOCOL_IRQ_STATUS3_ADDR A:0xe6401ac
y.create.l HWIO_OBSCHAN5_PROTOCOL_IRQ_STATUS0_ADDR A:0xe65002c
y.create.l HWIO_OBSCHAN5_PROTOCOL_IRQ_STATUS1_ADDR A:0xe6500ac
y.create.l HWIO_OBSCHAN5_PROTOCOL_IRQ_STATUS2_ADDR A:0xe65012c
y.create.l HWIO_OBSCHAN5_PROTOCOL_IRQ_STATUS3_ADDR A:0xe6501ac
y.create.l HWIO_OBSCHAN6_PROTOCOL_IRQ_STATUS0_ADDR A:0xe66002c
y.create.l HWIO_OBSCHAN6_PROTOCOL_IRQ_STATUS1_ADDR A:0xe6600ac
y.create.l HWIO_OBSCHAN6_PROTOCOL_IRQ_STATUS2_ADDR A:0xe66012c
y.create.l HWIO_OBSCHAN6_PROTOCOL_IRQ_STATUS3_ADDR A:0xe6601ac
y.create.l HWIO_PMIC_ARB_OBS0_ACCESS0_ADDR A:0xc450000
y.create.l HWIO_PMIC_ARB_OBS0_ACCESS1_ADDR A:0xc450004
y.create.l HWIO_PMIC_ARB_OBS0_ACCESS2_ADDR A:0xc450008
y.create.l HWIO_PMIC_ARB_OBS0_ACCESS3_ADDR A:0xc45000c
y.create.l HWIO_PMIC_ARB_OBS1_ACCESS0_ADDR A:0xc450040
y.create.l HWIO_PMIC_ARB_OBS1_ACCESS1_ADDR A:0xc450044
y.create.l HWIO_PMIC_ARB_OBS1_ACCESS2_ADDR A:0xc450048
y.create.l HWIO_PMIC_ARB_OBS1_ACCESS3_ADDR A:0xc45004c
y.create.l HWIO_PMIC_ARB_OBS2_ACCESS0_ADDR A:0xc450080
y.create.l HWIO_PMIC_ARB_OBS2_ACCESS1_ADDR A:0xc450084
y.create.l HWIO_PMIC_ARB_OBS2_ACCESS2_ADDR A:0xc450088
y.create.l HWIO_PMIC_ARB_OBS2_ACCESS3_ADDR A:0xc45008c
y.create.l HWIO_PMIC_ARB_OBS3_ACCESS0_ADDR A:0xc4500c0
y.create.l HWIO_PMIC_ARB_OBS3_ACCESS1_ADDR A:0xc4500c4
y.create.l HWIO_PMIC_ARB_OBS3_ACCESS2_ADDR A:0xc4500c8
y.create.l HWIO_PMIC_ARB_OBS3_ACCESS3_ADDR A:0xc4500cc
y.create.l HWIO_PMIC_ARB_OBS4_ACCESS0_ADDR A:0xc450100
y.create.l HWIO_PMIC_ARB_OBS4_ACCESS1_ADDR A:0xc450104
y.create.l HWIO_PMIC_ARB_OBS4_ACCESS2_ADDR A:0xc450108
y.create.l HWIO_PMIC_ARB_OBS4_ACCESS3_ADDR A:0xc45010c
y.create.l HWIO_PMIC_ARB_OBS5_ACCESS0_ADDR A:0xc450140
y.create.l HWIO_PMIC_ARB_OBS5_ACCESS1_ADDR A:0xc450144
y.create.l HWIO_PMIC_ARB_OBS5_ACCESS2_ADDR A:0xc450148
y.create.l HWIO_PMIC_ARB_OBS5_ACCESS3_ADDR A:0xc45014c
y.create.l HWIO_PMIC_ARB_OBS6_ACCESS0_ADDR A:0xc450180
y.create.l HWIO_PMIC_ARB_OBS6_ACCESS1_ADDR A:0xc450184
y.create.l HWIO_PMIC_ARB_OBS6_ACCESS2_ADDR A:0xc450188
y.create.l HWIO_PMIC_ARB_OBS6_ACCESS3_ADDR A:0xc45018c
y.create.done
