
local &file
entry &infile
if "&infile"!=""
(
  &file="&infile"
)
else
(
  &file="c:\temp\hwiosave.xml"
)
print "Reading register values..."
OPEN #1 &file /Create

WRITE #1 "<?xml version='1.0' encoding='utf-8'?>"
WRITE #1 "<!-- This log file can be parsed at http://ipcatalog/swi/dump/parser -->"
WRITE #1 "<hwioDump version='1'>"
WRITE #1 "    <timestamp>" clock.date() " " clock.time() "</timestamp>"
WRITE #1 "    <generator>Trace32</generator>"
WRITE #1 "    <chip name='napali_1.0' version='napali_v1.0_p3q1r48.1.0_MTO_partitioned_rtl'>"
WRITE #1 "        <register address='0xb290000' value='0x" DATA.LONG(EZAXI:0xb290000) "' name='RPMH_PDC_DISPLAY_VOTE_CMP_DATA_DRV0'/>"
WRITE #1 "        <register address='0xb291000' value='0x" DATA.LONG(EZAXI:0xb291000) "' name='RPMH_PDC_DISPLAY_PDC_VERSION_DRV0'/>"
WRITE #1 "        <register address='0xb291004' value='0x" DATA.LONG(EZAXI:0xb291004) "' name='RPMH_PDC_DISPLAY_PDC_PARAM_RESOURCE_DRV0'/>"
WRITE #1 "        <register address='0xb291008' value='0x" DATA.LONG(EZAXI:0xb291008) "' name='RPMH_PDC_DISPLAY_PDC_PARAM_SEQ_CONFIG_DRV0'/>"
WRITE #1 "        <register address='0xb29100c' value='0x" DATA.LONG(EZAXI:0xb29100c) "' name='RPMH_PDC_DISPLAY_PDC_PARAM_IRQ_CONFIG_DRV0'/>"
WRITE #1 "        <register address='0xb291020' value='0x" DATA.LONG(EZAXI:0xb291020) "' name='RPMH_PDC_DISPLAY_SEQ_BUSY_DRV0'/>"
WRITE #1 "        <register address='0xb291024' value='0x" DATA.LONG(EZAXI:0xb291024) "' name='RPMH_PDC_DISPLAY_SEQ_DBG_PROGRAM_COUNTER_DRV0'/>"
WRITE #1 "        <register address='0xb291028' value='0x" DATA.LONG(EZAXI:0xb291028) "' name='RPMH_PDC_DISPLAY_SEQ_DBG_STAT_DRV0'/>"
WRITE #1 "        <register address='0xb29102c' value='0x" DATA.LONG(EZAXI:0xb29102c) "' name='RPMH_PDC_DISPLAY_SEQ_DBG_WAIT_EVNT_DRV0'/>"
WRITE #1 "        <register address='0xb291030' value='0x" DATA.LONG(EZAXI:0xb291030) "' name='RPMH_PDC_DISPLAY_PDC_MODE_STATUS_DRV0'/>"
WRITE #1 "        <register address='0xb291034' value='0x" DATA.LONG(EZAXI:0xb291034) "' name='RPMH_PDC_DISPLAY_DBG_EPCB_RX_ADDR0'/>"
WRITE #1 "        <register address='0xb291038' value='0x" DATA.LONG(EZAXI:0xb291038) "' name='RPMH_PDC_DISPLAY_DBG_EPCB_RX_DATA0'/>"
WRITE #1 "        <register address='0xb291200' value='0x" DATA.LONG(EZAXI:0xb291200) "' name='RPMH_PDC_DISPLAY_PROFILING_UNIT0_DRV0_OUTPUT'/>"
WRITE #1 "        <register address='0xb291214' value='0x" DATA.LONG(EZAXI:0xb291214) "' name='RPMH_PDC_DISPLAY_PROFILING_UNIT1_DRV0_OUTPUT'/>"
WRITE #1 "        <register address='0xb291228' value='0x" DATA.LONG(EZAXI:0xb291228) "' name='RPMH_PDC_DISPLAY_PROFILING_UNIT2_DRV0_OUTPUT'/>"
WRITE #1 "        <register address='0xb29123c' value='0x" DATA.LONG(EZAXI:0xb29123c) "' name='RPMH_PDC_DISPLAY_PROFILING_UNIT3_DRV0_OUTPUT'/>"
WRITE #1 "        <register address='0xb291250' value='0x" DATA.LONG(EZAXI:0xb291250) "' name='RPMH_PDC_DISPLAY_PROFILING_UNIT4_DRV0_OUTPUT'/>"
WRITE #1 "        <register address='0xb291204' value='0x" DATA.LONG(EZAXI:0xb291204) "' name='RPMH_PDC_DISPLAY_PROFILING_UNIT0_DRV0_TIMESTAMP_LO'/>"
WRITE #1 "        <register address='0xb291218' value='0x" DATA.LONG(EZAXI:0xb291218) "' name='RPMH_PDC_DISPLAY_PROFILING_UNIT1_DRV0_TIMESTAMP_LO'/>"
WRITE #1 "        <register address='0xb29122c' value='0x" DATA.LONG(EZAXI:0xb29122c) "' name='RPMH_PDC_DISPLAY_PROFILING_UNIT2_DRV0_TIMESTAMP_LO'/>"
WRITE #1 "        <register address='0xb291240' value='0x" DATA.LONG(EZAXI:0xb291240) "' name='RPMH_PDC_DISPLAY_PROFILING_UNIT3_DRV0_TIMESTAMP_LO'/>"
WRITE #1 "        <register address='0xb291254' value='0x" DATA.LONG(EZAXI:0xb291254) "' name='RPMH_PDC_DISPLAY_PROFILING_UNIT4_DRV0_TIMESTAMP_LO'/>"
WRITE #1 "        <register address='0xb291208' value='0x" DATA.LONG(EZAXI:0xb291208) "' name='RPMH_PDC_DISPLAY_PROFILING_UNIT0_DRV0_TIMESTAMP_HI'/>"
WRITE #1 "        <register address='0xb29121c' value='0x" DATA.LONG(EZAXI:0xb29121c) "' name='RPMH_PDC_DISPLAY_PROFILING_UNIT1_DRV0_TIMESTAMP_HI'/>"
WRITE #1 "        <register address='0xb291230' value='0x" DATA.LONG(EZAXI:0xb291230) "' name='RPMH_PDC_DISPLAY_PROFILING_UNIT2_DRV0_TIMESTAMP_HI'/>"
WRITE #1 "        <register address='0xb291244' value='0x" DATA.LONG(EZAXI:0xb291244) "' name='RPMH_PDC_DISPLAY_PROFILING_UNIT3_DRV0_TIMESTAMP_HI'/>"
WRITE #1 "        <register address='0xb291258' value='0x" DATA.LONG(EZAXI:0xb291258) "' name='RPMH_PDC_DISPLAY_PROFILING_UNIT4_DRV0_TIMESTAMP_HI'/>"
WRITE #1 "        <register address='0xb291300' value='0x" DATA.LONG(EZAXI:0xb291300) "' name='RPMH_PDC_DISPLAY_TCS0_DRV0_STATUS'/>"
WRITE #1 "        <register address='0xb2913c8' value='0x" DATA.LONG(EZAXI:0xb2913c8) "' name='RPMH_PDC_DISPLAY_TCS1_DRV0_STATUS'/>"
WRITE #1 "        <register address='0xb291490' value='0x" DATA.LONG(EZAXI:0xb291490) "' name='RPMH_PDC_DISPLAY_TCS2_DRV0_STATUS'/>"
WRITE #1 "        <register address='0xb291304' value='0x" DATA.LONG(EZAXI:0xb291304) "' name='RPMH_PDC_DISPLAY_TCS0_CMD0_DRV0_STATUS'/>"
WRITE #1 "        <register address='0xb29130c' value='0x" DATA.LONG(EZAXI:0xb29130c) "' name='RPMH_PDC_DISPLAY_TCS0_CMD1_DRV0_STATUS'/>"
WRITE #1 "        <register address='0xb291314' value='0x" DATA.LONG(EZAXI:0xb291314) "' name='RPMH_PDC_DISPLAY_TCS0_CMD2_DRV0_STATUS'/>"
WRITE #1 "        <register address='0xb29131c' value='0x" DATA.LONG(EZAXI:0xb29131c) "' name='RPMH_PDC_DISPLAY_TCS0_CMD3_DRV0_STATUS'/>"
WRITE #1 "        <register address='0xb2913cc' value='0x" DATA.LONG(EZAXI:0xb2913cc) "' name='RPMH_PDC_DISPLAY_TCS1_CMD0_DRV0_STATUS'/>"
WRITE #1 "        <register address='0xb2913d4' value='0x" DATA.LONG(EZAXI:0xb2913d4) "' name='RPMH_PDC_DISPLAY_TCS1_CMD1_DRV0_STATUS'/>"
WRITE #1 "        <register address='0xb2913dc' value='0x" DATA.LONG(EZAXI:0xb2913dc) "' name='RPMH_PDC_DISPLAY_TCS1_CMD2_DRV0_STATUS'/>"
WRITE #1 "        <register address='0xb2913e4' value='0x" DATA.LONG(EZAXI:0xb2913e4) "' name='RPMH_PDC_DISPLAY_TCS1_CMD3_DRV0_STATUS'/>"
WRITE #1 "        <register address='0xb291494' value='0x" DATA.LONG(EZAXI:0xb291494) "' name='RPMH_PDC_DISPLAY_TCS2_CMD0_DRV0_STATUS'/>"
WRITE #1 "        <register address='0xb29149c' value='0x" DATA.LONG(EZAXI:0xb29149c) "' name='RPMH_PDC_DISPLAY_TCS2_CMD1_DRV0_STATUS'/>"
WRITE #1 "        <register address='0xb2914a4' value='0x" DATA.LONG(EZAXI:0xb2914a4) "' name='RPMH_PDC_DISPLAY_TCS2_CMD2_DRV0_STATUS'/>"
WRITE #1 "        <register address='0xb2914ac' value='0x" DATA.LONG(EZAXI:0xb2914ac) "' name='RPMH_PDC_DISPLAY_TCS2_CMD3_DRV0_STATUS'/>"
WRITE #1 "        <register address='0xb291308' value='0x" DATA.LONG(EZAXI:0xb291308) "' name='RPMH_PDC_DISPLAY_TCS0_CMD0_DRV0_READ_RESPONSE_DATA'/>"
WRITE #1 "        <register address='0xb291310' value='0x" DATA.LONG(EZAXI:0xb291310) "' name='RPMH_PDC_DISPLAY_TCS0_CMD1_DRV0_READ_RESPONSE_DATA'/>"
WRITE #1 "        <register address='0xb291318' value='0x" DATA.LONG(EZAXI:0xb291318) "' name='RPMH_PDC_DISPLAY_TCS0_CMD2_DRV0_READ_RESPONSE_DATA'/>"
WRITE #1 "        <register address='0xb291320' value='0x" DATA.LONG(EZAXI:0xb291320) "' name='RPMH_PDC_DISPLAY_TCS0_CMD3_DRV0_READ_RESPONSE_DATA'/>"
WRITE #1 "        <register address='0xb2913d0' value='0x" DATA.LONG(EZAXI:0xb2913d0) "' name='RPMH_PDC_DISPLAY_TCS1_CMD0_DRV0_READ_RESPONSE_DATA'/>"
WRITE #1 "        <register address='0xb2913d8' value='0x" DATA.LONG(EZAXI:0xb2913d8) "' name='RPMH_PDC_DISPLAY_TCS1_CMD1_DRV0_READ_RESPONSE_DATA'/>"
WRITE #1 "        <register address='0xb2913e0' value='0x" DATA.LONG(EZAXI:0xb2913e0) "' name='RPMH_PDC_DISPLAY_TCS1_CMD2_DRV0_READ_RESPONSE_DATA'/>"
WRITE #1 "        <register address='0xb2913e8' value='0x" DATA.LONG(EZAXI:0xb2913e8) "' name='RPMH_PDC_DISPLAY_TCS1_CMD3_DRV0_READ_RESPONSE_DATA'/>"
WRITE #1 "        <register address='0xb291498' value='0x" DATA.LONG(EZAXI:0xb291498) "' name='RPMH_PDC_DISPLAY_TCS2_CMD0_DRV0_READ_RESPONSE_DATA'/>"
WRITE #1 "        <register address='0xb2914a0' value='0x" DATA.LONG(EZAXI:0xb2914a0) "' name='RPMH_PDC_DISPLAY_TCS2_CMD1_DRV0_READ_RESPONSE_DATA'/>"
WRITE #1 "        <register address='0xb2914a8' value='0x" DATA.LONG(EZAXI:0xb2914a8) "' name='RPMH_PDC_DISPLAY_TCS2_CMD2_DRV0_READ_RESPONSE_DATA'/>"
WRITE #1 "        <register address='0xb2914b0' value='0x" DATA.LONG(EZAXI:0xb2914b0) "' name='RPMH_PDC_DISPLAY_TCS2_CMD3_DRV0_READ_RESPONSE_DATA'/>"
WRITE #1 "        <register address='0xb294500' value='0x" DATA.LONG(EZAXI:0xb294500) "' name='RPMH_PDC_DISPLAY_ENABLE_PDC'/>"
WRITE #1 "        <register address='0xb294510' value='0x" DATA.LONG(EZAXI:0xb294510) "' name='RPMH_PDC_DISPLAY_TIMER_MATCH_VALUE_LO'/>"
WRITE #1 "        <register address='0xb294514' value='0x" DATA.LONG(EZAXI:0xb294514) "' name='RPMH_PDC_DISPLAY_TIMER_MATCH_VALUE_HI'/>"
WRITE #1 "        <register address='0xb294518' value='0x" DATA.LONG(EZAXI:0xb294518) "' name='RPMH_PDC_DISPLAY_TIMER_DISABLED_FOR_ARC'/>"
WRITE #1 "        <register address='0xb294520' value='0x" DATA.LONG(EZAXI:0xb294520) "' name='RPMH_PDC_DISPLAY_SEQ_START_ADDR'/>"
WRITE #1 "        <register address='0xb294524' value='0x" DATA.LONG(EZAXI:0xb294524) "' name='RPMH_PDC_DISPLAY_SEQ_OVERRIDE_START_ADDR'/>"
WRITE #1 "        <register address='0xb29452c' value='0x" DATA.LONG(EZAXI:0xb29452c) "' name='RPMH_PDC_DISPLAY_SEQ_OVERRIDE_TRIGGER'/>"
WRITE #1 "        <register address='0xb294530' value='0x" DATA.LONG(EZAXI:0xb294530) "' name='RPMH_PDC_DISPLAY_SEQ_PWR_CTRL_OVERRIDE_MASK'/>"
WRITE #1 "        <register address='0xb294534' value='0x" DATA.LONG(EZAXI:0xb294534) "' name='RPMH_PDC_DISPLAY_SEQ_PWR_CTRL_OVERRIDE_VAL'/>"
WRITE #1 "        <register address='0xb294540' value='0x" DATA.LONG(EZAXI:0xb294540) "' name='RPMH_PDC_DISPLAY_SEQ_WAIT_EVENT_OVERRIDE_MASK'/>"
WRITE #1 "        <register address='0xb294544' value='0x" DATA.LONG(EZAXI:0xb294544) "' name='RPMH_PDC_DISPLAY_SEQ_WAIT_EVENT_OVERRIDE_VAL'/>"
WRITE #1 "        <register address='0xb294550' value='0x" DATA.LONG(EZAXI:0xb294550) "' name='RPMH_PDC_DISPLAY_SEQ_BR_EVENT_OVERRIDE_MASK'/>"
WRITE #1 "        <register address='0xb294554' value='0x" DATA.LONG(EZAXI:0xb294554) "' name='RPMH_PDC_DISPLAY_SEQ_BR_EVENT_OVERRIDE_VAL'/>"
WRITE #1 "        <register address='0xb294590' value='0x" DATA.LONG(EZAXI:0xb294590) "' name='RPMH_PDC_DISPLAY_SEQ_CFG_BR_ADDR_0'/>"
WRITE #1 "        <register address='0xb294594' value='0x" DATA.LONG(EZAXI:0xb294594) "' name='RPMH_PDC_DISPLAY_SEQ_CFG_BR_ADDR_1'/>"
WRITE #1 "        <register address='0xb294598' value='0x" DATA.LONG(EZAXI:0xb294598) "' name='RPMH_PDC_DISPLAY_SEQ_CFG_BR_ADDR_2'/>"
WRITE #1 "        <register address='0xb29459c' value='0x" DATA.LONG(EZAXI:0xb29459c) "' name='RPMH_PDC_DISPLAY_SEQ_CFG_BR_ADDR_3'/>"
WRITE #1 "        <register address='0xb2945a0' value='0x" DATA.LONG(EZAXI:0xb2945a0) "' name='RPMH_PDC_DISPLAY_SEQ_CFG_DELAY_VAL_0'/>"
WRITE #1 "        <register address='0xb2945a4' value='0x" DATA.LONG(EZAXI:0xb2945a4) "' name='RPMH_PDC_DISPLAY_SEQ_CFG_DELAY_VAL_1'/>"
WRITE #1 "        <register address='0xb2945a8' value='0x" DATA.LONG(EZAXI:0xb2945a8) "' name='RPMH_PDC_DISPLAY_SEQ_CFG_DELAY_VAL_2'/>"
WRITE #1 "        <register address='0xb2945ac' value='0x" DATA.LONG(EZAXI:0xb2945ac) "' name='RPMH_PDC_DISPLAY_SEQ_CFG_DELAY_VAL_3'/>"
WRITE #1 "        <register address='0xb2945b0' value='0x" DATA.LONG(EZAXI:0xb2945b0) "' name='RPMH_PDC_DISPLAY_SEQ_CFG_DELAY_VAL_4'/>"
WRITE #1 "        <register address='0xb2945b4' value='0x" DATA.LONG(EZAXI:0xb2945b4) "' name='RPMH_PDC_DISPLAY_SEQ_CFG_DELAY_VAL_5'/>"
WRITE #1 "        <register address='0xb2945b8' value='0x" DATA.LONG(EZAXI:0xb2945b8) "' name='RPMH_PDC_DISPLAY_SEQ_CFG_DELAY_VAL_6'/>"
WRITE #1 "        <register address='0xb2945bc' value='0x" DATA.LONG(EZAXI:0xb2945bc) "' name='RPMH_PDC_DISPLAY_SEQ_CFG_DELAY_VAL_7'/>"
WRITE #1 "        <register address='0xb2945c0' value='0x" DATA.LONG(EZAXI:0xb2945c0) "' name='RPMH_PDC_DISPLAY_SEQ_CFG_DELAY_VAL_8'/>"
WRITE #1 "        <register address='0xb2945c4' value='0x" DATA.LONG(EZAXI:0xb2945c4) "' name='RPMH_PDC_DISPLAY_SEQ_CFG_DELAY_VAL_9'/>"
WRITE #1 "        <register address='0xb2945c8' value='0x" DATA.LONG(EZAXI:0xb2945c8) "' name='RPMH_PDC_DISPLAY_SEQ_CFG_DELAY_VAL_10'/>"
WRITE #1 "        <register address='0xb2945cc' value='0x" DATA.LONG(EZAXI:0xb2945cc) "' name='RPMH_PDC_DISPLAY_SEQ_CFG_DELAY_VAL_11'/>"
WRITE #1 "        <register address='0xb2945d0' value='0x" DATA.LONG(EZAXI:0xb2945d0) "' name='RPMH_PDC_DISPLAY_SEQ_CFG_DELAY_VAL_12'/>"
WRITE #1 "        <register address='0xb2945d4' value='0x" DATA.LONG(EZAXI:0xb2945d4) "' name='RPMH_PDC_DISPLAY_SEQ_CFG_DELAY_VAL_13'/>"
WRITE #1 "        <register address='0xb2945d8' value='0x" DATA.LONG(EZAXI:0xb2945d8) "' name='RPMH_PDC_DISPLAY_SEQ_CFG_DELAY_VAL_14'/>"
WRITE #1 "        <register address='0xb2945dc' value='0x" DATA.LONG(EZAXI:0xb2945dc) "' name='RPMH_PDC_DISPLAY_SEQ_CFG_DELAY_VAL_15'/>"
WRITE #1 "        <register address='0xb2945e0' value='0x" DATA.LONG(EZAXI:0xb2945e0) "' name='RPMH_PDC_DISPLAY_SEQ_DBG_BREAKPOINT_ADDR'/>"
WRITE #1 "        <register address='0xb2945e4' value='0x" DATA.LONG(EZAXI:0xb2945e4) "' name='RPMH_PDC_DISPLAY_SEQ_DBG_STEP'/>"
WRITE #1 "        <register address='0xb295000' value='0x" DATA.LONG(EZAXI:0xb295000) "' name='RPMH_PDC_DISPLAY_PROFILING_UNIT0_EN'/>"
WRITE #1 "        <register address='0xb295014' value='0x" DATA.LONG(EZAXI:0xb295014) "' name='RPMH_PDC_DISPLAY_PROFILING_UNIT1_EN'/>"
WRITE #1 "        <register address='0xb295028' value='0x" DATA.LONG(EZAXI:0xb295028) "' name='RPMH_PDC_DISPLAY_PROFILING_UNIT2_EN'/>"
WRITE #1 "        <register address='0xb29503c' value='0x" DATA.LONG(EZAXI:0xb29503c) "' name='RPMH_PDC_DISPLAY_PROFILING_UNIT3_EN'/>"
WRITE #1 "        <register address='0xb295050' value='0x" DATA.LONG(EZAXI:0xb295050) "' name='RPMH_PDC_DISPLAY_PROFILING_UNIT4_EN'/>"
WRITE #1 "        <register address='0xb295500' value='0x" DATA.LONG(EZAXI:0xb295500) "' name='RPMH_PDC_DISPLAY_TCS0_CONTROL'/>"
WRITE #1 "        <register address='0xb2955c8' value='0x" DATA.LONG(EZAXI:0xb2955c8) "' name='RPMH_PDC_DISPLAY_TCS1_CONTROL'/>"
WRITE #1 "        <register address='0xb295690' value='0x" DATA.LONG(EZAXI:0xb295690) "' name='RPMH_PDC_DISPLAY_TCS2_CONTROL'/>"
WRITE #1 "        <register address='0xb295504' value='0x" DATA.LONG(EZAXI:0xb295504) "' name='RPMH_PDC_DISPLAY_TCS0_CMD_ENABLE_BANK'/>"
WRITE #1 "        <register address='0xb2955cc' value='0x" DATA.LONG(EZAXI:0xb2955cc) "' name='RPMH_PDC_DISPLAY_TCS1_CMD_ENABLE_BANK'/>"
WRITE #1 "        <register address='0xb295694' value='0x" DATA.LONG(EZAXI:0xb295694) "' name='RPMH_PDC_DISPLAY_TCS2_CMD_ENABLE_BANK'/>"
WRITE #1 "        <register address='0xb295508' value='0x" DATA.LONG(EZAXI:0xb295508) "' name='RPMH_PDC_DISPLAY_TCS0_CMD_WAIT_FOR_CMPL_BANK'/>"
WRITE #1 "        <register address='0xb2955d0' value='0x" DATA.LONG(EZAXI:0xb2955d0) "' name='RPMH_PDC_DISPLAY_TCS1_CMD_WAIT_FOR_CMPL_BANK'/>"
WRITE #1 "        <register address='0xb295698' value='0x" DATA.LONG(EZAXI:0xb295698) "' name='RPMH_PDC_DISPLAY_TCS2_CMD_WAIT_FOR_CMPL_BANK'/>"
WRITE #1 "        <register address='0xb29550c' value='0x" DATA.LONG(EZAXI:0xb29550c) "' name='RPMH_PDC_DISPLAY_TCS0_CMD0_MSGID'/>"
WRITE #1 "        <register address='0xb29551c' value='0x" DATA.LONG(EZAXI:0xb29551c) "' name='RPMH_PDC_DISPLAY_TCS0_CMD1_MSGID'/>"
WRITE #1 "        <register address='0xb29552c' value='0x" DATA.LONG(EZAXI:0xb29552c) "' name='RPMH_PDC_DISPLAY_TCS0_CMD2_MSGID'/>"
WRITE #1 "        <register address='0xb29553c' value='0x" DATA.LONG(EZAXI:0xb29553c) "' name='RPMH_PDC_DISPLAY_TCS0_CMD3_MSGID'/>"
WRITE #1 "        <register address='0xb2955d4' value='0x" DATA.LONG(EZAXI:0xb2955d4) "' name='RPMH_PDC_DISPLAY_TCS1_CMD0_MSGID'/>"
WRITE #1 "        <register address='0xb2955e4' value='0x" DATA.LONG(EZAXI:0xb2955e4) "' name='RPMH_PDC_DISPLAY_TCS1_CMD1_MSGID'/>"
WRITE #1 "        <register address='0xb2955f4' value='0x" DATA.LONG(EZAXI:0xb2955f4) "' name='RPMH_PDC_DISPLAY_TCS1_CMD2_MSGID'/>"
WRITE #1 "        <register address='0xb295604' value='0x" DATA.LONG(EZAXI:0xb295604) "' name='RPMH_PDC_DISPLAY_TCS1_CMD3_MSGID'/>"
WRITE #1 "        <register address='0xb29569c' value='0x" DATA.LONG(EZAXI:0xb29569c) "' name='RPMH_PDC_DISPLAY_TCS2_CMD0_MSGID'/>"
WRITE #1 "        <register address='0xb2956ac' value='0x" DATA.LONG(EZAXI:0xb2956ac) "' name='RPMH_PDC_DISPLAY_TCS2_CMD1_MSGID'/>"
WRITE #1 "        <register address='0xb2956bc' value='0x" DATA.LONG(EZAXI:0xb2956bc) "' name='RPMH_PDC_DISPLAY_TCS2_CMD2_MSGID'/>"
WRITE #1 "        <register address='0xb2956cc' value='0x" DATA.LONG(EZAXI:0xb2956cc) "' name='RPMH_PDC_DISPLAY_TCS2_CMD3_MSGID'/>"
WRITE #1 "        <register address='0xb295510' value='0x" DATA.LONG(EZAXI:0xb295510) "' name='RPMH_PDC_DISPLAY_TCS0_CMD0_ADDR'/>"
WRITE #1 "        <register address='0xb295520' value='0x" DATA.LONG(EZAXI:0xb295520) "' name='RPMH_PDC_DISPLAY_TCS0_CMD1_ADDR'/>"
WRITE #1 "        <register address='0xb295530' value='0x" DATA.LONG(EZAXI:0xb295530) "' name='RPMH_PDC_DISPLAY_TCS0_CMD2_ADDR'/>"
WRITE #1 "        <register address='0xb295540' value='0x" DATA.LONG(EZAXI:0xb295540) "' name='RPMH_PDC_DISPLAY_TCS0_CMD3_ADDR'/>"
WRITE #1 "        <register address='0xb2955d8' value='0x" DATA.LONG(EZAXI:0xb2955d8) "' name='RPMH_PDC_DISPLAY_TCS1_CMD0_ADDR'/>"
WRITE #1 "        <register address='0xb2955e8' value='0x" DATA.LONG(EZAXI:0xb2955e8) "' name='RPMH_PDC_DISPLAY_TCS1_CMD1_ADDR'/>"
WRITE #1 "        <register address='0xb2955f8' value='0x" DATA.LONG(EZAXI:0xb2955f8) "' name='RPMH_PDC_DISPLAY_TCS1_CMD2_ADDR'/>"
WRITE #1 "        <register address='0xb295608' value='0x" DATA.LONG(EZAXI:0xb295608) "' name='RPMH_PDC_DISPLAY_TCS1_CMD3_ADDR'/>"
WRITE #1 "        <register address='0xb2956a0' value='0x" DATA.LONG(EZAXI:0xb2956a0) "' name='RPMH_PDC_DISPLAY_TCS2_CMD0_ADDR'/>"
WRITE #1 "        <register address='0xb2956b0' value='0x" DATA.LONG(EZAXI:0xb2956b0) "' name='RPMH_PDC_DISPLAY_TCS2_CMD1_ADDR'/>"
WRITE #1 "        <register address='0xb2956c0' value='0x" DATA.LONG(EZAXI:0xb2956c0) "' name='RPMH_PDC_DISPLAY_TCS2_CMD2_ADDR'/>"
WRITE #1 "        <register address='0xb2956d0' value='0x" DATA.LONG(EZAXI:0xb2956d0) "' name='RPMH_PDC_DISPLAY_TCS2_CMD3_ADDR'/>"
WRITE #1 "        <register address='0xb295514' value='0x" DATA.LONG(EZAXI:0xb295514) "' name='RPMH_PDC_DISPLAY_TCS0_CMD0_DATA'/>"
WRITE #1 "        <register address='0xb295524' value='0x" DATA.LONG(EZAXI:0xb295524) "' name='RPMH_PDC_DISPLAY_TCS0_CMD1_DATA'/>"
WRITE #1 "        <register address='0xb295534' value='0x" DATA.LONG(EZAXI:0xb295534) "' name='RPMH_PDC_DISPLAY_TCS0_CMD2_DATA'/>"
WRITE #1 "        <register address='0xb295544' value='0x" DATA.LONG(EZAXI:0xb295544) "' name='RPMH_PDC_DISPLAY_TCS0_CMD3_DATA'/>"
WRITE #1 "        <register address='0xb2955dc' value='0x" DATA.LONG(EZAXI:0xb2955dc) "' name='RPMH_PDC_DISPLAY_TCS1_CMD0_DATA'/>"
WRITE #1 "        <register address='0xb2955ec' value='0x" DATA.LONG(EZAXI:0xb2955ec) "' name='RPMH_PDC_DISPLAY_TCS1_CMD1_DATA'/>"
WRITE #1 "        <register address='0xb2955fc' value='0x" DATA.LONG(EZAXI:0xb2955fc) "' name='RPMH_PDC_DISPLAY_TCS1_CMD2_DATA'/>"
WRITE #1 "        <register address='0xb29560c' value='0x" DATA.LONG(EZAXI:0xb29560c) "' name='RPMH_PDC_DISPLAY_TCS1_CMD3_DATA'/>"
WRITE #1 "        <register address='0xb2956a4' value='0x" DATA.LONG(EZAXI:0xb2956a4) "' name='RPMH_PDC_DISPLAY_TCS2_CMD0_DATA'/>"
WRITE #1 "        <register address='0xb2956b4' value='0x" DATA.LONG(EZAXI:0xb2956b4) "' name='RPMH_PDC_DISPLAY_TCS2_CMD1_DATA'/>"
WRITE #1 "        <register address='0xb2956c4' value='0x" DATA.LONG(EZAXI:0xb2956c4) "' name='RPMH_PDC_DISPLAY_TCS2_CMD2_DATA'/>"
WRITE #1 "        <register address='0xb2956d4' value='0x" DATA.LONG(EZAXI:0xb2956d4) "' name='RPMH_PDC_DISPLAY_TCS2_CMD3_DATA'/>"
WRITE #1 "        <register address='0xb490000' value='0x" DATA.LONG(EZAXI:0xb490000) "' name='RPMH_PDC_DISPLAY_SEQ_MEM_0'/>"
WRITE #1 "        <register address='0xb490004' value='0x" DATA.LONG(EZAXI:0xb490004) "' name='RPMH_PDC_DISPLAY_SEQ_MEM_1'/>"
WRITE #1 "        <register address='0xb490008' value='0x" DATA.LONG(EZAXI:0xb490008) "' name='RPMH_PDC_DISPLAY_SEQ_MEM_2'/>"
WRITE #1 "        <register address='0xb49000c' value='0x" DATA.LONG(EZAXI:0xb49000c) "' name='RPMH_PDC_DISPLAY_SEQ_MEM_3'/>"
WRITE #1 "        <register address='0xb490010' value='0x" DATA.LONG(EZAXI:0xb490010) "' name='RPMH_PDC_DISPLAY_SEQ_MEM_4'/>"
WRITE #1 "        <register address='0xb490014' value='0x" DATA.LONG(EZAXI:0xb490014) "' name='RPMH_PDC_DISPLAY_SEQ_MEM_5'/>"
WRITE #1 "        <register address='0xb490018' value='0x" DATA.LONG(EZAXI:0xb490018) "' name='RPMH_PDC_DISPLAY_SEQ_MEM_6'/>"
WRITE #1 "        <register address='0xb49001c' value='0x" DATA.LONG(EZAXI:0xb49001c) "' name='RPMH_PDC_DISPLAY_SEQ_MEM_7'/>"
WRITE #1 "        <register address='0xb490020' value='0x" DATA.LONG(EZAXI:0xb490020) "' name='RPMH_PDC_DISPLAY_SEQ_MEM_8'/>"
WRITE #1 "        <register address='0xb490024' value='0x" DATA.LONG(EZAXI:0xb490024) "' name='RPMH_PDC_DISPLAY_SEQ_MEM_9'/>"
WRITE #1 "        <register address='0xb490028' value='0x" DATA.LONG(EZAXI:0xb490028) "' name='RPMH_PDC_DISPLAY_SEQ_MEM_10'/>"
WRITE #1 "        <register address='0xb49002c' value='0x" DATA.LONG(EZAXI:0xb49002c) "' name='RPMH_PDC_DISPLAY_SEQ_MEM_11'/>"
WRITE #1 "        <register address='0xb490030' value='0x" DATA.LONG(EZAXI:0xb490030) "' name='RPMH_PDC_DISPLAY_SEQ_MEM_12'/>"
WRITE #1 "        <register address='0xb490034' value='0x" DATA.LONG(EZAXI:0xb490034) "' name='RPMH_PDC_DISPLAY_SEQ_MEM_13'/>"
WRITE #1 "        <register address='0xb490038' value='0x" DATA.LONG(EZAXI:0xb490038) "' name='RPMH_PDC_DISPLAY_SEQ_MEM_14'/>"
WRITE #1 "        <register address='0xb49003c' value='0x" DATA.LONG(EZAXI:0xb49003c) "' name='RPMH_PDC_DISPLAY_SEQ_MEM_15'/>"
WRITE #1 "        <register address='0xb490040' value='0x" DATA.LONG(EZAXI:0xb490040) "' name='RPMH_PDC_DISPLAY_SEQ_MEM_16'/>"
WRITE #1 "        <register address='0xb490044' value='0x" DATA.LONG(EZAXI:0xb490044) "' name='RPMH_PDC_DISPLAY_SEQ_MEM_17'/>"
WRITE #1 "        <register address='0xb490048' value='0x" DATA.LONG(EZAXI:0xb490048) "' name='RPMH_PDC_DISPLAY_SEQ_MEM_18'/>"
WRITE #1 "        <register address='0xb49004c' value='0x" DATA.LONG(EZAXI:0xb49004c) "' name='RPMH_PDC_DISPLAY_SEQ_MEM_19'/>"
WRITE #1 "        <register address='0xb490050' value='0x" DATA.LONG(EZAXI:0xb490050) "' name='RPMH_PDC_DISPLAY_SEQ_MEM_20'/>"
WRITE #1 "        <register address='0xb490054' value='0x" DATA.LONG(EZAXI:0xb490054) "' name='RPMH_PDC_DISPLAY_SEQ_MEM_21'/>"
WRITE #1 "        <register address='0xb490058' value='0x" DATA.LONG(EZAXI:0xb490058) "' name='RPMH_PDC_DISPLAY_SEQ_MEM_22'/>"
WRITE #1 "        <register address='0xb49005c' value='0x" DATA.LONG(EZAXI:0xb49005c) "' name='RPMH_PDC_DISPLAY_SEQ_MEM_23'/>"
WRITE #1 "    </chip>"
WRITE #1 "</hwioDump>"
CLOSE #1
PRINT "Register data sent to &file"

