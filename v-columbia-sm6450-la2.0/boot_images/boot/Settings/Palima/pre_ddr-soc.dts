// pre_ddr-soc.dts
//
// Container DTS file for specific hardware platform: Palima SoC

/dts-v1/;

/ {
	compatible = "qcom,palima";
	model = "qcom,palima";

	#address-cells = <2>;
	#size-cells = <2>;

	soc: soc {
		#address-cells = <1>;
		#size-cells = <1>;
	};

	sw: sw { };
};

#include "soc_pre-ddr.dtsi"                     /* Common SoC Node Definitions */
