
/dts-v1/;

/ {
    level1 {
        tboolean = <1>;
        fboolean = <0>;
        u64-list = /bits/ 64 <0xFFFFFFFF 0xAAAAAAAA>;
        u32-list = <1 2 3 4 5 6 7 8>;
        u16-list = /bits/ 16 <0x11 0x22 0x33 0x44 0x55 0x66 0x77 0x88>;
        string = "hello world";
        byte-list = [0123456789ABCDEF];
    };
    sw: sw { };
};

&sw {
        boot {
                /*        debug  trace  verbose */
                config = <0x0000 0x0000 0x0001>;
        };
};
