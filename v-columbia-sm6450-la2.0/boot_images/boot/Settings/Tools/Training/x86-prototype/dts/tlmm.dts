
/dts-v1/;

/ {
	model = "Qualcomm Technologies, Inc. Waipio MTP";
	compatible = "qcom,waipio-mtp", "qcom,waipio", "qcom,mtp";
	qcom,board-id = <0x1010>;

	tlmm: tlmm { };

};

#include "lahaina-pinctrl.dtsi"
