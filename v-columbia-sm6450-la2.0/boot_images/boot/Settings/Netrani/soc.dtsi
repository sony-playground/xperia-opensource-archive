// soc.dtsi
//
// Provides Common SoC settings for Netrani

// There should be nothing in this file except #include statements


/* Example of where various TechTeam provided settings files would land */
#include "Core/SMMU/iort.dtsi"
#include "Core/Boot/quantum.dtsi"
#include "../SW/Core/Boot/xbl_minidump_oem_public_key.dtsi"
#include "Core/Buses/I2C/i2c.dtsi"
#include "Core/Buses/SPI/spi.dtsi"
#include "Core/SSR/ssr.dtsi"
#include "Core/PIL/pil.dtsi"
//#include "Core/DAL/dal.dtsi"
#include "Core/HWEngines/BAM/bam.dtsi"
//#include "Core/HWEngines/PCIe/pcie.dtsi"
//#include "Core/HWEngines/TSENS/tsens.dtsi"
//#include "Core/MPROC/SMEM/smem.dtsi"
#include "Core/PMIC/pmic.dtsi"
//#include "Core/Services/services.dtsi"
//#include "Core/SocInfra/Busywait/busywait.dtsi"
//#include "Core/SocInfra/Clock/clock.dtsi"
//#include "Core/SocInfra/HWIO/hwio.dtsi"
//#include "Core/SocInfra/ICB/icb.dtsi"
#include "Core/SocInfra/TLMM/netrani-pinctrl.dtsi"
//#include "Core/Storage/SDCC/sdcc.dtsi"
//#include "Core/Storage/UFS/ufs.dtsi"
#include "Core/WiredConnectivity/USB/usb.dtsi"

//#include "../SW/Core/Buses/I2C/i2c.dtsi"
//#include "../SW/Core/Buses/SPI/spi.dtsi"
//#include "../SW/Core/DAL/dal.dtsi"
//#include "../SW/Core/HWEngines/ADC/adc.dtsi"
//#include "../SW/Core/HWEngines/BAM/bam.dtsi"
//#include "../SW/Core/HWEngines/PCIe/pcie.dtsi"
//#include "../SW/Core/HWEngines/TSENS/tsens.dtsi"
//#include "../SW/Core/MPROC/SMEM/smem.dtsi"
//#include "../SW/Core/PMIC/pmic.dtsi"
//#include "../SW/Core/Services/services.dtsi"
//#include "../SW/Core/SocInfra/Busywait/busywait.dtsi"
//#include "../SW/Core/SocInfra/Clock/clock.dtsi"
//#include "../SW/Core/SocInfra/HWIO/hwio.dtsi"
//#include "../SW/Core/SocInfra/ICB/icb.dtsi"
//#include "../SW/Core/SocInfra/TLMM/tlmm.dtsi"
//#include "../SW/Core/Storage/UFS/ufs.dtsi"
//#include "../SW/Core/WiredConnectivity/USB/usb.dtsi"
