// Core/Storage/SDCC/sdcc.dtsi
// core storage HW settings

#include "sdcc_defines.h" 
&soc{
storage {
    sdcc: sdc1 {
        compatible = "qc,sdcc";
        reg = <0x8804000 0x00001000>;

	EnableLogging = /bits/ 8 <0>; 

	DriveStrength = <0x1FE4>; 
	MaxSpeedMode = /bits/ 8 <SDCC_SDR104_MODE>; 

	HsrSettings {
	    DLLConfig = <0x7642C>;
	    DLLConfig2 = <0xA800>;
	    DLLConfig3 = <0x10>;
	    DLLTestCtrl = <0x1800000>; 
	    DDRConfig = <0x80040868>; 
	    DLLUserCtrl = <0x2C010800>;
	};
    };
};

};


