// pre_ddr-soc.dts
//
// Container DTS file for specific hardware platform: Waipio SoC

/dts-v1/;

/ {
	compatible = "qcom,waipio";
	model = "qcom,waipio";

	#address-cells = <2>;
	#size-cells = <2>;

	soc: soc {
		#address-cells = <1>;
		#size-cells = <1>;
	};

	sw: sw { };
};

#include "soc_pre-ddr.dtsi"                     /* Common SoC Node Definitions */
