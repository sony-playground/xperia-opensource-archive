// SW: Core/Boot/xbl_minidump_oem_public_key.dtsi
// core boot xbl oem public key

&sw {
        oem_pub_key {

                      /*    bitlength */
                      bitLen = <2048>;

                      /*    n */
                      n = "009741eda9188f5abe839661b175e62f57f94257d52ab4479644c2c3036d1b0e71fb86fef0dd7eabcad649dea4d9f76a1ef73af3adcd0ee3c36388e8df8808900a5ae651ab36a8a0e049abad05fcf97f9612f4ebbe51490ecf385d3fec502eac234b936b65b6c0fb912622d96edffe520fb98518d1c95e3e36f1189c90a99b21c803fe9658312c3d9a09b29921325709d638ea223387c132dec138b44675473c5a7ab7d396a135b156c5a58fd0c183d39abba88f480da27df059da17f8218d07eca8c0754956bd369f03eac8ac9f2a5d9adc0bc5b25c51876d02ff770194152e03cdf5cc4d8fd866a09b085a0ecb1c3c5b1e038e6cf025a017e1f65d8cbeeb990b";

                      e = "000000000000000000000000000000000000000000000000000000000000000000000000000000000000000000000000000000000000000000000000000000000000000000000000000000000000000000000000000000000000000000000000000000000000000000000000000000000000000000000000000000000010001";
        };
};
