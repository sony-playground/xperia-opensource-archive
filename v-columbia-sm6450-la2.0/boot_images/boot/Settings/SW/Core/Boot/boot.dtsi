// SW: Core/Boot/boot.dtsi
// core boot SW settings

#include <boot_sw_defines.h>

&sw {
        boot {
              /*        client trace  verbose */
              config = <0x0000 0x0000 0x0000>;


              /* 0x0 = DISABLE (default), 0x1 = ENABLE default test_mode behavior, 0x2 = ENABLE one time test */
              test_mode = <0x0>;
              
              /* DISABLE = 0x0, ENABLE = 0x1(default) */
              xbl_sc_wdog = <ENABLE>;


              /* Do not skip DDR init = 0x0(default), skip DDR init = 0x1 */
              skip_ddr_init_in_EDL = <DISABLE>;
			  
	              /* 0== off 1== on */
		      led_blink = <ENABLE>;


              /*        default action: vibration is enabled at start of XBL and disabled before exit */
              /*        DISABLE = 0X0 - turn off vibration, ENABLE = 0x1 - turn on vibration */
              // vibration = <ENABLE>;
              vibration = <DISABLE>;
              
              /* save boot logs to storage for each boot in the boot log partition */
              /* DISABLE = 0x0(default), ENABLE = 0x1  */            
              save_logs_to_media = <DISABLE>;

              /* Order of the properties in this node must not be changed as it will break the feature*/
              forced_download{
                               /*         Enable(default)/Disable User initiated EDL in XBL */
                               status = <DISABLE>;


                               /*                Enable(default)/Disable checking dp high */
                               check_dp_high = <ENABLE>;


                               /*                  Timeout in ms (maximum value is 10000 (10 seconds)) */
                               /*                  *Effective only if checks_dp_high is enabled */
                               check_dp_timeout = <10000>;
                               /*                Option to ignore power key pressed with VOL+ and VOL- */
                               /*                ENABLE: PWR key press will be ignored to enter EDL, DISABLE(default): PWR key press + VOL+/VOL- will not enter EDL*/
                               ignore_pwr_key = <DISABLE>;
                             };


              /* Order of the properties in this node must not be changed as it will break the feature*/
              fedl_timeout{
                           /*     Property version */
                           ver = <BOOT_FEDL_TIMEOUT_PROP_VERSION>;

                           /*        default action: hard reset */
                           /*        valid values for this property are defined in boot_sw_defines.h */
                           action = <BOOT_FEDL_TIMEOUT_ACTION_HARD_RESET>;
                          };
        };
};
