area.create ddr_clock
area.select ddr_clock
area.clear ddr_clock

;*************************************
;******** MC Clock Test Output *******
;********        HANA       *******
;*************************************

;---------;
; symbols ;
;---------;

y.create.l  HWIO_CABO0_CABO_GLOBAL_DDR_CLK_PERIOD_CFG_ADDR   ezaxi:0x9260080
y.create.done

area.view ddr_clock

if !run()
(
   &curr=data.long(EZAXI:HWIO_CABO0_CABO_GLOBAL_DDR_CLK_PERIOD_CFG_ADDR)
   if (&curr==0)
   (
     PRINT "DDR_freq=" 0 "Mhz"
   )
   else
   (
     &FREQ=1000000./&curr
     PRINT "DDR_freq=" &FREQ "Mhz"
   )
)

ENDDO

