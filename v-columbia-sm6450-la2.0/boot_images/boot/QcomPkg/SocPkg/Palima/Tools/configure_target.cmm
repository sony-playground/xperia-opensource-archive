;============================================================================
;  Name:
;    configure_target.cmm
;
;  Description:
;     Set Target specific variables, address's and offsets
;
; Copyright (c) 2020 Qualcomm Technologies Incorporated.
; All Rights Reserved.
; Qualcomm Technologies Confidential and Proprietary
;
;----------------------------------------------------------------------------
;============================================================================
;
;                        EDIT HISTORY FOR MODULE
;
;
;
;when         who     what, where, why
;----------   ---     ----------------------------------------------------------
;09-11-2020   ka      Initial Version
;============================================================================;
;
;============================================================================
;  CMM script variables
;============================================================================

global &gUefiRamEntryAddr
global &gRamFvAddr
global &gInfoBlkPtrOffset
global &gSharedImemAddress

&gUefiRamEntryAddr=0xA7000000
&gRamFvAddr=0xA7AD9000
&gInfoBlkPtrOffset=0x00601000
&gSharedImemAddress=0x146AA000