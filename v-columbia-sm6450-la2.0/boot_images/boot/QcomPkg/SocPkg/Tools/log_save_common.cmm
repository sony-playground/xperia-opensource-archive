;============================================================================
;  Name:
;    log_save.cmm
;
;  Description:
;     Save UEFI Debug Logs
;
; Copyright (c) 2012-2013,2015-2020 Qualcomm Technologies, Inc.  All 
; Rights Reserved. Qualcomm Technologies Proprietary and 
; Confidential. 
;
;----------------------------------------------------------------------------
;============================================================================
;
;                        EDIT HISTORY FOR MODULE
;
;
;
;  when         who     what, where, why
; ----------    ---     ----------------------------------------------------------
; 2020-11-09    ka      Added entry argument InfoBlkPtrOffset
; 2020-06-21    cm      Enable Log save for Olympic
; 2017-09-12    vk      Remove PATH
; 2016-08-02    na      Pass the log file name onto next script
; 2016-02-18    bh      Update UEFI entry address
; 2015-10-28    bh      Update PATH before executing
; 2015-09-17    vk      Move FD base
; 2013-07-22    vk      Rename to log_save.cmm
; 2012-12-10    yg      Initial Version
;============================================================================;


;  for Target(ex:Olympic) that has a different Ram entry address to what other Targets have, &Addr is passed as entry.
;  &Addr is not mandatory.

local &RamEntryAddr

ENTRY &LogFileName &Addr &InfoBlkPtrOffset
;  sys.m.a  ; T32 Sim

  if (run())
  (
    break
  )
  
  &CwDir=os.ppd()


  &RamEntryAddr=0x9FC00000
  if ("&Addr"!="")
  (
   &RamEntryAddr  = &Addr
  )
  do &CwDir/../../Tools/save_dbg_log.cmm  &RamEntryAddr &LogFileName &InfoBlkPtrOffset

enddo

