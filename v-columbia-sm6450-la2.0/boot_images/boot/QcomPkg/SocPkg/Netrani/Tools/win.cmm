;============================================================================
;  Name:
;    win.cmm
;
;  Description:
;     Windows size, pos configurations in T32. Overwrite to the desired
;     T32 setting using store windows to option.
;
; Copyright (c) 2010-2011, 2015, 2018 Qualcomm Technologies, Incorporated.
; All Rights Reserved.
; Qualcomm Confidential and Proprietary
;
;----------------------------------------------------------------------------

entry &consoletype
 B::

 area.create UEFI_Logs 1000. 8192.
 TOOLBAR ON
 STATUSBAR ON
 FramePOS 2.0 0.0 191. 73.
 WinPAGE.RESet

 WinPAGE.Create P000

 WinCLEAR
 WinPOS 0.0 62.667 152. 7. 0. 0. W004
 ws.area.view UEFI_Logs

 WinPOS 135.0 23.308 61. 52. 5. 0. W003
 ws.v.f

 WinPOS 134.86 0.0 52. 20. 0. 0. W002
 r /spotlight

 &consoletype=convert.toupper("&consoletype")
 if ("&consoletype"=="DCC")
 (
   WinPOS 69.143 39.231 120. 25. 0. 0. W005
   TERM.METHOD DCC3
   term.reset
   term.size 120. 10000
   term.scroll on
   term.mode VT100
   TERM.GATE
   TERM.WRITE C:\temp\dcc_output.txt
   screen.on
  )

 WinPOS 0.0 0.076923 131. 56. 13. 1. W001
 WinTABS 10. 18. 25. 56.
 ws.d.l

 WinPAGE.select P000

 ENDDO

