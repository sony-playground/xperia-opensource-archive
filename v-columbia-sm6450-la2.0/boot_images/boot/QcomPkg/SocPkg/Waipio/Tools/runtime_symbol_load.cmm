;============================================================================
; Name: runtime_symbol_load.cmm
; Parse info block and load symbols for drivers
; 
; Copyright (c) 2018, 2020 Qualcomm Technologies, Incorporated.
; All Rights Reserved.
; Qualcomm Confidential and Proprietary
;
;----------------------------------------------------------------------------
;============================================================================
;
;
;
;when         who     what, where, why
;----------   ---     ----------------------------------------------------------
;2020-05-11   kpa     use configure_target.cmm for target specific values
;2018-06-12   kpa     Initial Version
;============================================================================;

; Wrapper script for runtime_symbol_load_common.cmm 

  if !os.file("./configure_target.cmm")
  (
    print "Error: ./configure_target.cmm missing !"

  )
  else
  (
    do ./configure_target.cmm
  )
  
cd.do ../../Tools/runtime_symbol_load_common.cmm &gUefiRamEntryAddr &gInfoBlkPtrOffset