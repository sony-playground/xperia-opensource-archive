;****************************************************************************
;**         boot_debug.cmm
;**
;**         This script performs setup for debugging on secboot 3.0 Architecture.
;**
;** Copyright  2018-2022 by Qualcomm Technologies, Incorporated.  All Rights Reserved.
;**
;****************************************************************************
;**
;**                        EDIT HISTORY FOR MODULE
;**
;** $$
;**
;** when       who       what, where, why
;** --------   ---       ------------------------------------------------------
;** 06/21/22   nnaram     Added support for clarence
;** 11/12/21   nitesh     Added support for Palima
;** 10/21/21   rrwt       Added support for Netrani
;** 09/23/21   ck         Added support for Lassen
;** 02/19/21   rama       Ported changes for removing unused options
;** 10/06/20   rama       Added rumi emulation version as argument
;** 08/07/20   rama       Added support for Waipio
;** 03/13/20   ck         Added support for Olympic
;** 01/03/20   rrawat     Added support for Cedros
;** 06/20/18   ds         Add SM8250
;****************************************************************************

  ; This script is a wrapper for the target specific debug script

  ;============================================================================
  ; Declare variables used
  ;============================================================================
  local  &Choice
  local  &Option  ; Menu Option
  global &Platform
  global &Storage
  local  &Variant
  
  ;============================================================================
  ; Get the arguments passed in.
  ;============================================================================
  ENTRY &Choice &Variant &Platform &Option &Storage &DumpType &DumpStorage &QSEEBuildPath &RumiEmulation
  
  ;============================================================================
  ; Set up the display window
  ;============================================================================

  winclear
  area.RESET 
  WINPOS 0% 50% 68% 50% 0. 0. W001
  Area.create MAIN
  Area.view MAIN
  Area.select MAIN
  
  ;============================================================================
  ; If user passed TARGET on command line, just go
  ;============================================================================ 

  if "&Choice"=="Waipio"
  (
    gosub CheckVariant
    do boot_debug_common.cmm Soc Waipio SM Loader False &Variant &Platform &Option &Storage &DumpType &DumpStorage &QSEEBuildPath &RumiEmulation
    enddo
  )
  
  if "&Choice"=="Fillmore"
  (
    gosub CheckVariant
    do boot_debug_common.cmm Soc Fillmore SM Loader False &Variant &Platform &Option &Storage &DumpType &DumpStorage &QSEEBuildPath &RumiEmulation
    enddo
  )

  if "&Choice"=="Kailua"
  (
    gosub CheckVariant
    do boot_debug_common.cmm Soc Kailua SM Loader False &Variant &Platform &Option &Storage &DumpType &DumpStorage &QSEEBuildPath &RumiEmulation
    enddo
  )
  
  if "&Choice"=="Aurora"
  (
    gosub CheckVariant
    do boot_debug_common.cmm Soc Aurora SM Loader False &Variant &Platform &Option &Storage &DumpType &DumpStorage &QSEEBuildPath &RumiEmulation
    enddo
  )

  if "&Choice"=="Lassen"
  (
    gosub CheckVariant
    do boot_debug_common.cmm Soc Lassen CSM Loader False &Variant &Platform &Option &Storage &DumpType &DumpStorage &QSEEBuildPath &RumiEmulation
    enddo
  )
  
  if "&Choice"=="Netrani"
  (
    gosub CheckVariant
    do boot_debug_common.cmm Soc Netrani SM Loader False &Variant &Platform &Option &Storage &DumpType &DumpStorage &QSEEBuildPath &RumiEmulation
    enddo
  )
  if "&Choice"=="Clarence"
  (
    gosub CheckVariant
    do boot_debug_common.cmm Soc Clarence SM Loader False &Variant &Platform &Option &Storage &DumpType &DumpStorage &QSEEBuildPath &RumiEmulation
    enddo
  )
  if "&Choice"=="Palima"
  (
    gosub CheckVariant
    do boot_debug_common.cmm Soc Palima SM Loader False &Variant &Platform &Option &Storage &DumpType &DumpStorage &QSEEBuildPath &RumiEmulation
    enddo
  )

  ;============================================================================
  ; Provide user with a choice for the chipset
  ;============================================================================
    
  print "Please enter chipset name: "
  print "eg: Waipio, Fillmore, Kailua, Lassen, Palima, Netrani, Clarence"
  print
  print "Please make a choice: "
  enter &Choice
  print "Enter Variant Waipio LAA, Fillmore LAA, Kailua LAA, Lassen LE, Palima LAA, Netrani LAA, Clarence LAA:"
  enter &Variant
  gosub CheckVariant

  if "&Choice"=="Waipio"
  (
    do boot_debug_common.cmm Soc Waipio SM Loader False &Variant
    enddo
  )

  if "&Choice"=="Palima"
  (
    do boot_debug_common.cmm Soc Palima SM Loader False &Variant
    enddo
  )

  if "&Choice"=="Fillmore"
  (
    do boot_debug_common.cmm Soc Fillmore SM Loader False &Variant
    enddo
  )
  

  if "&Choice"=="Kailua"
  (
    do boot_debug_common.cmm Soc Kailua SM Loader False &Variant
    enddo
  )
  
  if "&Choice"=="Aurora"
  (
    gosub CheckVariant
    do boot_debug_common.cmm Soc Aurora SM Loader False &Variant &Platform &Option &Storage &DumpType &DumpStorage &QSEEBuildPath &RumiEmulation
    enddo
  )

  if "&Choice"=="Lassen"
  (
    do boot_debug_common.cmm Soc Lassen CSM Loader False &Variant
    enddo
  )
  if "&Choice"=="Netrani"
  (
    gosub CheckVariant
    do boot_debug_common.cmm Soc Netrani SM Loader False &Variant &Platform &Option &Storage &DumpType &DumpStorage &QSEEBuildPath &RumiEmulation
    enddo
  )
  
  if "&Choice"=="Clarence"
  (
    gosub CheckVariant
    do boot_debug_common.cmm Soc Clarence SM Loader False &Variant &Platform &Option &Storage &DumpType &DumpStorage &QSEEBuildPath &RumiEmulation
    enddo
  )
  ;Default case 
  (
    print "Incorrect entry"
    enddo
  )
  
CheckVariant:
  if "&Variant"==""
  (
    print "Variant not passed.  Exiting."
    END
  )
  return
