; aop_dump.cmm
; ------------------------------------------------------------------
;
; When to use this script 
; -----------------------
; This script should be used to dump the full RPM state from T32
; when a debug session's state must be recorded for later debugging.
;
; What this script does
; -----------------------
; This script will dump AOP code, data, and message ram
;
; How to use this script
; ----------------------
; After after breaking, retrieve all logs by running
;
; do aop_dump <dumpPath>
;
;update 10/8/2021:fillmore same msg_ram address

;CD.PSTEP \\harv-pravsahu\Perforce\fillmore\aop.ho.4.0.fillmore_1006_hansei_1\aop_proc\core\bsp\aop\scripts\aop_dump\fillmore\aop_dump_hansei.cmm C:\dropbox\fillmore\aop_dump_1

ENTRY &dumpPath

; Trim trailing "\" if necessary
IF string.char("&(dumpPath)", string.len("&(dumpPath)")-1)=='\'
(
  &dumpPath=string.cut("&(dumpPath)", -1)
  PRINT "No dump path"
)

;ON ERROR GOSUB error_catch
store "&(dumpPath)\aop_register_dump.cmm" register
d.save.binary "&(dumpPath)\CODERAM.bin" 0x0++0x17FFF
d.save.binary "&(dumpPath)\DATARAM.bin" 0xE0000++0x7FFF

d.save.binary "&(dumpPath)\aop_scs.bin"      esd:0xE000E000++0xFFF

d.save.binary "&(dumpPath)\MSGRAM0.bin" 0x1300000++0x3FF
d.save.binary "&(dumpPath)\MSGRAM1.bin" 0x1310000++0x3FF
d.save.binary "&(dumpPath)\MSGRAM2.bin" 0x1320000++0x3FF
d.save.binary "&(dumpPath)\MSGRAM3.bin" 0x1330000++0x3FF
d.save.binary "&(dumpPath)\MSGRAM4.bin" 0x1340000++0x3FF
d.save.binary "&(dumpPath)\MSGRAM5.bin" 0x1350000++0x3FF
d.save.binary "&(dumpPath)\MSGRAM6.bin" 0x1360000++0x3FF
d.save.binary "&(dumpPath)\MSGRAM7.bin" 0x1370000++0x3FF
d.save.binary "&(dumpPath)\MSGRAM8.bin" 0x1380000++0x3FF
d.save.binary "&(dumpPath)\MSGRAM9.bin" 0x1390000++0x3FF
d.save.binary "&(dumpPath)\MSGRAM10.bin" 0x13A0000++0x3FF
d.save.binary "&(dumpPath)\MSGRAM11.bin" 0x13B0000++0x3FF
d.save.binary "&(dumpPath)\MSGRAM12.bin" 0x13C0000++0x3FF
d.save.binary "&(dumpPath)\MSGRAM13.bin" 0x13D0000++0x3FF
d.save.binary "&(dumpPath)\MSGRAM14.bin" 0x13E0000++0x3FF
d.save.binary "&(dumpPath)\MSGRAM15.bin" 0x13F0000++0x3FF

LOCAL &rpmh_addr &rpmh_size

&rpmh_addr=0x00200000
&rpmh_size=0x00C00000

;saving RPMh data
;d.save.binary "&(dumpPath)\RPMH_BINARY.bin" ezaxi:0x00200000++0x0BFFFFF  -- ezaxi access worked, but bus error due to size
d.save.binary "&(dumpPath)\RPMH_BINARY.bin" ezaxi:&rpmh_addr++(&rpmh_size-1)

;Run hansei on the collected dumps
;&HANSEI_PATH="../../hansei"
;&ELF_PATH="../../../build/cedros/AOP_AAAAANAAO.elf"

;for now, not running hansei from here
;OS.Window python &HANSEI_PATH/hansei.py -t cedros dumpfile &dumpPath --elf &ELF_PATH --output &dumpPath  

;ON ERROR
;ENDDO

;error_catch:
;  PRINT "Error Caught... Continuing..."
;  RETURN
