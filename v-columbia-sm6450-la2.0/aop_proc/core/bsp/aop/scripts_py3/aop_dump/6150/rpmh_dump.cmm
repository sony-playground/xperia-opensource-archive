
local &file
entry &infile
if "&infile"!=""
(
  &file="&infile"
)
else
(
  &file="c:\temp\hwiosave.xml"
)
print "Reading register values..."
OPEN #1 &file /Create

WRITE #1 "<?xml version='1.0' encoding='utf-8'?>"
WRITE #1 "<!-- This log file can be parsed at http://ipcatalog/swi/dump/parser -->"
WRITE #1 "<hwioDump version='1'>"
WRITE #1 "    <timestamp>" clock.date() " " clock.time() "</timestamp>"
WRITE #1 "    <generator>Trace32</generator>"
WRITE #1 "    <chip name='talos_1.0' map='ARM_ADDRESS_FILE_SW' version='talos_v1.0_p3q2r65_BTO'>"
WRITE #1 "        <register address='0xb600000' value='0x" DATA.LONG(A:0x600000) "' name='RPMH_ARC_DRV0_RM0_VOTE'/>"
WRITE #1 "        <register address='0xb600010' value='0x" DATA.LONG(A:0x600010) "' name='RPMH_ARC_DRV0_RM1_VOTE'/>"
WRITE #1 "        <register address='0xb600020' value='0x" DATA.LONG(A:0x600020) "' name='RPMH_ARC_DRV0_RM2_VOTE'/>"
WRITE #1 "        <register address='0xb600030' value='0x" DATA.LONG(A:0x600030) "' name='RPMH_ARC_DRV0_RM3_VOTE'/>"
WRITE #1 "        <register address='0xb600040' value='0x" DATA.LONG(A:0x600040) "' name='RPMH_ARC_DRV0_RM4_VOTE'/>"
WRITE #1 "        <register address='0xb600050' value='0x" DATA.LONG(A:0x600050) "' name='RPMH_ARC_DRV0_RM5_VOTE'/>"
WRITE #1 "        <register address='0xb600060' value='0x" DATA.LONG(A:0x600060) "' name='RPMH_ARC_DRV0_RM6_VOTE'/>"
WRITE #1 "        <register address='0xb600070' value='0x" DATA.LONG(A:0x600070) "' name='RPMH_ARC_DRV0_RM7_VOTE'/>"
WRITE #1 "        <register address='0xb610000' value='0x" DATA.LONG(A:0x610000) "' name='RPMH_ARC_DRV1_RM0_VOTE'/>"
WRITE #1 "        <register address='0xb610010' value='0x" DATA.LONG(A:0x610010) "' name='RPMH_ARC_DRV1_RM1_VOTE'/>"
WRITE #1 "        <register address='0xb610020' value='0x" DATA.LONG(A:0x610020) "' name='RPMH_ARC_DRV1_RM2_VOTE'/>"
WRITE #1 "        <register address='0xb610030' value='0x" DATA.LONG(A:0x610030) "' name='RPMH_ARC_DRV1_RM3_VOTE'/>"
WRITE #1 "        <register address='0xb610040' value='0x" DATA.LONG(A:0x610040) "' name='RPMH_ARC_DRV1_RM4_VOTE'/>"
WRITE #1 "        <register address='0xb610050' value='0x" DATA.LONG(A:0x610050) "' name='RPMH_ARC_DRV1_RM5_VOTE'/>"
WRITE #1 "        <register address='0xb610060' value='0x" DATA.LONG(A:0x610060) "' name='RPMH_ARC_DRV1_RM6_VOTE'/>"
WRITE #1 "        <register address='0xb610070' value='0x" DATA.LONG(A:0x610070) "' name='RPMH_ARC_DRV1_RM7_VOTE'/>"
WRITE #1 "        <register address='0xb620000' value='0x" DATA.LONG(A:0x620000) "' name='RPMH_ARC_DRV2_RM0_VOTE'/>"
WRITE #1 "        <register address='0xb620010' value='0x" DATA.LONG(A:0x620010) "' name='RPMH_ARC_DRV2_RM1_VOTE'/>"
WRITE #1 "        <register address='0xb620020' value='0x" DATA.LONG(A:0x620020) "' name='RPMH_ARC_DRV2_RM2_VOTE'/>"
WRITE #1 "        <register address='0xb620030' value='0x" DATA.LONG(A:0x620030) "' name='RPMH_ARC_DRV2_RM3_VOTE'/>"
WRITE #1 "        <register address='0xb620040' value='0x" DATA.LONG(A:0x620040) "' name='RPMH_ARC_DRV2_RM4_VOTE'/>"
WRITE #1 "        <register address='0xb620050' value='0x" DATA.LONG(A:0x620050) "' name='RPMH_ARC_DRV2_RM5_VOTE'/>"
WRITE #1 "        <register address='0xb620060' value='0x" DATA.LONG(A:0x620060) "' name='RPMH_ARC_DRV2_RM6_VOTE'/>"
WRITE #1 "        <register address='0xb620070' value='0x" DATA.LONG(A:0x620070) "' name='RPMH_ARC_DRV2_RM7_VOTE'/>"
WRITE #1 "        <register address='0xb630000' value='0x" DATA.LONG(A:0x630000) "' name='RPMH_ARC_DRV3_RM0_VOTE'/>"
WRITE #1 "        <register address='0xb630010' value='0x" DATA.LONG(A:0x630010) "' name='RPMH_ARC_DRV3_RM1_VOTE'/>"
WRITE #1 "        <register address='0xb630020' value='0x" DATA.LONG(A:0x630020) "' name='RPMH_ARC_DRV3_RM2_VOTE'/>"
WRITE #1 "        <register address='0xb630030' value='0x" DATA.LONG(A:0x630030) "' name='RPMH_ARC_DRV3_RM3_VOTE'/>"
WRITE #1 "        <register address='0xb630040' value='0x" DATA.LONG(A:0x630040) "' name='RPMH_ARC_DRV3_RM4_VOTE'/>"
WRITE #1 "        <register address='0xb630050' value='0x" DATA.LONG(A:0x630050) "' name='RPMH_ARC_DRV3_RM5_VOTE'/>"
WRITE #1 "        <register address='0xb630060' value='0x" DATA.LONG(A:0x630060) "' name='RPMH_ARC_DRV3_RM6_VOTE'/>"
WRITE #1 "        <register address='0xb630070' value='0x" DATA.LONG(A:0x630070) "' name='RPMH_ARC_DRV3_RM7_VOTE'/>"
WRITE #1 "        <register address='0xb640000' value='0x" DATA.LONG(A:0x640000) "' name='RPMH_ARC_DRV4_RM0_VOTE'/>"
WRITE #1 "        <register address='0xb640010' value='0x" DATA.LONG(A:0x640010) "' name='RPMH_ARC_DRV4_RM1_VOTE'/>"
WRITE #1 "        <register address='0xb640020' value='0x" DATA.LONG(A:0x640020) "' name='RPMH_ARC_DRV4_RM2_VOTE'/>"
WRITE #1 "        <register address='0xb640030' value='0x" DATA.LONG(A:0x640030) "' name='RPMH_ARC_DRV4_RM3_VOTE'/>"
WRITE #1 "        <register address='0xb640040' value='0x" DATA.LONG(A:0x640040) "' name='RPMH_ARC_DRV4_RM4_VOTE'/>"
WRITE #1 "        <register address='0xb640050' value='0x" DATA.LONG(A:0x640050) "' name='RPMH_ARC_DRV4_RM5_VOTE'/>"
WRITE #1 "        <register address='0xb640060' value='0x" DATA.LONG(A:0x640060) "' name='RPMH_ARC_DRV4_RM6_VOTE'/>"
WRITE #1 "        <register address='0xb640070' value='0x" DATA.LONG(A:0x640070) "' name='RPMH_ARC_DRV4_RM7_VOTE'/>"
WRITE #1 "        <register address='0xb650000' value='0x" DATA.LONG(A:0x650000) "' name='RPMH_ARC_DRV5_RM0_VOTE'/>"
WRITE #1 "        <register address='0xb650010' value='0x" DATA.LONG(A:0x650010) "' name='RPMH_ARC_DRV5_RM1_VOTE'/>"
WRITE #1 "        <register address='0xb650020' value='0x" DATA.LONG(A:0x650020) "' name='RPMH_ARC_DRV5_RM2_VOTE'/>"
WRITE #1 "        <register address='0xb650030' value='0x" DATA.LONG(A:0x650030) "' name='RPMH_ARC_DRV5_RM3_VOTE'/>"
WRITE #1 "        <register address='0xb650040' value='0x" DATA.LONG(A:0x650040) "' name='RPMH_ARC_DRV5_RM4_VOTE'/>"
WRITE #1 "        <register address='0xb650050' value='0x" DATA.LONG(A:0x650050) "' name='RPMH_ARC_DRV5_RM5_VOTE'/>"
WRITE #1 "        <register address='0xb650060' value='0x" DATA.LONG(A:0x650060) "' name='RPMH_ARC_DRV5_RM6_VOTE'/>"
WRITE #1 "        <register address='0xb650070' value='0x" DATA.LONG(A:0x650070) "' name='RPMH_ARC_DRV5_RM7_VOTE'/>"
WRITE #1 "        <register address='0xb660000' value='0x" DATA.LONG(A:0x660000) "' name='RPMH_ARC_DRV6_RM0_VOTE'/>"
WRITE #1 "        <register address='0xb660010' value='0x" DATA.LONG(A:0x660010) "' name='RPMH_ARC_DRV6_RM1_VOTE'/>"
WRITE #1 "        <register address='0xb660020' value='0x" DATA.LONG(A:0x660020) "' name='RPMH_ARC_DRV6_RM2_VOTE'/>"
WRITE #1 "        <register address='0xb660030' value='0x" DATA.LONG(A:0x660030) "' name='RPMH_ARC_DRV6_RM3_VOTE'/>"
WRITE #1 "        <register address='0xb660040' value='0x" DATA.LONG(A:0x660040) "' name='RPMH_ARC_DRV6_RM4_VOTE'/>"
WRITE #1 "        <register address='0xb660050' value='0x" DATA.LONG(A:0x660050) "' name='RPMH_ARC_DRV6_RM5_VOTE'/>"
WRITE #1 "        <register address='0xb660060' value='0x" DATA.LONG(A:0x660060) "' name='RPMH_ARC_DRV6_RM6_VOTE'/>"
WRITE #1 "        <register address='0xb660070' value='0x" DATA.LONG(A:0x660070) "' name='RPMH_ARC_DRV6_RM7_VOTE'/>"
WRITE #1 "        <register address='0xb670000' value='0x" DATA.LONG(A:0x670000) "' name='RPMH_ARC_DRV7_RM0_VOTE'/>"
WRITE #1 "        <register address='0xb670010' value='0x" DATA.LONG(A:0x670010) "' name='RPMH_ARC_DRV7_RM1_VOTE'/>"
WRITE #1 "        <register address='0xb670020' value='0x" DATA.LONG(A:0x670020) "' name='RPMH_ARC_DRV7_RM2_VOTE'/>"
WRITE #1 "        <register address='0xb670030' value='0x" DATA.LONG(A:0x670030) "' name='RPMH_ARC_DRV7_RM3_VOTE'/>"
WRITE #1 "        <register address='0xb670040' value='0x" DATA.LONG(A:0x670040) "' name='RPMH_ARC_DRV7_RM4_VOTE'/>"
WRITE #1 "        <register address='0xb670050' value='0x" DATA.LONG(A:0x670050) "' name='RPMH_ARC_DRV7_RM5_VOTE'/>"
WRITE #1 "        <register address='0xb670060' value='0x" DATA.LONG(A:0x670060) "' name='RPMH_ARC_DRV7_RM6_VOTE'/>"
WRITE #1 "        <register address='0xb670070' value='0x" DATA.LONG(A:0x670070) "' name='RPMH_ARC_DRV7_RM7_VOTE'/>"
WRITE #1 "        <register address='0xb680000' value='0x" DATA.LONG(A:0x680000) "' name='RPMH_ARC_DRV8_RM0_VOTE'/>"
WRITE #1 "        <register address='0xb680010' value='0x" DATA.LONG(A:0x680010) "' name='RPMH_ARC_DRV8_RM1_VOTE'/>"
WRITE #1 "        <register address='0xb680020' value='0x" DATA.LONG(A:0x680020) "' name='RPMH_ARC_DRV8_RM2_VOTE'/>"
WRITE #1 "        <register address='0xb680030' value='0x" DATA.LONG(A:0x680030) "' name='RPMH_ARC_DRV8_RM3_VOTE'/>"
WRITE #1 "        <register address='0xb680040' value='0x" DATA.LONG(A:0x680040) "' name='RPMH_ARC_DRV8_RM4_VOTE'/>"
WRITE #1 "        <register address='0xb680050' value='0x" DATA.LONG(A:0x680050) "' name='RPMH_ARC_DRV8_RM5_VOTE'/>"
WRITE #1 "        <register address='0xb680060' value='0x" DATA.LONG(A:0x680060) "' name='RPMH_ARC_DRV8_RM6_VOTE'/>"
WRITE #1 "        <register address='0xb680070' value='0x" DATA.LONG(A:0x680070) "' name='RPMH_ARC_DRV8_RM7_VOTE'/>"
WRITE #1 "        <register address='0xb690000' value='0x" DATA.LONG(A:0x690000) "' name='RPMH_ARC_DRV9_RM0_VOTE'/>"
WRITE #1 "        <register address='0xb690010' value='0x" DATA.LONG(A:0x690010) "' name='RPMH_ARC_DRV9_RM1_VOTE'/>"
WRITE #1 "        <register address='0xb690020' value='0x" DATA.LONG(A:0x690020) "' name='RPMH_ARC_DRV9_RM2_VOTE'/>"
WRITE #1 "        <register address='0xb690030' value='0x" DATA.LONG(A:0x690030) "' name='RPMH_ARC_DRV9_RM3_VOTE'/>"
WRITE #1 "        <register address='0xb690040' value='0x" DATA.LONG(A:0x690040) "' name='RPMH_ARC_DRV9_RM4_VOTE'/>"
WRITE #1 "        <register address='0xb690050' value='0x" DATA.LONG(A:0x690050) "' name='RPMH_ARC_DRV9_RM5_VOTE'/>"
WRITE #1 "        <register address='0xb690060' value='0x" DATA.LONG(A:0x690060) "' name='RPMH_ARC_DRV9_RM6_VOTE'/>"
WRITE #1 "        <register address='0xb690070' value='0x" DATA.LONG(A:0x690070) "' name='RPMH_ARC_DRV9_RM7_VOTE'/>"
WRITE #1 "        <register address='0xb6a0000' value='0x" DATA.LONG(A:0x6a0000) "' name='RPMH_ARC_DRV10_RM0_VOTE'/>"
WRITE #1 "        <register address='0xb6a0010' value='0x" DATA.LONG(A:0x6a0010) "' name='RPMH_ARC_DRV10_RM1_VOTE'/>"
WRITE #1 "        <register address='0xb6a0020' value='0x" DATA.LONG(A:0x6a0020) "' name='RPMH_ARC_DRV10_RM2_VOTE'/>"
WRITE #1 "        <register address='0xb6a0030' value='0x" DATA.LONG(A:0x6a0030) "' name='RPMH_ARC_DRV10_RM3_VOTE'/>"
WRITE #1 "        <register address='0xb6a0040' value='0x" DATA.LONG(A:0x6a0040) "' name='RPMH_ARC_DRV10_RM4_VOTE'/>"
WRITE #1 "        <register address='0xb6a0050' value='0x" DATA.LONG(A:0x6a0050) "' name='RPMH_ARC_DRV10_RM5_VOTE'/>"
WRITE #1 "        <register address='0xb6a0060' value='0x" DATA.LONG(A:0x6a0060) "' name='RPMH_ARC_DRV10_RM6_VOTE'/>"
WRITE #1 "        <register address='0xb6a0070' value='0x" DATA.LONG(A:0x6a0070) "' name='RPMH_ARC_DRV10_RM7_VOTE'/>"
WRITE #1 "        <register address='0xb7e0000' value='0x" DATA.LONG(A:0x7e0000) "' name='RPMH_ARC_BCM_DRV0_RM0_VOTE'/>"
WRITE #1 "        <register address='0xb7e0010' value='0x" DATA.LONG(A:0x7e0010) "' name='RPMH_ARC_BCM_DRV0_RM1_VOTE'/>"
WRITE #1 "        <register address='0xb7e0020' value='0x" DATA.LONG(A:0x7e0020) "' name='RPMH_ARC_BCM_DRV0_RM2_VOTE'/>"
WRITE #1 "        <register address='0xb7e0030' value='0x" DATA.LONG(A:0x7e0030) "' name='RPMH_ARC_BCM_DRV0_RM3_VOTE'/>"
WRITE #1 "        <register address='0xb7e0040' value='0x" DATA.LONG(A:0x7e0040) "' name='RPMH_ARC_BCM_DRV0_RM4_VOTE'/>"
WRITE #1 "        <register address='0xb7e0050' value='0x" DATA.LONG(A:0x7e0050) "' name='RPMH_ARC_BCM_DRV0_RM5_VOTE'/>"
WRITE #1 "        <register address='0xb7e0060' value='0x" DATA.LONG(A:0x7e0060) "' name='RPMH_ARC_BCM_DRV0_RM6_VOTE'/>"
WRITE #1 "        <register address='0xb7e0070' value='0x" DATA.LONG(A:0x7e0070) "' name='RPMH_ARC_BCM_DRV0_RM7_VOTE'/>"
WRITE #1 "        <register address='0xb7e1000' value='0x" DATA.LONG(A:0x7e1000) "' name='RPMH_ARC_BCM_DRV1_RM0_VOTE'/>"
WRITE #1 "        <register address='0xb7e1010' value='0x" DATA.LONG(A:0x7e1010) "' name='RPMH_ARC_BCM_DRV1_RM1_VOTE'/>"
WRITE #1 "        <register address='0xb7e1020' value='0x" DATA.LONG(A:0x7e1020) "' name='RPMH_ARC_BCM_DRV1_RM2_VOTE'/>"
WRITE #1 "        <register address='0xb7e1030' value='0x" DATA.LONG(A:0x7e1030) "' name='RPMH_ARC_BCM_DRV1_RM3_VOTE'/>"
WRITE #1 "        <register address='0xb7e1040' value='0x" DATA.LONG(A:0x7e1040) "' name='RPMH_ARC_BCM_DRV1_RM4_VOTE'/>"
WRITE #1 "        <register address='0xb7e1050' value='0x" DATA.LONG(A:0x7e1050) "' name='RPMH_ARC_BCM_DRV1_RM5_VOTE'/>"
WRITE #1 "        <register address='0xb7e1060' value='0x" DATA.LONG(A:0x7e1060) "' name='RPMH_ARC_BCM_DRV1_RM6_VOTE'/>"
WRITE #1 "        <register address='0xb7e1070' value='0x" DATA.LONG(A:0x7e1070) "' name='RPMH_ARC_BCM_DRV1_RM7_VOTE'/>"
WRITE #1 "        <register address='0xb7e2000' value='0x" DATA.LONG(A:0x7e2000) "' name='RPMH_ARC_BCM_DRV2_RM0_VOTE'/>"
WRITE #1 "        <register address='0xb7e2010' value='0x" DATA.LONG(A:0x7e2010) "' name='RPMH_ARC_BCM_DRV2_RM1_VOTE'/>"
WRITE #1 "        <register address='0xb7e2020' value='0x" DATA.LONG(A:0x7e2020) "' name='RPMH_ARC_BCM_DRV2_RM2_VOTE'/>"
WRITE #1 "        <register address='0xb7e2030' value='0x" DATA.LONG(A:0x7e2030) "' name='RPMH_ARC_BCM_DRV2_RM3_VOTE'/>"
WRITE #1 "        <register address='0xb7e2040' value='0x" DATA.LONG(A:0x7e2040) "' name='RPMH_ARC_BCM_DRV2_RM4_VOTE'/>"
WRITE #1 "        <register address='0xb7e2050' value='0x" DATA.LONG(A:0x7e2050) "' name='RPMH_ARC_BCM_DRV2_RM5_VOTE'/>"
WRITE #1 "        <register address='0xb7e2060' value='0x" DATA.LONG(A:0x7e2060) "' name='RPMH_ARC_BCM_DRV2_RM6_VOTE'/>"
WRITE #1 "        <register address='0xb7e2070' value='0x" DATA.LONG(A:0x7e2070) "' name='RPMH_ARC_BCM_DRV2_RM7_VOTE'/>"
WRITE #1 "        <register address='0xb7e3000' value='0x" DATA.LONG(A:0x7e3000) "' name='RPMH_ARC_BCM_DRV3_RM0_VOTE'/>"
WRITE #1 "        <register address='0xb7e3010' value='0x" DATA.LONG(A:0x7e3010) "' name='RPMH_ARC_BCM_DRV3_RM1_VOTE'/>"
WRITE #1 "        <register address='0xb7e3020' value='0x" DATA.LONG(A:0x7e3020) "' name='RPMH_ARC_BCM_DRV3_RM2_VOTE'/>"
WRITE #1 "        <register address='0xb7e3030' value='0x" DATA.LONG(A:0x7e3030) "' name='RPMH_ARC_BCM_DRV3_RM3_VOTE'/>"
WRITE #1 "        <register address='0xb7e3040' value='0x" DATA.LONG(A:0x7e3040) "' name='RPMH_ARC_BCM_DRV3_RM4_VOTE'/>"
WRITE #1 "        <register address='0xb7e3050' value='0x" DATA.LONG(A:0x7e3050) "' name='RPMH_ARC_BCM_DRV3_RM5_VOTE'/>"
WRITE #1 "        <register address='0xb7e3060' value='0x" DATA.LONG(A:0x7e3060) "' name='RPMH_ARC_BCM_DRV3_RM6_VOTE'/>"
WRITE #1 "        <register address='0xb7e3070' value='0x" DATA.LONG(A:0x7e3070) "' name='RPMH_ARC_BCM_DRV3_RM7_VOTE'/>"
WRITE #1 "        <register address='0xb7e4000' value='0x" DATA.LONG(A:0x7e4000) "' name='RPMH_ARC_BCM_DRV4_RM0_VOTE'/>"
WRITE #1 "        <register address='0xb7e4010' value='0x" DATA.LONG(A:0x7e4010) "' name='RPMH_ARC_BCM_DRV4_RM1_VOTE'/>"
WRITE #1 "        <register address='0xb7e4020' value='0x" DATA.LONG(A:0x7e4020) "' name='RPMH_ARC_BCM_DRV4_RM2_VOTE'/>"
WRITE #1 "        <register address='0xb7e4030' value='0x" DATA.LONG(A:0x7e4030) "' name='RPMH_ARC_BCM_DRV4_RM3_VOTE'/>"
WRITE #1 "        <register address='0xb7e4040' value='0x" DATA.LONG(A:0x7e4040) "' name='RPMH_ARC_BCM_DRV4_RM4_VOTE'/>"
WRITE #1 "        <register address='0xb7e4050' value='0x" DATA.LONG(A:0x7e4050) "' name='RPMH_ARC_BCM_DRV4_RM5_VOTE'/>"
WRITE #1 "        <register address='0xb7e4060' value='0x" DATA.LONG(A:0x7e4060) "' name='RPMH_ARC_BCM_DRV4_RM6_VOTE'/>"
WRITE #1 "        <register address='0xb7e4070' value='0x" DATA.LONG(A:0x7e4070) "' name='RPMH_ARC_BCM_DRV4_RM7_VOTE'/>"
WRITE #1 "        <register address='0xb7e5000' value='0x" DATA.LONG(A:0x7e5000) "' name='RPMH_ARC_BCM_DRV5_RM0_VOTE'/>"
WRITE #1 "        <register address='0xb7e5010' value='0x" DATA.LONG(A:0x7e5010) "' name='RPMH_ARC_BCM_DRV5_RM1_VOTE'/>"
WRITE #1 "        <register address='0xb7e5020' value='0x" DATA.LONG(A:0x7e5020) "' name='RPMH_ARC_BCM_DRV5_RM2_VOTE'/>"
WRITE #1 "        <register address='0xb7e5030' value='0x" DATA.LONG(A:0x7e5030) "' name='RPMH_ARC_BCM_DRV5_RM3_VOTE'/>"
WRITE #1 "        <register address='0xb7e5040' value='0x" DATA.LONG(A:0x7e5040) "' name='RPMH_ARC_BCM_DRV5_RM4_VOTE'/>"
WRITE #1 "        <register address='0xb7e5050' value='0x" DATA.LONG(A:0x7e5050) "' name='RPMH_ARC_BCM_DRV5_RM5_VOTE'/>"
WRITE #1 "        <register address='0xb7e5060' value='0x" DATA.LONG(A:0x7e5060) "' name='RPMH_ARC_BCM_DRV5_RM6_VOTE'/>"
WRITE #1 "        <register address='0xb7e5070' value='0x" DATA.LONG(A:0x7e5070) "' name='RPMH_ARC_BCM_DRV5_RM7_VOTE'/>"
WRITE #1 "        <register address='0xb7e6000' value='0x" DATA.LONG(A:0x7e6000) "' name='RPMH_ARC_BCM_DRV6_RM0_VOTE'/>"
WRITE #1 "        <register address='0xb7e6010' value='0x" DATA.LONG(A:0x7e6010) "' name='RPMH_ARC_BCM_DRV6_RM1_VOTE'/>"
WRITE #1 "        <register address='0xb7e6020' value='0x" DATA.LONG(A:0x7e6020) "' name='RPMH_ARC_BCM_DRV6_RM2_VOTE'/>"
WRITE #1 "        <register address='0xb7e6030' value='0x" DATA.LONG(A:0x7e6030) "' name='RPMH_ARC_BCM_DRV6_RM3_VOTE'/>"
WRITE #1 "        <register address='0xb7e6040' value='0x" DATA.LONG(A:0x7e6040) "' name='RPMH_ARC_BCM_DRV6_RM4_VOTE'/>"
WRITE #1 "        <register address='0xb7e6050' value='0x" DATA.LONG(A:0x7e6050) "' name='RPMH_ARC_BCM_DRV6_RM5_VOTE'/>"
WRITE #1 "        <register address='0xb7e6060' value='0x" DATA.LONG(A:0x7e6060) "' name='RPMH_ARC_BCM_DRV6_RM6_VOTE'/>"
WRITE #1 "        <register address='0xb7e6070' value='0x" DATA.LONG(A:0x7e6070) "' name='RPMH_ARC_BCM_DRV6_RM7_VOTE'/>"
WRITE #1 "        <register address='0xb7e7000' value='0x" DATA.LONG(A:0x7e7000) "' name='RPMH_ARC_BCM_DRV7_RM0_VOTE'/>"
WRITE #1 "        <register address='0xb7e7010' value='0x" DATA.LONG(A:0x7e7010) "' name='RPMH_ARC_BCM_DRV7_RM1_VOTE'/>"
WRITE #1 "        <register address='0xb7e7020' value='0x" DATA.LONG(A:0x7e7020) "' name='RPMH_ARC_BCM_DRV7_RM2_VOTE'/>"
WRITE #1 "        <register address='0xb7e7030' value='0x" DATA.LONG(A:0x7e7030) "' name='RPMH_ARC_BCM_DRV7_RM3_VOTE'/>"
WRITE #1 "        <register address='0xb7e7040' value='0x" DATA.LONG(A:0x7e7040) "' name='RPMH_ARC_BCM_DRV7_RM4_VOTE'/>"
WRITE #1 "        <register address='0xb7e7050' value='0x" DATA.LONG(A:0x7e7050) "' name='RPMH_ARC_BCM_DRV7_RM5_VOTE'/>"
WRITE #1 "        <register address='0xb7e7060' value='0x" DATA.LONG(A:0x7e7060) "' name='RPMH_ARC_BCM_DRV7_RM6_VOTE'/>"
WRITE #1 "        <register address='0xb7e7070' value='0x" DATA.LONG(A:0x7e7070) "' name='RPMH_ARC_BCM_DRV7_RM7_VOTE'/>"
WRITE #1 "        <register address='0xb7e8000' value='0x" DATA.LONG(A:0x7e8000) "' name='RPMH_ARC_BCM_DRV8_RM0_VOTE'/>"
WRITE #1 "        <register address='0xb7e8010' value='0x" DATA.LONG(A:0x7e8010) "' name='RPMH_ARC_BCM_DRV8_RM1_VOTE'/>"
WRITE #1 "        <register address='0xb7e8020' value='0x" DATA.LONG(A:0x7e8020) "' name='RPMH_ARC_BCM_DRV8_RM2_VOTE'/>"
WRITE #1 "        <register address='0xb7e8030' value='0x" DATA.LONG(A:0x7e8030) "' name='RPMH_ARC_BCM_DRV8_RM3_VOTE'/>"
WRITE #1 "        <register address='0xb7e8040' value='0x" DATA.LONG(A:0x7e8040) "' name='RPMH_ARC_BCM_DRV8_RM4_VOTE'/>"
WRITE #1 "        <register address='0xb7e8050' value='0x" DATA.LONG(A:0x7e8050) "' name='RPMH_ARC_BCM_DRV8_RM5_VOTE'/>"
WRITE #1 "        <register address='0xb7e8060' value='0x" DATA.LONG(A:0x7e8060) "' name='RPMH_ARC_BCM_DRV8_RM6_VOTE'/>"
WRITE #1 "        <register address='0xb7e8070' value='0x" DATA.LONG(A:0x7e8070) "' name='RPMH_ARC_BCM_DRV8_RM7_VOTE'/>"
WRITE #1 "        <register address='0xb7e9000' value='0x" DATA.LONG(A:0x7e9000) "' name='RPMH_ARC_BCM_DRV9_RM0_VOTE'/>"
WRITE #1 "        <register address='0xb7e9010' value='0x" DATA.LONG(A:0x7e9010) "' name='RPMH_ARC_BCM_DRV9_RM1_VOTE'/>"
WRITE #1 "        <register address='0xb7e9020' value='0x" DATA.LONG(A:0x7e9020) "' name='RPMH_ARC_BCM_DRV9_RM2_VOTE'/>"
WRITE #1 "        <register address='0xb7e9030' value='0x" DATA.LONG(A:0x7e9030) "' name='RPMH_ARC_BCM_DRV9_RM3_VOTE'/>"
WRITE #1 "        <register address='0xb7e9040' value='0x" DATA.LONG(A:0x7e9040) "' name='RPMH_ARC_BCM_DRV9_RM4_VOTE'/>"
WRITE #1 "        <register address='0xb7e9050' value='0x" DATA.LONG(A:0x7e9050) "' name='RPMH_ARC_BCM_DRV9_RM5_VOTE'/>"
WRITE #1 "        <register address='0xb7e9060' value='0x" DATA.LONG(A:0x7e9060) "' name='RPMH_ARC_BCM_DRV9_RM6_VOTE'/>"
WRITE #1 "        <register address='0xb7e9070' value='0x" DATA.LONG(A:0x7e9070) "' name='RPMH_ARC_BCM_DRV9_RM7_VOTE'/>"
WRITE #1 "        <register address='0xb600004' value='0x" DATA.LONG(A:0x600004) "' name='RPMH_ARC_DRV0_RM0_TIMER'/>"
WRITE #1 "        <register address='0xb600014' value='0x" DATA.LONG(A:0x600014) "' name='RPMH_ARC_DRV0_RM1_TIMER'/>"
WRITE #1 "        <register address='0xb600024' value='0x" DATA.LONG(A:0x600024) "' name='RPMH_ARC_DRV0_RM2_TIMER'/>"
WRITE #1 "        <register address='0xb600034' value='0x" DATA.LONG(A:0x600034) "' name='RPMH_ARC_DRV0_RM3_TIMER'/>"
WRITE #1 "        <register address='0xb600044' value='0x" DATA.LONG(A:0x600044) "' name='RPMH_ARC_DRV0_RM4_TIMER'/>"
WRITE #1 "        <register address='0xb600054' value='0x" DATA.LONG(A:0x600054) "' name='RPMH_ARC_DRV0_RM5_TIMER'/>"
WRITE #1 "        <register address='0xb600064' value='0x" DATA.LONG(A:0x600064) "' name='RPMH_ARC_DRV0_RM6_TIMER'/>"
WRITE #1 "        <register address='0xb600074' value='0x" DATA.LONG(A:0x600074) "' name='RPMH_ARC_DRV0_RM7_TIMER'/>"
WRITE #1 "        <register address='0xb610004' value='0x" DATA.LONG(A:0x610004) "' name='RPMH_ARC_DRV1_RM0_TIMER'/>"
WRITE #1 "        <register address='0xb610014' value='0x" DATA.LONG(A:0x610014) "' name='RPMH_ARC_DRV1_RM1_TIMER'/>"
WRITE #1 "        <register address='0xb610024' value='0x" DATA.LONG(A:0x610024) "' name='RPMH_ARC_DRV1_RM2_TIMER'/>"
WRITE #1 "        <register address='0xb610034' value='0x" DATA.LONG(A:0x610034) "' name='RPMH_ARC_DRV1_RM3_TIMER'/>"
WRITE #1 "        <register address='0xb610044' value='0x" DATA.LONG(A:0x610044) "' name='RPMH_ARC_DRV1_RM4_TIMER'/>"
WRITE #1 "        <register address='0xb610054' value='0x" DATA.LONG(A:0x610054) "' name='RPMH_ARC_DRV1_RM5_TIMER'/>"
WRITE #1 "        <register address='0xb610064' value='0x" DATA.LONG(A:0x610064) "' name='RPMH_ARC_DRV1_RM6_TIMER'/>"
WRITE #1 "        <register address='0xb610074' value='0x" DATA.LONG(A:0x610074) "' name='RPMH_ARC_DRV1_RM7_TIMER'/>"
WRITE #1 "        <register address='0xb620004' value='0x" DATA.LONG(A:0x620004) "' name='RPMH_ARC_DRV2_RM0_TIMER'/>"
WRITE #1 "        <register address='0xb620014' value='0x" DATA.LONG(A:0x620014) "' name='RPMH_ARC_DRV2_RM1_TIMER'/>"
WRITE #1 "        <register address='0xb620024' value='0x" DATA.LONG(A:0x620024) "' name='RPMH_ARC_DRV2_RM2_TIMER'/>"
WRITE #1 "        <register address='0xb620034' value='0x" DATA.LONG(A:0x620034) "' name='RPMH_ARC_DRV2_RM3_TIMER'/>"
WRITE #1 "        <register address='0xb620044' value='0x" DATA.LONG(A:0x620044) "' name='RPMH_ARC_DRV2_RM4_TIMER'/>"
WRITE #1 "        <register address='0xb620054' value='0x" DATA.LONG(A:0x620054) "' name='RPMH_ARC_DRV2_RM5_TIMER'/>"
WRITE #1 "        <register address='0xb620064' value='0x" DATA.LONG(A:0x620064) "' name='RPMH_ARC_DRV2_RM6_TIMER'/>"
WRITE #1 "        <register address='0xb620074' value='0x" DATA.LONG(A:0x620074) "' name='RPMH_ARC_DRV2_RM7_TIMER'/>"
WRITE #1 "        <register address='0xb630004' value='0x" DATA.LONG(A:0x630004) "' name='RPMH_ARC_DRV3_RM0_TIMER'/>"
WRITE #1 "        <register address='0xb630014' value='0x" DATA.LONG(A:0x630014) "' name='RPMH_ARC_DRV3_RM1_TIMER'/>"
WRITE #1 "        <register address='0xb630024' value='0x" DATA.LONG(A:0x630024) "' name='RPMH_ARC_DRV3_RM2_TIMER'/>"
WRITE #1 "        <register address='0xb630034' value='0x" DATA.LONG(A:0x630034) "' name='RPMH_ARC_DRV3_RM3_TIMER'/>"
WRITE #1 "        <register address='0xb630044' value='0x" DATA.LONG(A:0x630044) "' name='RPMH_ARC_DRV3_RM4_TIMER'/>"
WRITE #1 "        <register address='0xb630054' value='0x" DATA.LONG(A:0x630054) "' name='RPMH_ARC_DRV3_RM5_TIMER'/>"
WRITE #1 "        <register address='0xb630064' value='0x" DATA.LONG(A:0x630064) "' name='RPMH_ARC_DRV3_RM6_TIMER'/>"
WRITE #1 "        <register address='0xb630074' value='0x" DATA.LONG(A:0x630074) "' name='RPMH_ARC_DRV3_RM7_TIMER'/>"
WRITE #1 "        <register address='0xb640004' value='0x" DATA.LONG(A:0x640004) "' name='RPMH_ARC_DRV4_RM0_TIMER'/>"
WRITE #1 "        <register address='0xb640014' value='0x" DATA.LONG(A:0x640014) "' name='RPMH_ARC_DRV4_RM1_TIMER'/>"
WRITE #1 "        <register address='0xb640024' value='0x" DATA.LONG(A:0x640024) "' name='RPMH_ARC_DRV4_RM2_TIMER'/>"
WRITE #1 "        <register address='0xb640034' value='0x" DATA.LONG(A:0x640034) "' name='RPMH_ARC_DRV4_RM3_TIMER'/>"
WRITE #1 "        <register address='0xb640044' value='0x" DATA.LONG(A:0x640044) "' name='RPMH_ARC_DRV4_RM4_TIMER'/>"
WRITE #1 "        <register address='0xb640054' value='0x" DATA.LONG(A:0x640054) "' name='RPMH_ARC_DRV4_RM5_TIMER'/>"
WRITE #1 "        <register address='0xb640064' value='0x" DATA.LONG(A:0x640064) "' name='RPMH_ARC_DRV4_RM6_TIMER'/>"
WRITE #1 "        <register address='0xb640074' value='0x" DATA.LONG(A:0x640074) "' name='RPMH_ARC_DRV4_RM7_TIMER'/>"
WRITE #1 "        <register address='0xb650004' value='0x" DATA.LONG(A:0x650004) "' name='RPMH_ARC_DRV5_RM0_TIMER'/>"
WRITE #1 "        <register address='0xb650014' value='0x" DATA.LONG(A:0x650014) "' name='RPMH_ARC_DRV5_RM1_TIMER'/>"
WRITE #1 "        <register address='0xb650024' value='0x" DATA.LONG(A:0x650024) "' name='RPMH_ARC_DRV5_RM2_TIMER'/>"
WRITE #1 "        <register address='0xb650034' value='0x" DATA.LONG(A:0x650034) "' name='RPMH_ARC_DRV5_RM3_TIMER'/>"
WRITE #1 "        <register address='0xb650044' value='0x" DATA.LONG(A:0x650044) "' name='RPMH_ARC_DRV5_RM4_TIMER'/>"
WRITE #1 "        <register address='0xb650054' value='0x" DATA.LONG(A:0x650054) "' name='RPMH_ARC_DRV5_RM5_TIMER'/>"
WRITE #1 "        <register address='0xb650064' value='0x" DATA.LONG(A:0x650064) "' name='RPMH_ARC_DRV5_RM6_TIMER'/>"
WRITE #1 "        <register address='0xb650074' value='0x" DATA.LONG(A:0x650074) "' name='RPMH_ARC_DRV5_RM7_TIMER'/>"
WRITE #1 "        <register address='0xb660004' value='0x" DATA.LONG(A:0x660004) "' name='RPMH_ARC_DRV6_RM0_TIMER'/>"
WRITE #1 "        <register address='0xb660014' value='0x" DATA.LONG(A:0x660014) "' name='RPMH_ARC_DRV6_RM1_TIMER'/>"
WRITE #1 "        <register address='0xb660024' value='0x" DATA.LONG(A:0x660024) "' name='RPMH_ARC_DRV6_RM2_TIMER'/>"
WRITE #1 "        <register address='0xb660034' value='0x" DATA.LONG(A:0x660034) "' name='RPMH_ARC_DRV6_RM3_TIMER'/>"
WRITE #1 "        <register address='0xb660044' value='0x" DATA.LONG(A:0x660044) "' name='RPMH_ARC_DRV6_RM4_TIMER'/>"
WRITE #1 "        <register address='0xb660054' value='0x" DATA.LONG(A:0x660054) "' name='RPMH_ARC_DRV6_RM5_TIMER'/>"
WRITE #1 "        <register address='0xb660064' value='0x" DATA.LONG(A:0x660064) "' name='RPMH_ARC_DRV6_RM6_TIMER'/>"
WRITE #1 "        <register address='0xb660074' value='0x" DATA.LONG(A:0x660074) "' name='RPMH_ARC_DRV6_RM7_TIMER'/>"
WRITE #1 "        <register address='0xb670004' value='0x" DATA.LONG(A:0x670004) "' name='RPMH_ARC_DRV7_RM0_TIMER'/>"
WRITE #1 "        <register address='0xb670014' value='0x" DATA.LONG(A:0x670014) "' name='RPMH_ARC_DRV7_RM1_TIMER'/>"
WRITE #1 "        <register address='0xb670024' value='0x" DATA.LONG(A:0x670024) "' name='RPMH_ARC_DRV7_RM2_TIMER'/>"
WRITE #1 "        <register address='0xb670034' value='0x" DATA.LONG(A:0x670034) "' name='RPMH_ARC_DRV7_RM3_TIMER'/>"
WRITE #1 "        <register address='0xb670044' value='0x" DATA.LONG(A:0x670044) "' name='RPMH_ARC_DRV7_RM4_TIMER'/>"
WRITE #1 "        <register address='0xb670054' value='0x" DATA.LONG(A:0x670054) "' name='RPMH_ARC_DRV7_RM5_TIMER'/>"
WRITE #1 "        <register address='0xb670064' value='0x" DATA.LONG(A:0x670064) "' name='RPMH_ARC_DRV7_RM6_TIMER'/>"
WRITE #1 "        <register address='0xb670074' value='0x" DATA.LONG(A:0x670074) "' name='RPMH_ARC_DRV7_RM7_TIMER'/>"
WRITE #1 "        <register address='0xb680004' value='0x" DATA.LONG(A:0x680004) "' name='RPMH_ARC_DRV8_RM0_TIMER'/>"
WRITE #1 "        <register address='0xb680014' value='0x" DATA.LONG(A:0x680014) "' name='RPMH_ARC_DRV8_RM1_TIMER'/>"
WRITE #1 "        <register address='0xb680024' value='0x" DATA.LONG(A:0x680024) "' name='RPMH_ARC_DRV8_RM2_TIMER'/>"
WRITE #1 "        <register address='0xb680034' value='0x" DATA.LONG(A:0x680034) "' name='RPMH_ARC_DRV8_RM3_TIMER'/>"
WRITE #1 "        <register address='0xb680044' value='0x" DATA.LONG(A:0x680044) "' name='RPMH_ARC_DRV8_RM4_TIMER'/>"
WRITE #1 "        <register address='0xb680054' value='0x" DATA.LONG(A:0x680054) "' name='RPMH_ARC_DRV8_RM5_TIMER'/>"
WRITE #1 "        <register address='0xb680064' value='0x" DATA.LONG(A:0x680064) "' name='RPMH_ARC_DRV8_RM6_TIMER'/>"
WRITE #1 "        <register address='0xb680074' value='0x" DATA.LONG(A:0x680074) "' name='RPMH_ARC_DRV8_RM7_TIMER'/>"
WRITE #1 "        <register address='0xb690004' value='0x" DATA.LONG(A:0x690004) "' name='RPMH_ARC_DRV9_RM0_TIMER'/>"
WRITE #1 "        <register address='0xb690014' value='0x" DATA.LONG(A:0x690014) "' name='RPMH_ARC_DRV9_RM1_TIMER'/>"
WRITE #1 "        <register address='0xb690024' value='0x" DATA.LONG(A:0x690024) "' name='RPMH_ARC_DRV9_RM2_TIMER'/>"
WRITE #1 "        <register address='0xb690034' value='0x" DATA.LONG(A:0x690034) "' name='RPMH_ARC_DRV9_RM3_TIMER'/>"
WRITE #1 "        <register address='0xb690044' value='0x" DATA.LONG(A:0x690044) "' name='RPMH_ARC_DRV9_RM4_TIMER'/>"
WRITE #1 "        <register address='0xb690054' value='0x" DATA.LONG(A:0x690054) "' name='RPMH_ARC_DRV9_RM5_TIMER'/>"
WRITE #1 "        <register address='0xb690064' value='0x" DATA.LONG(A:0x690064) "' name='RPMH_ARC_DRV9_RM6_TIMER'/>"
WRITE #1 "        <register address='0xb690074' value='0x" DATA.LONG(A:0x690074) "' name='RPMH_ARC_DRV9_RM7_TIMER'/>"
WRITE #1 "        <register address='0xb6a0004' value='0x" DATA.LONG(A:0x6a0004) "' name='RPMH_ARC_DRV10_RM0_TIMER'/>"
WRITE #1 "        <register address='0xb6a0014' value='0x" DATA.LONG(A:0x6a0014) "' name='RPMH_ARC_DRV10_RM1_TIMER'/>"
WRITE #1 "        <register address='0xb6a0024' value='0x" DATA.LONG(A:0x6a0024) "' name='RPMH_ARC_DRV10_RM2_TIMER'/>"
WRITE #1 "        <register address='0xb6a0034' value='0x" DATA.LONG(A:0x6a0034) "' name='RPMH_ARC_DRV10_RM3_TIMER'/>"
WRITE #1 "        <register address='0xb6a0044' value='0x" DATA.LONG(A:0x6a0044) "' name='RPMH_ARC_DRV10_RM4_TIMER'/>"
WRITE #1 "        <register address='0xb6a0054' value='0x" DATA.LONG(A:0x6a0054) "' name='RPMH_ARC_DRV10_RM5_TIMER'/>"
WRITE #1 "        <register address='0xb6a0064' value='0x" DATA.LONG(A:0x6a0064) "' name='RPMH_ARC_DRV10_RM6_TIMER'/>"
WRITE #1 "        <register address='0xb6a0074' value='0x" DATA.LONG(A:0x6a0074) "' name='RPMH_ARC_DRV10_RM7_TIMER'/>"
WRITE #1 "        <register address='0xb600008' value='0x" DATA.LONG(A:0x600008) "' name='RPMH_ARC_DRV0_RM0_SHADOW_STATUS'/>"
WRITE #1 "        <register address='0xb600018' value='0x" DATA.LONG(A:0x600018) "' name='RPMH_ARC_DRV0_RM1_SHADOW_STATUS'/>"
WRITE #1 "        <register address='0xb600028' value='0x" DATA.LONG(A:0x600028) "' name='RPMH_ARC_DRV0_RM2_SHADOW_STATUS'/>"
WRITE #1 "        <register address='0xb600038' value='0x" DATA.LONG(A:0x600038) "' name='RPMH_ARC_DRV0_RM3_SHADOW_STATUS'/>"
WRITE #1 "        <register address='0xb600048' value='0x" DATA.LONG(A:0x600048) "' name='RPMH_ARC_DRV0_RM4_SHADOW_STATUS'/>"
WRITE #1 "        <register address='0xb600058' value='0x" DATA.LONG(A:0x600058) "' name='RPMH_ARC_DRV0_RM5_SHADOW_STATUS'/>"
WRITE #1 "        <register address='0xb600068' value='0x" DATA.LONG(A:0x600068) "' name='RPMH_ARC_DRV0_RM6_SHADOW_STATUS'/>"
WRITE #1 "        <register address='0xb600078' value='0x" DATA.LONG(A:0x600078) "' name='RPMH_ARC_DRV0_RM7_SHADOW_STATUS'/>"
WRITE #1 "        <register address='0xb610008' value='0x" DATA.LONG(A:0x610008) "' name='RPMH_ARC_DRV1_RM0_SHADOW_STATUS'/>"
WRITE #1 "        <register address='0xb610018' value='0x" DATA.LONG(A:0x610018) "' name='RPMH_ARC_DRV1_RM1_SHADOW_STATUS'/>"
WRITE #1 "        <register address='0xb610028' value='0x" DATA.LONG(A:0x610028) "' name='RPMH_ARC_DRV1_RM2_SHADOW_STATUS'/>"
WRITE #1 "        <register address='0xb610038' value='0x" DATA.LONG(A:0x610038) "' name='RPMH_ARC_DRV1_RM3_SHADOW_STATUS'/>"
WRITE #1 "        <register address='0xb610048' value='0x" DATA.LONG(A:0x610048) "' name='RPMH_ARC_DRV1_RM4_SHADOW_STATUS'/>"
WRITE #1 "        <register address='0xb610058' value='0x" DATA.LONG(A:0x610058) "' name='RPMH_ARC_DRV1_RM5_SHADOW_STATUS'/>"
WRITE #1 "        <register address='0xb610068' value='0x" DATA.LONG(A:0x610068) "' name='RPMH_ARC_DRV1_RM6_SHADOW_STATUS'/>"
WRITE #1 "        <register address='0xb610078' value='0x" DATA.LONG(A:0x610078) "' name='RPMH_ARC_DRV1_RM7_SHADOW_STATUS'/>"
WRITE #1 "        <register address='0xb620008' value='0x" DATA.LONG(A:0x620008) "' name='RPMH_ARC_DRV2_RM0_SHADOW_STATUS'/>"
WRITE #1 "        <register address='0xb620018' value='0x" DATA.LONG(A:0x620018) "' name='RPMH_ARC_DRV2_RM1_SHADOW_STATUS'/>"
WRITE #1 "        <register address='0xb620028' value='0x" DATA.LONG(A:0x620028) "' name='RPMH_ARC_DRV2_RM2_SHADOW_STATUS'/>"
WRITE #1 "        <register address='0xb620038' value='0x" DATA.LONG(A:0x620038) "' name='RPMH_ARC_DRV2_RM3_SHADOW_STATUS'/>"
WRITE #1 "        <register address='0xb620048' value='0x" DATA.LONG(A:0x620048) "' name='RPMH_ARC_DRV2_RM4_SHADOW_STATUS'/>"
WRITE #1 "        <register address='0xb620058' value='0x" DATA.LONG(A:0x620058) "' name='RPMH_ARC_DRV2_RM5_SHADOW_STATUS'/>"
WRITE #1 "        <register address='0xb620068' value='0x" DATA.LONG(A:0x620068) "' name='RPMH_ARC_DRV2_RM6_SHADOW_STATUS'/>"
WRITE #1 "        <register address='0xb620078' value='0x" DATA.LONG(A:0x620078) "' name='RPMH_ARC_DRV2_RM7_SHADOW_STATUS'/>"
WRITE #1 "        <register address='0xb630008' value='0x" DATA.LONG(A:0x630008) "' name='RPMH_ARC_DRV3_RM0_SHADOW_STATUS'/>"
WRITE #1 "        <register address='0xb630018' value='0x" DATA.LONG(A:0x630018) "' name='RPMH_ARC_DRV3_RM1_SHADOW_STATUS'/>"
WRITE #1 "        <register address='0xb630028' value='0x" DATA.LONG(A:0x630028) "' name='RPMH_ARC_DRV3_RM2_SHADOW_STATUS'/>"
WRITE #1 "        <register address='0xb630038' value='0x" DATA.LONG(A:0x630038) "' name='RPMH_ARC_DRV3_RM3_SHADOW_STATUS'/>"
WRITE #1 "        <register address='0xb630048' value='0x" DATA.LONG(A:0x630048) "' name='RPMH_ARC_DRV3_RM4_SHADOW_STATUS'/>"
WRITE #1 "        <register address='0xb630058' value='0x" DATA.LONG(A:0x630058) "' name='RPMH_ARC_DRV3_RM5_SHADOW_STATUS'/>"
WRITE #1 "        <register address='0xb630068' value='0x" DATA.LONG(A:0x630068) "' name='RPMH_ARC_DRV3_RM6_SHADOW_STATUS'/>"
WRITE #1 "        <register address='0xb630078' value='0x" DATA.LONG(A:0x630078) "' name='RPMH_ARC_DRV3_RM7_SHADOW_STATUS'/>"
WRITE #1 "        <register address='0xb640008' value='0x" DATA.LONG(A:0x640008) "' name='RPMH_ARC_DRV4_RM0_SHADOW_STATUS'/>"
WRITE #1 "        <register address='0xb640018' value='0x" DATA.LONG(A:0x640018) "' name='RPMH_ARC_DRV4_RM1_SHADOW_STATUS'/>"
WRITE #1 "        <register address='0xb640028' value='0x" DATA.LONG(A:0x640028) "' name='RPMH_ARC_DRV4_RM2_SHADOW_STATUS'/>"
WRITE #1 "        <register address='0xb640038' value='0x" DATA.LONG(A:0x640038) "' name='RPMH_ARC_DRV4_RM3_SHADOW_STATUS'/>"
WRITE #1 "        <register address='0xb640048' value='0x" DATA.LONG(A:0x640048) "' name='RPMH_ARC_DRV4_RM4_SHADOW_STATUS'/>"
WRITE #1 "        <register address='0xb640058' value='0x" DATA.LONG(A:0x640058) "' name='RPMH_ARC_DRV4_RM5_SHADOW_STATUS'/>"
WRITE #1 "        <register address='0xb640068' value='0x" DATA.LONG(A:0x640068) "' name='RPMH_ARC_DRV4_RM6_SHADOW_STATUS'/>"
WRITE #1 "        <register address='0xb640078' value='0x" DATA.LONG(A:0x640078) "' name='RPMH_ARC_DRV4_RM7_SHADOW_STATUS'/>"
WRITE #1 "        <register address='0xb650008' value='0x" DATA.LONG(A:0x650008) "' name='RPMH_ARC_DRV5_RM0_SHADOW_STATUS'/>"
WRITE #1 "        <register address='0xb650018' value='0x" DATA.LONG(A:0x650018) "' name='RPMH_ARC_DRV5_RM1_SHADOW_STATUS'/>"
WRITE #1 "        <register address='0xb650028' value='0x" DATA.LONG(A:0x650028) "' name='RPMH_ARC_DRV5_RM2_SHADOW_STATUS'/>"
WRITE #1 "        <register address='0xb650038' value='0x" DATA.LONG(A:0x650038) "' name='RPMH_ARC_DRV5_RM3_SHADOW_STATUS'/>"
WRITE #1 "        <register address='0xb650048' value='0x" DATA.LONG(A:0x650048) "' name='RPMH_ARC_DRV5_RM4_SHADOW_STATUS'/>"
WRITE #1 "        <register address='0xb650058' value='0x" DATA.LONG(A:0x650058) "' name='RPMH_ARC_DRV5_RM5_SHADOW_STATUS'/>"
WRITE #1 "        <register address='0xb650068' value='0x" DATA.LONG(A:0x650068) "' name='RPMH_ARC_DRV5_RM6_SHADOW_STATUS'/>"
WRITE #1 "        <register address='0xb650078' value='0x" DATA.LONG(A:0x650078) "' name='RPMH_ARC_DRV5_RM7_SHADOW_STATUS'/>"
WRITE #1 "        <register address='0xb660008' value='0x" DATA.LONG(A:0x660008) "' name='RPMH_ARC_DRV6_RM0_SHADOW_STATUS'/>"
WRITE #1 "        <register address='0xb660018' value='0x" DATA.LONG(A:0x660018) "' name='RPMH_ARC_DRV6_RM1_SHADOW_STATUS'/>"
WRITE #1 "        <register address='0xb660028' value='0x" DATA.LONG(A:0x660028) "' name='RPMH_ARC_DRV6_RM2_SHADOW_STATUS'/>"
WRITE #1 "        <register address='0xb660038' value='0x" DATA.LONG(A:0x660038) "' name='RPMH_ARC_DRV6_RM3_SHADOW_STATUS'/>"
WRITE #1 "        <register address='0xb660048' value='0x" DATA.LONG(A:0x660048) "' name='RPMH_ARC_DRV6_RM4_SHADOW_STATUS'/>"
WRITE #1 "        <register address='0xb660058' value='0x" DATA.LONG(A:0x660058) "' name='RPMH_ARC_DRV6_RM5_SHADOW_STATUS'/>"
WRITE #1 "        <register address='0xb660068' value='0x" DATA.LONG(A:0x660068) "' name='RPMH_ARC_DRV6_RM6_SHADOW_STATUS'/>"
WRITE #1 "        <register address='0xb660078' value='0x" DATA.LONG(A:0x660078) "' name='RPMH_ARC_DRV6_RM7_SHADOW_STATUS'/>"
WRITE #1 "        <register address='0xb670008' value='0x" DATA.LONG(A:0x670008) "' name='RPMH_ARC_DRV7_RM0_SHADOW_STATUS'/>"
WRITE #1 "        <register address='0xb670018' value='0x" DATA.LONG(A:0x670018) "' name='RPMH_ARC_DRV7_RM1_SHADOW_STATUS'/>"
WRITE #1 "        <register address='0xb670028' value='0x" DATA.LONG(A:0x670028) "' name='RPMH_ARC_DRV7_RM2_SHADOW_STATUS'/>"
WRITE #1 "        <register address='0xb670038' value='0x" DATA.LONG(A:0x670038) "' name='RPMH_ARC_DRV7_RM3_SHADOW_STATUS'/>"
WRITE #1 "        <register address='0xb670048' value='0x" DATA.LONG(A:0x670048) "' name='RPMH_ARC_DRV7_RM4_SHADOW_STATUS'/>"
WRITE #1 "        <register address='0xb670058' value='0x" DATA.LONG(A:0x670058) "' name='RPMH_ARC_DRV7_RM5_SHADOW_STATUS'/>"
WRITE #1 "        <register address='0xb670068' value='0x" DATA.LONG(A:0x670068) "' name='RPMH_ARC_DRV7_RM6_SHADOW_STATUS'/>"
WRITE #1 "        <register address='0xb670078' value='0x" DATA.LONG(A:0x670078) "' name='RPMH_ARC_DRV7_RM7_SHADOW_STATUS'/>"
WRITE #1 "        <register address='0xb680008' value='0x" DATA.LONG(A:0x680008) "' name='RPMH_ARC_DRV8_RM0_SHADOW_STATUS'/>"
WRITE #1 "        <register address='0xb680018' value='0x" DATA.LONG(A:0x680018) "' name='RPMH_ARC_DRV8_RM1_SHADOW_STATUS'/>"
WRITE #1 "        <register address='0xb680028' value='0x" DATA.LONG(A:0x680028) "' name='RPMH_ARC_DRV8_RM2_SHADOW_STATUS'/>"
WRITE #1 "        <register address='0xb680038' value='0x" DATA.LONG(A:0x680038) "' name='RPMH_ARC_DRV8_RM3_SHADOW_STATUS'/>"
WRITE #1 "        <register address='0xb680048' value='0x" DATA.LONG(A:0x680048) "' name='RPMH_ARC_DRV8_RM4_SHADOW_STATUS'/>"
WRITE #1 "        <register address='0xb680058' value='0x" DATA.LONG(A:0x680058) "' name='RPMH_ARC_DRV8_RM5_SHADOW_STATUS'/>"
WRITE #1 "        <register address='0xb680068' value='0x" DATA.LONG(A:0x680068) "' name='RPMH_ARC_DRV8_RM6_SHADOW_STATUS'/>"
WRITE #1 "        <register address='0xb680078' value='0x" DATA.LONG(A:0x680078) "' name='RPMH_ARC_DRV8_RM7_SHADOW_STATUS'/>"
WRITE #1 "        <register address='0xb690008' value='0x" DATA.LONG(A:0x690008) "' name='RPMH_ARC_DRV9_RM0_SHADOW_STATUS'/>"
WRITE #1 "        <register address='0xb690018' value='0x" DATA.LONG(A:0x690018) "' name='RPMH_ARC_DRV9_RM1_SHADOW_STATUS'/>"
WRITE #1 "        <register address='0xb690028' value='0x" DATA.LONG(A:0x690028) "' name='RPMH_ARC_DRV9_RM2_SHADOW_STATUS'/>"
WRITE #1 "        <register address='0xb690038' value='0x" DATA.LONG(A:0x690038) "' name='RPMH_ARC_DRV9_RM3_SHADOW_STATUS'/>"
WRITE #1 "        <register address='0xb690048' value='0x" DATA.LONG(A:0x690048) "' name='RPMH_ARC_DRV9_RM4_SHADOW_STATUS'/>"
WRITE #1 "        <register address='0xb690058' value='0x" DATA.LONG(A:0x690058) "' name='RPMH_ARC_DRV9_RM5_SHADOW_STATUS'/>"
WRITE #1 "        <register address='0xb690068' value='0x" DATA.LONG(A:0x690068) "' name='RPMH_ARC_DRV9_RM6_SHADOW_STATUS'/>"
WRITE #1 "        <register address='0xb690078' value='0x" DATA.LONG(A:0x690078) "' name='RPMH_ARC_DRV9_RM7_SHADOW_STATUS'/>"
WRITE #1 "        <register address='0xb6a0008' value='0x" DATA.LONG(A:0x6a0008) "' name='RPMH_ARC_DRV10_RM0_SHADOW_STATUS'/>"
WRITE #1 "        <register address='0xb6a0018' value='0x" DATA.LONG(A:0x6a0018) "' name='RPMH_ARC_DRV10_RM1_SHADOW_STATUS'/>"
WRITE #1 "        <register address='0xb6a0028' value='0x" DATA.LONG(A:0x6a0028) "' name='RPMH_ARC_DRV10_RM2_SHADOW_STATUS'/>"
WRITE #1 "        <register address='0xb6a0038' value='0x" DATA.LONG(A:0x6a0038) "' name='RPMH_ARC_DRV10_RM3_SHADOW_STATUS'/>"
WRITE #1 "        <register address='0xb6a0048' value='0x" DATA.LONG(A:0x6a0048) "' name='RPMH_ARC_DRV10_RM4_SHADOW_STATUS'/>"
WRITE #1 "        <register address='0xb6a0058' value='0x" DATA.LONG(A:0x6a0058) "' name='RPMH_ARC_DRV10_RM5_SHADOW_STATUS'/>"
WRITE #1 "        <register address='0xb6a0068' value='0x" DATA.LONG(A:0x6a0068) "' name='RPMH_ARC_DRV10_RM6_SHADOW_STATUS'/>"
WRITE #1 "        <register address='0xb6a0078' value='0x" DATA.LONG(A:0x6a0078) "' name='RPMH_ARC_DRV10_RM7_SHADOW_STATUS'/>"
WRITE #1 "        <register address='0xb7e0008' value='0x" DATA.LONG(A:0x7e0008) "' name='RPMH_ARC_BCM_DRV0_RM0_SHADOW_STATUS'/>"
WRITE #1 "        <register address='0xb7e0018' value='0x" DATA.LONG(A:0x7e0018) "' name='RPMH_ARC_BCM_DRV0_RM1_SHADOW_STATUS'/>"
WRITE #1 "        <register address='0xb7e0028' value='0x" DATA.LONG(A:0x7e0028) "' name='RPMH_ARC_BCM_DRV0_RM2_SHADOW_STATUS'/>"
WRITE #1 "        <register address='0xb7e0038' value='0x" DATA.LONG(A:0x7e0038) "' name='RPMH_ARC_BCM_DRV0_RM3_SHADOW_STATUS'/>"
WRITE #1 "        <register address='0xb7e0048' value='0x" DATA.LONG(A:0x7e0048) "' name='RPMH_ARC_BCM_DRV0_RM4_SHADOW_STATUS'/>"
WRITE #1 "        <register address='0xb7e0058' value='0x" DATA.LONG(A:0x7e0058) "' name='RPMH_ARC_BCM_DRV0_RM5_SHADOW_STATUS'/>"
WRITE #1 "        <register address='0xb7e0068' value='0x" DATA.LONG(A:0x7e0068) "' name='RPMH_ARC_BCM_DRV0_RM6_SHADOW_STATUS'/>"
WRITE #1 "        <register address='0xb7e0078' value='0x" DATA.LONG(A:0x7e0078) "' name='RPMH_ARC_BCM_DRV0_RM7_SHADOW_STATUS'/>"
WRITE #1 "        <register address='0xb7e1008' value='0x" DATA.LONG(A:0x7e1008) "' name='RPMH_ARC_BCM_DRV1_RM0_SHADOW_STATUS'/>"
WRITE #1 "        <register address='0xb7e1018' value='0x" DATA.LONG(A:0x7e1018) "' name='RPMH_ARC_BCM_DRV1_RM1_SHADOW_STATUS'/>"
WRITE #1 "        <register address='0xb7e1028' value='0x" DATA.LONG(A:0x7e1028) "' name='RPMH_ARC_BCM_DRV1_RM2_SHADOW_STATUS'/>"
WRITE #1 "        <register address='0xb7e1038' value='0x" DATA.LONG(A:0x7e1038) "' name='RPMH_ARC_BCM_DRV1_RM3_SHADOW_STATUS'/>"
WRITE #1 "        <register address='0xb7e1048' value='0x" DATA.LONG(A:0x7e1048) "' name='RPMH_ARC_BCM_DRV1_RM4_SHADOW_STATUS'/>"
WRITE #1 "        <register address='0xb7e1058' value='0x" DATA.LONG(A:0x7e1058) "' name='RPMH_ARC_BCM_DRV1_RM5_SHADOW_STATUS'/>"
WRITE #1 "        <register address='0xb7e1068' value='0x" DATA.LONG(A:0x7e1068) "' name='RPMH_ARC_BCM_DRV1_RM6_SHADOW_STATUS'/>"
WRITE #1 "        <register address='0xb7e1078' value='0x" DATA.LONG(A:0x7e1078) "' name='RPMH_ARC_BCM_DRV1_RM7_SHADOW_STATUS'/>"
WRITE #1 "        <register address='0xb7e2008' value='0x" DATA.LONG(A:0x7e2008) "' name='RPMH_ARC_BCM_DRV2_RM0_SHADOW_STATUS'/>"
WRITE #1 "        <register address='0xb7e2018' value='0x" DATA.LONG(A:0x7e2018) "' name='RPMH_ARC_BCM_DRV2_RM1_SHADOW_STATUS'/>"
WRITE #1 "        <register address='0xb7e2028' value='0x" DATA.LONG(A:0x7e2028) "' name='RPMH_ARC_BCM_DRV2_RM2_SHADOW_STATUS'/>"
WRITE #1 "        <register address='0xb7e2038' value='0x" DATA.LONG(A:0x7e2038) "' name='RPMH_ARC_BCM_DRV2_RM3_SHADOW_STATUS'/>"
WRITE #1 "        <register address='0xb7e2048' value='0x" DATA.LONG(A:0x7e2048) "' name='RPMH_ARC_BCM_DRV2_RM4_SHADOW_STATUS'/>"
WRITE #1 "        <register address='0xb7e2058' value='0x" DATA.LONG(A:0x7e2058) "' name='RPMH_ARC_BCM_DRV2_RM5_SHADOW_STATUS'/>"
WRITE #1 "        <register address='0xb7e2068' value='0x" DATA.LONG(A:0x7e2068) "' name='RPMH_ARC_BCM_DRV2_RM6_SHADOW_STATUS'/>"
WRITE #1 "        <register address='0xb7e2078' value='0x" DATA.LONG(A:0x7e2078) "' name='RPMH_ARC_BCM_DRV2_RM7_SHADOW_STATUS'/>"
WRITE #1 "        <register address='0xb7e3008' value='0x" DATA.LONG(A:0x7e3008) "' name='RPMH_ARC_BCM_DRV3_RM0_SHADOW_STATUS'/>"
WRITE #1 "        <register address='0xb7e3018' value='0x" DATA.LONG(A:0x7e3018) "' name='RPMH_ARC_BCM_DRV3_RM1_SHADOW_STATUS'/>"
WRITE #1 "        <register address='0xb7e3028' value='0x" DATA.LONG(A:0x7e3028) "' name='RPMH_ARC_BCM_DRV3_RM2_SHADOW_STATUS'/>"
WRITE #1 "        <register address='0xb7e3038' value='0x" DATA.LONG(A:0x7e3038) "' name='RPMH_ARC_BCM_DRV3_RM3_SHADOW_STATUS'/>"
WRITE #1 "        <register address='0xb7e3048' value='0x" DATA.LONG(A:0x7e3048) "' name='RPMH_ARC_BCM_DRV3_RM4_SHADOW_STATUS'/>"
WRITE #1 "        <register address='0xb7e3058' value='0x" DATA.LONG(A:0x7e3058) "' name='RPMH_ARC_BCM_DRV3_RM5_SHADOW_STATUS'/>"
WRITE #1 "        <register address='0xb7e3068' value='0x" DATA.LONG(A:0x7e3068) "' name='RPMH_ARC_BCM_DRV3_RM6_SHADOW_STATUS'/>"
WRITE #1 "        <register address='0xb7e3078' value='0x" DATA.LONG(A:0x7e3078) "' name='RPMH_ARC_BCM_DRV3_RM7_SHADOW_STATUS'/>"
WRITE #1 "        <register address='0xb7e4008' value='0x" DATA.LONG(A:0x7e4008) "' name='RPMH_ARC_BCM_DRV4_RM0_SHADOW_STATUS'/>"
WRITE #1 "        <register address='0xb7e4018' value='0x" DATA.LONG(A:0x7e4018) "' name='RPMH_ARC_BCM_DRV4_RM1_SHADOW_STATUS'/>"
WRITE #1 "        <register address='0xb7e4028' value='0x" DATA.LONG(A:0x7e4028) "' name='RPMH_ARC_BCM_DRV4_RM2_SHADOW_STATUS'/>"
WRITE #1 "        <register address='0xb7e4038' value='0x" DATA.LONG(A:0x7e4038) "' name='RPMH_ARC_BCM_DRV4_RM3_SHADOW_STATUS'/>"
WRITE #1 "        <register address='0xb7e4048' value='0x" DATA.LONG(A:0x7e4048) "' name='RPMH_ARC_BCM_DRV4_RM4_SHADOW_STATUS'/>"
WRITE #1 "        <register address='0xb7e4058' value='0x" DATA.LONG(A:0x7e4058) "' name='RPMH_ARC_BCM_DRV4_RM5_SHADOW_STATUS'/>"
WRITE #1 "        <register address='0xb7e4068' value='0x" DATA.LONG(A:0x7e4068) "' name='RPMH_ARC_BCM_DRV4_RM6_SHADOW_STATUS'/>"
WRITE #1 "        <register address='0xb7e4078' value='0x" DATA.LONG(A:0x7e4078) "' name='RPMH_ARC_BCM_DRV4_RM7_SHADOW_STATUS'/>"
WRITE #1 "        <register address='0xb7e5008' value='0x" DATA.LONG(A:0x7e5008) "' name='RPMH_ARC_BCM_DRV5_RM0_SHADOW_STATUS'/>"
WRITE #1 "        <register address='0xb7e5018' value='0x" DATA.LONG(A:0x7e5018) "' name='RPMH_ARC_BCM_DRV5_RM1_SHADOW_STATUS'/>"
WRITE #1 "        <register address='0xb7e5028' value='0x" DATA.LONG(A:0x7e5028) "' name='RPMH_ARC_BCM_DRV5_RM2_SHADOW_STATUS'/>"
WRITE #1 "        <register address='0xb7e5038' value='0x" DATA.LONG(A:0x7e5038) "' name='RPMH_ARC_BCM_DRV5_RM3_SHADOW_STATUS'/>"
WRITE #1 "        <register address='0xb7e5048' value='0x" DATA.LONG(A:0x7e5048) "' name='RPMH_ARC_BCM_DRV5_RM4_SHADOW_STATUS'/>"
WRITE #1 "        <register address='0xb7e5058' value='0x" DATA.LONG(A:0x7e5058) "' name='RPMH_ARC_BCM_DRV5_RM5_SHADOW_STATUS'/>"
WRITE #1 "        <register address='0xb7e5068' value='0x" DATA.LONG(A:0x7e5068) "' name='RPMH_ARC_BCM_DRV5_RM6_SHADOW_STATUS'/>"
WRITE #1 "        <register address='0xb7e5078' value='0x" DATA.LONG(A:0x7e5078) "' name='RPMH_ARC_BCM_DRV5_RM7_SHADOW_STATUS'/>"
WRITE #1 "        <register address='0xb7e6008' value='0x" DATA.LONG(A:0x7e6008) "' name='RPMH_ARC_BCM_DRV6_RM0_SHADOW_STATUS'/>"
WRITE #1 "        <register address='0xb7e6018' value='0x" DATA.LONG(A:0x7e6018) "' name='RPMH_ARC_BCM_DRV6_RM1_SHADOW_STATUS'/>"
WRITE #1 "        <register address='0xb7e6028' value='0x" DATA.LONG(A:0x7e6028) "' name='RPMH_ARC_BCM_DRV6_RM2_SHADOW_STATUS'/>"
WRITE #1 "        <register address='0xb7e6038' value='0x" DATA.LONG(A:0x7e6038) "' name='RPMH_ARC_BCM_DRV6_RM3_SHADOW_STATUS'/>"
WRITE #1 "        <register address='0xb7e6048' value='0x" DATA.LONG(A:0x7e6048) "' name='RPMH_ARC_BCM_DRV6_RM4_SHADOW_STATUS'/>"
WRITE #1 "        <register address='0xb7e6058' value='0x" DATA.LONG(A:0x7e6058) "' name='RPMH_ARC_BCM_DRV6_RM5_SHADOW_STATUS'/>"
WRITE #1 "        <register address='0xb7e6068' value='0x" DATA.LONG(A:0x7e6068) "' name='RPMH_ARC_BCM_DRV6_RM6_SHADOW_STATUS'/>"
WRITE #1 "        <register address='0xb7e6078' value='0x" DATA.LONG(A:0x7e6078) "' name='RPMH_ARC_BCM_DRV6_RM7_SHADOW_STATUS'/>"
WRITE #1 "        <register address='0xb7e7008' value='0x" DATA.LONG(A:0x7e7008) "' name='RPMH_ARC_BCM_DRV7_RM0_SHADOW_STATUS'/>"
WRITE #1 "        <register address='0xb7e7018' value='0x" DATA.LONG(A:0x7e7018) "' name='RPMH_ARC_BCM_DRV7_RM1_SHADOW_STATUS'/>"
WRITE #1 "        <register address='0xb7e7028' value='0x" DATA.LONG(A:0x7e7028) "' name='RPMH_ARC_BCM_DRV7_RM2_SHADOW_STATUS'/>"
WRITE #1 "        <register address='0xb7e7038' value='0x" DATA.LONG(A:0x7e7038) "' name='RPMH_ARC_BCM_DRV7_RM3_SHADOW_STATUS'/>"
WRITE #1 "        <register address='0xb7e7048' value='0x" DATA.LONG(A:0x7e7048) "' name='RPMH_ARC_BCM_DRV7_RM4_SHADOW_STATUS'/>"
WRITE #1 "        <register address='0xb7e7058' value='0x" DATA.LONG(A:0x7e7058) "' name='RPMH_ARC_BCM_DRV7_RM5_SHADOW_STATUS'/>"
WRITE #1 "        <register address='0xb7e7068' value='0x" DATA.LONG(A:0x7e7068) "' name='RPMH_ARC_BCM_DRV7_RM6_SHADOW_STATUS'/>"
WRITE #1 "        <register address='0xb7e7078' value='0x" DATA.LONG(A:0x7e7078) "' name='RPMH_ARC_BCM_DRV7_RM7_SHADOW_STATUS'/>"
WRITE #1 "        <register address='0xb7e8008' value='0x" DATA.LONG(A:0x7e8008) "' name='RPMH_ARC_BCM_DRV8_RM0_SHADOW_STATUS'/>"
WRITE #1 "        <register address='0xb7e8018' value='0x" DATA.LONG(A:0x7e8018) "' name='RPMH_ARC_BCM_DRV8_RM1_SHADOW_STATUS'/>"
WRITE #1 "        <register address='0xb7e8028' value='0x" DATA.LONG(A:0x7e8028) "' name='RPMH_ARC_BCM_DRV8_RM2_SHADOW_STATUS'/>"
WRITE #1 "        <register address='0xb7e8038' value='0x" DATA.LONG(A:0x7e8038) "' name='RPMH_ARC_BCM_DRV8_RM3_SHADOW_STATUS'/>"
WRITE #1 "        <register address='0xb7e8048' value='0x" DATA.LONG(A:0x7e8048) "' name='RPMH_ARC_BCM_DRV8_RM4_SHADOW_STATUS'/>"
WRITE #1 "        <register address='0xb7e8058' value='0x" DATA.LONG(A:0x7e8058) "' name='RPMH_ARC_BCM_DRV8_RM5_SHADOW_STATUS'/>"
WRITE #1 "        <register address='0xb7e8068' value='0x" DATA.LONG(A:0x7e8068) "' name='RPMH_ARC_BCM_DRV8_RM6_SHADOW_STATUS'/>"
WRITE #1 "        <register address='0xb7e8078' value='0x" DATA.LONG(A:0x7e8078) "' name='RPMH_ARC_BCM_DRV8_RM7_SHADOW_STATUS'/>"
WRITE #1 "        <register address='0xb7e9008' value='0x" DATA.LONG(A:0x7e9008) "' name='RPMH_ARC_BCM_DRV9_RM0_SHADOW_STATUS'/>"
WRITE #1 "        <register address='0xb7e9018' value='0x" DATA.LONG(A:0x7e9018) "' name='RPMH_ARC_BCM_DRV9_RM1_SHADOW_STATUS'/>"
WRITE #1 "        <register address='0xb7e9028' value='0x" DATA.LONG(A:0x7e9028) "' name='RPMH_ARC_BCM_DRV9_RM2_SHADOW_STATUS'/>"
WRITE #1 "        <register address='0xb7e9038' value='0x" DATA.LONG(A:0x7e9038) "' name='RPMH_ARC_BCM_DRV9_RM3_SHADOW_STATUS'/>"
WRITE #1 "        <register address='0xb7e9048' value='0x" DATA.LONG(A:0x7e9048) "' name='RPMH_ARC_BCM_DRV9_RM4_SHADOW_STATUS'/>"
WRITE #1 "        <register address='0xb7e9058' value='0x" DATA.LONG(A:0x7e9058) "' name='RPMH_ARC_BCM_DRV9_RM5_SHADOW_STATUS'/>"
WRITE #1 "        <register address='0xb7e9068' value='0x" DATA.LONG(A:0x7e9068) "' name='RPMH_ARC_BCM_DRV9_RM6_SHADOW_STATUS'/>"
WRITE #1 "        <register address='0xb7e9078' value='0x" DATA.LONG(A:0x7e9078) "' name='RPMH_ARC_BCM_DRV9_RM7_SHADOW_STATUS'/>"
WRITE #1 "        <register address='0xb7f0000' value='0x" DATA.LONG(A:0x7f0000) "' name='RPMH_ARC_RM0_CTRL'/>"
WRITE #1 "        <register address='0xb7f0004' value='0x" DATA.LONG(A:0x7f0004) "' name='RPMH_ARC_RM1_CTRL'/>"
WRITE #1 "        <register address='0xb7f0008' value='0x" DATA.LONG(A:0x7f0008) "' name='RPMH_ARC_RM2_CTRL'/>"
WRITE #1 "        <register address='0xb7f000c' value='0x" DATA.LONG(A:0x7f000c) "' name='RPMH_ARC_RM3_CTRL'/>"
WRITE #1 "        <register address='0xb7f0010' value='0x" DATA.LONG(A:0x7f0010) "' name='RPMH_ARC_RM4_CTRL'/>"
WRITE #1 "        <register address='0xb7f0014' value='0x" DATA.LONG(A:0x7f0014) "' name='RPMH_ARC_RM5_CTRL'/>"
WRITE #1 "        <register address='0xb7f0018' value='0x" DATA.LONG(A:0x7f0018) "' name='RPMH_ARC_RM6_CTRL'/>"
WRITE #1 "        <register address='0xb7f001c' value='0x" DATA.LONG(A:0x7f001c) "' name='RPMH_ARC_RM7_CTRL'/>"
WRITE #1 "        <register address='0xb7f0040' value='0x" DATA.LONG(A:0x7f0040) "' name='RPMH_ARC_RM0_AGGR_BLOCK_EN'/>"
WRITE #1 "        <register address='0xb7f0044' value='0x" DATA.LONG(A:0x7f0044) "' name='RPMH_ARC_RM1_AGGR_BLOCK_EN'/>"
WRITE #1 "        <register address='0xb7f0048' value='0x" DATA.LONG(A:0x7f0048) "' name='RPMH_ARC_RM2_AGGR_BLOCK_EN'/>"
WRITE #1 "        <register address='0xb7f004c' value='0x" DATA.LONG(A:0x7f004c) "' name='RPMH_ARC_RM3_AGGR_BLOCK_EN'/>"
WRITE #1 "        <register address='0xb7f0050' value='0x" DATA.LONG(A:0x7f0050) "' name='RPMH_ARC_RM4_AGGR_BLOCK_EN'/>"
WRITE #1 "        <register address='0xb7f0054' value='0x" DATA.LONG(A:0x7f0054) "' name='RPMH_ARC_RM5_AGGR_BLOCK_EN'/>"
WRITE #1 "        <register address='0xb7f0058' value='0x" DATA.LONG(A:0x7f0058) "' name='RPMH_ARC_RM6_AGGR_BLOCK_EN'/>"
WRITE #1 "        <register address='0xb7f005c' value='0x" DATA.LONG(A:0x7f005c) "' name='RPMH_ARC_RM7_AGGR_BLOCK_EN'/>"
WRITE #1 "        <register address='0xb7f0080' value='0x" DATA.LONG(A:0x7f0080) "' name='RPMH_ARC_RM0_AGGR_UNBLOCK'/>"
WRITE #1 "        <register address='0xb7f0084' value='0x" DATA.LONG(A:0x7f0084) "' name='RPMH_ARC_RM1_AGGR_UNBLOCK'/>"
WRITE #1 "        <register address='0xb7f0088' value='0x" DATA.LONG(A:0x7f0088) "' name='RPMH_ARC_RM2_AGGR_UNBLOCK'/>"
WRITE #1 "        <register address='0xb7f008c' value='0x" DATA.LONG(A:0x7f008c) "' name='RPMH_ARC_RM3_AGGR_UNBLOCK'/>"
WRITE #1 "        <register address='0xb7f0090' value='0x" DATA.LONG(A:0x7f0090) "' name='RPMH_ARC_RM4_AGGR_UNBLOCK'/>"
WRITE #1 "        <register address='0xb7f0094' value='0x" DATA.LONG(A:0x7f0094) "' name='RPMH_ARC_RM5_AGGR_UNBLOCK'/>"
WRITE #1 "        <register address='0xb7f0098' value='0x" DATA.LONG(A:0x7f0098) "' name='RPMH_ARC_RM6_AGGR_UNBLOCK'/>"
WRITE #1 "        <register address='0xb7f009c' value='0x" DATA.LONG(A:0x7f009c) "' name='RPMH_ARC_RM7_AGGR_UNBLOCK'/>"
WRITE #1 "        <register address='0xb7f00c0' value='0x" DATA.LONG(A:0x7f00c0) "' name='RPMH_ARC_RM0_OPERATIONAL_LEVEL'/>"
WRITE #1 "        <register address='0xb7f00c4' value='0x" DATA.LONG(A:0x7f00c4) "' name='RPMH_ARC_RM1_OPERATIONAL_LEVEL'/>"
WRITE #1 "        <register address='0xb7f00c8' value='0x" DATA.LONG(A:0x7f00c8) "' name='RPMH_ARC_RM2_OPERATIONAL_LEVEL'/>"
WRITE #1 "        <register address='0xb7f00cc' value='0x" DATA.LONG(A:0x7f00cc) "' name='RPMH_ARC_RM3_OPERATIONAL_LEVEL'/>"
WRITE #1 "        <register address='0xb7f00d0' value='0x" DATA.LONG(A:0x7f00d0) "' name='RPMH_ARC_RM4_OPERATIONAL_LEVEL'/>"
WRITE #1 "        <register address='0xb7f00d4' value='0x" DATA.LONG(A:0x7f00d4) "' name='RPMH_ARC_RM5_OPERATIONAL_LEVEL'/>"
WRITE #1 "        <register address='0xb7f00d8' value='0x" DATA.LONG(A:0x7f00d8) "' name='RPMH_ARC_RM6_OPERATIONAL_LEVEL'/>"
WRITE #1 "        <register address='0xb7f00dc' value='0x" DATA.LONG(A:0x7f00dc) "' name='RPMH_ARC_RM7_OPERATIONAL_LEVEL'/>"
WRITE #1 "        <register address='0xb7f0100' value='0x" DATA.LONG(A:0x7f0100) "' name='RPMH_ARC_RM0_MIN_IDLE_TIME_SOLVING_LOW'/>"
WRITE #1 "        <register address='0xb7f0104' value='0x" DATA.LONG(A:0x7f0104) "' name='RPMH_ARC_RM1_MIN_IDLE_TIME_SOLVING_LOW'/>"
WRITE #1 "        <register address='0xb7f0108' value='0x" DATA.LONG(A:0x7f0108) "' name='RPMH_ARC_RM2_MIN_IDLE_TIME_SOLVING_LOW'/>"
WRITE #1 "        <register address='0xb7f010c' value='0x" DATA.LONG(A:0x7f010c) "' name='RPMH_ARC_RM3_MIN_IDLE_TIME_SOLVING_LOW'/>"
WRITE #1 "        <register address='0xb7f0110' value='0x" DATA.LONG(A:0x7f0110) "' name='RPMH_ARC_RM4_MIN_IDLE_TIME_SOLVING_LOW'/>"
WRITE #1 "        <register address='0xb7f0114' value='0x" DATA.LONG(A:0x7f0114) "' name='RPMH_ARC_RM5_MIN_IDLE_TIME_SOLVING_LOW'/>"
WRITE #1 "        <register address='0xb7f0118' value='0x" DATA.LONG(A:0x7f0118) "' name='RPMH_ARC_RM6_MIN_IDLE_TIME_SOLVING_LOW'/>"
WRITE #1 "        <register address='0xb7f011c' value='0x" DATA.LONG(A:0x7f011c) "' name='RPMH_ARC_RM7_MIN_IDLE_TIME_SOLVING_LOW'/>"
WRITE #1 "        <register address='0xb7f0140' value='0x" DATA.LONG(A:0x7f0140) "' name='RPMH_ARC_RM0_MIN_IDLE_TIME_SOLVING_HIGH'/>"
WRITE #1 "        <register address='0xb7f0144' value='0x" DATA.LONG(A:0x7f0144) "' name='RPMH_ARC_RM1_MIN_IDLE_TIME_SOLVING_HIGH'/>"
WRITE #1 "        <register address='0xb7f0148' value='0x" DATA.LONG(A:0x7f0148) "' name='RPMH_ARC_RM2_MIN_IDLE_TIME_SOLVING_HIGH'/>"
WRITE #1 "        <register address='0xb7f014c' value='0x" DATA.LONG(A:0x7f014c) "' name='RPMH_ARC_RM3_MIN_IDLE_TIME_SOLVING_HIGH'/>"
WRITE #1 "        <register address='0xb7f0150' value='0x" DATA.LONG(A:0x7f0150) "' name='RPMH_ARC_RM4_MIN_IDLE_TIME_SOLVING_HIGH'/>"
WRITE #1 "        <register address='0xb7f0154' value='0x" DATA.LONG(A:0x7f0154) "' name='RPMH_ARC_RM5_MIN_IDLE_TIME_SOLVING_HIGH'/>"
WRITE #1 "        <register address='0xb7f0158' value='0x" DATA.LONG(A:0x7f0158) "' name='RPMH_ARC_RM6_MIN_IDLE_TIME_SOLVING_HIGH'/>"
WRITE #1 "        <register address='0xb7f015c' value='0x" DATA.LONG(A:0x7f015c) "' name='RPMH_ARC_RM7_MIN_IDLE_TIME_SOLVING_HIGH'/>"
WRITE #1 "        <register address='0xb7f0180' value='0x" DATA.LONG(A:0x7f0180) "' name='RPMH_ARC_RM0_WAKEUP_TIMER_STATUS_LOW'/>"
WRITE #1 "        <register address='0xb7f0184' value='0x" DATA.LONG(A:0x7f0184) "' name='RPMH_ARC_RM1_WAKEUP_TIMER_STATUS_LOW'/>"
WRITE #1 "        <register address='0xb7f0188' value='0x" DATA.LONG(A:0x7f0188) "' name='RPMH_ARC_RM2_WAKEUP_TIMER_STATUS_LOW'/>"
WRITE #1 "        <register address='0xb7f018c' value='0x" DATA.LONG(A:0x7f018c) "' name='RPMH_ARC_RM3_WAKEUP_TIMER_STATUS_LOW'/>"
WRITE #1 "        <register address='0xb7f0190' value='0x" DATA.LONG(A:0x7f0190) "' name='RPMH_ARC_RM4_WAKEUP_TIMER_STATUS_LOW'/>"
WRITE #1 "        <register address='0xb7f0194' value='0x" DATA.LONG(A:0x7f0194) "' name='RPMH_ARC_RM5_WAKEUP_TIMER_STATUS_LOW'/>"
WRITE #1 "        <register address='0xb7f0198' value='0x" DATA.LONG(A:0x7f0198) "' name='RPMH_ARC_RM6_WAKEUP_TIMER_STATUS_LOW'/>"
WRITE #1 "        <register address='0xb7f019c' value='0x" DATA.LONG(A:0x7f019c) "' name='RPMH_ARC_RM7_WAKEUP_TIMER_STATUS_LOW'/>"
WRITE #1 "        <register address='0xb7f01c0' value='0x" DATA.LONG(A:0x7f01c0) "' name='RPMH_ARC_RM0_WAKEUP_TIMER_STATUS_HIGH'/>"
WRITE #1 "        <register address='0xb7f01c4' value='0x" DATA.LONG(A:0x7f01c4) "' name='RPMH_ARC_RM1_WAKEUP_TIMER_STATUS_HIGH'/>"
WRITE #1 "        <register address='0xb7f01c8' value='0x" DATA.LONG(A:0x7f01c8) "' name='RPMH_ARC_RM2_WAKEUP_TIMER_STATUS_HIGH'/>"
WRITE #1 "        <register address='0xb7f01cc' value='0x" DATA.LONG(A:0x7f01cc) "' name='RPMH_ARC_RM3_WAKEUP_TIMER_STATUS_HIGH'/>"
WRITE #1 "        <register address='0xb7f01d0' value='0x" DATA.LONG(A:0x7f01d0) "' name='RPMH_ARC_RM4_WAKEUP_TIMER_STATUS_HIGH'/>"
WRITE #1 "        <register address='0xb7f01d4' value='0x" DATA.LONG(A:0x7f01d4) "' name='RPMH_ARC_RM5_WAKEUP_TIMER_STATUS_HIGH'/>"
WRITE #1 "        <register address='0xb7f01d8' value='0x" DATA.LONG(A:0x7f01d8) "' name='RPMH_ARC_RM6_WAKEUP_TIMER_STATUS_HIGH'/>"
WRITE #1 "        <register address='0xb7f01dc' value='0x" DATA.LONG(A:0x7f01dc) "' name='RPMH_ARC_RM7_WAKEUP_TIMER_STATUS_HIGH'/>"
WRITE #1 "        <register address='0xb7f1240' value='0x" DATA.LONG(A:0x7f1240) "' name='RPMH_ARC_RM0_SEQ_UP_BR_ADDR0'/>"
WRITE #1 "        <register address='0xb7f1244' value='0x" DATA.LONG(A:0x7f1244) "' name='RPMH_ARC_RM0_SEQ_UP_BR_ADDR1'/>"
WRITE #1 "        <register address='0xb7f1248' value='0x" DATA.LONG(A:0x7f1248) "' name='RPMH_ARC_RM0_SEQ_UP_BR_ADDR2'/>"
WRITE #1 "        <register address='0xb7f124c' value='0x" DATA.LONG(A:0x7f124c) "' name='RPMH_ARC_RM0_SEQ_UP_BR_ADDR3'/>"
WRITE #1 "        <register address='0xb7f1250' value='0x" DATA.LONG(A:0x7f1250) "' name='RPMH_ARC_RM0_SEQ_UP_BR_ADDR4'/>"
WRITE #1 "        <register address='0xb7f1254' value='0x" DATA.LONG(A:0x7f1254) "' name='RPMH_ARC_RM0_SEQ_UP_BR_ADDR5'/>"
WRITE #1 "        <register address='0xb7f1258' value='0x" DATA.LONG(A:0x7f1258) "' name='RPMH_ARC_RM0_SEQ_UP_BR_ADDR6'/>"
WRITE #1 "        <register address='0xb7f125c' value='0x" DATA.LONG(A:0x7f125c) "' name='RPMH_ARC_RM0_SEQ_UP_BR_ADDR7'/>"
WRITE #1 "        <register address='0xb7f1260' value='0x" DATA.LONG(A:0x7f1260) "' name='RPMH_ARC_RM0_SEQ_UP_BR_ADDR8'/>"
WRITE #1 "        <register address='0xb7f1264' value='0x" DATA.LONG(A:0x7f1264) "' name='RPMH_ARC_RM0_SEQ_UP_BR_ADDR9'/>"
WRITE #1 "        <register address='0xb7f1268' value='0x" DATA.LONG(A:0x7f1268) "' name='RPMH_ARC_RM0_SEQ_UP_BR_ADDR10'/>"
WRITE #1 "        <register address='0xb7f126c' value='0x" DATA.LONG(A:0x7f126c) "' name='RPMH_ARC_RM0_SEQ_UP_BR_ADDR11'/>"
WRITE #1 "        <register address='0xb7f1270' value='0x" DATA.LONG(A:0x7f1270) "' name='RPMH_ARC_RM0_SEQ_UP_BR_ADDR12'/>"
WRITE #1 "        <register address='0xb7f1274' value='0x" DATA.LONG(A:0x7f1274) "' name='RPMH_ARC_RM0_SEQ_UP_BR_ADDR13'/>"
WRITE #1 "        <register address='0xb7f1278' value='0x" DATA.LONG(A:0x7f1278) "' name='RPMH_ARC_RM0_SEQ_UP_BR_ADDR14'/>"
WRITE #1 "        <register address='0xb7f127c' value='0x" DATA.LONG(A:0x7f127c) "' name='RPMH_ARC_RM0_SEQ_UP_BR_ADDR15'/>"
WRITE #1 "        <register address='0xb7f1280' value='0x" DATA.LONG(A:0x7f1280) "' name='RPMH_ARC_RM1_SEQ_UP_BR_ADDR0'/>"
WRITE #1 "        <register address='0xb7f1284' value='0x" DATA.LONG(A:0x7f1284) "' name='RPMH_ARC_RM1_SEQ_UP_BR_ADDR1'/>"
WRITE #1 "        <register address='0xb7f1288' value='0x" DATA.LONG(A:0x7f1288) "' name='RPMH_ARC_RM1_SEQ_UP_BR_ADDR2'/>"
WRITE #1 "        <register address='0xb7f128c' value='0x" DATA.LONG(A:0x7f128c) "' name='RPMH_ARC_RM1_SEQ_UP_BR_ADDR3'/>"
WRITE #1 "        <register address='0xb7f1290' value='0x" DATA.LONG(A:0x7f1290) "' name='RPMH_ARC_RM1_SEQ_UP_BR_ADDR4'/>"
WRITE #1 "        <register address='0xb7f1294' value='0x" DATA.LONG(A:0x7f1294) "' name='RPMH_ARC_RM1_SEQ_UP_BR_ADDR5'/>"
WRITE #1 "        <register address='0xb7f1298' value='0x" DATA.LONG(A:0x7f1298) "' name='RPMH_ARC_RM1_SEQ_UP_BR_ADDR6'/>"
WRITE #1 "        <register address='0xb7f129c' value='0x" DATA.LONG(A:0x7f129c) "' name='RPMH_ARC_RM1_SEQ_UP_BR_ADDR7'/>"
WRITE #1 "        <register address='0xb7f12a0' value='0x" DATA.LONG(A:0x7f12a0) "' name='RPMH_ARC_RM1_SEQ_UP_BR_ADDR8'/>"
WRITE #1 "        <register address='0xb7f12a4' value='0x" DATA.LONG(A:0x7f12a4) "' name='RPMH_ARC_RM1_SEQ_UP_BR_ADDR9'/>"
WRITE #1 "        <register address='0xb7f12a8' value='0x" DATA.LONG(A:0x7f12a8) "' name='RPMH_ARC_RM1_SEQ_UP_BR_ADDR10'/>"
WRITE #1 "        <register address='0xb7f12ac' value='0x" DATA.LONG(A:0x7f12ac) "' name='RPMH_ARC_RM1_SEQ_UP_BR_ADDR11'/>"
WRITE #1 "        <register address='0xb7f12b0' value='0x" DATA.LONG(A:0x7f12b0) "' name='RPMH_ARC_RM1_SEQ_UP_BR_ADDR12'/>"
WRITE #1 "        <register address='0xb7f12b4' value='0x" DATA.LONG(A:0x7f12b4) "' name='RPMH_ARC_RM1_SEQ_UP_BR_ADDR13'/>"
WRITE #1 "        <register address='0xb7f12b8' value='0x" DATA.LONG(A:0x7f12b8) "' name='RPMH_ARC_RM1_SEQ_UP_BR_ADDR14'/>"
WRITE #1 "        <register address='0xb7f12bc' value='0x" DATA.LONG(A:0x7f12bc) "' name='RPMH_ARC_RM1_SEQ_UP_BR_ADDR15'/>"
WRITE #1 "        <register address='0xb7f12c0' value='0x" DATA.LONG(A:0x7f12c0) "' name='RPMH_ARC_RM2_SEQ_UP_BR_ADDR0'/>"
WRITE #1 "        <register address='0xb7f12c4' value='0x" DATA.LONG(A:0x7f12c4) "' name='RPMH_ARC_RM2_SEQ_UP_BR_ADDR1'/>"
WRITE #1 "        <register address='0xb7f12c8' value='0x" DATA.LONG(A:0x7f12c8) "' name='RPMH_ARC_RM2_SEQ_UP_BR_ADDR2'/>"
WRITE #1 "        <register address='0xb7f12cc' value='0x" DATA.LONG(A:0x7f12cc) "' name='RPMH_ARC_RM2_SEQ_UP_BR_ADDR3'/>"
WRITE #1 "        <register address='0xb7f12d0' value='0x" DATA.LONG(A:0x7f12d0) "' name='RPMH_ARC_RM2_SEQ_UP_BR_ADDR4'/>"
WRITE #1 "        <register address='0xb7f12d4' value='0x" DATA.LONG(A:0x7f12d4) "' name='RPMH_ARC_RM2_SEQ_UP_BR_ADDR5'/>"
WRITE #1 "        <register address='0xb7f12d8' value='0x" DATA.LONG(A:0x7f12d8) "' name='RPMH_ARC_RM2_SEQ_UP_BR_ADDR6'/>"
WRITE #1 "        <register address='0xb7f12dc' value='0x" DATA.LONG(A:0x7f12dc) "' name='RPMH_ARC_RM2_SEQ_UP_BR_ADDR7'/>"
WRITE #1 "        <register address='0xb7f12e0' value='0x" DATA.LONG(A:0x7f12e0) "' name='RPMH_ARC_RM2_SEQ_UP_BR_ADDR8'/>"
WRITE #1 "        <register address='0xb7f12e4' value='0x" DATA.LONG(A:0x7f12e4) "' name='RPMH_ARC_RM2_SEQ_UP_BR_ADDR9'/>"
WRITE #1 "        <register address='0xb7f12e8' value='0x" DATA.LONG(A:0x7f12e8) "' name='RPMH_ARC_RM2_SEQ_UP_BR_ADDR10'/>"
WRITE #1 "        <register address='0xb7f12ec' value='0x" DATA.LONG(A:0x7f12ec) "' name='RPMH_ARC_RM2_SEQ_UP_BR_ADDR11'/>"
WRITE #1 "        <register address='0xb7f12f0' value='0x" DATA.LONG(A:0x7f12f0) "' name='RPMH_ARC_RM2_SEQ_UP_BR_ADDR12'/>"
WRITE #1 "        <register address='0xb7f12f4' value='0x" DATA.LONG(A:0x7f12f4) "' name='RPMH_ARC_RM2_SEQ_UP_BR_ADDR13'/>"
WRITE #1 "        <register address='0xb7f12f8' value='0x" DATA.LONG(A:0x7f12f8) "' name='RPMH_ARC_RM2_SEQ_UP_BR_ADDR14'/>"
WRITE #1 "        <register address='0xb7f12fc' value='0x" DATA.LONG(A:0x7f12fc) "' name='RPMH_ARC_RM2_SEQ_UP_BR_ADDR15'/>"
WRITE #1 "        <register address='0xb7f1300' value='0x" DATA.LONG(A:0x7f1300) "' name='RPMH_ARC_RM3_SEQ_UP_BR_ADDR0'/>"
WRITE #1 "        <register address='0xb7f1304' value='0x" DATA.LONG(A:0x7f1304) "' name='RPMH_ARC_RM3_SEQ_UP_BR_ADDR1'/>"
WRITE #1 "        <register address='0xb7f1308' value='0x" DATA.LONG(A:0x7f1308) "' name='RPMH_ARC_RM3_SEQ_UP_BR_ADDR2'/>"
WRITE #1 "        <register address='0xb7f130c' value='0x" DATA.LONG(A:0x7f130c) "' name='RPMH_ARC_RM3_SEQ_UP_BR_ADDR3'/>"
WRITE #1 "        <register address='0xb7f1310' value='0x" DATA.LONG(A:0x7f1310) "' name='RPMH_ARC_RM3_SEQ_UP_BR_ADDR4'/>"
WRITE #1 "        <register address='0xb7f1314' value='0x" DATA.LONG(A:0x7f1314) "' name='RPMH_ARC_RM3_SEQ_UP_BR_ADDR5'/>"
WRITE #1 "        <register address='0xb7f1318' value='0x" DATA.LONG(A:0x7f1318) "' name='RPMH_ARC_RM3_SEQ_UP_BR_ADDR6'/>"
WRITE #1 "        <register address='0xb7f131c' value='0x" DATA.LONG(A:0x7f131c) "' name='RPMH_ARC_RM3_SEQ_UP_BR_ADDR7'/>"
WRITE #1 "        <register address='0xb7f1320' value='0x" DATA.LONG(A:0x7f1320) "' name='RPMH_ARC_RM3_SEQ_UP_BR_ADDR8'/>"
WRITE #1 "        <register address='0xb7f1324' value='0x" DATA.LONG(A:0x7f1324) "' name='RPMH_ARC_RM3_SEQ_UP_BR_ADDR9'/>"
WRITE #1 "        <register address='0xb7f1328' value='0x" DATA.LONG(A:0x7f1328) "' name='RPMH_ARC_RM3_SEQ_UP_BR_ADDR10'/>"
WRITE #1 "        <register address='0xb7f132c' value='0x" DATA.LONG(A:0x7f132c) "' name='RPMH_ARC_RM3_SEQ_UP_BR_ADDR11'/>"
WRITE #1 "        <register address='0xb7f1330' value='0x" DATA.LONG(A:0x7f1330) "' name='RPMH_ARC_RM3_SEQ_UP_BR_ADDR12'/>"
WRITE #1 "        <register address='0xb7f1334' value='0x" DATA.LONG(A:0x7f1334) "' name='RPMH_ARC_RM3_SEQ_UP_BR_ADDR13'/>"
WRITE #1 "        <register address='0xb7f1338' value='0x" DATA.LONG(A:0x7f1338) "' name='RPMH_ARC_RM3_SEQ_UP_BR_ADDR14'/>"
WRITE #1 "        <register address='0xb7f133c' value='0x" DATA.LONG(A:0x7f133c) "' name='RPMH_ARC_RM3_SEQ_UP_BR_ADDR15'/>"
WRITE #1 "        <register address='0xb7f1340' value='0x" DATA.LONG(A:0x7f1340) "' name='RPMH_ARC_RM4_SEQ_UP_BR_ADDR0'/>"
WRITE #1 "        <register address='0xb7f1344' value='0x" DATA.LONG(A:0x7f1344) "' name='RPMH_ARC_RM4_SEQ_UP_BR_ADDR1'/>"
WRITE #1 "        <register address='0xb7f1348' value='0x" DATA.LONG(A:0x7f1348) "' name='RPMH_ARC_RM4_SEQ_UP_BR_ADDR2'/>"
WRITE #1 "        <register address='0xb7f134c' value='0x" DATA.LONG(A:0x7f134c) "' name='RPMH_ARC_RM4_SEQ_UP_BR_ADDR3'/>"
WRITE #1 "        <register address='0xb7f1350' value='0x" DATA.LONG(A:0x7f1350) "' name='RPMH_ARC_RM4_SEQ_UP_BR_ADDR4'/>"
WRITE #1 "        <register address='0xb7f1354' value='0x" DATA.LONG(A:0x7f1354) "' name='RPMH_ARC_RM4_SEQ_UP_BR_ADDR5'/>"
WRITE #1 "        <register address='0xb7f1358' value='0x" DATA.LONG(A:0x7f1358) "' name='RPMH_ARC_RM4_SEQ_UP_BR_ADDR6'/>"
WRITE #1 "        <register address='0xb7f135c' value='0x" DATA.LONG(A:0x7f135c) "' name='RPMH_ARC_RM4_SEQ_UP_BR_ADDR7'/>"
WRITE #1 "        <register address='0xb7f1360' value='0x" DATA.LONG(A:0x7f1360) "' name='RPMH_ARC_RM4_SEQ_UP_BR_ADDR8'/>"
WRITE #1 "        <register address='0xb7f1364' value='0x" DATA.LONG(A:0x7f1364) "' name='RPMH_ARC_RM4_SEQ_UP_BR_ADDR9'/>"
WRITE #1 "        <register address='0xb7f1368' value='0x" DATA.LONG(A:0x7f1368) "' name='RPMH_ARC_RM4_SEQ_UP_BR_ADDR10'/>"
WRITE #1 "        <register address='0xb7f136c' value='0x" DATA.LONG(A:0x7f136c) "' name='RPMH_ARC_RM4_SEQ_UP_BR_ADDR11'/>"
WRITE #1 "        <register address='0xb7f1370' value='0x" DATA.LONG(A:0x7f1370) "' name='RPMH_ARC_RM4_SEQ_UP_BR_ADDR12'/>"
WRITE #1 "        <register address='0xb7f1374' value='0x" DATA.LONG(A:0x7f1374) "' name='RPMH_ARC_RM4_SEQ_UP_BR_ADDR13'/>"
WRITE #1 "        <register address='0xb7f1378' value='0x" DATA.LONG(A:0x7f1378) "' name='RPMH_ARC_RM4_SEQ_UP_BR_ADDR14'/>"
WRITE #1 "        <register address='0xb7f137c' value='0x" DATA.LONG(A:0x7f137c) "' name='RPMH_ARC_RM4_SEQ_UP_BR_ADDR15'/>"
WRITE #1 "        <register address='0xb7f1380' value='0x" DATA.LONG(A:0x7f1380) "' name='RPMH_ARC_RM5_SEQ_UP_BR_ADDR0'/>"
WRITE #1 "        <register address='0xb7f1384' value='0x" DATA.LONG(A:0x7f1384) "' name='RPMH_ARC_RM5_SEQ_UP_BR_ADDR1'/>"
WRITE #1 "        <register address='0xb7f1388' value='0x" DATA.LONG(A:0x7f1388) "' name='RPMH_ARC_RM5_SEQ_UP_BR_ADDR2'/>"
WRITE #1 "        <register address='0xb7f138c' value='0x" DATA.LONG(A:0x7f138c) "' name='RPMH_ARC_RM5_SEQ_UP_BR_ADDR3'/>"
WRITE #1 "        <register address='0xb7f1390' value='0x" DATA.LONG(A:0x7f1390) "' name='RPMH_ARC_RM5_SEQ_UP_BR_ADDR4'/>"
WRITE #1 "        <register address='0xb7f1394' value='0x" DATA.LONG(A:0x7f1394) "' name='RPMH_ARC_RM5_SEQ_UP_BR_ADDR5'/>"
WRITE #1 "        <register address='0xb7f1398' value='0x" DATA.LONG(A:0x7f1398) "' name='RPMH_ARC_RM5_SEQ_UP_BR_ADDR6'/>"
WRITE #1 "        <register address='0xb7f139c' value='0x" DATA.LONG(A:0x7f139c) "' name='RPMH_ARC_RM5_SEQ_UP_BR_ADDR7'/>"
WRITE #1 "        <register address='0xb7f13a0' value='0x" DATA.LONG(A:0x7f13a0) "' name='RPMH_ARC_RM5_SEQ_UP_BR_ADDR8'/>"
WRITE #1 "        <register address='0xb7f13a4' value='0x" DATA.LONG(A:0x7f13a4) "' name='RPMH_ARC_RM5_SEQ_UP_BR_ADDR9'/>"
WRITE #1 "        <register address='0xb7f13a8' value='0x" DATA.LONG(A:0x7f13a8) "' name='RPMH_ARC_RM5_SEQ_UP_BR_ADDR10'/>"
WRITE #1 "        <register address='0xb7f13ac' value='0x" DATA.LONG(A:0x7f13ac) "' name='RPMH_ARC_RM5_SEQ_UP_BR_ADDR11'/>"
WRITE #1 "        <register address='0xb7f13b0' value='0x" DATA.LONG(A:0x7f13b0) "' name='RPMH_ARC_RM5_SEQ_UP_BR_ADDR12'/>"
WRITE #1 "        <register address='0xb7f13b4' value='0x" DATA.LONG(A:0x7f13b4) "' name='RPMH_ARC_RM5_SEQ_UP_BR_ADDR13'/>"
WRITE #1 "        <register address='0xb7f13b8' value='0x" DATA.LONG(A:0x7f13b8) "' name='RPMH_ARC_RM5_SEQ_UP_BR_ADDR14'/>"
WRITE #1 "        <register address='0xb7f13bc' value='0x" DATA.LONG(A:0x7f13bc) "' name='RPMH_ARC_RM5_SEQ_UP_BR_ADDR15'/>"
WRITE #1 "        <register address='0xb7f13c0' value='0x" DATA.LONG(A:0x7f13c0) "' name='RPMH_ARC_RM6_SEQ_UP_BR_ADDR0'/>"
WRITE #1 "        <register address='0xb7f13c4' value='0x" DATA.LONG(A:0x7f13c4) "' name='RPMH_ARC_RM6_SEQ_UP_BR_ADDR1'/>"
WRITE #1 "        <register address='0xb7f13c8' value='0x" DATA.LONG(A:0x7f13c8) "' name='RPMH_ARC_RM6_SEQ_UP_BR_ADDR2'/>"
WRITE #1 "        <register address='0xb7f13cc' value='0x" DATA.LONG(A:0x7f13cc) "' name='RPMH_ARC_RM6_SEQ_UP_BR_ADDR3'/>"
WRITE #1 "        <register address='0xb7f13d0' value='0x" DATA.LONG(A:0x7f13d0) "' name='RPMH_ARC_RM6_SEQ_UP_BR_ADDR4'/>"
WRITE #1 "        <register address='0xb7f13d4' value='0x" DATA.LONG(A:0x7f13d4) "' name='RPMH_ARC_RM6_SEQ_UP_BR_ADDR5'/>"
WRITE #1 "        <register address='0xb7f13d8' value='0x" DATA.LONG(A:0x7f13d8) "' name='RPMH_ARC_RM6_SEQ_UP_BR_ADDR6'/>"
WRITE #1 "        <register address='0xb7f13dc' value='0x" DATA.LONG(A:0x7f13dc) "' name='RPMH_ARC_RM6_SEQ_UP_BR_ADDR7'/>"
WRITE #1 "        <register address='0xb7f13e0' value='0x" DATA.LONG(A:0x7f13e0) "' name='RPMH_ARC_RM6_SEQ_UP_BR_ADDR8'/>"
WRITE #1 "        <register address='0xb7f13e4' value='0x" DATA.LONG(A:0x7f13e4) "' name='RPMH_ARC_RM6_SEQ_UP_BR_ADDR9'/>"
WRITE #1 "        <register address='0xb7f13e8' value='0x" DATA.LONG(A:0x7f13e8) "' name='RPMH_ARC_RM6_SEQ_UP_BR_ADDR10'/>"
WRITE #1 "        <register address='0xb7f13ec' value='0x" DATA.LONG(A:0x7f13ec) "' name='RPMH_ARC_RM6_SEQ_UP_BR_ADDR11'/>"
WRITE #1 "        <register address='0xb7f13f0' value='0x" DATA.LONG(A:0x7f13f0) "' name='RPMH_ARC_RM6_SEQ_UP_BR_ADDR12'/>"
WRITE #1 "        <register address='0xb7f13f4' value='0x" DATA.LONG(A:0x7f13f4) "' name='RPMH_ARC_RM6_SEQ_UP_BR_ADDR13'/>"
WRITE #1 "        <register address='0xb7f13f8' value='0x" DATA.LONG(A:0x7f13f8) "' name='RPMH_ARC_RM6_SEQ_UP_BR_ADDR14'/>"
WRITE #1 "        <register address='0xb7f13fc' value='0x" DATA.LONG(A:0x7f13fc) "' name='RPMH_ARC_RM6_SEQ_UP_BR_ADDR15'/>"
WRITE #1 "        <register address='0xb7f1400' value='0x" DATA.LONG(A:0x7f1400) "' name='RPMH_ARC_RM7_SEQ_UP_BR_ADDR0'/>"
WRITE #1 "        <register address='0xb7f1404' value='0x" DATA.LONG(A:0x7f1404) "' name='RPMH_ARC_RM7_SEQ_UP_BR_ADDR1'/>"
WRITE #1 "        <register address='0xb7f1408' value='0x" DATA.LONG(A:0x7f1408) "' name='RPMH_ARC_RM7_SEQ_UP_BR_ADDR2'/>"
WRITE #1 "        <register address='0xb7f140c' value='0x" DATA.LONG(A:0x7f140c) "' name='RPMH_ARC_RM7_SEQ_UP_BR_ADDR3'/>"
WRITE #1 "        <register address='0xb7f1410' value='0x" DATA.LONG(A:0x7f1410) "' name='RPMH_ARC_RM7_SEQ_UP_BR_ADDR4'/>"
WRITE #1 "        <register address='0xb7f1414' value='0x" DATA.LONG(A:0x7f1414) "' name='RPMH_ARC_RM7_SEQ_UP_BR_ADDR5'/>"
WRITE #1 "        <register address='0xb7f1418' value='0x" DATA.LONG(A:0x7f1418) "' name='RPMH_ARC_RM7_SEQ_UP_BR_ADDR6'/>"
WRITE #1 "        <register address='0xb7f141c' value='0x" DATA.LONG(A:0x7f141c) "' name='RPMH_ARC_RM7_SEQ_UP_BR_ADDR7'/>"
WRITE #1 "        <register address='0xb7f1420' value='0x" DATA.LONG(A:0x7f1420) "' name='RPMH_ARC_RM7_SEQ_UP_BR_ADDR8'/>"
WRITE #1 "        <register address='0xb7f1424' value='0x" DATA.LONG(A:0x7f1424) "' name='RPMH_ARC_RM7_SEQ_UP_BR_ADDR9'/>"
WRITE #1 "        <register address='0xb7f1428' value='0x" DATA.LONG(A:0x7f1428) "' name='RPMH_ARC_RM7_SEQ_UP_BR_ADDR10'/>"
WRITE #1 "        <register address='0xb7f142c' value='0x" DATA.LONG(A:0x7f142c) "' name='RPMH_ARC_RM7_SEQ_UP_BR_ADDR11'/>"
WRITE #1 "        <register address='0xb7f1430' value='0x" DATA.LONG(A:0x7f1430) "' name='RPMH_ARC_RM7_SEQ_UP_BR_ADDR12'/>"
WRITE #1 "        <register address='0xb7f1434' value='0x" DATA.LONG(A:0x7f1434) "' name='RPMH_ARC_RM7_SEQ_UP_BR_ADDR13'/>"
WRITE #1 "        <register address='0xb7f1438' value='0x" DATA.LONG(A:0x7f1438) "' name='RPMH_ARC_RM7_SEQ_UP_BR_ADDR14'/>"
WRITE #1 "        <register address='0xb7f143c' value='0x" DATA.LONG(A:0x7f143c) "' name='RPMH_ARC_RM7_SEQ_UP_BR_ADDR15'/>"
WRITE #1 "        <register address='0xb7f1640' value='0x" DATA.LONG(A:0x7f1640) "' name='RPMH_ARC_RM0_SEQ_DOWN_BR_ADDR0'/>"
WRITE #1 "        <register address='0xb7f1644' value='0x" DATA.LONG(A:0x7f1644) "' name='RPMH_ARC_RM0_SEQ_DOWN_BR_ADDR1'/>"
WRITE #1 "        <register address='0xb7f1648' value='0x" DATA.LONG(A:0x7f1648) "' name='RPMH_ARC_RM0_SEQ_DOWN_BR_ADDR2'/>"
WRITE #1 "        <register address='0xb7f164c' value='0x" DATA.LONG(A:0x7f164c) "' name='RPMH_ARC_RM0_SEQ_DOWN_BR_ADDR3'/>"
WRITE #1 "        <register address='0xb7f1650' value='0x" DATA.LONG(A:0x7f1650) "' name='RPMH_ARC_RM0_SEQ_DOWN_BR_ADDR4'/>"
WRITE #1 "        <register address='0xb7f1654' value='0x" DATA.LONG(A:0x7f1654) "' name='RPMH_ARC_RM0_SEQ_DOWN_BR_ADDR5'/>"
WRITE #1 "        <register address='0xb7f1658' value='0x" DATA.LONG(A:0x7f1658) "' name='RPMH_ARC_RM0_SEQ_DOWN_BR_ADDR6'/>"
WRITE #1 "        <register address='0xb7f165c' value='0x" DATA.LONG(A:0x7f165c) "' name='RPMH_ARC_RM0_SEQ_DOWN_BR_ADDR7'/>"
WRITE #1 "        <register address='0xb7f1660' value='0x" DATA.LONG(A:0x7f1660) "' name='RPMH_ARC_RM0_SEQ_DOWN_BR_ADDR8'/>"
WRITE #1 "        <register address='0xb7f1664' value='0x" DATA.LONG(A:0x7f1664) "' name='RPMH_ARC_RM0_SEQ_DOWN_BR_ADDR9'/>"
WRITE #1 "        <register address='0xb7f1668' value='0x" DATA.LONG(A:0x7f1668) "' name='RPMH_ARC_RM0_SEQ_DOWN_BR_ADDR10'/>"
WRITE #1 "        <register address='0xb7f166c' value='0x" DATA.LONG(A:0x7f166c) "' name='RPMH_ARC_RM0_SEQ_DOWN_BR_ADDR11'/>"
WRITE #1 "        <register address='0xb7f1670' value='0x" DATA.LONG(A:0x7f1670) "' name='RPMH_ARC_RM0_SEQ_DOWN_BR_ADDR12'/>"
WRITE #1 "        <register address='0xb7f1674' value='0x" DATA.LONG(A:0x7f1674) "' name='RPMH_ARC_RM0_SEQ_DOWN_BR_ADDR13'/>"
WRITE #1 "        <register address='0xb7f1678' value='0x" DATA.LONG(A:0x7f1678) "' name='RPMH_ARC_RM0_SEQ_DOWN_BR_ADDR14'/>"
WRITE #1 "        <register address='0xb7f167c' value='0x" DATA.LONG(A:0x7f167c) "' name='RPMH_ARC_RM0_SEQ_DOWN_BR_ADDR15'/>"
WRITE #1 "        <register address='0xb7f1680' value='0x" DATA.LONG(A:0x7f1680) "' name='RPMH_ARC_RM1_SEQ_DOWN_BR_ADDR0'/>"
WRITE #1 "        <register address='0xb7f1684' value='0x" DATA.LONG(A:0x7f1684) "' name='RPMH_ARC_RM1_SEQ_DOWN_BR_ADDR1'/>"
WRITE #1 "        <register address='0xb7f1688' value='0x" DATA.LONG(A:0x7f1688) "' name='RPMH_ARC_RM1_SEQ_DOWN_BR_ADDR2'/>"
WRITE #1 "        <register address='0xb7f168c' value='0x" DATA.LONG(A:0x7f168c) "' name='RPMH_ARC_RM1_SEQ_DOWN_BR_ADDR3'/>"
WRITE #1 "        <register address='0xb7f1690' value='0x" DATA.LONG(A:0x7f1690) "' name='RPMH_ARC_RM1_SEQ_DOWN_BR_ADDR4'/>"
WRITE #1 "        <register address='0xb7f1694' value='0x" DATA.LONG(A:0x7f1694) "' name='RPMH_ARC_RM1_SEQ_DOWN_BR_ADDR5'/>"
WRITE #1 "        <register address='0xb7f1698' value='0x" DATA.LONG(A:0x7f1698) "' name='RPMH_ARC_RM1_SEQ_DOWN_BR_ADDR6'/>"
WRITE #1 "        <register address='0xb7f169c' value='0x" DATA.LONG(A:0x7f169c) "' name='RPMH_ARC_RM1_SEQ_DOWN_BR_ADDR7'/>"
WRITE #1 "        <register address='0xb7f16a0' value='0x" DATA.LONG(A:0x7f16a0) "' name='RPMH_ARC_RM1_SEQ_DOWN_BR_ADDR8'/>"
WRITE #1 "        <register address='0xb7f16a4' value='0x" DATA.LONG(A:0x7f16a4) "' name='RPMH_ARC_RM1_SEQ_DOWN_BR_ADDR9'/>"
WRITE #1 "        <register address='0xb7f16a8' value='0x" DATA.LONG(A:0x7f16a8) "' name='RPMH_ARC_RM1_SEQ_DOWN_BR_ADDR10'/>"
WRITE #1 "        <register address='0xb7f16ac' value='0x" DATA.LONG(A:0x7f16ac) "' name='RPMH_ARC_RM1_SEQ_DOWN_BR_ADDR11'/>"
WRITE #1 "        <register address='0xb7f16b0' value='0x" DATA.LONG(A:0x7f16b0) "' name='RPMH_ARC_RM1_SEQ_DOWN_BR_ADDR12'/>"
WRITE #1 "        <register address='0xb7f16b4' value='0x" DATA.LONG(A:0x7f16b4) "' name='RPMH_ARC_RM1_SEQ_DOWN_BR_ADDR13'/>"
WRITE #1 "        <register address='0xb7f16b8' value='0x" DATA.LONG(A:0x7f16b8) "' name='RPMH_ARC_RM1_SEQ_DOWN_BR_ADDR14'/>"
WRITE #1 "        <register address='0xb7f16bc' value='0x" DATA.LONG(A:0x7f16bc) "' name='RPMH_ARC_RM1_SEQ_DOWN_BR_ADDR15'/>"
WRITE #1 "        <register address='0xb7f16c0' value='0x" DATA.LONG(A:0x7f16c0) "' name='RPMH_ARC_RM2_SEQ_DOWN_BR_ADDR0'/>"
WRITE #1 "        <register address='0xb7f16c4' value='0x" DATA.LONG(A:0x7f16c4) "' name='RPMH_ARC_RM2_SEQ_DOWN_BR_ADDR1'/>"
WRITE #1 "        <register address='0xb7f16c8' value='0x" DATA.LONG(A:0x7f16c8) "' name='RPMH_ARC_RM2_SEQ_DOWN_BR_ADDR2'/>"
WRITE #1 "        <register address='0xb7f16cc' value='0x" DATA.LONG(A:0x7f16cc) "' name='RPMH_ARC_RM2_SEQ_DOWN_BR_ADDR3'/>"
WRITE #1 "        <register address='0xb7f16d0' value='0x" DATA.LONG(A:0x7f16d0) "' name='RPMH_ARC_RM2_SEQ_DOWN_BR_ADDR4'/>"
WRITE #1 "        <register address='0xb7f16d4' value='0x" DATA.LONG(A:0x7f16d4) "' name='RPMH_ARC_RM2_SEQ_DOWN_BR_ADDR5'/>"
WRITE #1 "        <register address='0xb7f16d8' value='0x" DATA.LONG(A:0x7f16d8) "' name='RPMH_ARC_RM2_SEQ_DOWN_BR_ADDR6'/>"
WRITE #1 "        <register address='0xb7f16dc' value='0x" DATA.LONG(A:0x7f16dc) "' name='RPMH_ARC_RM2_SEQ_DOWN_BR_ADDR7'/>"
WRITE #1 "        <register address='0xb7f16e0' value='0x" DATA.LONG(A:0x7f16e0) "' name='RPMH_ARC_RM2_SEQ_DOWN_BR_ADDR8'/>"
WRITE #1 "        <register address='0xb7f16e4' value='0x" DATA.LONG(A:0x7f16e4) "' name='RPMH_ARC_RM2_SEQ_DOWN_BR_ADDR9'/>"
WRITE #1 "        <register address='0xb7f16e8' value='0x" DATA.LONG(A:0x7f16e8) "' name='RPMH_ARC_RM2_SEQ_DOWN_BR_ADDR10'/>"
WRITE #1 "        <register address='0xb7f16ec' value='0x" DATA.LONG(A:0x7f16ec) "' name='RPMH_ARC_RM2_SEQ_DOWN_BR_ADDR11'/>"
WRITE #1 "        <register address='0xb7f16f0' value='0x" DATA.LONG(A:0x7f16f0) "' name='RPMH_ARC_RM2_SEQ_DOWN_BR_ADDR12'/>"
WRITE #1 "        <register address='0xb7f16f4' value='0x" DATA.LONG(A:0x7f16f4) "' name='RPMH_ARC_RM2_SEQ_DOWN_BR_ADDR13'/>"
WRITE #1 "        <register address='0xb7f16f8' value='0x" DATA.LONG(A:0x7f16f8) "' name='RPMH_ARC_RM2_SEQ_DOWN_BR_ADDR14'/>"
WRITE #1 "        <register address='0xb7f16fc' value='0x" DATA.LONG(A:0x7f16fc) "' name='RPMH_ARC_RM2_SEQ_DOWN_BR_ADDR15'/>"
WRITE #1 "        <register address='0xb7f1700' value='0x" DATA.LONG(A:0x7f1700) "' name='RPMH_ARC_RM3_SEQ_DOWN_BR_ADDR0'/>"
WRITE #1 "        <register address='0xb7f1704' value='0x" DATA.LONG(A:0x7f1704) "' name='RPMH_ARC_RM3_SEQ_DOWN_BR_ADDR1'/>"
WRITE #1 "        <register address='0xb7f1708' value='0x" DATA.LONG(A:0x7f1708) "' name='RPMH_ARC_RM3_SEQ_DOWN_BR_ADDR2'/>"
WRITE #1 "        <register address='0xb7f170c' value='0x" DATA.LONG(A:0x7f170c) "' name='RPMH_ARC_RM3_SEQ_DOWN_BR_ADDR3'/>"
WRITE #1 "        <register address='0xb7f1710' value='0x" DATA.LONG(A:0x7f1710) "' name='RPMH_ARC_RM3_SEQ_DOWN_BR_ADDR4'/>"
WRITE #1 "        <register address='0xb7f1714' value='0x" DATA.LONG(A:0x7f1714) "' name='RPMH_ARC_RM3_SEQ_DOWN_BR_ADDR5'/>"
WRITE #1 "        <register address='0xb7f1718' value='0x" DATA.LONG(A:0x7f1718) "' name='RPMH_ARC_RM3_SEQ_DOWN_BR_ADDR6'/>"
WRITE #1 "        <register address='0xb7f171c' value='0x" DATA.LONG(A:0x7f171c) "' name='RPMH_ARC_RM3_SEQ_DOWN_BR_ADDR7'/>"
WRITE #1 "        <register address='0xb7f1720' value='0x" DATA.LONG(A:0x7f1720) "' name='RPMH_ARC_RM3_SEQ_DOWN_BR_ADDR8'/>"
WRITE #1 "        <register address='0xb7f1724' value='0x" DATA.LONG(A:0x7f1724) "' name='RPMH_ARC_RM3_SEQ_DOWN_BR_ADDR9'/>"
WRITE #1 "        <register address='0xb7f1728' value='0x" DATA.LONG(A:0x7f1728) "' name='RPMH_ARC_RM3_SEQ_DOWN_BR_ADDR10'/>"
WRITE #1 "        <register address='0xb7f172c' value='0x" DATA.LONG(A:0x7f172c) "' name='RPMH_ARC_RM3_SEQ_DOWN_BR_ADDR11'/>"
WRITE #1 "        <register address='0xb7f1730' value='0x" DATA.LONG(A:0x7f1730) "' name='RPMH_ARC_RM3_SEQ_DOWN_BR_ADDR12'/>"
WRITE #1 "        <register address='0xb7f1734' value='0x" DATA.LONG(A:0x7f1734) "' name='RPMH_ARC_RM3_SEQ_DOWN_BR_ADDR13'/>"
WRITE #1 "        <register address='0xb7f1738' value='0x" DATA.LONG(A:0x7f1738) "' name='RPMH_ARC_RM3_SEQ_DOWN_BR_ADDR14'/>"
WRITE #1 "        <register address='0xb7f173c' value='0x" DATA.LONG(A:0x7f173c) "' name='RPMH_ARC_RM3_SEQ_DOWN_BR_ADDR15'/>"
WRITE #1 "        <register address='0xb7f1740' value='0x" DATA.LONG(A:0x7f1740) "' name='RPMH_ARC_RM4_SEQ_DOWN_BR_ADDR0'/>"
WRITE #1 "        <register address='0xb7f1744' value='0x" DATA.LONG(A:0x7f1744) "' name='RPMH_ARC_RM4_SEQ_DOWN_BR_ADDR1'/>"
WRITE #1 "        <register address='0xb7f1748' value='0x" DATA.LONG(A:0x7f1748) "' name='RPMH_ARC_RM4_SEQ_DOWN_BR_ADDR2'/>"
WRITE #1 "        <register address='0xb7f174c' value='0x" DATA.LONG(A:0x7f174c) "' name='RPMH_ARC_RM4_SEQ_DOWN_BR_ADDR3'/>"
WRITE #1 "        <register address='0xb7f1750' value='0x" DATA.LONG(A:0x7f1750) "' name='RPMH_ARC_RM4_SEQ_DOWN_BR_ADDR4'/>"
WRITE #1 "        <register address='0xb7f1754' value='0x" DATA.LONG(A:0x7f1754) "' name='RPMH_ARC_RM4_SEQ_DOWN_BR_ADDR5'/>"
WRITE #1 "        <register address='0xb7f1758' value='0x" DATA.LONG(A:0x7f1758) "' name='RPMH_ARC_RM4_SEQ_DOWN_BR_ADDR6'/>"
WRITE #1 "        <register address='0xb7f175c' value='0x" DATA.LONG(A:0x7f175c) "' name='RPMH_ARC_RM4_SEQ_DOWN_BR_ADDR7'/>"
WRITE #1 "        <register address='0xb7f1760' value='0x" DATA.LONG(A:0x7f1760) "' name='RPMH_ARC_RM4_SEQ_DOWN_BR_ADDR8'/>"
WRITE #1 "        <register address='0xb7f1764' value='0x" DATA.LONG(A:0x7f1764) "' name='RPMH_ARC_RM4_SEQ_DOWN_BR_ADDR9'/>"
WRITE #1 "        <register address='0xb7f1768' value='0x" DATA.LONG(A:0x7f1768) "' name='RPMH_ARC_RM4_SEQ_DOWN_BR_ADDR10'/>"
WRITE #1 "        <register address='0xb7f176c' value='0x" DATA.LONG(A:0x7f176c) "' name='RPMH_ARC_RM4_SEQ_DOWN_BR_ADDR11'/>"
WRITE #1 "        <register address='0xb7f1770' value='0x" DATA.LONG(A:0x7f1770) "' name='RPMH_ARC_RM4_SEQ_DOWN_BR_ADDR12'/>"
WRITE #1 "        <register address='0xb7f1774' value='0x" DATA.LONG(A:0x7f1774) "' name='RPMH_ARC_RM4_SEQ_DOWN_BR_ADDR13'/>"
WRITE #1 "        <register address='0xb7f1778' value='0x" DATA.LONG(A:0x7f1778) "' name='RPMH_ARC_RM4_SEQ_DOWN_BR_ADDR14'/>"
WRITE #1 "        <register address='0xb7f177c' value='0x" DATA.LONG(A:0x7f177c) "' name='RPMH_ARC_RM4_SEQ_DOWN_BR_ADDR15'/>"
WRITE #1 "        <register address='0xb7f1780' value='0x" DATA.LONG(A:0x7f1780) "' name='RPMH_ARC_RM5_SEQ_DOWN_BR_ADDR0'/>"
WRITE #1 "        <register address='0xb7f1784' value='0x" DATA.LONG(A:0x7f1784) "' name='RPMH_ARC_RM5_SEQ_DOWN_BR_ADDR1'/>"
WRITE #1 "        <register address='0xb7f1788' value='0x" DATA.LONG(A:0x7f1788) "' name='RPMH_ARC_RM5_SEQ_DOWN_BR_ADDR2'/>"
WRITE #1 "        <register address='0xb7f178c' value='0x" DATA.LONG(A:0x7f178c) "' name='RPMH_ARC_RM5_SEQ_DOWN_BR_ADDR3'/>"
WRITE #1 "        <register address='0xb7f1790' value='0x" DATA.LONG(A:0x7f1790) "' name='RPMH_ARC_RM5_SEQ_DOWN_BR_ADDR4'/>"
WRITE #1 "        <register address='0xb7f1794' value='0x" DATA.LONG(A:0x7f1794) "' name='RPMH_ARC_RM5_SEQ_DOWN_BR_ADDR5'/>"
WRITE #1 "        <register address='0xb7f1798' value='0x" DATA.LONG(A:0x7f1798) "' name='RPMH_ARC_RM5_SEQ_DOWN_BR_ADDR6'/>"
WRITE #1 "        <register address='0xb7f179c' value='0x" DATA.LONG(A:0x7f179c) "' name='RPMH_ARC_RM5_SEQ_DOWN_BR_ADDR7'/>"
WRITE #1 "        <register address='0xb7f17a0' value='0x" DATA.LONG(A:0x7f17a0) "' name='RPMH_ARC_RM5_SEQ_DOWN_BR_ADDR8'/>"
WRITE #1 "        <register address='0xb7f17a4' value='0x" DATA.LONG(A:0x7f17a4) "' name='RPMH_ARC_RM5_SEQ_DOWN_BR_ADDR9'/>"
WRITE #1 "        <register address='0xb7f17a8' value='0x" DATA.LONG(A:0x7f17a8) "' name='RPMH_ARC_RM5_SEQ_DOWN_BR_ADDR10'/>"
WRITE #1 "        <register address='0xb7f17ac' value='0x" DATA.LONG(A:0x7f17ac) "' name='RPMH_ARC_RM5_SEQ_DOWN_BR_ADDR11'/>"
WRITE #1 "        <register address='0xb7f17b0' value='0x" DATA.LONG(A:0x7f17b0) "' name='RPMH_ARC_RM5_SEQ_DOWN_BR_ADDR12'/>"
WRITE #1 "        <register address='0xb7f17b4' value='0x" DATA.LONG(A:0x7f17b4) "' name='RPMH_ARC_RM5_SEQ_DOWN_BR_ADDR13'/>"
WRITE #1 "        <register address='0xb7f17b8' value='0x" DATA.LONG(A:0x7f17b8) "' name='RPMH_ARC_RM5_SEQ_DOWN_BR_ADDR14'/>"
WRITE #1 "        <register address='0xb7f17bc' value='0x" DATA.LONG(A:0x7f17bc) "' name='RPMH_ARC_RM5_SEQ_DOWN_BR_ADDR15'/>"
WRITE #1 "        <register address='0xb7f17c0' value='0x" DATA.LONG(A:0x7f17c0) "' name='RPMH_ARC_RM6_SEQ_DOWN_BR_ADDR0'/>"
WRITE #1 "        <register address='0xb7f17c4' value='0x" DATA.LONG(A:0x7f17c4) "' name='RPMH_ARC_RM6_SEQ_DOWN_BR_ADDR1'/>"
WRITE #1 "        <register address='0xb7f17c8' value='0x" DATA.LONG(A:0x7f17c8) "' name='RPMH_ARC_RM6_SEQ_DOWN_BR_ADDR2'/>"
WRITE #1 "        <register address='0xb7f17cc' value='0x" DATA.LONG(A:0x7f17cc) "' name='RPMH_ARC_RM6_SEQ_DOWN_BR_ADDR3'/>"
WRITE #1 "        <register address='0xb7f17d0' value='0x" DATA.LONG(A:0x7f17d0) "' name='RPMH_ARC_RM6_SEQ_DOWN_BR_ADDR4'/>"
WRITE #1 "        <register address='0xb7f17d4' value='0x" DATA.LONG(A:0x7f17d4) "' name='RPMH_ARC_RM6_SEQ_DOWN_BR_ADDR5'/>"
WRITE #1 "        <register address='0xb7f17d8' value='0x" DATA.LONG(A:0x7f17d8) "' name='RPMH_ARC_RM6_SEQ_DOWN_BR_ADDR6'/>"
WRITE #1 "        <register address='0xb7f17dc' value='0x" DATA.LONG(A:0x7f17dc) "' name='RPMH_ARC_RM6_SEQ_DOWN_BR_ADDR7'/>"
WRITE #1 "        <register address='0xb7f17e0' value='0x" DATA.LONG(A:0x7f17e0) "' name='RPMH_ARC_RM6_SEQ_DOWN_BR_ADDR8'/>"
WRITE #1 "        <register address='0xb7f17e4' value='0x" DATA.LONG(A:0x7f17e4) "' name='RPMH_ARC_RM6_SEQ_DOWN_BR_ADDR9'/>"
WRITE #1 "        <register address='0xb7f17e8' value='0x" DATA.LONG(A:0x7f17e8) "' name='RPMH_ARC_RM6_SEQ_DOWN_BR_ADDR10'/>"
WRITE #1 "        <register address='0xb7f17ec' value='0x" DATA.LONG(A:0x7f17ec) "' name='RPMH_ARC_RM6_SEQ_DOWN_BR_ADDR11'/>"
WRITE #1 "        <register address='0xb7f17f0' value='0x" DATA.LONG(A:0x7f17f0) "' name='RPMH_ARC_RM6_SEQ_DOWN_BR_ADDR12'/>"
WRITE #1 "        <register address='0xb7f17f4' value='0x" DATA.LONG(A:0x7f17f4) "' name='RPMH_ARC_RM6_SEQ_DOWN_BR_ADDR13'/>"
WRITE #1 "        <register address='0xb7f17f8' value='0x" DATA.LONG(A:0x7f17f8) "' name='RPMH_ARC_RM6_SEQ_DOWN_BR_ADDR14'/>"
WRITE #1 "        <register address='0xb7f17fc' value='0x" DATA.LONG(A:0x7f17fc) "' name='RPMH_ARC_RM6_SEQ_DOWN_BR_ADDR15'/>"
WRITE #1 "        <register address='0xb7f1800' value='0x" DATA.LONG(A:0x7f1800) "' name='RPMH_ARC_RM7_SEQ_DOWN_BR_ADDR0'/>"
WRITE #1 "        <register address='0xb7f1804' value='0x" DATA.LONG(A:0x7f1804) "' name='RPMH_ARC_RM7_SEQ_DOWN_BR_ADDR1'/>"
WRITE #1 "        <register address='0xb7f1808' value='0x" DATA.LONG(A:0x7f1808) "' name='RPMH_ARC_RM7_SEQ_DOWN_BR_ADDR2'/>"
WRITE #1 "        <register address='0xb7f180c' value='0x" DATA.LONG(A:0x7f180c) "' name='RPMH_ARC_RM7_SEQ_DOWN_BR_ADDR3'/>"
WRITE #1 "        <register address='0xb7f1810' value='0x" DATA.LONG(A:0x7f1810) "' name='RPMH_ARC_RM7_SEQ_DOWN_BR_ADDR4'/>"
WRITE #1 "        <register address='0xb7f1814' value='0x" DATA.LONG(A:0x7f1814) "' name='RPMH_ARC_RM7_SEQ_DOWN_BR_ADDR5'/>"
WRITE #1 "        <register address='0xb7f1818' value='0x" DATA.LONG(A:0x7f1818) "' name='RPMH_ARC_RM7_SEQ_DOWN_BR_ADDR6'/>"
WRITE #1 "        <register address='0xb7f181c' value='0x" DATA.LONG(A:0x7f181c) "' name='RPMH_ARC_RM7_SEQ_DOWN_BR_ADDR7'/>"
WRITE #1 "        <register address='0xb7f1820' value='0x" DATA.LONG(A:0x7f1820) "' name='RPMH_ARC_RM7_SEQ_DOWN_BR_ADDR8'/>"
WRITE #1 "        <register address='0xb7f1824' value='0x" DATA.LONG(A:0x7f1824) "' name='RPMH_ARC_RM7_SEQ_DOWN_BR_ADDR9'/>"
WRITE #1 "        <register address='0xb7f1828' value='0x" DATA.LONG(A:0x7f1828) "' name='RPMH_ARC_RM7_SEQ_DOWN_BR_ADDR10'/>"
WRITE #1 "        <register address='0xb7f182c' value='0x" DATA.LONG(A:0x7f182c) "' name='RPMH_ARC_RM7_SEQ_DOWN_BR_ADDR11'/>"
WRITE #1 "        <register address='0xb7f1830' value='0x" DATA.LONG(A:0x7f1830) "' name='RPMH_ARC_RM7_SEQ_DOWN_BR_ADDR12'/>"
WRITE #1 "        <register address='0xb7f1834' value='0x" DATA.LONG(A:0x7f1834) "' name='RPMH_ARC_RM7_SEQ_DOWN_BR_ADDR13'/>"
WRITE #1 "        <register address='0xb7f1838' value='0x" DATA.LONG(A:0x7f1838) "' name='RPMH_ARC_RM7_SEQ_DOWN_BR_ADDR14'/>"
WRITE #1 "        <register address='0xb7f183c' value='0x" DATA.LONG(A:0x7f183c) "' name='RPMH_ARC_RM7_SEQ_DOWN_BR_ADDR15'/>"
WRITE #1 "        <register address='0xb7f1a40' value='0x" DATA.LONG(A:0x7f1a40) "' name='RPMH_ARC_RM0_SEQ_SW_CONF_ADDR0'/>"
WRITE #1 "        <register address='0xb7f1a44' value='0x" DATA.LONG(A:0x7f1a44) "' name='RPMH_ARC_RM0_SEQ_SW_CONF_ADDR1'/>"
WRITE #1 "        <register address='0xb7f1a48' value='0x" DATA.LONG(A:0x7f1a48) "' name='RPMH_ARC_RM0_SEQ_SW_CONF_ADDR2'/>"
WRITE #1 "        <register address='0xb7f1a4c' value='0x" DATA.LONG(A:0x7f1a4c) "' name='RPMH_ARC_RM0_SEQ_SW_CONF_ADDR3'/>"
WRITE #1 "        <register address='0xb7f1a50' value='0x" DATA.LONG(A:0x7f1a50) "' name='RPMH_ARC_RM0_SEQ_SW_CONF_ADDR4'/>"
WRITE #1 "        <register address='0xb7f1a54' value='0x" DATA.LONG(A:0x7f1a54) "' name='RPMH_ARC_RM0_SEQ_SW_CONF_ADDR5'/>"
WRITE #1 "        <register address='0xb7f1a58' value='0x" DATA.LONG(A:0x7f1a58) "' name='RPMH_ARC_RM0_SEQ_SW_CONF_ADDR6'/>"
WRITE #1 "        <register address='0xb7f1a5c' value='0x" DATA.LONG(A:0x7f1a5c) "' name='RPMH_ARC_RM0_SEQ_SW_CONF_ADDR7'/>"
WRITE #1 "        <register address='0xb7f1a60' value='0x" DATA.LONG(A:0x7f1a60) "' name='RPMH_ARC_RM0_SEQ_SW_CONF_ADDR8'/>"
WRITE #1 "        <register address='0xb7f1a64' value='0x" DATA.LONG(A:0x7f1a64) "' name='RPMH_ARC_RM0_SEQ_SW_CONF_ADDR9'/>"
WRITE #1 "        <register address='0xb7f1a68' value='0x" DATA.LONG(A:0x7f1a68) "' name='RPMH_ARC_RM0_SEQ_SW_CONF_ADDR10'/>"
WRITE #1 "        <register address='0xb7f1a6c' value='0x" DATA.LONG(A:0x7f1a6c) "' name='RPMH_ARC_RM0_SEQ_SW_CONF_ADDR11'/>"
WRITE #1 "        <register address='0xb7f1a70' value='0x" DATA.LONG(A:0x7f1a70) "' name='RPMH_ARC_RM0_SEQ_SW_CONF_ADDR12'/>"
WRITE #1 "        <register address='0xb7f1a74' value='0x" DATA.LONG(A:0x7f1a74) "' name='RPMH_ARC_RM0_SEQ_SW_CONF_ADDR13'/>"
WRITE #1 "        <register address='0xb7f1a78' value='0x" DATA.LONG(A:0x7f1a78) "' name='RPMH_ARC_RM0_SEQ_SW_CONF_ADDR14'/>"
WRITE #1 "        <register address='0xb7f1a7c' value='0x" DATA.LONG(A:0x7f1a7c) "' name='RPMH_ARC_RM0_SEQ_SW_CONF_ADDR15'/>"
WRITE #1 "        <register address='0xb7f1a80' value='0x" DATA.LONG(A:0x7f1a80) "' name='RPMH_ARC_RM1_SEQ_SW_CONF_ADDR0'/>"
WRITE #1 "        <register address='0xb7f1a84' value='0x" DATA.LONG(A:0x7f1a84) "' name='RPMH_ARC_RM1_SEQ_SW_CONF_ADDR1'/>"
WRITE #1 "        <register address='0xb7f1a88' value='0x" DATA.LONG(A:0x7f1a88) "' name='RPMH_ARC_RM1_SEQ_SW_CONF_ADDR2'/>"
WRITE #1 "        <register address='0xb7f1a8c' value='0x" DATA.LONG(A:0x7f1a8c) "' name='RPMH_ARC_RM1_SEQ_SW_CONF_ADDR3'/>"
WRITE #1 "        <register address='0xb7f1a90' value='0x" DATA.LONG(A:0x7f1a90) "' name='RPMH_ARC_RM1_SEQ_SW_CONF_ADDR4'/>"
WRITE #1 "        <register address='0xb7f1a94' value='0x" DATA.LONG(A:0x7f1a94) "' name='RPMH_ARC_RM1_SEQ_SW_CONF_ADDR5'/>"
WRITE #1 "        <register address='0xb7f1a98' value='0x" DATA.LONG(A:0x7f1a98) "' name='RPMH_ARC_RM1_SEQ_SW_CONF_ADDR6'/>"
WRITE #1 "        <register address='0xb7f1a9c' value='0x" DATA.LONG(A:0x7f1a9c) "' name='RPMH_ARC_RM1_SEQ_SW_CONF_ADDR7'/>"
WRITE #1 "        <register address='0xb7f1aa0' value='0x" DATA.LONG(A:0x7f1aa0) "' name='RPMH_ARC_RM1_SEQ_SW_CONF_ADDR8'/>"
WRITE #1 "        <register address='0xb7f1aa4' value='0x" DATA.LONG(A:0x7f1aa4) "' name='RPMH_ARC_RM1_SEQ_SW_CONF_ADDR9'/>"
WRITE #1 "        <register address='0xb7f1aa8' value='0x" DATA.LONG(A:0x7f1aa8) "' name='RPMH_ARC_RM1_SEQ_SW_CONF_ADDR10'/>"
WRITE #1 "        <register address='0xb7f1aac' value='0x" DATA.LONG(A:0x7f1aac) "' name='RPMH_ARC_RM1_SEQ_SW_CONF_ADDR11'/>"
WRITE #1 "        <register address='0xb7f1ab0' value='0x" DATA.LONG(A:0x7f1ab0) "' name='RPMH_ARC_RM1_SEQ_SW_CONF_ADDR12'/>"
WRITE #1 "        <register address='0xb7f1ab4' value='0x" DATA.LONG(A:0x7f1ab4) "' name='RPMH_ARC_RM1_SEQ_SW_CONF_ADDR13'/>"
WRITE #1 "        <register address='0xb7f1ab8' value='0x" DATA.LONG(A:0x7f1ab8) "' name='RPMH_ARC_RM1_SEQ_SW_CONF_ADDR14'/>"
WRITE #1 "        <register address='0xb7f1abc' value='0x" DATA.LONG(A:0x7f1abc) "' name='RPMH_ARC_RM1_SEQ_SW_CONF_ADDR15'/>"
WRITE #1 "        <register address='0xb7f1ac0' value='0x" DATA.LONG(A:0x7f1ac0) "' name='RPMH_ARC_RM2_SEQ_SW_CONF_ADDR0'/>"
WRITE #1 "        <register address='0xb7f1ac4' value='0x" DATA.LONG(A:0x7f1ac4) "' name='RPMH_ARC_RM2_SEQ_SW_CONF_ADDR1'/>"
WRITE #1 "        <register address='0xb7f1ac8' value='0x" DATA.LONG(A:0x7f1ac8) "' name='RPMH_ARC_RM2_SEQ_SW_CONF_ADDR2'/>"
WRITE #1 "        <register address='0xb7f1acc' value='0x" DATA.LONG(A:0x7f1acc) "' name='RPMH_ARC_RM2_SEQ_SW_CONF_ADDR3'/>"
WRITE #1 "        <register address='0xb7f1ad0' value='0x" DATA.LONG(A:0x7f1ad0) "' name='RPMH_ARC_RM2_SEQ_SW_CONF_ADDR4'/>"
WRITE #1 "        <register address='0xb7f1ad4' value='0x" DATA.LONG(A:0x7f1ad4) "' name='RPMH_ARC_RM2_SEQ_SW_CONF_ADDR5'/>"
WRITE #1 "        <register address='0xb7f1ad8' value='0x" DATA.LONG(A:0x7f1ad8) "' name='RPMH_ARC_RM2_SEQ_SW_CONF_ADDR6'/>"
WRITE #1 "        <register address='0xb7f1adc' value='0x" DATA.LONG(A:0x7f1adc) "' name='RPMH_ARC_RM2_SEQ_SW_CONF_ADDR7'/>"
WRITE #1 "        <register address='0xb7f1ae0' value='0x" DATA.LONG(A:0x7f1ae0) "' name='RPMH_ARC_RM2_SEQ_SW_CONF_ADDR8'/>"
WRITE #1 "        <register address='0xb7f1ae4' value='0x" DATA.LONG(A:0x7f1ae4) "' name='RPMH_ARC_RM2_SEQ_SW_CONF_ADDR9'/>"
WRITE #1 "        <register address='0xb7f1ae8' value='0x" DATA.LONG(A:0x7f1ae8) "' name='RPMH_ARC_RM2_SEQ_SW_CONF_ADDR10'/>"
WRITE #1 "        <register address='0xb7f1aec' value='0x" DATA.LONG(A:0x7f1aec) "' name='RPMH_ARC_RM2_SEQ_SW_CONF_ADDR11'/>"
WRITE #1 "        <register address='0xb7f1af0' value='0x" DATA.LONG(A:0x7f1af0) "' name='RPMH_ARC_RM2_SEQ_SW_CONF_ADDR12'/>"
WRITE #1 "        <register address='0xb7f1af4' value='0x" DATA.LONG(A:0x7f1af4) "' name='RPMH_ARC_RM2_SEQ_SW_CONF_ADDR13'/>"
WRITE #1 "        <register address='0xb7f1af8' value='0x" DATA.LONG(A:0x7f1af8) "' name='RPMH_ARC_RM2_SEQ_SW_CONF_ADDR14'/>"
WRITE #1 "        <register address='0xb7f1afc' value='0x" DATA.LONG(A:0x7f1afc) "' name='RPMH_ARC_RM2_SEQ_SW_CONF_ADDR15'/>"
WRITE #1 "        <register address='0xb7f1b00' value='0x" DATA.LONG(A:0x7f1b00) "' name='RPMH_ARC_RM3_SEQ_SW_CONF_ADDR0'/>"
WRITE #1 "        <register address='0xb7f1b04' value='0x" DATA.LONG(A:0x7f1b04) "' name='RPMH_ARC_RM3_SEQ_SW_CONF_ADDR1'/>"
WRITE #1 "        <register address='0xb7f1b08' value='0x" DATA.LONG(A:0x7f1b08) "' name='RPMH_ARC_RM3_SEQ_SW_CONF_ADDR2'/>"
WRITE #1 "        <register address='0xb7f1b0c' value='0x" DATA.LONG(A:0x7f1b0c) "' name='RPMH_ARC_RM3_SEQ_SW_CONF_ADDR3'/>"
WRITE #1 "        <register address='0xb7f1b10' value='0x" DATA.LONG(A:0x7f1b10) "' name='RPMH_ARC_RM3_SEQ_SW_CONF_ADDR4'/>"
WRITE #1 "        <register address='0xb7f1b14' value='0x" DATA.LONG(A:0x7f1b14) "' name='RPMH_ARC_RM3_SEQ_SW_CONF_ADDR5'/>"
WRITE #1 "        <register address='0xb7f1b18' value='0x" DATA.LONG(A:0x7f1b18) "' name='RPMH_ARC_RM3_SEQ_SW_CONF_ADDR6'/>"
WRITE #1 "        <register address='0xb7f1b1c' value='0x" DATA.LONG(A:0x7f1b1c) "' name='RPMH_ARC_RM3_SEQ_SW_CONF_ADDR7'/>"
WRITE #1 "        <register address='0xb7f1b20' value='0x" DATA.LONG(A:0x7f1b20) "' name='RPMH_ARC_RM3_SEQ_SW_CONF_ADDR8'/>"
WRITE #1 "        <register address='0xb7f1b24' value='0x" DATA.LONG(A:0x7f1b24) "' name='RPMH_ARC_RM3_SEQ_SW_CONF_ADDR9'/>"
WRITE #1 "        <register address='0xb7f1b28' value='0x" DATA.LONG(A:0x7f1b28) "' name='RPMH_ARC_RM3_SEQ_SW_CONF_ADDR10'/>"
WRITE #1 "        <register address='0xb7f1b2c' value='0x" DATA.LONG(A:0x7f1b2c) "' name='RPMH_ARC_RM3_SEQ_SW_CONF_ADDR11'/>"
WRITE #1 "        <register address='0xb7f1b30' value='0x" DATA.LONG(A:0x7f1b30) "' name='RPMH_ARC_RM3_SEQ_SW_CONF_ADDR12'/>"
WRITE #1 "        <register address='0xb7f1b34' value='0x" DATA.LONG(A:0x7f1b34) "' name='RPMH_ARC_RM3_SEQ_SW_CONF_ADDR13'/>"
WRITE #1 "        <register address='0xb7f1b38' value='0x" DATA.LONG(A:0x7f1b38) "' name='RPMH_ARC_RM3_SEQ_SW_CONF_ADDR14'/>"
WRITE #1 "        <register address='0xb7f1b3c' value='0x" DATA.LONG(A:0x7f1b3c) "' name='RPMH_ARC_RM3_SEQ_SW_CONF_ADDR15'/>"
WRITE #1 "        <register address='0xb7f1b40' value='0x" DATA.LONG(A:0x7f1b40) "' name='RPMH_ARC_RM4_SEQ_SW_CONF_ADDR0'/>"
WRITE #1 "        <register address='0xb7f1b44' value='0x" DATA.LONG(A:0x7f1b44) "' name='RPMH_ARC_RM4_SEQ_SW_CONF_ADDR1'/>"
WRITE #1 "        <register address='0xb7f1b48' value='0x" DATA.LONG(A:0x7f1b48) "' name='RPMH_ARC_RM4_SEQ_SW_CONF_ADDR2'/>"
WRITE #1 "        <register address='0xb7f1b4c' value='0x" DATA.LONG(A:0x7f1b4c) "' name='RPMH_ARC_RM4_SEQ_SW_CONF_ADDR3'/>"
WRITE #1 "        <register address='0xb7f1b50' value='0x" DATA.LONG(A:0x7f1b50) "' name='RPMH_ARC_RM4_SEQ_SW_CONF_ADDR4'/>"
WRITE #1 "        <register address='0xb7f1b54' value='0x" DATA.LONG(A:0x7f1b54) "' name='RPMH_ARC_RM4_SEQ_SW_CONF_ADDR5'/>"
WRITE #1 "        <register address='0xb7f1b58' value='0x" DATA.LONG(A:0x7f1b58) "' name='RPMH_ARC_RM4_SEQ_SW_CONF_ADDR6'/>"
WRITE #1 "        <register address='0xb7f1b5c' value='0x" DATA.LONG(A:0x7f1b5c) "' name='RPMH_ARC_RM4_SEQ_SW_CONF_ADDR7'/>"
WRITE #1 "        <register address='0xb7f1b60' value='0x" DATA.LONG(A:0x7f1b60) "' name='RPMH_ARC_RM4_SEQ_SW_CONF_ADDR8'/>"
WRITE #1 "        <register address='0xb7f1b64' value='0x" DATA.LONG(A:0x7f1b64) "' name='RPMH_ARC_RM4_SEQ_SW_CONF_ADDR9'/>"
WRITE #1 "        <register address='0xb7f1b68' value='0x" DATA.LONG(A:0x7f1b68) "' name='RPMH_ARC_RM4_SEQ_SW_CONF_ADDR10'/>"
WRITE #1 "        <register address='0xb7f1b6c' value='0x" DATA.LONG(A:0x7f1b6c) "' name='RPMH_ARC_RM4_SEQ_SW_CONF_ADDR11'/>"
WRITE #1 "        <register address='0xb7f1b70' value='0x" DATA.LONG(A:0x7f1b70) "' name='RPMH_ARC_RM4_SEQ_SW_CONF_ADDR12'/>"
WRITE #1 "        <register address='0xb7f1b74' value='0x" DATA.LONG(A:0x7f1b74) "' name='RPMH_ARC_RM4_SEQ_SW_CONF_ADDR13'/>"
WRITE #1 "        <register address='0xb7f1b78' value='0x" DATA.LONG(A:0x7f1b78) "' name='RPMH_ARC_RM4_SEQ_SW_CONF_ADDR14'/>"
WRITE #1 "        <register address='0xb7f1b7c' value='0x" DATA.LONG(A:0x7f1b7c) "' name='RPMH_ARC_RM4_SEQ_SW_CONF_ADDR15'/>"
WRITE #1 "        <register address='0xb7f1b80' value='0x" DATA.LONG(A:0x7f1b80) "' name='RPMH_ARC_RM5_SEQ_SW_CONF_ADDR0'/>"
WRITE #1 "        <register address='0xb7f1b84' value='0x" DATA.LONG(A:0x7f1b84) "' name='RPMH_ARC_RM5_SEQ_SW_CONF_ADDR1'/>"
WRITE #1 "        <register address='0xb7f1b88' value='0x" DATA.LONG(A:0x7f1b88) "' name='RPMH_ARC_RM5_SEQ_SW_CONF_ADDR2'/>"
WRITE #1 "        <register address='0xb7f1b8c' value='0x" DATA.LONG(A:0x7f1b8c) "' name='RPMH_ARC_RM5_SEQ_SW_CONF_ADDR3'/>"
WRITE #1 "        <register address='0xb7f1b90' value='0x" DATA.LONG(A:0x7f1b90) "' name='RPMH_ARC_RM5_SEQ_SW_CONF_ADDR4'/>"
WRITE #1 "        <register address='0xb7f1b94' value='0x" DATA.LONG(A:0x7f1b94) "' name='RPMH_ARC_RM5_SEQ_SW_CONF_ADDR5'/>"
WRITE #1 "        <register address='0xb7f1b98' value='0x" DATA.LONG(A:0x7f1b98) "' name='RPMH_ARC_RM5_SEQ_SW_CONF_ADDR6'/>"
WRITE #1 "        <register address='0xb7f1b9c' value='0x" DATA.LONG(A:0x7f1b9c) "' name='RPMH_ARC_RM5_SEQ_SW_CONF_ADDR7'/>"
WRITE #1 "        <register address='0xb7f1ba0' value='0x" DATA.LONG(A:0x7f1ba0) "' name='RPMH_ARC_RM5_SEQ_SW_CONF_ADDR8'/>"
WRITE #1 "        <register address='0xb7f1ba4' value='0x" DATA.LONG(A:0x7f1ba4) "' name='RPMH_ARC_RM5_SEQ_SW_CONF_ADDR9'/>"
WRITE #1 "        <register address='0xb7f1ba8' value='0x" DATA.LONG(A:0x7f1ba8) "' name='RPMH_ARC_RM5_SEQ_SW_CONF_ADDR10'/>"
WRITE #1 "        <register address='0xb7f1bac' value='0x" DATA.LONG(A:0x7f1bac) "' name='RPMH_ARC_RM5_SEQ_SW_CONF_ADDR11'/>"
WRITE #1 "        <register address='0xb7f1bb0' value='0x" DATA.LONG(A:0x7f1bb0) "' name='RPMH_ARC_RM5_SEQ_SW_CONF_ADDR12'/>"
WRITE #1 "        <register address='0xb7f1bb4' value='0x" DATA.LONG(A:0x7f1bb4) "' name='RPMH_ARC_RM5_SEQ_SW_CONF_ADDR13'/>"
WRITE #1 "        <register address='0xb7f1bb8' value='0x" DATA.LONG(A:0x7f1bb8) "' name='RPMH_ARC_RM5_SEQ_SW_CONF_ADDR14'/>"
WRITE #1 "        <register address='0xb7f1bbc' value='0x" DATA.LONG(A:0x7f1bbc) "' name='RPMH_ARC_RM5_SEQ_SW_CONF_ADDR15'/>"
WRITE #1 "        <register address='0xb7f1bc0' value='0x" DATA.LONG(A:0x7f1bc0) "' name='RPMH_ARC_RM6_SEQ_SW_CONF_ADDR0'/>"
WRITE #1 "        <register address='0xb7f1bc4' value='0x" DATA.LONG(A:0x7f1bc4) "' name='RPMH_ARC_RM6_SEQ_SW_CONF_ADDR1'/>"
WRITE #1 "        <register address='0xb7f1bc8' value='0x" DATA.LONG(A:0x7f1bc8) "' name='RPMH_ARC_RM6_SEQ_SW_CONF_ADDR2'/>"
WRITE #1 "        <register address='0xb7f1bcc' value='0x" DATA.LONG(A:0x7f1bcc) "' name='RPMH_ARC_RM6_SEQ_SW_CONF_ADDR3'/>"
WRITE #1 "        <register address='0xb7f1bd0' value='0x" DATA.LONG(A:0x7f1bd0) "' name='RPMH_ARC_RM6_SEQ_SW_CONF_ADDR4'/>"
WRITE #1 "        <register address='0xb7f1bd4' value='0x" DATA.LONG(A:0x7f1bd4) "' name='RPMH_ARC_RM6_SEQ_SW_CONF_ADDR5'/>"
WRITE #1 "        <register address='0xb7f1bd8' value='0x" DATA.LONG(A:0x7f1bd8) "' name='RPMH_ARC_RM6_SEQ_SW_CONF_ADDR6'/>"
WRITE #1 "        <register address='0xb7f1bdc' value='0x" DATA.LONG(A:0x7f1bdc) "' name='RPMH_ARC_RM6_SEQ_SW_CONF_ADDR7'/>"
WRITE #1 "        <register address='0xb7f1be0' value='0x" DATA.LONG(A:0x7f1be0) "' name='RPMH_ARC_RM6_SEQ_SW_CONF_ADDR8'/>"
WRITE #1 "        <register address='0xb7f1be4' value='0x" DATA.LONG(A:0x7f1be4) "' name='RPMH_ARC_RM6_SEQ_SW_CONF_ADDR9'/>"
WRITE #1 "        <register address='0xb7f1be8' value='0x" DATA.LONG(A:0x7f1be8) "' name='RPMH_ARC_RM6_SEQ_SW_CONF_ADDR10'/>"
WRITE #1 "        <register address='0xb7f1bec' value='0x" DATA.LONG(A:0x7f1bec) "' name='RPMH_ARC_RM6_SEQ_SW_CONF_ADDR11'/>"
WRITE #1 "        <register address='0xb7f1bf0' value='0x" DATA.LONG(A:0x7f1bf0) "' name='RPMH_ARC_RM6_SEQ_SW_CONF_ADDR12'/>"
WRITE #1 "        <register address='0xb7f1bf4' value='0x" DATA.LONG(A:0x7f1bf4) "' name='RPMH_ARC_RM6_SEQ_SW_CONF_ADDR13'/>"
WRITE #1 "        <register address='0xb7f1bf8' value='0x" DATA.LONG(A:0x7f1bf8) "' name='RPMH_ARC_RM6_SEQ_SW_CONF_ADDR14'/>"
WRITE #1 "        <register address='0xb7f1bfc' value='0x" DATA.LONG(A:0x7f1bfc) "' name='RPMH_ARC_RM6_SEQ_SW_CONF_ADDR15'/>"
WRITE #1 "        <register address='0xb7f1c00' value='0x" DATA.LONG(A:0x7f1c00) "' name='RPMH_ARC_RM7_SEQ_SW_CONF_ADDR0'/>"
WRITE #1 "        <register address='0xb7f1c04' value='0x" DATA.LONG(A:0x7f1c04) "' name='RPMH_ARC_RM7_SEQ_SW_CONF_ADDR1'/>"
WRITE #1 "        <register address='0xb7f1c08' value='0x" DATA.LONG(A:0x7f1c08) "' name='RPMH_ARC_RM7_SEQ_SW_CONF_ADDR2'/>"
WRITE #1 "        <register address='0xb7f1c0c' value='0x" DATA.LONG(A:0x7f1c0c) "' name='RPMH_ARC_RM7_SEQ_SW_CONF_ADDR3'/>"
WRITE #1 "        <register address='0xb7f1c10' value='0x" DATA.LONG(A:0x7f1c10) "' name='RPMH_ARC_RM7_SEQ_SW_CONF_ADDR4'/>"
WRITE #1 "        <register address='0xb7f1c14' value='0x" DATA.LONG(A:0x7f1c14) "' name='RPMH_ARC_RM7_SEQ_SW_CONF_ADDR5'/>"
WRITE #1 "        <register address='0xb7f1c18' value='0x" DATA.LONG(A:0x7f1c18) "' name='RPMH_ARC_RM7_SEQ_SW_CONF_ADDR6'/>"
WRITE #1 "        <register address='0xb7f1c1c' value='0x" DATA.LONG(A:0x7f1c1c) "' name='RPMH_ARC_RM7_SEQ_SW_CONF_ADDR7'/>"
WRITE #1 "        <register address='0xb7f1c20' value='0x" DATA.LONG(A:0x7f1c20) "' name='RPMH_ARC_RM7_SEQ_SW_CONF_ADDR8'/>"
WRITE #1 "        <register address='0xb7f1c24' value='0x" DATA.LONG(A:0x7f1c24) "' name='RPMH_ARC_RM7_SEQ_SW_CONF_ADDR9'/>"
WRITE #1 "        <register address='0xb7f1c28' value='0x" DATA.LONG(A:0x7f1c28) "' name='RPMH_ARC_RM7_SEQ_SW_CONF_ADDR10'/>"
WRITE #1 "        <register address='0xb7f1c2c' value='0x" DATA.LONG(A:0x7f1c2c) "' name='RPMH_ARC_RM7_SEQ_SW_CONF_ADDR11'/>"
WRITE #1 "        <register address='0xb7f1c30' value='0x" DATA.LONG(A:0x7f1c30) "' name='RPMH_ARC_RM7_SEQ_SW_CONF_ADDR12'/>"
WRITE #1 "        <register address='0xb7f1c34' value='0x" DATA.LONG(A:0x7f1c34) "' name='RPMH_ARC_RM7_SEQ_SW_CONF_ADDR13'/>"
WRITE #1 "        <register address='0xb7f1c38' value='0x" DATA.LONG(A:0x7f1c38) "' name='RPMH_ARC_RM7_SEQ_SW_CONF_ADDR14'/>"
WRITE #1 "        <register address='0xb7f1c3c' value='0x" DATA.LONG(A:0x7f1c3c) "' name='RPMH_ARC_RM7_SEQ_SW_CONF_ADDR15'/>"
WRITE #1 "        <register address='0xb7f2240' value='0x" DATA.LONG(A:0x7f2240) "' name='RPMH_ARC_RM0_SEQ_UP_BR_EVENT'/>"
WRITE #1 "        <register address='0xb7f2244' value='0x" DATA.LONG(A:0x7f2244) "' name='RPMH_ARC_RM1_SEQ_UP_BR_EVENT'/>"
WRITE #1 "        <register address='0xb7f2248' value='0x" DATA.LONG(A:0x7f2248) "' name='RPMH_ARC_RM2_SEQ_UP_BR_EVENT'/>"
WRITE #1 "        <register address='0xb7f224c' value='0x" DATA.LONG(A:0x7f224c) "' name='RPMH_ARC_RM3_SEQ_UP_BR_EVENT'/>"
WRITE #1 "        <register address='0xb7f2250' value='0x" DATA.LONG(A:0x7f2250) "' name='RPMH_ARC_RM4_SEQ_UP_BR_EVENT'/>"
WRITE #1 "        <register address='0xb7f2254' value='0x" DATA.LONG(A:0x7f2254) "' name='RPMH_ARC_RM5_SEQ_UP_BR_EVENT'/>"
WRITE #1 "        <register address='0xb7f2258' value='0x" DATA.LONG(A:0x7f2258) "' name='RPMH_ARC_RM6_SEQ_UP_BR_EVENT'/>"
WRITE #1 "        <register address='0xb7f225c' value='0x" DATA.LONG(A:0x7f225c) "' name='RPMH_ARC_RM7_SEQ_UP_BR_EVENT'/>"
WRITE #1 "        <register address='0xb7f22c0' value='0x" DATA.LONG(A:0x7f22c0) "' name='RPMH_ARC_RM0_SEQ_DOWN_BR_EVENT'/>"
WRITE #1 "        <register address='0xb7f22c4' value='0x" DATA.LONG(A:0x7f22c4) "' name='RPMH_ARC_RM1_SEQ_DOWN_BR_EVENT'/>"
WRITE #1 "        <register address='0xb7f22c8' value='0x" DATA.LONG(A:0x7f22c8) "' name='RPMH_ARC_RM2_SEQ_DOWN_BR_EVENT'/>"
WRITE #1 "        <register address='0xb7f22cc' value='0x" DATA.LONG(A:0x7f22cc) "' name='RPMH_ARC_RM3_SEQ_DOWN_BR_EVENT'/>"
WRITE #1 "        <register address='0xb7f22d0' value='0x" DATA.LONG(A:0x7f22d0) "' name='RPMH_ARC_RM4_SEQ_DOWN_BR_EVENT'/>"
WRITE #1 "        <register address='0xb7f22d4' value='0x" DATA.LONG(A:0x7f22d4) "' name='RPMH_ARC_RM5_SEQ_DOWN_BR_EVENT'/>"
WRITE #1 "        <register address='0xb7f22d8' value='0x" DATA.LONG(A:0x7f22d8) "' name='RPMH_ARC_RM6_SEQ_DOWN_BR_EVENT'/>"
WRITE #1 "        <register address='0xb7f22dc' value='0x" DATA.LONG(A:0x7f22dc) "' name='RPMH_ARC_RM7_SEQ_DOWN_BR_EVENT'/>"
WRITE #1 "        <register address='0xb7f2340' value='0x" DATA.LONG(A:0x7f2340) "' name='RPMH_ARC_RM0_SEQ_SW_CONF_EVENT'/>"
WRITE #1 "        <register address='0xb7f2344' value='0x" DATA.LONG(A:0x7f2344) "' name='RPMH_ARC_RM1_SEQ_SW_CONF_EVENT'/>"
WRITE #1 "        <register address='0xb7f2348' value='0x" DATA.LONG(A:0x7f2348) "' name='RPMH_ARC_RM2_SEQ_SW_CONF_EVENT'/>"
WRITE #1 "        <register address='0xb7f234c' value='0x" DATA.LONG(A:0x7f234c) "' name='RPMH_ARC_RM3_SEQ_SW_CONF_EVENT'/>"
WRITE #1 "        <register address='0xb7f2350' value='0x" DATA.LONG(A:0x7f2350) "' name='RPMH_ARC_RM4_SEQ_SW_CONF_EVENT'/>"
WRITE #1 "        <register address='0xb7f2354' value='0x" DATA.LONG(A:0x7f2354) "' name='RPMH_ARC_RM5_SEQ_SW_CONF_EVENT'/>"
WRITE #1 "        <register address='0xb7f2358' value='0x" DATA.LONG(A:0x7f2358) "' name='RPMH_ARC_RM6_SEQ_SW_CONF_EVENT'/>"
WRITE #1 "        <register address='0xb7f235c' value='0x" DATA.LONG(A:0x7f235c) "' name='RPMH_ARC_RM7_SEQ_SW_CONF_EVENT'/>"
WRITE #1 "        <register address='0xb7f2440' value='0x" DATA.LONG(A:0x7f2440) "' name='RPMH_ARC_RM0_SEQ_UP_START_ADDR'/>"
WRITE #1 "        <register address='0xb7f2480' value='0x" DATA.LONG(A:0x7f2480) "' name='RPMH_ARC_RM1_SEQ_UP_START_ADDR'/>"
WRITE #1 "        <register address='0xb7f24c0' value='0x" DATA.LONG(A:0x7f24c0) "' name='RPMH_ARC_RM2_SEQ_UP_START_ADDR'/>"
WRITE #1 "        <register address='0xb7f2500' value='0x" DATA.LONG(A:0x7f2500) "' name='RPMH_ARC_RM3_SEQ_UP_START_ADDR'/>"
WRITE #1 "        <register address='0xb7f2540' value='0x" DATA.LONG(A:0x7f2540) "' name='RPMH_ARC_RM4_SEQ_UP_START_ADDR'/>"
WRITE #1 "        <register address='0xb7f2580' value='0x" DATA.LONG(A:0x7f2580) "' name='RPMH_ARC_RM5_SEQ_UP_START_ADDR'/>"
WRITE #1 "        <register address='0xb7f25c0' value='0x" DATA.LONG(A:0x7f25c0) "' name='RPMH_ARC_RM6_SEQ_UP_START_ADDR'/>"
WRITE #1 "        <register address='0xb7f2600' value='0x" DATA.LONG(A:0x7f2600) "' name='RPMH_ARC_RM7_SEQ_UP_START_ADDR'/>"
WRITE #1 "        <register address='0xb7f2700' value='0x" DATA.LONG(A:0x7f2700) "' name='RPMH_ARC_RM0_SEQ_DOWN_START_ADDR'/>"
WRITE #1 "        <register address='0xb7f2740' value='0x" DATA.LONG(A:0x7f2740) "' name='RPMH_ARC_RM1_SEQ_DOWN_START_ADDR'/>"
WRITE #1 "        <register address='0xb7f2780' value='0x" DATA.LONG(A:0x7f2780) "' name='RPMH_ARC_RM2_SEQ_DOWN_START_ADDR'/>"
WRITE #1 "        <register address='0xb7f27c0' value='0x" DATA.LONG(A:0x7f27c0) "' name='RPMH_ARC_RM3_SEQ_DOWN_START_ADDR'/>"
WRITE #1 "        <register address='0xb7f2800' value='0x" DATA.LONG(A:0x7f2800) "' name='RPMH_ARC_RM4_SEQ_DOWN_START_ADDR'/>"
WRITE #1 "        <register address='0xb7f2840' value='0x" DATA.LONG(A:0x7f2840) "' name='RPMH_ARC_RM5_SEQ_DOWN_START_ADDR'/>"
WRITE #1 "        <register address='0xb7f2880' value='0x" DATA.LONG(A:0x7f2880) "' name='RPMH_ARC_RM6_SEQ_DOWN_START_ADDR'/>"
WRITE #1 "        <register address='0xb7f28c0' value='0x" DATA.LONG(A:0x7f28c0) "' name='RPMH_ARC_RM7_SEQ_DOWN_START_ADDR'/>"
WRITE #1 "        <register address='0xb7f2a00' value='0x" DATA.LONG(A:0x7f2a00) "' name='RPMH_ARC_RM0_SEQ_DELAY0'/>"
WRITE #1 "        <register address='0xb7f2a04' value='0x" DATA.LONG(A:0x7f2a04) "' name='RPMH_ARC_RM0_SEQ_DELAY1'/>"
WRITE #1 "        <register address='0xb7f2a08' value='0x" DATA.LONG(A:0x7f2a08) "' name='RPMH_ARC_RM0_SEQ_DELAY2'/>"
WRITE #1 "        <register address='0xb7f2a0c' value='0x" DATA.LONG(A:0x7f2a0c) "' name='RPMH_ARC_RM0_SEQ_DELAY3'/>"
WRITE #1 "        <register address='0xb7f2a40' value='0x" DATA.LONG(A:0x7f2a40) "' name='RPMH_ARC_RM1_SEQ_DELAY0'/>"
WRITE #1 "        <register address='0xb7f2a44' value='0x" DATA.LONG(A:0x7f2a44) "' name='RPMH_ARC_RM1_SEQ_DELAY1'/>"
WRITE #1 "        <register address='0xb7f2a48' value='0x" DATA.LONG(A:0x7f2a48) "' name='RPMH_ARC_RM1_SEQ_DELAY2'/>"
WRITE #1 "        <register address='0xb7f2a4c' value='0x" DATA.LONG(A:0x7f2a4c) "' name='RPMH_ARC_RM1_SEQ_DELAY3'/>"
WRITE #1 "        <register address='0xb7f2a80' value='0x" DATA.LONG(A:0x7f2a80) "' name='RPMH_ARC_RM2_SEQ_DELAY0'/>"
WRITE #1 "        <register address='0xb7f2a84' value='0x" DATA.LONG(A:0x7f2a84) "' name='RPMH_ARC_RM2_SEQ_DELAY1'/>"
WRITE #1 "        <register address='0xb7f2a88' value='0x" DATA.LONG(A:0x7f2a88) "' name='RPMH_ARC_RM2_SEQ_DELAY2'/>"
WRITE #1 "        <register address='0xb7f2a8c' value='0x" DATA.LONG(A:0x7f2a8c) "' name='RPMH_ARC_RM2_SEQ_DELAY3'/>"
WRITE #1 "        <register address='0xb7f2ac0' value='0x" DATA.LONG(A:0x7f2ac0) "' name='RPMH_ARC_RM3_SEQ_DELAY0'/>"
WRITE #1 "        <register address='0xb7f2ac4' value='0x" DATA.LONG(A:0x7f2ac4) "' name='RPMH_ARC_RM3_SEQ_DELAY1'/>"
WRITE #1 "        <register address='0xb7f2ac8' value='0x" DATA.LONG(A:0x7f2ac8) "' name='RPMH_ARC_RM3_SEQ_DELAY2'/>"
WRITE #1 "        <register address='0xb7f2acc' value='0x" DATA.LONG(A:0x7f2acc) "' name='RPMH_ARC_RM3_SEQ_DELAY3'/>"
WRITE #1 "        <register address='0xb7f2b00' value='0x" DATA.LONG(A:0x7f2b00) "' name='RPMH_ARC_RM4_SEQ_DELAY0'/>"
WRITE #1 "        <register address='0xb7f2b04' value='0x" DATA.LONG(A:0x7f2b04) "' name='RPMH_ARC_RM4_SEQ_DELAY1'/>"
WRITE #1 "        <register address='0xb7f2b08' value='0x" DATA.LONG(A:0x7f2b08) "' name='RPMH_ARC_RM4_SEQ_DELAY2'/>"
WRITE #1 "        <register address='0xb7f2b0c' value='0x" DATA.LONG(A:0x7f2b0c) "' name='RPMH_ARC_RM4_SEQ_DELAY3'/>"
WRITE #1 "        <register address='0xb7f2b40' value='0x" DATA.LONG(A:0x7f2b40) "' name='RPMH_ARC_RM5_SEQ_DELAY0'/>"
WRITE #1 "        <register address='0xb7f2b44' value='0x" DATA.LONG(A:0x7f2b44) "' name='RPMH_ARC_RM5_SEQ_DELAY1'/>"
WRITE #1 "        <register address='0xb7f2b48' value='0x" DATA.LONG(A:0x7f2b48) "' name='RPMH_ARC_RM5_SEQ_DELAY2'/>"
WRITE #1 "        <register address='0xb7f2b4c' value='0x" DATA.LONG(A:0x7f2b4c) "' name='RPMH_ARC_RM5_SEQ_DELAY3'/>"
WRITE #1 "        <register address='0xb7f2b80' value='0x" DATA.LONG(A:0x7f2b80) "' name='RPMH_ARC_RM6_SEQ_DELAY0'/>"
WRITE #1 "        <register address='0xb7f2b84' value='0x" DATA.LONG(A:0x7f2b84) "' name='RPMH_ARC_RM6_SEQ_DELAY1'/>"
WRITE #1 "        <register address='0xb7f2b88' value='0x" DATA.LONG(A:0x7f2b88) "' name='RPMH_ARC_RM6_SEQ_DELAY2'/>"
WRITE #1 "        <register address='0xb7f2b8c' value='0x" DATA.LONG(A:0x7f2b8c) "' name='RPMH_ARC_RM6_SEQ_DELAY3'/>"
WRITE #1 "        <register address='0xb7f2bc0' value='0x" DATA.LONG(A:0x7f2bc0) "' name='RPMH_ARC_RM7_SEQ_DELAY0'/>"
WRITE #1 "        <register address='0xb7f2bc4' value='0x" DATA.LONG(A:0x7f2bc4) "' name='RPMH_ARC_RM7_SEQ_DELAY1'/>"
WRITE #1 "        <register address='0xb7f2bc8' value='0x" DATA.LONG(A:0x7f2bc8) "' name='RPMH_ARC_RM7_SEQ_DELAY2'/>"
WRITE #1 "        <register address='0xb7f2bcc' value='0x" DATA.LONG(A:0x7f2bcc) "' name='RPMH_ARC_RM7_SEQ_DELAY3'/>"
WRITE #1 "        <register address='0xb7f3a00' value='0x" DATA.LONG(A:0x7f3a00) "' name='RPMH_ARC_RM0_SOLVER_TABLE_MODE0'/>"
WRITE #1 "        <register address='0xb7f3a04' value='0x" DATA.LONG(A:0x7f3a04) "' name='RPMH_ARC_RM0_SOLVER_TABLE_MODE1'/>"
WRITE #1 "        <register address='0xb7f3a08' value='0x" DATA.LONG(A:0x7f3a08) "' name='RPMH_ARC_RM0_SOLVER_TABLE_MODE2'/>"
WRITE #1 "        <register address='0xb7f3a0c' value='0x" DATA.LONG(A:0x7f3a0c) "' name='RPMH_ARC_RM0_SOLVER_TABLE_MODE3'/>"
WRITE #1 "        <register address='0xb7f3a10' value='0x" DATA.LONG(A:0x7f3a10) "' name='RPMH_ARC_RM0_SOLVER_TABLE_MODE4'/>"
WRITE #1 "        <register address='0xb7f3a14' value='0x" DATA.LONG(A:0x7f3a14) "' name='RPMH_ARC_RM0_SOLVER_TABLE_MODE5'/>"
WRITE #1 "        <register address='0xb7f3a40' value='0x" DATA.LONG(A:0x7f3a40) "' name='RPMH_ARC_RM1_SOLVER_TABLE_MODE0'/>"
WRITE #1 "        <register address='0xb7f3a44' value='0x" DATA.LONG(A:0x7f3a44) "' name='RPMH_ARC_RM1_SOLVER_TABLE_MODE1'/>"
WRITE #1 "        <register address='0xb7f3a48' value='0x" DATA.LONG(A:0x7f3a48) "' name='RPMH_ARC_RM1_SOLVER_TABLE_MODE2'/>"
WRITE #1 "        <register address='0xb7f3a4c' value='0x" DATA.LONG(A:0x7f3a4c) "' name='RPMH_ARC_RM1_SOLVER_TABLE_MODE3'/>"
WRITE #1 "        <register address='0xb7f3a50' value='0x" DATA.LONG(A:0x7f3a50) "' name='RPMH_ARC_RM1_SOLVER_TABLE_MODE4'/>"
WRITE #1 "        <register address='0xb7f3a54' value='0x" DATA.LONG(A:0x7f3a54) "' name='RPMH_ARC_RM1_SOLVER_TABLE_MODE5'/>"
WRITE #1 "        <register address='0xb7f3a80' value='0x" DATA.LONG(A:0x7f3a80) "' name='RPMH_ARC_RM2_SOLVER_TABLE_MODE0'/>"
WRITE #1 "        <register address='0xb7f3a84' value='0x" DATA.LONG(A:0x7f3a84) "' name='RPMH_ARC_RM2_SOLVER_TABLE_MODE1'/>"
WRITE #1 "        <register address='0xb7f3a88' value='0x" DATA.LONG(A:0x7f3a88) "' name='RPMH_ARC_RM2_SOLVER_TABLE_MODE2'/>"
WRITE #1 "        <register address='0xb7f3a8c' value='0x" DATA.LONG(A:0x7f3a8c) "' name='RPMH_ARC_RM2_SOLVER_TABLE_MODE3'/>"
WRITE #1 "        <register address='0xb7f3a90' value='0x" DATA.LONG(A:0x7f3a90) "' name='RPMH_ARC_RM2_SOLVER_TABLE_MODE4'/>"
WRITE #1 "        <register address='0xb7f3a94' value='0x" DATA.LONG(A:0x7f3a94) "' name='RPMH_ARC_RM2_SOLVER_TABLE_MODE5'/>"
WRITE #1 "        <register address='0xb7f3ac0' value='0x" DATA.LONG(A:0x7f3ac0) "' name='RPMH_ARC_RM3_SOLVER_TABLE_MODE0'/>"
WRITE #1 "        <register address='0xb7f3ac4' value='0x" DATA.LONG(A:0x7f3ac4) "' name='RPMH_ARC_RM3_SOLVER_TABLE_MODE1'/>"
WRITE #1 "        <register address='0xb7f3ac8' value='0x" DATA.LONG(A:0x7f3ac8) "' name='RPMH_ARC_RM3_SOLVER_TABLE_MODE2'/>"
WRITE #1 "        <register address='0xb7f3acc' value='0x" DATA.LONG(A:0x7f3acc) "' name='RPMH_ARC_RM3_SOLVER_TABLE_MODE3'/>"
WRITE #1 "        <register address='0xb7f3ad0' value='0x" DATA.LONG(A:0x7f3ad0) "' name='RPMH_ARC_RM3_SOLVER_TABLE_MODE4'/>"
WRITE #1 "        <register address='0xb7f3ad4' value='0x" DATA.LONG(A:0x7f3ad4) "' name='RPMH_ARC_RM3_SOLVER_TABLE_MODE5'/>"
WRITE #1 "        <register address='0xb7f3b00' value='0x" DATA.LONG(A:0x7f3b00) "' name='RPMH_ARC_RM4_SOLVER_TABLE_MODE0'/>"
WRITE #1 "        <register address='0xb7f3b04' value='0x" DATA.LONG(A:0x7f3b04) "' name='RPMH_ARC_RM4_SOLVER_TABLE_MODE1'/>"
WRITE #1 "        <register address='0xb7f3b08' value='0x" DATA.LONG(A:0x7f3b08) "' name='RPMH_ARC_RM4_SOLVER_TABLE_MODE2'/>"
WRITE #1 "        <register address='0xb7f3b0c' value='0x" DATA.LONG(A:0x7f3b0c) "' name='RPMH_ARC_RM4_SOLVER_TABLE_MODE3'/>"
WRITE #1 "        <register address='0xb7f3b10' value='0x" DATA.LONG(A:0x7f3b10) "' name='RPMH_ARC_RM4_SOLVER_TABLE_MODE4'/>"
WRITE #1 "        <register address='0xb7f3b14' value='0x" DATA.LONG(A:0x7f3b14) "' name='RPMH_ARC_RM4_SOLVER_TABLE_MODE5'/>"
WRITE #1 "        <register address='0xb7f3b40' value='0x" DATA.LONG(A:0x7f3b40) "' name='RPMH_ARC_RM5_SOLVER_TABLE_MODE0'/>"
WRITE #1 "        <register address='0xb7f3b44' value='0x" DATA.LONG(A:0x7f3b44) "' name='RPMH_ARC_RM5_SOLVER_TABLE_MODE1'/>"
WRITE #1 "        <register address='0xb7f3b48' value='0x" DATA.LONG(A:0x7f3b48) "' name='RPMH_ARC_RM5_SOLVER_TABLE_MODE2'/>"
WRITE #1 "        <register address='0xb7f3b4c' value='0x" DATA.LONG(A:0x7f3b4c) "' name='RPMH_ARC_RM5_SOLVER_TABLE_MODE3'/>"
WRITE #1 "        <register address='0xb7f3b50' value='0x" DATA.LONG(A:0x7f3b50) "' name='RPMH_ARC_RM5_SOLVER_TABLE_MODE4'/>"
WRITE #1 "        <register address='0xb7f3b54' value='0x" DATA.LONG(A:0x7f3b54) "' name='RPMH_ARC_RM5_SOLVER_TABLE_MODE5'/>"
WRITE #1 "        <register address='0xb7f3b80' value='0x" DATA.LONG(A:0x7f3b80) "' name='RPMH_ARC_RM6_SOLVER_TABLE_MODE0'/>"
WRITE #1 "        <register address='0xb7f3b84' value='0x" DATA.LONG(A:0x7f3b84) "' name='RPMH_ARC_RM6_SOLVER_TABLE_MODE1'/>"
WRITE #1 "        <register address='0xb7f3b88' value='0x" DATA.LONG(A:0x7f3b88) "' name='RPMH_ARC_RM6_SOLVER_TABLE_MODE2'/>"
WRITE #1 "        <register address='0xb7f3b8c' value='0x" DATA.LONG(A:0x7f3b8c) "' name='RPMH_ARC_RM6_SOLVER_TABLE_MODE3'/>"
WRITE #1 "        <register address='0xb7f3b90' value='0x" DATA.LONG(A:0x7f3b90) "' name='RPMH_ARC_RM6_SOLVER_TABLE_MODE4'/>"
WRITE #1 "        <register address='0xb7f3b94' value='0x" DATA.LONG(A:0x7f3b94) "' name='RPMH_ARC_RM6_SOLVER_TABLE_MODE5'/>"
WRITE #1 "        <register address='0xb7f3bc0' value='0x" DATA.LONG(A:0x7f3bc0) "' name='RPMH_ARC_RM7_SOLVER_TABLE_MODE0'/>"
WRITE #1 "        <register address='0xb7f3bc4' value='0x" DATA.LONG(A:0x7f3bc4) "' name='RPMH_ARC_RM7_SOLVER_TABLE_MODE1'/>"
WRITE #1 "        <register address='0xb7f3bc8' value='0x" DATA.LONG(A:0x7f3bc8) "' name='RPMH_ARC_RM7_SOLVER_TABLE_MODE2'/>"
WRITE #1 "        <register address='0xb7f3bcc' value='0x" DATA.LONG(A:0x7f3bcc) "' name='RPMH_ARC_RM7_SOLVER_TABLE_MODE3'/>"
WRITE #1 "        <register address='0xb7f3bd0' value='0x" DATA.LONG(A:0x7f3bd0) "' name='RPMH_ARC_RM7_SOLVER_TABLE_MODE4'/>"
WRITE #1 "        <register address='0xb7f3bd4' value='0x" DATA.LONG(A:0x7f3bd4) "' name='RPMH_ARC_RM7_SOLVER_TABLE_MODE5'/>"
WRITE #1 "        <register address='0xb7f4100' value='0x" DATA.LONG(A:0x7f4100) "' name='RPMH_ARC_RM0_SOLVER_TABLE_MIN_SLEEP_TIME0'/>"
WRITE #1 "        <register address='0xb7f4104' value='0x" DATA.LONG(A:0x7f4104) "' name='RPMH_ARC_RM0_SOLVER_TABLE_MIN_SLEEP_TIME1'/>"
WRITE #1 "        <register address='0xb7f4108' value='0x" DATA.LONG(A:0x7f4108) "' name='RPMH_ARC_RM0_SOLVER_TABLE_MIN_SLEEP_TIME2'/>"
WRITE #1 "        <register address='0xb7f410c' value='0x" DATA.LONG(A:0x7f410c) "' name='RPMH_ARC_RM0_SOLVER_TABLE_MIN_SLEEP_TIME3'/>"
WRITE #1 "        <register address='0xb7f4110' value='0x" DATA.LONG(A:0x7f4110) "' name='RPMH_ARC_RM0_SOLVER_TABLE_MIN_SLEEP_TIME4'/>"
WRITE #1 "        <register address='0xb7f4114' value='0x" DATA.LONG(A:0x7f4114) "' name='RPMH_ARC_RM0_SOLVER_TABLE_MIN_SLEEP_TIME5'/>"
WRITE #1 "        <register address='0xb7f4140' value='0x" DATA.LONG(A:0x7f4140) "' name='RPMH_ARC_RM1_SOLVER_TABLE_MIN_SLEEP_TIME0'/>"
WRITE #1 "        <register address='0xb7f4144' value='0x" DATA.LONG(A:0x7f4144) "' name='RPMH_ARC_RM1_SOLVER_TABLE_MIN_SLEEP_TIME1'/>"
WRITE #1 "        <register address='0xb7f4148' value='0x" DATA.LONG(A:0x7f4148) "' name='RPMH_ARC_RM1_SOLVER_TABLE_MIN_SLEEP_TIME2'/>"
WRITE #1 "        <register address='0xb7f414c' value='0x" DATA.LONG(A:0x7f414c) "' name='RPMH_ARC_RM1_SOLVER_TABLE_MIN_SLEEP_TIME3'/>"
WRITE #1 "        <register address='0xb7f4150' value='0x" DATA.LONG(A:0x7f4150) "' name='RPMH_ARC_RM1_SOLVER_TABLE_MIN_SLEEP_TIME4'/>"
WRITE #1 "        <register address='0xb7f4154' value='0x" DATA.LONG(A:0x7f4154) "' name='RPMH_ARC_RM1_SOLVER_TABLE_MIN_SLEEP_TIME5'/>"
WRITE #1 "        <register address='0xb7f4180' value='0x" DATA.LONG(A:0x7f4180) "' name='RPMH_ARC_RM2_SOLVER_TABLE_MIN_SLEEP_TIME0'/>"
WRITE #1 "        <register address='0xb7f4184' value='0x" DATA.LONG(A:0x7f4184) "' name='RPMH_ARC_RM2_SOLVER_TABLE_MIN_SLEEP_TIME1'/>"
WRITE #1 "        <register address='0xb7f4188' value='0x" DATA.LONG(A:0x7f4188) "' name='RPMH_ARC_RM2_SOLVER_TABLE_MIN_SLEEP_TIME2'/>"
WRITE #1 "        <register address='0xb7f418c' value='0x" DATA.LONG(A:0x7f418c) "' name='RPMH_ARC_RM2_SOLVER_TABLE_MIN_SLEEP_TIME3'/>"
WRITE #1 "        <register address='0xb7f4190' value='0x" DATA.LONG(A:0x7f4190) "' name='RPMH_ARC_RM2_SOLVER_TABLE_MIN_SLEEP_TIME4'/>"
WRITE #1 "        <register address='0xb7f4194' value='0x" DATA.LONG(A:0x7f4194) "' name='RPMH_ARC_RM2_SOLVER_TABLE_MIN_SLEEP_TIME5'/>"
WRITE #1 "        <register address='0xb7f41c0' value='0x" DATA.LONG(A:0x7f41c0) "' name='RPMH_ARC_RM3_SOLVER_TABLE_MIN_SLEEP_TIME0'/>"
WRITE #1 "        <register address='0xb7f41c4' value='0x" DATA.LONG(A:0x7f41c4) "' name='RPMH_ARC_RM3_SOLVER_TABLE_MIN_SLEEP_TIME1'/>"
WRITE #1 "        <register address='0xb7f41c8' value='0x" DATA.LONG(A:0x7f41c8) "' name='RPMH_ARC_RM3_SOLVER_TABLE_MIN_SLEEP_TIME2'/>"
WRITE #1 "        <register address='0xb7f41cc' value='0x" DATA.LONG(A:0x7f41cc) "' name='RPMH_ARC_RM3_SOLVER_TABLE_MIN_SLEEP_TIME3'/>"
WRITE #1 "        <register address='0xb7f41d0' value='0x" DATA.LONG(A:0x7f41d0) "' name='RPMH_ARC_RM3_SOLVER_TABLE_MIN_SLEEP_TIME4'/>"
WRITE #1 "        <register address='0xb7f41d4' value='0x" DATA.LONG(A:0x7f41d4) "' name='RPMH_ARC_RM3_SOLVER_TABLE_MIN_SLEEP_TIME5'/>"
WRITE #1 "        <register address='0xb7f4200' value='0x" DATA.LONG(A:0x7f4200) "' name='RPMH_ARC_RM4_SOLVER_TABLE_MIN_SLEEP_TIME0'/>"
WRITE #1 "        <register address='0xb7f4204' value='0x" DATA.LONG(A:0x7f4204) "' name='RPMH_ARC_RM4_SOLVER_TABLE_MIN_SLEEP_TIME1'/>"
WRITE #1 "        <register address='0xb7f4208' value='0x" DATA.LONG(A:0x7f4208) "' name='RPMH_ARC_RM4_SOLVER_TABLE_MIN_SLEEP_TIME2'/>"
WRITE #1 "        <register address='0xb7f420c' value='0x" DATA.LONG(A:0x7f420c) "' name='RPMH_ARC_RM4_SOLVER_TABLE_MIN_SLEEP_TIME3'/>"
WRITE #1 "        <register address='0xb7f4210' value='0x" DATA.LONG(A:0x7f4210) "' name='RPMH_ARC_RM4_SOLVER_TABLE_MIN_SLEEP_TIME4'/>"
WRITE #1 "        <register address='0xb7f4214' value='0x" DATA.LONG(A:0x7f4214) "' name='RPMH_ARC_RM4_SOLVER_TABLE_MIN_SLEEP_TIME5'/>"
WRITE #1 "        <register address='0xb7f4240' value='0x" DATA.LONG(A:0x7f4240) "' name='RPMH_ARC_RM5_SOLVER_TABLE_MIN_SLEEP_TIME0'/>"
WRITE #1 "        <register address='0xb7f4244' value='0x" DATA.LONG(A:0x7f4244) "' name='RPMH_ARC_RM5_SOLVER_TABLE_MIN_SLEEP_TIME1'/>"
WRITE #1 "        <register address='0xb7f4248' value='0x" DATA.LONG(A:0x7f4248) "' name='RPMH_ARC_RM5_SOLVER_TABLE_MIN_SLEEP_TIME2'/>"
WRITE #1 "        <register address='0xb7f424c' value='0x" DATA.LONG(A:0x7f424c) "' name='RPMH_ARC_RM5_SOLVER_TABLE_MIN_SLEEP_TIME3'/>"
WRITE #1 "        <register address='0xb7f4250' value='0x" DATA.LONG(A:0x7f4250) "' name='RPMH_ARC_RM5_SOLVER_TABLE_MIN_SLEEP_TIME4'/>"
WRITE #1 "        <register address='0xb7f4254' value='0x" DATA.LONG(A:0x7f4254) "' name='RPMH_ARC_RM5_SOLVER_TABLE_MIN_SLEEP_TIME5'/>"
WRITE #1 "        <register address='0xb7f4280' value='0x" DATA.LONG(A:0x7f4280) "' name='RPMH_ARC_RM6_SOLVER_TABLE_MIN_SLEEP_TIME0'/>"
WRITE #1 "        <register address='0xb7f4284' value='0x" DATA.LONG(A:0x7f4284) "' name='RPMH_ARC_RM6_SOLVER_TABLE_MIN_SLEEP_TIME1'/>"
WRITE #1 "        <register address='0xb7f4288' value='0x" DATA.LONG(A:0x7f4288) "' name='RPMH_ARC_RM6_SOLVER_TABLE_MIN_SLEEP_TIME2'/>"
WRITE #1 "        <register address='0xb7f428c' value='0x" DATA.LONG(A:0x7f428c) "' name='RPMH_ARC_RM6_SOLVER_TABLE_MIN_SLEEP_TIME3'/>"
WRITE #1 "        <register address='0xb7f4290' value='0x" DATA.LONG(A:0x7f4290) "' name='RPMH_ARC_RM6_SOLVER_TABLE_MIN_SLEEP_TIME4'/>"
WRITE #1 "        <register address='0xb7f4294' value='0x" DATA.LONG(A:0x7f4294) "' name='RPMH_ARC_RM6_SOLVER_TABLE_MIN_SLEEP_TIME5'/>"
WRITE #1 "        <register address='0xb7f42c0' value='0x" DATA.LONG(A:0x7f42c0) "' name='RPMH_ARC_RM7_SOLVER_TABLE_MIN_SLEEP_TIME0'/>"
WRITE #1 "        <register address='0xb7f42c4' value='0x" DATA.LONG(A:0x7f42c4) "' name='RPMH_ARC_RM7_SOLVER_TABLE_MIN_SLEEP_TIME1'/>"
WRITE #1 "        <register address='0xb7f42c8' value='0x" DATA.LONG(A:0x7f42c8) "' name='RPMH_ARC_RM7_SOLVER_TABLE_MIN_SLEEP_TIME2'/>"
WRITE #1 "        <register address='0xb7f42cc' value='0x" DATA.LONG(A:0x7f42cc) "' name='RPMH_ARC_RM7_SOLVER_TABLE_MIN_SLEEP_TIME3'/>"
WRITE #1 "        <register address='0xb7f42d0' value='0x" DATA.LONG(A:0x7f42d0) "' name='RPMH_ARC_RM7_SOLVER_TABLE_MIN_SLEEP_TIME4'/>"
WRITE #1 "        <register address='0xb7f42d4' value='0x" DATA.LONG(A:0x7f42d4) "' name='RPMH_ARC_RM7_SOLVER_TABLE_MIN_SLEEP_TIME5'/>"
WRITE #1 "        <register address='0xb7f4500' value='0x" DATA.LONG(A:0x7f4500) "' name='RPMH_ARC_RM0_SEQUENCER_STATUS_CSR'/>"
WRITE #1 "        <register address='0xb7f4540' value='0x" DATA.LONG(A:0x7f4540) "' name='RPMH_ARC_RM1_SEQUENCER_STATUS_CSR'/>"
WRITE #1 "        <register address='0xb7f4580' value='0x" DATA.LONG(A:0x7f4580) "' name='RPMH_ARC_RM2_SEQUENCER_STATUS_CSR'/>"
WRITE #1 "        <register address='0xb7f45c0' value='0x" DATA.LONG(A:0x7f45c0) "' name='RPMH_ARC_RM3_SEQUENCER_STATUS_CSR'/>"
WRITE #1 "        <register address='0xb7f4600' value='0x" DATA.LONG(A:0x7f4600) "' name='RPMH_ARC_RM4_SEQUENCER_STATUS_CSR'/>"
WRITE #1 "        <register address='0xb7f4640' value='0x" DATA.LONG(A:0x7f4640) "' name='RPMH_ARC_RM5_SEQUENCER_STATUS_CSR'/>"
WRITE #1 "        <register address='0xb7f4680' value='0x" DATA.LONG(A:0x7f4680) "' name='RPMH_ARC_RM6_SEQUENCER_STATUS_CSR'/>"
WRITE #1 "        <register address='0xb7f46c0' value='0x" DATA.LONG(A:0x7f46c0) "' name='RPMH_ARC_RM7_SEQUENCER_STATUS_CSR'/>"
WRITE #1 "        <register address='0xb7fd000' value='0x" DATA.LONG(A:0x7fd000) "' name='RPMH_ARC_ARC_VERSION'/>"
WRITE #1 "        <register address='0xb7fd004' value='0x" DATA.LONG(A:0x7fd004) "' name='RPMH_ARC_ARC_EN'/>"
WRITE #1 "        <register address='0xb7fd008' value='0x" DATA.LONG(A:0x7fd008) "' name='RPMH_ARC_SLV_ID_FOR_RESP'/>"
WRITE #1 "        <register address='0xb7fd00c' value='0x" DATA.LONG(A:0x7fd00c) "' name='RPMH_ARC_DRV_ID_FOR_VOTING'/>"
WRITE #1 "        <register address='0xb7fd010' value='0x" DATA.LONG(A:0x7fd010) "' name='RPMH_ARC_ERROR_RESP_CTRL'/>"
WRITE #1 "        <register address='0xb7fd040' value='0x" DATA.LONG(A:0x7fd040) "' name='RPMH_ARC_DRV0_RESP_ADDR'/>"
WRITE #1 "        <register address='0xb7fd044' value='0x" DATA.LONG(A:0x7fd044) "' name='RPMH_ARC_DRV1_RESP_ADDR'/>"
WRITE #1 "        <register address='0xb7fd048' value='0x" DATA.LONG(A:0x7fd048) "' name='RPMH_ARC_DRV2_RESP_ADDR'/>"
WRITE #1 "        <register address='0xb7fd04c' value='0x" DATA.LONG(A:0x7fd04c) "' name='RPMH_ARC_DRV3_RESP_ADDR'/>"
WRITE #1 "        <register address='0xb7fd050' value='0x" DATA.LONG(A:0x7fd050) "' name='RPMH_ARC_DRV4_RESP_ADDR'/>"
WRITE #1 "        <register address='0xb7fd054' value='0x" DATA.LONG(A:0x7fd054) "' name='RPMH_ARC_DRV5_RESP_ADDR'/>"
WRITE #1 "        <register address='0xb7fd058' value='0x" DATA.LONG(A:0x7fd058) "' name='RPMH_ARC_DRV6_RESP_ADDR'/>"
WRITE #1 "        <register address='0xb7fd05c' value='0x" DATA.LONG(A:0x7fd05c) "' name='RPMH_ARC_DRV7_RESP_ADDR'/>"
WRITE #1 "        <register address='0xb7fd060' value='0x" DATA.LONG(A:0x7fd060) "' name='RPMH_ARC_DRV8_RESP_ADDR'/>"
WRITE #1 "        <register address='0xb7fd064' value='0x" DATA.LONG(A:0x7fd064) "' name='RPMH_ARC_DRV9_RESP_ADDR'/>"
WRITE #1 "        <register address='0xb7fd068' value='0x" DATA.LONG(A:0x7fd068) "' name='RPMH_ARC_DRV10_RESP_ADDR'/>"
WRITE #1 "        <register address='0xb7fd080' value='0x" DATA.LONG(A:0x7fd080) "' name='RPMH_ARC_BCM_DRV0_RESP_ADDR'/>"
WRITE #1 "        <register address='0xb7fd084' value='0x" DATA.LONG(A:0x7fd084) "' name='RPMH_ARC_BCM_DRV1_RESP_ADDR'/>"
WRITE #1 "        <register address='0xb7fd088' value='0x" DATA.LONG(A:0x7fd088) "' name='RPMH_ARC_BCM_DRV2_RESP_ADDR'/>"
WRITE #1 "        <register address='0xb7fd08c' value='0x" DATA.LONG(A:0x7fd08c) "' name='RPMH_ARC_BCM_DRV3_RESP_ADDR'/>"
WRITE #1 "        <register address='0xb7fd090' value='0x" DATA.LONG(A:0x7fd090) "' name='RPMH_ARC_BCM_DRV4_RESP_ADDR'/>"
WRITE #1 "        <register address='0xb7fd094' value='0x" DATA.LONG(A:0x7fd094) "' name='RPMH_ARC_BCM_DRV5_RESP_ADDR'/>"
WRITE #1 "        <register address='0xb7fd098' value='0x" DATA.LONG(A:0x7fd098) "' name='RPMH_ARC_BCM_DRV6_RESP_ADDR'/>"
WRITE #1 "        <register address='0xb7fd09c' value='0x" DATA.LONG(A:0x7fd09c) "' name='RPMH_ARC_BCM_DRV7_RESP_ADDR'/>"
WRITE #1 "        <register address='0xb7fd0a0' value='0x" DATA.LONG(A:0x7fd0a0) "' name='RPMH_ARC_BCM_DRV8_RESP_ADDR'/>"
WRITE #1 "        <register address='0xb7fd0a4' value='0x" DATA.LONG(A:0x7fd0a4) "' name='RPMH_ARC_BCM_DRV9_RESP_ADDR'/>"
WRITE #1 "        <register address='0xb7fd0f0' value='0x" DATA.LONG(A:0x7fd0f0) "' name='RPMH_ARC_ARC_DEBUG_BUS_DATA'/>"
WRITE #1 "        <register address='0xb7fd0f4' value='0x" DATA.LONG(A:0x7fd0f4) "' name='RPMH_ARC_ARC_CLK_GATING_EN_CFG'/>"
WRITE #1 "        <register address='0xb7fd0f8' value='0x" DATA.LONG(A:0x7fd0f8) "' name='RPMH_ARC_ARC_DEBUG_BUS_EN_CFG'/>"
WRITE #1 "        <register address='0xb7fd0fc' value='0x" DATA.LONG(A:0x7fd0fc) "' name='RPMH_ARC_DEBUG_BUS_CFG'/>"
WRITE #1 "        <register address='0xb7fd100' value='0x" DATA.LONG(A:0x7fd100) "' name='RPMH_ARC_DRV0_TIMER_LOW'/>"
WRITE #1 "        <register address='0xb7fd104' value='0x" DATA.LONG(A:0x7fd104) "' name='RPMH_ARC_DRV1_TIMER_LOW'/>"
WRITE #1 "        <register address='0xb7fd108' value='0x" DATA.LONG(A:0x7fd108) "' name='RPMH_ARC_DRV2_TIMER_LOW'/>"
WRITE #1 "        <register address='0xb7fd10c' value='0x" DATA.LONG(A:0x7fd10c) "' name='RPMH_ARC_DRV3_TIMER_LOW'/>"
WRITE #1 "        <register address='0xb7fd110' value='0x" DATA.LONG(A:0x7fd110) "' name='RPMH_ARC_DRV4_TIMER_LOW'/>"
WRITE #1 "        <register address='0xb7fd114' value='0x" DATA.LONG(A:0x7fd114) "' name='RPMH_ARC_DRV5_TIMER_LOW'/>"
WRITE #1 "        <register address='0xb7fd118' value='0x" DATA.LONG(A:0x7fd118) "' name='RPMH_ARC_DRV6_TIMER_LOW'/>"
WRITE #1 "        <register address='0xb7fd11c' value='0x" DATA.LONG(A:0x7fd11c) "' name='RPMH_ARC_DRV7_TIMER_LOW'/>"
WRITE #1 "        <register address='0xb7fd120' value='0x" DATA.LONG(A:0x7fd120) "' name='RPMH_ARC_DRV8_TIMER_LOW'/>"
WRITE #1 "        <register address='0xb7fd124' value='0x" DATA.LONG(A:0x7fd124) "' name='RPMH_ARC_DRV9_TIMER_LOW'/>"
WRITE #1 "        <register address='0xb7fd128' value='0x" DATA.LONG(A:0x7fd128) "' name='RPMH_ARC_DRV10_TIMER_LOW'/>"
WRITE #1 "        <register address='0xb7fd180' value='0x" DATA.LONG(A:0x7fd180) "' name='RPMH_ARC_DRV0_TIMER_HIGH'/>"
WRITE #1 "        <register address='0xb7fd184' value='0x" DATA.LONG(A:0x7fd184) "' name='RPMH_ARC_DRV1_TIMER_HIGH'/>"
WRITE #1 "        <register address='0xb7fd188' value='0x" DATA.LONG(A:0x7fd188) "' name='RPMH_ARC_DRV2_TIMER_HIGH'/>"
WRITE #1 "        <register address='0xb7fd18c' value='0x" DATA.LONG(A:0x7fd18c) "' name='RPMH_ARC_DRV3_TIMER_HIGH'/>"
WRITE #1 "        <register address='0xb7fd190' value='0x" DATA.LONG(A:0x7fd190) "' name='RPMH_ARC_DRV4_TIMER_HIGH'/>"
WRITE #1 "        <register address='0xb7fd194' value='0x" DATA.LONG(A:0x7fd194) "' name='RPMH_ARC_DRV5_TIMER_HIGH'/>"
WRITE #1 "        <register address='0xb7fd198' value='0x" DATA.LONG(A:0x7fd198) "' name='RPMH_ARC_DRV6_TIMER_HIGH'/>"
WRITE #1 "        <register address='0xb7fd19c' value='0x" DATA.LONG(A:0x7fd19c) "' name='RPMH_ARC_DRV7_TIMER_HIGH'/>"
WRITE #1 "        <register address='0xb7fd1a0' value='0x" DATA.LONG(A:0x7fd1a0) "' name='RPMH_ARC_DRV8_TIMER_HIGH'/>"
WRITE #1 "        <register address='0xb7fd1a4' value='0x" DATA.LONG(A:0x7fd1a4) "' name='RPMH_ARC_DRV9_TIMER_HIGH'/>"
WRITE #1 "        <register address='0xb7fd1a8' value='0x" DATA.LONG(A:0x7fd1a8) "' name='RPMH_ARC_DRV10_TIMER_HIGH'/>"
WRITE #1 "        <register address='0xb7fd200' value='0x" DATA.LONG(A:0x7fd200) "' name='RPMH_ARC_DRVS_TIMER_CONSIDERED_STATUS'/>"
WRITE #1 "        <register address='0xb7fd204' value='0x" DATA.LONG(A:0x7fd204) "' name='RPMH_ARC_RM_CTRL_STATUS'/>"
WRITE #1 "        <register address='0xb7fd300' value='0x" DATA.LONG(A:0x7fd300) "' name='RPMH_ARC_RM0_ACC_CTRL'/>"
WRITE #1 "        <register address='0xb7fd304' value='0x" DATA.LONG(A:0x7fd304) "' name='RPMH_ARC_RM1_ACC_CTRL'/>"
WRITE #1 "        <register address='0xb7fd308' value='0x" DATA.LONG(A:0x7fd308) "' name='RPMH_ARC_RM2_ACC_CTRL'/>"
WRITE #1 "        <register address='0xb7fd30c' value='0x" DATA.LONG(A:0x7fd30c) "' name='RPMH_ARC_RM3_ACC_CTRL'/>"
WRITE #1 "        <register address='0xb7fd310' value='0x" DATA.LONG(A:0x7fd310) "' name='RPMH_ARC_RM4_ACC_CTRL'/>"
WRITE #1 "        <register address='0xb7fd314' value='0x" DATA.LONG(A:0x7fd314) "' name='RPMH_ARC_RM5_ACC_CTRL'/>"
WRITE #1 "        <register address='0xb7fd318' value='0x" DATA.LONG(A:0x7fd318) "' name='RPMH_ARC_RM6_ACC_CTRL'/>"
WRITE #1 "        <register address='0xb7fd31c' value='0x" DATA.LONG(A:0x7fd31c) "' name='RPMH_ARC_RM7_ACC_CTRL'/>"
WRITE #1 "        <register address='0xb7fd80c' value='0x" DATA.LONG(A:0x7fd80c) "' name='RPMH_ARC_RM0_IRQ_EN'/>"
WRITE #1 "        <register address='0xb7fd810' value='0x" DATA.LONG(A:0x7fd810) "' name='RPMH_ARC_RM1_IRQ_EN'/>"
WRITE #1 "        <register address='0xb7fd814' value='0x" DATA.LONG(A:0x7fd814) "' name='RPMH_ARC_RM2_IRQ_EN'/>"
WRITE #1 "        <register address='0xb7fd818' value='0x" DATA.LONG(A:0x7fd818) "' name='RPMH_ARC_RM3_IRQ_EN'/>"
WRITE #1 "        <register address='0xb7fd81c' value='0x" DATA.LONG(A:0x7fd81c) "' name='RPMH_ARC_RM4_IRQ_EN'/>"
WRITE #1 "        <register address='0xb7fd820' value='0x" DATA.LONG(A:0x7fd820) "' name='RPMH_ARC_RM5_IRQ_EN'/>"
WRITE #1 "        <register address='0xb7fd824' value='0x" DATA.LONG(A:0x7fd824) "' name='RPMH_ARC_RM6_IRQ_EN'/>"
WRITE #1 "        <register address='0xb7fd828' value='0x" DATA.LONG(A:0x7fd828) "' name='RPMH_ARC_RM7_IRQ_EN'/>"
WRITE #1 "        <register address='0xb7fd900' value='0x" DATA.LONG(A:0x7fd900) "' name='RPMH_ARC_RM0_IRQ_STATUS'/>"
WRITE #1 "        <register address='0xb7fd904' value='0x" DATA.LONG(A:0x7fd904) "' name='RPMH_ARC_RM1_IRQ_STATUS'/>"
WRITE #1 "        <register address='0xb7fd908' value='0x" DATA.LONG(A:0x7fd908) "' name='RPMH_ARC_RM2_IRQ_STATUS'/>"
WRITE #1 "        <register address='0xb7fd90c' value='0x" DATA.LONG(A:0x7fd90c) "' name='RPMH_ARC_RM3_IRQ_STATUS'/>"
WRITE #1 "        <register address='0xb7fd910' value='0x" DATA.LONG(A:0x7fd910) "' name='RPMH_ARC_RM4_IRQ_STATUS'/>"
WRITE #1 "        <register address='0xb7fd914' value='0x" DATA.LONG(A:0x7fd914) "' name='RPMH_ARC_RM5_IRQ_STATUS'/>"
WRITE #1 "        <register address='0xb7fd918' value='0x" DATA.LONG(A:0x7fd918) "' name='RPMH_ARC_RM6_IRQ_STATUS'/>"
WRITE #1 "        <register address='0xb7fd91c' value='0x" DATA.LONG(A:0x7fd91c) "' name='RPMH_ARC_RM7_IRQ_STATUS'/>"
WRITE #1 "        <register address='0xb7fe000' value='0x" DATA.LONG(A:0x7fe000) "' name='RPMH_ARC_PV_ADDR_FOR_COMP'/>"
WRITE #1 "        <register address='0xb7fe040' value='0x" DATA.LONG(A:0x7fe040) "' name='RPMH_ARC_RM0_PV_TCS_CMD0_STATUS'/>"
WRITE #1 "        <register address='0xb7fe044' value='0x" DATA.LONG(A:0x7fe044) "' name='RPMH_ARC_RM0_PV_TCS_CMD1_STATUS'/>"
WRITE #1 "        <register address='0xb7fe048' value='0x" DATA.LONG(A:0x7fe048) "' name='RPMH_ARC_RM0_PV_TCS_CMD2_STATUS'/>"
WRITE #1 "        <register address='0xb7fe04c' value='0x" DATA.LONG(A:0x7fe04c) "' name='RPMH_ARC_RM0_PV_TCS_CMD3_STATUS'/>"
WRITE #1 "        <register address='0xb7fe050' value='0x" DATA.LONG(A:0x7fe050) "' name='RPMH_ARC_RM1_PV_TCS_CMD0_STATUS'/>"
WRITE #1 "        <register address='0xb7fe054' value='0x" DATA.LONG(A:0x7fe054) "' name='RPMH_ARC_RM1_PV_TCS_CMD1_STATUS'/>"
WRITE #1 "        <register address='0xb7fe058' value='0x" DATA.LONG(A:0x7fe058) "' name='RPMH_ARC_RM1_PV_TCS_CMD2_STATUS'/>"
WRITE #1 "        <register address='0xb7fe05c' value='0x" DATA.LONG(A:0x7fe05c) "' name='RPMH_ARC_RM1_PV_TCS_CMD3_STATUS'/>"
WRITE #1 "        <register address='0xb7fe060' value='0x" DATA.LONG(A:0x7fe060) "' name='RPMH_ARC_RM2_PV_TCS_CMD0_STATUS'/>"
WRITE #1 "        <register address='0xb7fe064' value='0x" DATA.LONG(A:0x7fe064) "' name='RPMH_ARC_RM2_PV_TCS_CMD1_STATUS'/>"
WRITE #1 "        <register address='0xb7fe068' value='0x" DATA.LONG(A:0x7fe068) "' name='RPMH_ARC_RM2_PV_TCS_CMD2_STATUS'/>"
WRITE #1 "        <register address='0xb7fe06c' value='0x" DATA.LONG(A:0x7fe06c) "' name='RPMH_ARC_RM2_PV_TCS_CMD3_STATUS'/>"
WRITE #1 "        <register address='0xb7fe070' value='0x" DATA.LONG(A:0x7fe070) "' name='RPMH_ARC_RM3_PV_TCS_CMD0_STATUS'/>"
WRITE #1 "        <register address='0xb7fe074' value='0x" DATA.LONG(A:0x7fe074) "' name='RPMH_ARC_RM3_PV_TCS_CMD1_STATUS'/>"
WRITE #1 "        <register address='0xb7fe078' value='0x" DATA.LONG(A:0x7fe078) "' name='RPMH_ARC_RM3_PV_TCS_CMD2_STATUS'/>"
WRITE #1 "        <register address='0xb7fe07c' value='0x" DATA.LONG(A:0x7fe07c) "' name='RPMH_ARC_RM3_PV_TCS_CMD3_STATUS'/>"
WRITE #1 "        <register address='0xb7fe080' value='0x" DATA.LONG(A:0x7fe080) "' name='RPMH_ARC_RM4_PV_TCS_CMD0_STATUS'/>"
WRITE #1 "        <register address='0xb7fe084' value='0x" DATA.LONG(A:0x7fe084) "' name='RPMH_ARC_RM4_PV_TCS_CMD1_STATUS'/>"
WRITE #1 "        <register address='0xb7fe088' value='0x" DATA.LONG(A:0x7fe088) "' name='RPMH_ARC_RM4_PV_TCS_CMD2_STATUS'/>"
WRITE #1 "        <register address='0xb7fe08c' value='0x" DATA.LONG(A:0x7fe08c) "' name='RPMH_ARC_RM4_PV_TCS_CMD3_STATUS'/>"
WRITE #1 "        <register address='0xb7fe090' value='0x" DATA.LONG(A:0x7fe090) "' name='RPMH_ARC_RM5_PV_TCS_CMD0_STATUS'/>"
WRITE #1 "        <register address='0xb7fe094' value='0x" DATA.LONG(A:0x7fe094) "' name='RPMH_ARC_RM5_PV_TCS_CMD1_STATUS'/>"
WRITE #1 "        <register address='0xb7fe098' value='0x" DATA.LONG(A:0x7fe098) "' name='RPMH_ARC_RM5_PV_TCS_CMD2_STATUS'/>"
WRITE #1 "        <register address='0xb7fe09c' value='0x" DATA.LONG(A:0x7fe09c) "' name='RPMH_ARC_RM5_PV_TCS_CMD3_STATUS'/>"
WRITE #1 "        <register address='0xb7fe0a0' value='0x" DATA.LONG(A:0x7fe0a0) "' name='RPMH_ARC_RM6_PV_TCS_CMD0_STATUS'/>"
WRITE #1 "        <register address='0xb7fe0a4' value='0x" DATA.LONG(A:0x7fe0a4) "' name='RPMH_ARC_RM6_PV_TCS_CMD1_STATUS'/>"
WRITE #1 "        <register address='0xb7fe0a8' value='0x" DATA.LONG(A:0x7fe0a8) "' name='RPMH_ARC_RM6_PV_TCS_CMD2_STATUS'/>"
WRITE #1 "        <register address='0xb7fe0ac' value='0x" DATA.LONG(A:0x7fe0ac) "' name='RPMH_ARC_RM6_PV_TCS_CMD3_STATUS'/>"
WRITE #1 "        <register address='0xb7fe0b0' value='0x" DATA.LONG(A:0x7fe0b0) "' name='RPMH_ARC_RM7_PV_TCS_CMD0_STATUS'/>"
WRITE #1 "        <register address='0xb7fe0b4' value='0x" DATA.LONG(A:0x7fe0b4) "' name='RPMH_ARC_RM7_PV_TCS_CMD1_STATUS'/>"
WRITE #1 "        <register address='0xb7fe0b8' value='0x" DATA.LONG(A:0x7fe0b8) "' name='RPMH_ARC_RM7_PV_TCS_CMD2_STATUS'/>"
WRITE #1 "        <register address='0xb7fe0bc' value='0x" DATA.LONG(A:0x7fe0bc) "' name='RPMH_ARC_RM7_PV_TCS_CMD3_STATUS'/>"
WRITE #1 "        <register address='0xb7fe150' value='0x" DATA.LONG(A:0x7fe150) "' name='RPMH_ARC_RM0_PV_TCS_CMD0_VOTE'/>"
WRITE #1 "        <register address='0xb7fe154' value='0x" DATA.LONG(A:0x7fe154) "' name='RPMH_ARC_RM0_PV_TCS_CMD1_VOTE'/>"
WRITE #1 "        <register address='0xb7fe158' value='0x" DATA.LONG(A:0x7fe158) "' name='RPMH_ARC_RM0_PV_TCS_CMD2_VOTE'/>"
WRITE #1 "        <register address='0xb7fe15c' value='0x" DATA.LONG(A:0x7fe15c) "' name='RPMH_ARC_RM0_PV_TCS_CMD3_VOTE'/>"
WRITE #1 "        <register address='0xb7fe160' value='0x" DATA.LONG(A:0x7fe160) "' name='RPMH_ARC_RM1_PV_TCS_CMD0_VOTE'/>"
WRITE #1 "        <register address='0xb7fe164' value='0x" DATA.LONG(A:0x7fe164) "' name='RPMH_ARC_RM1_PV_TCS_CMD1_VOTE'/>"
WRITE #1 "        <register address='0xb7fe168' value='0x" DATA.LONG(A:0x7fe168) "' name='RPMH_ARC_RM1_PV_TCS_CMD2_VOTE'/>"
WRITE #1 "        <register address='0xb7fe16c' value='0x" DATA.LONG(A:0x7fe16c) "' name='RPMH_ARC_RM1_PV_TCS_CMD3_VOTE'/>"
WRITE #1 "        <register address='0xb7fe170' value='0x" DATA.LONG(A:0x7fe170) "' name='RPMH_ARC_RM2_PV_TCS_CMD0_VOTE'/>"
WRITE #1 "        <register address='0xb7fe174' value='0x" DATA.LONG(A:0x7fe174) "' name='RPMH_ARC_RM2_PV_TCS_CMD1_VOTE'/>"
WRITE #1 "        <register address='0xb7fe178' value='0x" DATA.LONG(A:0x7fe178) "' name='RPMH_ARC_RM2_PV_TCS_CMD2_VOTE'/>"
WRITE #1 "        <register address='0xb7fe17c' value='0x" DATA.LONG(A:0x7fe17c) "' name='RPMH_ARC_RM2_PV_TCS_CMD3_VOTE'/>"
WRITE #1 "        <register address='0xb7fe180' value='0x" DATA.LONG(A:0x7fe180) "' name='RPMH_ARC_RM3_PV_TCS_CMD0_VOTE'/>"
WRITE #1 "        <register address='0xb7fe184' value='0x" DATA.LONG(A:0x7fe184) "' name='RPMH_ARC_RM3_PV_TCS_CMD1_VOTE'/>"
WRITE #1 "        <register address='0xb7fe188' value='0x" DATA.LONG(A:0x7fe188) "' name='RPMH_ARC_RM3_PV_TCS_CMD2_VOTE'/>"
WRITE #1 "        <register address='0xb7fe18c' value='0x" DATA.LONG(A:0x7fe18c) "' name='RPMH_ARC_RM3_PV_TCS_CMD3_VOTE'/>"
WRITE #1 "        <register address='0xb7fe190' value='0x" DATA.LONG(A:0x7fe190) "' name='RPMH_ARC_RM4_PV_TCS_CMD0_VOTE'/>"
WRITE #1 "        <register address='0xb7fe194' value='0x" DATA.LONG(A:0x7fe194) "' name='RPMH_ARC_RM4_PV_TCS_CMD1_VOTE'/>"
WRITE #1 "        <register address='0xb7fe198' value='0x" DATA.LONG(A:0x7fe198) "' name='RPMH_ARC_RM4_PV_TCS_CMD2_VOTE'/>"
WRITE #1 "        <register address='0xb7fe19c' value='0x" DATA.LONG(A:0x7fe19c) "' name='RPMH_ARC_RM4_PV_TCS_CMD3_VOTE'/>"
WRITE #1 "        <register address='0xb7fe1a0' value='0x" DATA.LONG(A:0x7fe1a0) "' name='RPMH_ARC_RM5_PV_TCS_CMD0_VOTE'/>"
WRITE #1 "        <register address='0xb7fe1a4' value='0x" DATA.LONG(A:0x7fe1a4) "' name='RPMH_ARC_RM5_PV_TCS_CMD1_VOTE'/>"
WRITE #1 "        <register address='0xb7fe1a8' value='0x" DATA.LONG(A:0x7fe1a8) "' name='RPMH_ARC_RM5_PV_TCS_CMD2_VOTE'/>"
WRITE #1 "        <register address='0xb7fe1ac' value='0x" DATA.LONG(A:0x7fe1ac) "' name='RPMH_ARC_RM5_PV_TCS_CMD3_VOTE'/>"
WRITE #1 "        <register address='0xb7fe1b0' value='0x" DATA.LONG(A:0x7fe1b0) "' name='RPMH_ARC_RM6_PV_TCS_CMD0_VOTE'/>"
WRITE #1 "        <register address='0xb7fe1b4' value='0x" DATA.LONG(A:0x7fe1b4) "' name='RPMH_ARC_RM6_PV_TCS_CMD1_VOTE'/>"
WRITE #1 "        <register address='0xb7fe1b8' value='0x" DATA.LONG(A:0x7fe1b8) "' name='RPMH_ARC_RM6_PV_TCS_CMD2_VOTE'/>"
WRITE #1 "        <register address='0xb7fe1bc' value='0x" DATA.LONG(A:0x7fe1bc) "' name='RPMH_ARC_RM6_PV_TCS_CMD3_VOTE'/>"
WRITE #1 "        <register address='0xb7fe1c0' value='0x" DATA.LONG(A:0x7fe1c0) "' name='RPMH_ARC_RM7_PV_TCS_CMD0_VOTE'/>"
WRITE #1 "        <register address='0xb7fe1c4' value='0x" DATA.LONG(A:0x7fe1c4) "' name='RPMH_ARC_RM7_PV_TCS_CMD1_VOTE'/>"
WRITE #1 "        <register address='0xb7fe1c8' value='0x" DATA.LONG(A:0x7fe1c8) "' name='RPMH_ARC_RM7_PV_TCS_CMD2_VOTE'/>"
WRITE #1 "        <register address='0xb7fe1cc' value='0x" DATA.LONG(A:0x7fe1cc) "' name='RPMH_ARC_RM7_PV_TCS_CMD3_VOTE'/>"
WRITE #1 "        <register address='0xb7fe300' value='0x" DATA.LONG(A:0x7fe300) "' name='RPMH_ARC_RM0_PV_TCS_CMD0_VOTE_ADDR'/>"
WRITE #1 "        <register address='0xb7fe304' value='0x" DATA.LONG(A:0x7fe304) "' name='RPMH_ARC_RM0_PV_TCS_CMD1_VOTE_ADDR'/>"
WRITE #1 "        <register address='0xb7fe308' value='0x" DATA.LONG(A:0x7fe308) "' name='RPMH_ARC_RM0_PV_TCS_CMD2_VOTE_ADDR'/>"
WRITE #1 "        <register address='0xb7fe30c' value='0x" DATA.LONG(A:0x7fe30c) "' name='RPMH_ARC_RM0_PV_TCS_CMD3_VOTE_ADDR'/>"
WRITE #1 "        <register address='0xb7fe310' value='0x" DATA.LONG(A:0x7fe310) "' name='RPMH_ARC_RM1_PV_TCS_CMD0_VOTE_ADDR'/>"
WRITE #1 "        <register address='0xb7fe314' value='0x" DATA.LONG(A:0x7fe314) "' name='RPMH_ARC_RM1_PV_TCS_CMD1_VOTE_ADDR'/>"
WRITE #1 "        <register address='0xb7fe318' value='0x" DATA.LONG(A:0x7fe318) "' name='RPMH_ARC_RM1_PV_TCS_CMD2_VOTE_ADDR'/>"
WRITE #1 "        <register address='0xb7fe31c' value='0x" DATA.LONG(A:0x7fe31c) "' name='RPMH_ARC_RM1_PV_TCS_CMD3_VOTE_ADDR'/>"
WRITE #1 "        <register address='0xb7fe320' value='0x" DATA.LONG(A:0x7fe320) "' name='RPMH_ARC_RM2_PV_TCS_CMD0_VOTE_ADDR'/>"
WRITE #1 "        <register address='0xb7fe324' value='0x" DATA.LONG(A:0x7fe324) "' name='RPMH_ARC_RM2_PV_TCS_CMD1_VOTE_ADDR'/>"
WRITE #1 "        <register address='0xb7fe328' value='0x" DATA.LONG(A:0x7fe328) "' name='RPMH_ARC_RM2_PV_TCS_CMD2_VOTE_ADDR'/>"
WRITE #1 "        <register address='0xb7fe32c' value='0x" DATA.LONG(A:0x7fe32c) "' name='RPMH_ARC_RM2_PV_TCS_CMD3_VOTE_ADDR'/>"
WRITE #1 "        <register address='0xb7fe330' value='0x" DATA.LONG(A:0x7fe330) "' name='RPMH_ARC_RM3_PV_TCS_CMD0_VOTE_ADDR'/>"
WRITE #1 "        <register address='0xb7fe334' value='0x" DATA.LONG(A:0x7fe334) "' name='RPMH_ARC_RM3_PV_TCS_CMD1_VOTE_ADDR'/>"
WRITE #1 "        <register address='0xb7fe338' value='0x" DATA.LONG(A:0x7fe338) "' name='RPMH_ARC_RM3_PV_TCS_CMD2_VOTE_ADDR'/>"
WRITE #1 "        <register address='0xb7fe33c' value='0x" DATA.LONG(A:0x7fe33c) "' name='RPMH_ARC_RM3_PV_TCS_CMD3_VOTE_ADDR'/>"
WRITE #1 "        <register address='0xb7fe340' value='0x" DATA.LONG(A:0x7fe340) "' name='RPMH_ARC_RM4_PV_TCS_CMD0_VOTE_ADDR'/>"
WRITE #1 "        <register address='0xb7fe344' value='0x" DATA.LONG(A:0x7fe344) "' name='RPMH_ARC_RM4_PV_TCS_CMD1_VOTE_ADDR'/>"
WRITE #1 "        <register address='0xb7fe348' value='0x" DATA.LONG(A:0x7fe348) "' name='RPMH_ARC_RM4_PV_TCS_CMD2_VOTE_ADDR'/>"
WRITE #1 "        <register address='0xb7fe34c' value='0x" DATA.LONG(A:0x7fe34c) "' name='RPMH_ARC_RM4_PV_TCS_CMD3_VOTE_ADDR'/>"
WRITE #1 "        <register address='0xb7fe350' value='0x" DATA.LONG(A:0x7fe350) "' name='RPMH_ARC_RM5_PV_TCS_CMD0_VOTE_ADDR'/>"
WRITE #1 "        <register address='0xb7fe354' value='0x" DATA.LONG(A:0x7fe354) "' name='RPMH_ARC_RM5_PV_TCS_CMD1_VOTE_ADDR'/>"
WRITE #1 "        <register address='0xb7fe358' value='0x" DATA.LONG(A:0x7fe358) "' name='RPMH_ARC_RM5_PV_TCS_CMD2_VOTE_ADDR'/>"
WRITE #1 "        <register address='0xb7fe35c' value='0x" DATA.LONG(A:0x7fe35c) "' name='RPMH_ARC_RM5_PV_TCS_CMD3_VOTE_ADDR'/>"
WRITE #1 "        <register address='0xb7fe360' value='0x" DATA.LONG(A:0x7fe360) "' name='RPMH_ARC_RM6_PV_TCS_CMD0_VOTE_ADDR'/>"
WRITE #1 "        <register address='0xb7fe364' value='0x" DATA.LONG(A:0x7fe364) "' name='RPMH_ARC_RM6_PV_TCS_CMD1_VOTE_ADDR'/>"
WRITE #1 "        <register address='0xb7fe368' value='0x" DATA.LONG(A:0x7fe368) "' name='RPMH_ARC_RM6_PV_TCS_CMD2_VOTE_ADDR'/>"
WRITE #1 "        <register address='0xb7fe36c' value='0x" DATA.LONG(A:0x7fe36c) "' name='RPMH_ARC_RM6_PV_TCS_CMD3_VOTE_ADDR'/>"
WRITE #1 "        <register address='0xb7fe370' value='0x" DATA.LONG(A:0x7fe370) "' name='RPMH_ARC_RM7_PV_TCS_CMD0_VOTE_ADDR'/>"
WRITE #1 "        <register address='0xb7fe374' value='0x" DATA.LONG(A:0x7fe374) "' name='RPMH_ARC_RM7_PV_TCS_CMD1_VOTE_ADDR'/>"
WRITE #1 "        <register address='0xb7fe378' value='0x" DATA.LONG(A:0x7fe378) "' name='RPMH_ARC_RM7_PV_TCS_CMD2_VOTE_ADDR'/>"
WRITE #1 "        <register address='0xb7fe37c' value='0x" DATA.LONG(A:0x7fe37c) "' name='RPMH_ARC_RM7_PV_TCS_CMD3_VOTE_ADDR'/>"
WRITE #1 "        <register address='0xb7fe5c0' value='0x" DATA.LONG(A:0x7fe5c0) "' name='RPMH_ARC_RM0_PV_TCS_CMD0_VOTE_DATA'/>"
WRITE #1 "        <register address='0xb7fe5c4' value='0x" DATA.LONG(A:0x7fe5c4) "' name='RPMH_ARC_RM0_PV_TCS_CMD1_VOTE_DATA'/>"
WRITE #1 "        <register address='0xb7fe5c8' value='0x" DATA.LONG(A:0x7fe5c8) "' name='RPMH_ARC_RM0_PV_TCS_CMD2_VOTE_DATA'/>"
WRITE #1 "        <register address='0xb7fe5cc' value='0x" DATA.LONG(A:0x7fe5cc) "' name='RPMH_ARC_RM0_PV_TCS_CMD3_VOTE_DATA'/>"
WRITE #1 "        <register address='0xb7fe5d0' value='0x" DATA.LONG(A:0x7fe5d0) "' name='RPMH_ARC_RM1_PV_TCS_CMD0_VOTE_DATA'/>"
WRITE #1 "        <register address='0xb7fe5d4' value='0x" DATA.LONG(A:0x7fe5d4) "' name='RPMH_ARC_RM1_PV_TCS_CMD1_VOTE_DATA'/>"
WRITE #1 "        <register address='0xb7fe5d8' value='0x" DATA.LONG(A:0x7fe5d8) "' name='RPMH_ARC_RM1_PV_TCS_CMD2_VOTE_DATA'/>"
WRITE #1 "        <register address='0xb7fe5dc' value='0x" DATA.LONG(A:0x7fe5dc) "' name='RPMH_ARC_RM1_PV_TCS_CMD3_VOTE_DATA'/>"
WRITE #1 "        <register address='0xb7fe5e0' value='0x" DATA.LONG(A:0x7fe5e0) "' name='RPMH_ARC_RM2_PV_TCS_CMD0_VOTE_DATA'/>"
WRITE #1 "        <register address='0xb7fe5e4' value='0x" DATA.LONG(A:0x7fe5e4) "' name='RPMH_ARC_RM2_PV_TCS_CMD1_VOTE_DATA'/>"
WRITE #1 "        <register address='0xb7fe5e8' value='0x" DATA.LONG(A:0x7fe5e8) "' name='RPMH_ARC_RM2_PV_TCS_CMD2_VOTE_DATA'/>"
WRITE #1 "        <register address='0xb7fe5ec' value='0x" DATA.LONG(A:0x7fe5ec) "' name='RPMH_ARC_RM2_PV_TCS_CMD3_VOTE_DATA'/>"
WRITE #1 "        <register address='0xb7fe5f0' value='0x" DATA.LONG(A:0x7fe5f0) "' name='RPMH_ARC_RM3_PV_TCS_CMD0_VOTE_DATA'/>"
WRITE #1 "        <register address='0xb7fe5f4' value='0x" DATA.LONG(A:0x7fe5f4) "' name='RPMH_ARC_RM3_PV_TCS_CMD1_VOTE_DATA'/>"
WRITE #1 "        <register address='0xb7fe5f8' value='0x" DATA.LONG(A:0x7fe5f8) "' name='RPMH_ARC_RM3_PV_TCS_CMD2_VOTE_DATA'/>"
WRITE #1 "        <register address='0xb7fe5fc' value='0x" DATA.LONG(A:0x7fe5fc) "' name='RPMH_ARC_RM3_PV_TCS_CMD3_VOTE_DATA'/>"
WRITE #1 "        <register address='0xb7fe600' value='0x" DATA.LONG(A:0x7fe600) "' name='RPMH_ARC_RM4_PV_TCS_CMD0_VOTE_DATA'/>"
WRITE #1 "        <register address='0xb7fe604' value='0x" DATA.LONG(A:0x7fe604) "' name='RPMH_ARC_RM4_PV_TCS_CMD1_VOTE_DATA'/>"
WRITE #1 "        <register address='0xb7fe608' value='0x" DATA.LONG(A:0x7fe608) "' name='RPMH_ARC_RM4_PV_TCS_CMD2_VOTE_DATA'/>"
WRITE #1 "        <register address='0xb7fe60c' value='0x" DATA.LONG(A:0x7fe60c) "' name='RPMH_ARC_RM4_PV_TCS_CMD3_VOTE_DATA'/>"
WRITE #1 "        <register address='0xb7fe610' value='0x" DATA.LONG(A:0x7fe610) "' name='RPMH_ARC_RM5_PV_TCS_CMD0_VOTE_DATA'/>"
WRITE #1 "        <register address='0xb7fe614' value='0x" DATA.LONG(A:0x7fe614) "' name='RPMH_ARC_RM5_PV_TCS_CMD1_VOTE_DATA'/>"
WRITE #1 "        <register address='0xb7fe618' value='0x" DATA.LONG(A:0x7fe618) "' name='RPMH_ARC_RM5_PV_TCS_CMD2_VOTE_DATA'/>"
WRITE #1 "        <register address='0xb7fe61c' value='0x" DATA.LONG(A:0x7fe61c) "' name='RPMH_ARC_RM5_PV_TCS_CMD3_VOTE_DATA'/>"
WRITE #1 "        <register address='0xb7fe620' value='0x" DATA.LONG(A:0x7fe620) "' name='RPMH_ARC_RM6_PV_TCS_CMD0_VOTE_DATA'/>"
WRITE #1 "        <register address='0xb7fe624' value='0x" DATA.LONG(A:0x7fe624) "' name='RPMH_ARC_RM6_PV_TCS_CMD1_VOTE_DATA'/>"
WRITE #1 "        <register address='0xb7fe628' value='0x" DATA.LONG(A:0x7fe628) "' name='RPMH_ARC_RM6_PV_TCS_CMD2_VOTE_DATA'/>"
WRITE #1 "        <register address='0xb7fe62c' value='0x" DATA.LONG(A:0x7fe62c) "' name='RPMH_ARC_RM6_PV_TCS_CMD3_VOTE_DATA'/>"
WRITE #1 "        <register address='0xb7fe630' value='0x" DATA.LONG(A:0x7fe630) "' name='RPMH_ARC_RM7_PV_TCS_CMD0_VOTE_DATA'/>"
WRITE #1 "        <register address='0xb7fe634' value='0x" DATA.LONG(A:0x7fe634) "' name='RPMH_ARC_RM7_PV_TCS_CMD1_VOTE_DATA'/>"
WRITE #1 "        <register address='0xb7fe638' value='0x" DATA.LONG(A:0x7fe638) "' name='RPMH_ARC_RM7_PV_TCS_CMD2_VOTE_DATA'/>"
WRITE #1 "        <register address='0xb7fe63c' value='0x" DATA.LONG(A:0x7fe63c) "' name='RPMH_ARC_RM7_PV_TCS_CMD3_VOTE_DATA'/>"
WRITE #1 "        <register address='0xb7fea40' value='0x" DATA.LONG(A:0x7fea40) "' name='RPMH_ARC_SW_OVERRIDE_PWR_CTRL_VAL_RM0'/>"
WRITE #1 "        <register address='0xb7fea44' value='0x" DATA.LONG(A:0x7fea44) "' name='RPMH_ARC_SW_OVERRIDE_PWR_CTRL_VAL_RM1'/>"
WRITE #1 "        <register address='0xb7fea48' value='0x" DATA.LONG(A:0x7fea48) "' name='RPMH_ARC_SW_OVERRIDE_PWR_CTRL_VAL_RM2'/>"
WRITE #1 "        <register address='0xb7fea4c' value='0x" DATA.LONG(A:0x7fea4c) "' name='RPMH_ARC_SW_OVERRIDE_PWR_CTRL_VAL_RM3'/>"
WRITE #1 "        <register address='0xb7fea50' value='0x" DATA.LONG(A:0x7fea50) "' name='RPMH_ARC_SW_OVERRIDE_PWR_CTRL_VAL_RM4'/>"
WRITE #1 "        <register address='0xb7fea54' value='0x" DATA.LONG(A:0x7fea54) "' name='RPMH_ARC_SW_OVERRIDE_PWR_CTRL_VAL_RM5'/>"
WRITE #1 "        <register address='0xb7fea58' value='0x" DATA.LONG(A:0x7fea58) "' name='RPMH_ARC_SW_OVERRIDE_PWR_CTRL_VAL_RM6'/>"
WRITE #1 "        <register address='0xb7fea5c' value='0x" DATA.LONG(A:0x7fea5c) "' name='RPMH_ARC_SW_OVERRIDE_PWR_CTRL_VAL_RM7'/>"
WRITE #1 "        <register address='0xb7fea80' value='0x" DATA.LONG(A:0x7fea80) "' name='RPMH_ARC_SW_OVERRIDE_PWR_CTRL2_VAL_RM0'/>"
WRITE #1 "        <register address='0xb7fea84' value='0x" DATA.LONG(A:0x7fea84) "' name='RPMH_ARC_SW_OVERRIDE_PWR_CTRL2_VAL_RM1'/>"
WRITE #1 "        <register address='0xb7fea88' value='0x" DATA.LONG(A:0x7fea88) "' name='RPMH_ARC_SW_OVERRIDE_PWR_CTRL2_VAL_RM2'/>"
WRITE #1 "        <register address='0xb7fea8c' value='0x" DATA.LONG(A:0x7fea8c) "' name='RPMH_ARC_SW_OVERRIDE_PWR_CTRL2_VAL_RM3'/>"
WRITE #1 "        <register address='0xb7fea90' value='0x" DATA.LONG(A:0x7fea90) "' name='RPMH_ARC_SW_OVERRIDE_PWR_CTRL2_VAL_RM4'/>"
WRITE #1 "        <register address='0xb7fea94' value='0x" DATA.LONG(A:0x7fea94) "' name='RPMH_ARC_SW_OVERRIDE_PWR_CTRL2_VAL_RM5'/>"
WRITE #1 "        <register address='0xb7fea98' value='0x" DATA.LONG(A:0x7fea98) "' name='RPMH_ARC_SW_OVERRIDE_PWR_CTRL2_VAL_RM6'/>"
WRITE #1 "        <register address='0xb7fea9c' value='0x" DATA.LONG(A:0x7fea9c) "' name='RPMH_ARC_SW_OVERRIDE_PWR_CTRL2_VAL_RM7'/>"
WRITE #1 "        <register address='0xb7feac0' value='0x" DATA.LONG(A:0x7feac0) "' name='RPMH_ARC_SW_OVERRIDE_PWR_CTRL_MASK_RM0'/>"
WRITE #1 "        <register address='0xb7feac4' value='0x" DATA.LONG(A:0x7feac4) "' name='RPMH_ARC_SW_OVERRIDE_PWR_CTRL_MASK_RM1'/>"
WRITE #1 "        <register address='0xb7feac8' value='0x" DATA.LONG(A:0x7feac8) "' name='RPMH_ARC_SW_OVERRIDE_PWR_CTRL_MASK_RM2'/>"
WRITE #1 "        <register address='0xb7feacc' value='0x" DATA.LONG(A:0x7feacc) "' name='RPMH_ARC_SW_OVERRIDE_PWR_CTRL_MASK_RM3'/>"
WRITE #1 "        <register address='0xb7fead0' value='0x" DATA.LONG(A:0x7fead0) "' name='RPMH_ARC_SW_OVERRIDE_PWR_CTRL_MASK_RM4'/>"
WRITE #1 "        <register address='0xb7fead4' value='0x" DATA.LONG(A:0x7fead4) "' name='RPMH_ARC_SW_OVERRIDE_PWR_CTRL_MASK_RM5'/>"
WRITE #1 "        <register address='0xb7fead8' value='0x" DATA.LONG(A:0x7fead8) "' name='RPMH_ARC_SW_OVERRIDE_PWR_CTRL_MASK_RM6'/>"
WRITE #1 "        <register address='0xb7feadc' value='0x" DATA.LONG(A:0x7feadc) "' name='RPMH_ARC_SW_OVERRIDE_PWR_CTRL_MASK_RM7'/>"
WRITE #1 "        <register address='0xb7feb00' value='0x" DATA.LONG(A:0x7feb00) "' name='RPMH_ARC_SW_OVERRIDE_PWR_CTRL2_MASK_RM0'/>"
WRITE #1 "        <register address='0xb7feb04' value='0x" DATA.LONG(A:0x7feb04) "' name='RPMH_ARC_SW_OVERRIDE_PWR_CTRL2_MASK_RM1'/>"
WRITE #1 "        <register address='0xb7feb08' value='0x" DATA.LONG(A:0x7feb08) "' name='RPMH_ARC_SW_OVERRIDE_PWR_CTRL2_MASK_RM2'/>"
WRITE #1 "        <register address='0xb7feb0c' value='0x" DATA.LONG(A:0x7feb0c) "' name='RPMH_ARC_SW_OVERRIDE_PWR_CTRL2_MASK_RM3'/>"
WRITE #1 "        <register address='0xb7feb10' value='0x" DATA.LONG(A:0x7feb10) "' name='RPMH_ARC_SW_OVERRIDE_PWR_CTRL2_MASK_RM4'/>"
WRITE #1 "        <register address='0xb7feb14' value='0x" DATA.LONG(A:0x7feb14) "' name='RPMH_ARC_SW_OVERRIDE_PWR_CTRL2_MASK_RM5'/>"
WRITE #1 "        <register address='0xb7feb18' value='0x" DATA.LONG(A:0x7feb18) "' name='RPMH_ARC_SW_OVERRIDE_PWR_CTRL2_MASK_RM6'/>"
WRITE #1 "        <register address='0xb7feb1c' value='0x" DATA.LONG(A:0x7feb1c) "' name='RPMH_ARC_SW_OVERRIDE_PWR_CTRL2_MASK_RM7'/>"
WRITE #1 "        <register address='0xb7feb40' value='0x" DATA.LONG(A:0x7feb40) "' name='RPMH_ARC_SW_OVERRIDE_WAIT_EVENT_VAL_RM0'/>"
WRITE #1 "        <register address='0xb7feb44' value='0x" DATA.LONG(A:0x7feb44) "' name='RPMH_ARC_SW_OVERRIDE_WAIT_EVENT_VAL_RM1'/>"
WRITE #1 "        <register address='0xb7feb48' value='0x" DATA.LONG(A:0x7feb48) "' name='RPMH_ARC_SW_OVERRIDE_WAIT_EVENT_VAL_RM2'/>"
WRITE #1 "        <register address='0xb7feb4c' value='0x" DATA.LONG(A:0x7feb4c) "' name='RPMH_ARC_SW_OVERRIDE_WAIT_EVENT_VAL_RM3'/>"
WRITE #1 "        <register address='0xb7feb50' value='0x" DATA.LONG(A:0x7feb50) "' name='RPMH_ARC_SW_OVERRIDE_WAIT_EVENT_VAL_RM4'/>"
WRITE #1 "        <register address='0xb7feb54' value='0x" DATA.LONG(A:0x7feb54) "' name='RPMH_ARC_SW_OVERRIDE_WAIT_EVENT_VAL_RM5'/>"
WRITE #1 "        <register address='0xb7feb58' value='0x" DATA.LONG(A:0x7feb58) "' name='RPMH_ARC_SW_OVERRIDE_WAIT_EVENT_VAL_RM6'/>"
WRITE #1 "        <register address='0xb7feb5c' value='0x" DATA.LONG(A:0x7feb5c) "' name='RPMH_ARC_SW_OVERRIDE_WAIT_EVENT_VAL_RM7'/>"
WRITE #1 "        <register address='0xb7feb80' value='0x" DATA.LONG(A:0x7feb80) "' name='RPMH_ARC_SW_OVERRIDE_WAIT_EVENT_MASK_RM0'/>"
WRITE #1 "        <register address='0xb7feb84' value='0x" DATA.LONG(A:0x7feb84) "' name='RPMH_ARC_SW_OVERRIDE_WAIT_EVENT_MASK_RM1'/>"
WRITE #1 "        <register address='0xb7feb88' value='0x" DATA.LONG(A:0x7feb88) "' name='RPMH_ARC_SW_OVERRIDE_WAIT_EVENT_MASK_RM2'/>"
WRITE #1 "        <register address='0xb7feb8c' value='0x" DATA.LONG(A:0x7feb8c) "' name='RPMH_ARC_SW_OVERRIDE_WAIT_EVENT_MASK_RM3'/>"
WRITE #1 "        <register address='0xb7feb90' value='0x" DATA.LONG(A:0x7feb90) "' name='RPMH_ARC_SW_OVERRIDE_WAIT_EVENT_MASK_RM4'/>"
WRITE #1 "        <register address='0xb7feb94' value='0x" DATA.LONG(A:0x7feb94) "' name='RPMH_ARC_SW_OVERRIDE_WAIT_EVENT_MASK_RM5'/>"
WRITE #1 "        <register address='0xb7feb98' value='0x" DATA.LONG(A:0x7feb98) "' name='RPMH_ARC_SW_OVERRIDE_WAIT_EVENT_MASK_RM6'/>"
WRITE #1 "        <register address='0xb7feb9c' value='0x" DATA.LONG(A:0x7feb9c) "' name='RPMH_ARC_SW_OVERRIDE_WAIT_EVENT_MASK_RM7'/>"
WRITE #1 "        <register address='0xb7febc0' value='0x" DATA.LONG(A:0x7febc0) "' name='RPMH_ARC_SW_OVERRIDE_BR_EVENT_VAL_RM0'/>"
WRITE #1 "        <register address='0xb7febc4' value='0x" DATA.LONG(A:0x7febc4) "' name='RPMH_ARC_SW_OVERRIDE_BR_EVENT_VAL_RM1'/>"
WRITE #1 "        <register address='0xb7febc8' value='0x" DATA.LONG(A:0x7febc8) "' name='RPMH_ARC_SW_OVERRIDE_BR_EVENT_VAL_RM2'/>"
WRITE #1 "        <register address='0xb7febcc' value='0x" DATA.LONG(A:0x7febcc) "' name='RPMH_ARC_SW_OVERRIDE_BR_EVENT_VAL_RM3'/>"
WRITE #1 "        <register address='0xb7febd0' value='0x" DATA.LONG(A:0x7febd0) "' name='RPMH_ARC_SW_OVERRIDE_BR_EVENT_VAL_RM4'/>"
WRITE #1 "        <register address='0xb7febd4' value='0x" DATA.LONG(A:0x7febd4) "' name='RPMH_ARC_SW_OVERRIDE_BR_EVENT_VAL_RM5'/>"
WRITE #1 "        <register address='0xb7febd8' value='0x" DATA.LONG(A:0x7febd8) "' name='RPMH_ARC_SW_OVERRIDE_BR_EVENT_VAL_RM6'/>"
WRITE #1 "        <register address='0xb7febdc' value='0x" DATA.LONG(A:0x7febdc) "' name='RPMH_ARC_SW_OVERRIDE_BR_EVENT_VAL_RM7'/>"
WRITE #1 "        <register address='0xb7fec00' value='0x" DATA.LONG(A:0x7fec00) "' name='RPMH_ARC_SW_OVERRIDE_BR_EVENT_MASK_RM0'/>"
WRITE #1 "        <register address='0xb7fec04' value='0x" DATA.LONG(A:0x7fec04) "' name='RPMH_ARC_SW_OVERRIDE_BR_EVENT_MASK_RM1'/>"
WRITE #1 "        <register address='0xb7fec08' value='0x" DATA.LONG(A:0x7fec08) "' name='RPMH_ARC_SW_OVERRIDE_BR_EVENT_MASK_RM2'/>"
WRITE #1 "        <register address='0xb7fec0c' value='0x" DATA.LONG(A:0x7fec0c) "' name='RPMH_ARC_SW_OVERRIDE_BR_EVENT_MASK_RM3'/>"
WRITE #1 "        <register address='0xb7fec10' value='0x" DATA.LONG(A:0x7fec10) "' name='RPMH_ARC_SW_OVERRIDE_BR_EVENT_MASK_RM4'/>"
WRITE #1 "        <register address='0xb7fec14' value='0x" DATA.LONG(A:0x7fec14) "' name='RPMH_ARC_SW_OVERRIDE_BR_EVENT_MASK_RM5'/>"
WRITE #1 "        <register address='0xb7fec18' value='0x" DATA.LONG(A:0x7fec18) "' name='RPMH_ARC_SW_OVERRIDE_BR_EVENT_MASK_RM6'/>"
WRITE #1 "        <register address='0xb7fec1c' value='0x" DATA.LONG(A:0x7fec1c) "' name='RPMH_ARC_SW_OVERRIDE_BR_EVENT_MASK_RM7'/>"
WRITE #1 "        <register address='0xb7fec40' value='0x" DATA.LONG(A:0x7fec40) "' name='RPMH_ARC_SW_OVERRIDE_MEM_ACC_VAL_RM0'/>"
WRITE #1 "        <register address='0xb7fec44' value='0x" DATA.LONG(A:0x7fec44) "' name='RPMH_ARC_SW_OVERRIDE_MEM_ACC_VAL_RM1'/>"
WRITE #1 "        <register address='0xb7fec48' value='0x" DATA.LONG(A:0x7fec48) "' name='RPMH_ARC_SW_OVERRIDE_MEM_ACC_VAL_RM2'/>"
WRITE #1 "        <register address='0xb7fec4c' value='0x" DATA.LONG(A:0x7fec4c) "' name='RPMH_ARC_SW_OVERRIDE_MEM_ACC_VAL_RM3'/>"
WRITE #1 "        <register address='0xb7fec50' value='0x" DATA.LONG(A:0x7fec50) "' name='RPMH_ARC_SW_OVERRIDE_MEM_ACC_VAL_RM4'/>"
WRITE #1 "        <register address='0xb7fec54' value='0x" DATA.LONG(A:0x7fec54) "' name='RPMH_ARC_SW_OVERRIDE_MEM_ACC_VAL_RM5'/>"
WRITE #1 "        <register address='0xb7fec58' value='0x" DATA.LONG(A:0x7fec58) "' name='RPMH_ARC_SW_OVERRIDE_MEM_ACC_VAL_RM6'/>"
WRITE #1 "        <register address='0xb7fec5c' value='0x" DATA.LONG(A:0x7fec5c) "' name='RPMH_ARC_SW_OVERRIDE_MEM_ACC_VAL_RM7'/>"
WRITE #1 "        <register address='0xb7fec80' value='0x" DATA.LONG(A:0x7fec80) "' name='RPMH_ARC_SW_OVERRIDE_MEM_ACC_MASK_RM0'/>"
WRITE #1 "        <register address='0xb7fec84' value='0x" DATA.LONG(A:0x7fec84) "' name='RPMH_ARC_SW_OVERRIDE_MEM_ACC_MASK_RM1'/>"
WRITE #1 "        <register address='0xb7fec88' value='0x" DATA.LONG(A:0x7fec88) "' name='RPMH_ARC_SW_OVERRIDE_MEM_ACC_MASK_RM2'/>"
WRITE #1 "        <register address='0xb7fec8c' value='0x" DATA.LONG(A:0x7fec8c) "' name='RPMH_ARC_SW_OVERRIDE_MEM_ACC_MASK_RM3'/>"
WRITE #1 "        <register address='0xb7fec90' value='0x" DATA.LONG(A:0x7fec90) "' name='RPMH_ARC_SW_OVERRIDE_MEM_ACC_MASK_RM4'/>"
WRITE #1 "        <register address='0xb7fec94' value='0x" DATA.LONG(A:0x7fec94) "' name='RPMH_ARC_SW_OVERRIDE_MEM_ACC_MASK_RM5'/>"
WRITE #1 "        <register address='0xb7fec98' value='0x" DATA.LONG(A:0x7fec98) "' name='RPMH_ARC_SW_OVERRIDE_MEM_ACC_MASK_RM6'/>"
WRITE #1 "        <register address='0xb7fec9c' value='0x" DATA.LONG(A:0x7fec9c) "' name='RPMH_ARC_SW_OVERRIDE_MEM_ACC_MASK_RM7'/>"
WRITE #1 "        <register address='0xb7fed00' value='0x" DATA.LONG(A:0x7fed00) "' name='RPMH_ARC_SW_UNBLOCK_SEQ_PRE_RM0'/>"
WRITE #1 "        <register address='0xb7fed04' value='0x" DATA.LONG(A:0x7fed04) "' name='RPMH_ARC_SW_UNBLOCK_SEQ_PRE_RM1'/>"
WRITE #1 "        <register address='0xb7fed08' value='0x" DATA.LONG(A:0x7fed08) "' name='RPMH_ARC_SW_UNBLOCK_SEQ_PRE_RM2'/>"
WRITE #1 "        <register address='0xb7fed0c' value='0x" DATA.LONG(A:0x7fed0c) "' name='RPMH_ARC_SW_UNBLOCK_SEQ_PRE_RM3'/>"
WRITE #1 "        <register address='0xb7fed10' value='0x" DATA.LONG(A:0x7fed10) "' name='RPMH_ARC_SW_UNBLOCK_SEQ_PRE_RM4'/>"
WRITE #1 "        <register address='0xb7fed14' value='0x" DATA.LONG(A:0x7fed14) "' name='RPMH_ARC_SW_UNBLOCK_SEQ_PRE_RM5'/>"
WRITE #1 "        <register address='0xb7fed18' value='0x" DATA.LONG(A:0x7fed18) "' name='RPMH_ARC_SW_UNBLOCK_SEQ_PRE_RM6'/>"
WRITE #1 "        <register address='0xb7fed1c' value='0x" DATA.LONG(A:0x7fed1c) "' name='RPMH_ARC_SW_UNBLOCK_SEQ_PRE_RM7'/>"
WRITE #1 "        <register address='0xb7fed40' value='0x" DATA.LONG(A:0x7fed40) "' name='RPMH_ARC_SW_UNBLOCK_SEQ_POST_RM0'/>"
WRITE #1 "        <register address='0xb7fed44' value='0x" DATA.LONG(A:0x7fed44) "' name='RPMH_ARC_SW_UNBLOCK_SEQ_POST_RM1'/>"
WRITE #1 "        <register address='0xb7fed48' value='0x" DATA.LONG(A:0x7fed48) "' name='RPMH_ARC_SW_UNBLOCK_SEQ_POST_RM2'/>"
WRITE #1 "        <register address='0xb7fed4c' value='0x" DATA.LONG(A:0x7fed4c) "' name='RPMH_ARC_SW_UNBLOCK_SEQ_POST_RM3'/>"
WRITE #1 "        <register address='0xb7fed50' value='0x" DATA.LONG(A:0x7fed50) "' name='RPMH_ARC_SW_UNBLOCK_SEQ_POST_RM4'/>"
WRITE #1 "        <register address='0xb7fed54' value='0x" DATA.LONG(A:0x7fed54) "' name='RPMH_ARC_SW_UNBLOCK_SEQ_POST_RM5'/>"
WRITE #1 "        <register address='0xb7fed58' value='0x" DATA.LONG(A:0x7fed58) "' name='RPMH_ARC_SW_UNBLOCK_SEQ_POST_RM6'/>"
WRITE #1 "        <register address='0xb7fed5c' value='0x" DATA.LONG(A:0x7fed5c) "' name='RPMH_ARC_SW_UNBLOCK_SEQ_POST_RM7'/>"
WRITE #1 "        <register address='0xb7ff000' value='0x" DATA.LONG(A:0x7ff000) "' name='RPMH_ARC_SEQ_MEM_0'/>"
WRITE #1 "        <register address='0xb7ff004' value='0x" DATA.LONG(A:0x7ff004) "' name='RPMH_ARC_SEQ_MEM_1'/>"
WRITE #1 "        <register address='0xb7ff008' value='0x" DATA.LONG(A:0x7ff008) "' name='RPMH_ARC_SEQ_MEM_2'/>"
WRITE #1 "        <register address='0xb7ff00c' value='0x" DATA.LONG(A:0x7ff00c) "' name='RPMH_ARC_SEQ_MEM_3'/>"
WRITE #1 "        <register address='0xb7ff010' value='0x" DATA.LONG(A:0x7ff010) "' name='RPMH_ARC_SEQ_MEM_4'/>"
WRITE #1 "        <register address='0xb7ff014' value='0x" DATA.LONG(A:0x7ff014) "' name='RPMH_ARC_SEQ_MEM_5'/>"
WRITE #1 "        <register address='0xb7ff018' value='0x" DATA.LONG(A:0x7ff018) "' name='RPMH_ARC_SEQ_MEM_6'/>"
WRITE #1 "        <register address='0xb7ff01c' value='0x" DATA.LONG(A:0x7ff01c) "' name='RPMH_ARC_SEQ_MEM_7'/>"
WRITE #1 "        <register address='0xb7ff020' value='0x" DATA.LONG(A:0x7ff020) "' name='RPMH_ARC_SEQ_MEM_8'/>"
WRITE #1 "        <register address='0xb7ff024' value='0x" DATA.LONG(A:0x7ff024) "' name='RPMH_ARC_SEQ_MEM_9'/>"
WRITE #1 "        <register address='0xb7ff028' value='0x" DATA.LONG(A:0x7ff028) "' name='RPMH_ARC_SEQ_MEM_10'/>"
WRITE #1 "        <register address='0xb7ff02c' value='0x" DATA.LONG(A:0x7ff02c) "' name='RPMH_ARC_SEQ_MEM_11'/>"
WRITE #1 "        <register address='0xb7ff030' value='0x" DATA.LONG(A:0x7ff030) "' name='RPMH_ARC_SEQ_MEM_12'/>"
WRITE #1 "        <register address='0xb7ff034' value='0x" DATA.LONG(A:0x7ff034) "' name='RPMH_ARC_SEQ_MEM_13'/>"
WRITE #1 "        <register address='0xb7ff038' value='0x" DATA.LONG(A:0x7ff038) "' name='RPMH_ARC_SEQ_MEM_14'/>"
WRITE #1 "        <register address='0xb7ff03c' value='0x" DATA.LONG(A:0x7ff03c) "' name='RPMH_ARC_SEQ_MEM_15'/>"
WRITE #1 "        <register address='0xb7ff040' value='0x" DATA.LONG(A:0x7ff040) "' name='RPMH_ARC_SEQ_MEM_16'/>"
WRITE #1 "        <register address='0xb7ff044' value='0x" DATA.LONG(A:0x7ff044) "' name='RPMH_ARC_SEQ_MEM_17'/>"
WRITE #1 "        <register address='0xb7ff048' value='0x" DATA.LONG(A:0x7ff048) "' name='RPMH_ARC_SEQ_MEM_18'/>"
WRITE #1 "        <register address='0xb7ff04c' value='0x" DATA.LONG(A:0x7ff04c) "' name='RPMH_ARC_SEQ_MEM_19'/>"
WRITE #1 "        <register address='0xb7ff050' value='0x" DATA.LONG(A:0x7ff050) "' name='RPMH_ARC_SEQ_MEM_20'/>"
WRITE #1 "        <register address='0xb7ff054' value='0x" DATA.LONG(A:0x7ff054) "' name='RPMH_ARC_SEQ_MEM_21'/>"
WRITE #1 "        <register address='0xb7ff058' value='0x" DATA.LONG(A:0x7ff058) "' name='RPMH_ARC_SEQ_MEM_22'/>"
WRITE #1 "        <register address='0xb7ff05c' value='0x" DATA.LONG(A:0x7ff05c) "' name='RPMH_ARC_SEQ_MEM_23'/>"
WRITE #1 "        <register address='0xb7ff060' value='0x" DATA.LONG(A:0x7ff060) "' name='RPMH_ARC_SEQ_MEM_24'/>"
WRITE #1 "        <register address='0xb7ff064' value='0x" DATA.LONG(A:0x7ff064) "' name='RPMH_ARC_SEQ_MEM_25'/>"
WRITE #1 "        <register address='0xb7ff068' value='0x" DATA.LONG(A:0x7ff068) "' name='RPMH_ARC_SEQ_MEM_26'/>"
WRITE #1 "        <register address='0xb7ff06c' value='0x" DATA.LONG(A:0x7ff06c) "' name='RPMH_ARC_SEQ_MEM_27'/>"
WRITE #1 "        <register address='0xb7ff070' value='0x" DATA.LONG(A:0x7ff070) "' name='RPMH_ARC_SEQ_MEM_28'/>"
WRITE #1 "        <register address='0xb7ff074' value='0x" DATA.LONG(A:0x7ff074) "' name='RPMH_ARC_SEQ_MEM_29'/>"
WRITE #1 "        <register address='0xb7ff078' value='0x" DATA.LONG(A:0x7ff078) "' name='RPMH_ARC_SEQ_MEM_30'/>"
WRITE #1 "        <register address='0xb7ff07c' value='0x" DATA.LONG(A:0x7ff07c) "' name='RPMH_ARC_SEQ_MEM_31'/>"
WRITE #1 "        <register address='0xb7ff080' value='0x" DATA.LONG(A:0x7ff080) "' name='RPMH_ARC_SEQ_MEM_32'/>"
WRITE #1 "        <register address='0xb7ff084' value='0x" DATA.LONG(A:0x7ff084) "' name='RPMH_ARC_SEQ_MEM_33'/>"
WRITE #1 "        <register address='0xb7ff088' value='0x" DATA.LONG(A:0x7ff088) "' name='RPMH_ARC_SEQ_MEM_34'/>"
WRITE #1 "        <register address='0xb7ff08c' value='0x" DATA.LONG(A:0x7ff08c) "' name='RPMH_ARC_SEQ_MEM_35'/>"
WRITE #1 "        <register address='0xb7ff090' value='0x" DATA.LONG(A:0x7ff090) "' name='RPMH_ARC_SEQ_MEM_36'/>"
WRITE #1 "        <register address='0xb7ff094' value='0x" DATA.LONG(A:0x7ff094) "' name='RPMH_ARC_SEQ_MEM_37'/>"
WRITE #1 "        <register address='0xb7ff098' value='0x" DATA.LONG(A:0x7ff098) "' name='RPMH_ARC_SEQ_MEM_38'/>"
WRITE #1 "        <register address='0xb7ff09c' value='0x" DATA.LONG(A:0x7ff09c) "' name='RPMH_ARC_SEQ_MEM_39'/>"
WRITE #1 "        <register address='0xb7ff0a0' value='0x" DATA.LONG(A:0x7ff0a0) "' name='RPMH_ARC_SEQ_MEM_40'/>"
WRITE #1 "        <register address='0xb7ff0a4' value='0x" DATA.LONG(A:0x7ff0a4) "' name='RPMH_ARC_SEQ_MEM_41'/>"
WRITE #1 "        <register address='0xb7ff0a8' value='0x" DATA.LONG(A:0x7ff0a8) "' name='RPMH_ARC_SEQ_MEM_42'/>"
WRITE #1 "        <register address='0xb7ff0ac' value='0x" DATA.LONG(A:0x7ff0ac) "' name='RPMH_ARC_SEQ_MEM_43'/>"
WRITE #1 "        <register address='0xb7ff0b0' value='0x" DATA.LONG(A:0x7ff0b0) "' name='RPMH_ARC_SEQ_MEM_44'/>"
WRITE #1 "        <register address='0xb7ff0b4' value='0x" DATA.LONG(A:0x7ff0b4) "' name='RPMH_ARC_SEQ_MEM_45'/>"
WRITE #1 "        <register address='0xb7ff0b8' value='0x" DATA.LONG(A:0x7ff0b8) "' name='RPMH_ARC_SEQ_MEM_46'/>"
WRITE #1 "        <register address='0xb7ff0bc' value='0x" DATA.LONG(A:0x7ff0bc) "' name='RPMH_ARC_SEQ_MEM_47'/>"
WRITE #1 "        <register address='0xb7ff0c0' value='0x" DATA.LONG(A:0x7ff0c0) "' name='RPMH_ARC_SEQ_MEM_48'/>"
WRITE #1 "        <register address='0xb7ff0c4' value='0x" DATA.LONG(A:0x7ff0c4) "' name='RPMH_ARC_SEQ_MEM_49'/>"
WRITE #1 "        <register address='0xb7ff0c8' value='0x" DATA.LONG(A:0x7ff0c8) "' name='RPMH_ARC_SEQ_MEM_50'/>"
WRITE #1 "        <register address='0xb7ff0cc' value='0x" DATA.LONG(A:0x7ff0cc) "' name='RPMH_ARC_SEQ_MEM_51'/>"
WRITE #1 "        <register address='0xb7ff0d0' value='0x" DATA.LONG(A:0x7ff0d0) "' name='RPMH_ARC_SEQ_MEM_52'/>"
WRITE #1 "        <register address='0xb7ff0d4' value='0x" DATA.LONG(A:0x7ff0d4) "' name='RPMH_ARC_SEQ_MEM_53'/>"
WRITE #1 "        <register address='0xb7ff0d8' value='0x" DATA.LONG(A:0x7ff0d8) "' name='RPMH_ARC_SEQ_MEM_54'/>"
WRITE #1 "        <register address='0xb7ff0dc' value='0x" DATA.LONG(A:0x7ff0dc) "' name='RPMH_ARC_SEQ_MEM_55'/>"
WRITE #1 "        <register address='0xb7ff0e0' value='0x" DATA.LONG(A:0x7ff0e0) "' name='RPMH_ARC_SEQ_MEM_56'/>"
WRITE #1 "        <register address='0xb7ff0e4' value='0x" DATA.LONG(A:0x7ff0e4) "' name='RPMH_ARC_SEQ_MEM_57'/>"
WRITE #1 "        <register address='0xb7ff0e8' value='0x" DATA.LONG(A:0x7ff0e8) "' name='RPMH_ARC_SEQ_MEM_58'/>"
WRITE #1 "        <register address='0xb7ff0ec' value='0x" DATA.LONG(A:0x7ff0ec) "' name='RPMH_ARC_SEQ_MEM_59'/>"
WRITE #1 "        <register address='0xb7ff0f0' value='0x" DATA.LONG(A:0x7ff0f0) "' name='RPMH_ARC_SEQ_MEM_60'/>"
WRITE #1 "        <register address='0xb7ff0f4' value='0x" DATA.LONG(A:0x7ff0f4) "' name='RPMH_ARC_SEQ_MEM_61'/>"
WRITE #1 "        <register address='0xb7ff0f8' value='0x" DATA.LONG(A:0x7ff0f8) "' name='RPMH_ARC_SEQ_MEM_62'/>"
WRITE #1 "        <register address='0xb7ff0fc' value='0x" DATA.LONG(A:0x7ff0fc) "' name='RPMH_ARC_SEQ_MEM_63'/>"
WRITE #1 "        <register address='0xb7ff100' value='0x" DATA.LONG(A:0x7ff100) "' name='RPMH_ARC_SEQ_MEM_64'/>"
WRITE #1 "        <register address='0xb7ff104' value='0x" DATA.LONG(A:0x7ff104) "' name='RPMH_ARC_SEQ_MEM_65'/>"
WRITE #1 "        <register address='0xb7ff108' value='0x" DATA.LONG(A:0x7ff108) "' name='RPMH_ARC_SEQ_MEM_66'/>"
WRITE #1 "        <register address='0xb7ff10c' value='0x" DATA.LONG(A:0x7ff10c) "' name='RPMH_ARC_SEQ_MEM_67'/>"
WRITE #1 "        <register address='0xb7ff110' value='0x" DATA.LONG(A:0x7ff110) "' name='RPMH_ARC_SEQ_MEM_68'/>"
WRITE #1 "        <register address='0xb7ff114' value='0x" DATA.LONG(A:0x7ff114) "' name='RPMH_ARC_SEQ_MEM_69'/>"
WRITE #1 "        <register address='0xb7ff118' value='0x" DATA.LONG(A:0x7ff118) "' name='RPMH_ARC_SEQ_MEM_70'/>"
WRITE #1 "        <register address='0xb7ff11c' value='0x" DATA.LONG(A:0x7ff11c) "' name='RPMH_ARC_SEQ_MEM_71'/>"
WRITE #1 "        <register address='0xb7ff120' value='0x" DATA.LONG(A:0x7ff120) "' name='RPMH_ARC_SEQ_MEM_72'/>"
WRITE #1 "        <register address='0xb7ff124' value='0x" DATA.LONG(A:0x7ff124) "' name='RPMH_ARC_SEQ_MEM_73'/>"
WRITE #1 "        <register address='0xb7ff128' value='0x" DATA.LONG(A:0x7ff128) "' name='RPMH_ARC_SEQ_MEM_74'/>"
WRITE #1 "        <register address='0xb7ff12c' value='0x" DATA.LONG(A:0x7ff12c) "' name='RPMH_ARC_SEQ_MEM_75'/>"
WRITE #1 "        <register address='0xb7ff130' value='0x" DATA.LONG(A:0x7ff130) "' name='RPMH_ARC_SEQ_MEM_76'/>"
WRITE #1 "        <register address='0xb7ff134' value='0x" DATA.LONG(A:0x7ff134) "' name='RPMH_ARC_SEQ_MEM_77'/>"
WRITE #1 "        <register address='0xb7ff138' value='0x" DATA.LONG(A:0x7ff138) "' name='RPMH_ARC_SEQ_MEM_78'/>"
WRITE #1 "        <register address='0xb7ff13c' value='0x" DATA.LONG(A:0x7ff13c) "' name='RPMH_ARC_SEQ_MEM_79'/>"
WRITE #1 "        <register address='0xb7ff140' value='0x" DATA.LONG(A:0x7ff140) "' name='RPMH_ARC_SEQ_MEM_80'/>"
WRITE #1 "        <register address='0xb7ff144' value='0x" DATA.LONG(A:0x7ff144) "' name='RPMH_ARC_SEQ_MEM_81'/>"
WRITE #1 "        <register address='0xb7ff148' value='0x" DATA.LONG(A:0x7ff148) "' name='RPMH_ARC_SEQ_MEM_82'/>"
WRITE #1 "        <register address='0xb7ff14c' value='0x" DATA.LONG(A:0x7ff14c) "' name='RPMH_ARC_SEQ_MEM_83'/>"
WRITE #1 "        <register address='0xb7ff150' value='0x" DATA.LONG(A:0x7ff150) "' name='RPMH_ARC_SEQ_MEM_84'/>"
WRITE #1 "        <register address='0xb7ff154' value='0x" DATA.LONG(A:0x7ff154) "' name='RPMH_ARC_SEQ_MEM_85'/>"
WRITE #1 "        <register address='0xb7ff158' value='0x" DATA.LONG(A:0x7ff158) "' name='RPMH_ARC_SEQ_MEM_86'/>"
WRITE #1 "        <register address='0xb7ff15c' value='0x" DATA.LONG(A:0x7ff15c) "' name='RPMH_ARC_SEQ_MEM_87'/>"
WRITE #1 "        <register address='0xb7ff160' value='0x" DATA.LONG(A:0x7ff160) "' name='RPMH_ARC_SEQ_MEM_88'/>"
WRITE #1 "        <register address='0xb7ff164' value='0x" DATA.LONG(A:0x7ff164) "' name='RPMH_ARC_SEQ_MEM_89'/>"
WRITE #1 "        <register address='0xb7ff168' value='0x" DATA.LONG(A:0x7ff168) "' name='RPMH_ARC_SEQ_MEM_90'/>"
WRITE #1 "        <register address='0xb7ff16c' value='0x" DATA.LONG(A:0x7ff16c) "' name='RPMH_ARC_SEQ_MEM_91'/>"
WRITE #1 "        <register address='0xb7ff170' value='0x" DATA.LONG(A:0x7ff170) "' name='RPMH_ARC_SEQ_MEM_92'/>"
WRITE #1 "        <register address='0xb7ff174' value='0x" DATA.LONG(A:0x7ff174) "' name='RPMH_ARC_SEQ_MEM_93'/>"
WRITE #1 "        <register address='0xb7ff178' value='0x" DATA.LONG(A:0x7ff178) "' name='RPMH_ARC_SEQ_MEM_94'/>"
WRITE #1 "        <register address='0xb7ff17c' value='0x" DATA.LONG(A:0x7ff17c) "' name='RPMH_ARC_SEQ_MEM_95'/>"
WRITE #1 "        <register address='0xb200000' value='0x" DATA.LONG(A:0x200000) "' name='RPMH_PDC_APPS_VOTE_CMP_DATA_DRV0'/>"
WRITE #1 "        <register address='0xb210000' value='0x" DATA.LONG(A:0x210000) "' name='RPMH_PDC_APPS_VOTE_CMP_DATA_DRV1'/>"
WRITE #1 "        <register address='0xb220000' value='0x" DATA.LONG(A:0x220000) "' name='RPMH_PDC_APPS_VOTE_CMP_DATA_DRV2'/>"
WRITE #1 "        <register address='0xb200010' value='0x" DATA.LONG(A:0x200010) "' name='RPMH_PDC_APPS_IRQ_ENABLE_BANK0_DRV0'/>"
WRITE #1 "        <register address='0xb200014' value='0x" DATA.LONG(A:0x200014) "' name='RPMH_PDC_APPS_IRQ_ENABLE_BANK1_DRV0'/>"
WRITE #1 "        <register address='0xb200018' value='0x" DATA.LONG(A:0x200018) "' name='RPMH_PDC_APPS_IRQ_ENABLE_BANK2_DRV0'/>"
WRITE #1 "        <register address='0xb20001c' value='0x" DATA.LONG(A:0x20001c) "' name='RPMH_PDC_APPS_IRQ_ENABLE_BANK3_DRV0'/>"
WRITE #1 "        <register address='0xb210010' value='0x" DATA.LONG(A:0x210010) "' name='RPMH_PDC_APPS_IRQ_ENABLE_BANK0_DRV1'/>"
WRITE #1 "        <register address='0xb210014' value='0x" DATA.LONG(A:0x210014) "' name='RPMH_PDC_APPS_IRQ_ENABLE_BANK1_DRV1'/>"
WRITE #1 "        <register address='0xb210018' value='0x" DATA.LONG(A:0x210018) "' name='RPMH_PDC_APPS_IRQ_ENABLE_BANK2_DRV1'/>"
WRITE #1 "        <register address='0xb21001c' value='0x" DATA.LONG(A:0x21001c) "' name='RPMH_PDC_APPS_IRQ_ENABLE_BANK3_DRV1'/>"
WRITE #1 "        <register address='0xb220010' value='0x" DATA.LONG(A:0x220010) "' name='RPMH_PDC_APPS_IRQ_ENABLE_BANK0_DRV2'/>"
WRITE #1 "        <register address='0xb220014' value='0x" DATA.LONG(A:0x220014) "' name='RPMH_PDC_APPS_IRQ_ENABLE_BANK1_DRV2'/>"
WRITE #1 "        <register address='0xb220018' value='0x" DATA.LONG(A:0x220018) "' name='RPMH_PDC_APPS_IRQ_ENABLE_BANK2_DRV2'/>"
WRITE #1 "        <register address='0xb22001c' value='0x" DATA.LONG(A:0x22001c) "' name='RPMH_PDC_APPS_IRQ_ENABLE_BANK3_DRV2'/>"
WRITE #1 "        <register address='0xb200110' value='0x" DATA.LONG(A:0x200110) "' name='RPMH_PDC_APPS_IRQ_0_CFG_DRV0'/>"
WRITE #1 "        <register address='0xb200114' value='0x" DATA.LONG(A:0x200114) "' name='RPMH_PDC_APPS_IRQ_1_CFG_DRV0'/>"
WRITE #1 "        <register address='0xb200118' value='0x" DATA.LONG(A:0x200118) "' name='RPMH_PDC_APPS_IRQ_2_CFG_DRV0'/>"
WRITE #1 "        <register address='0xb20011c' value='0x" DATA.LONG(A:0x20011c) "' name='RPMH_PDC_APPS_IRQ_3_CFG_DRV0'/>"
WRITE #1 "        <register address='0xb200120' value='0x" DATA.LONG(A:0x200120) "' name='RPMH_PDC_APPS_IRQ_4_CFG_DRV0'/>"
WRITE #1 "        <register address='0xb200124' value='0x" DATA.LONG(A:0x200124) "' name='RPMH_PDC_APPS_IRQ_5_CFG_DRV0'/>"
WRITE #1 "        <register address='0xb200128' value='0x" DATA.LONG(A:0x200128) "' name='RPMH_PDC_APPS_IRQ_6_CFG_DRV0'/>"
WRITE #1 "        <register address='0xb20012c' value='0x" DATA.LONG(A:0x20012c) "' name='RPMH_PDC_APPS_IRQ_7_CFG_DRV0'/>"
WRITE #1 "        <register address='0xb200130' value='0x" DATA.LONG(A:0x200130) "' name='RPMH_PDC_APPS_IRQ_8_CFG_DRV0'/>"
WRITE #1 "        <register address='0xb200134' value='0x" DATA.LONG(A:0x200134) "' name='RPMH_PDC_APPS_IRQ_9_CFG_DRV0'/>"
WRITE #1 "        <register address='0xb200138' value='0x" DATA.LONG(A:0x200138) "' name='RPMH_PDC_APPS_IRQ_10_CFG_DRV0'/>"
WRITE #1 "        <register address='0xb20013c' value='0x" DATA.LONG(A:0x20013c) "' name='RPMH_PDC_APPS_IRQ_11_CFG_DRV0'/>"
WRITE #1 "        <register address='0xb200140' value='0x" DATA.LONG(A:0x200140) "' name='RPMH_PDC_APPS_IRQ_12_CFG_DRV0'/>"
WRITE #1 "        <register address='0xb200144' value='0x" DATA.LONG(A:0x200144) "' name='RPMH_PDC_APPS_IRQ_13_CFG_DRV0'/>"
WRITE #1 "        <register address='0xb200148' value='0x" DATA.LONG(A:0x200148) "' name='RPMH_PDC_APPS_IRQ_14_CFG_DRV0'/>"
WRITE #1 "        <register address='0xb20014c' value='0x" DATA.LONG(A:0x20014c) "' name='RPMH_PDC_APPS_IRQ_15_CFG_DRV0'/>"
WRITE #1 "        <register address='0xb200150' value='0x" DATA.LONG(A:0x200150) "' name='RPMH_PDC_APPS_IRQ_16_CFG_DRV0'/>"
WRITE #1 "        <register address='0xb200154' value='0x" DATA.LONG(A:0x200154) "' name='RPMH_PDC_APPS_IRQ_17_CFG_DRV0'/>"
WRITE #1 "        <register address='0xb200158' value='0x" DATA.LONG(A:0x200158) "' name='RPMH_PDC_APPS_IRQ_18_CFG_DRV0'/>"
WRITE #1 "        <register address='0xb20015c' value='0x" DATA.LONG(A:0x20015c) "' name='RPMH_PDC_APPS_IRQ_19_CFG_DRV0'/>"
WRITE #1 "        <register address='0xb200160' value='0x" DATA.LONG(A:0x200160) "' name='RPMH_PDC_APPS_IRQ_20_CFG_DRV0'/>"
WRITE #1 "        <register address='0xb200164' value='0x" DATA.LONG(A:0x200164) "' name='RPMH_PDC_APPS_IRQ_21_CFG_DRV0'/>"
WRITE #1 "        <register address='0xb200168' value='0x" DATA.LONG(A:0x200168) "' name='RPMH_PDC_APPS_IRQ_22_CFG_DRV0'/>"
WRITE #1 "        <register address='0xb20016c' value='0x" DATA.LONG(A:0x20016c) "' name='RPMH_PDC_APPS_IRQ_23_CFG_DRV0'/>"
WRITE #1 "        <register address='0xb200170' value='0x" DATA.LONG(A:0x200170) "' name='RPMH_PDC_APPS_IRQ_24_CFG_DRV0'/>"
WRITE #1 "        <register address='0xb200174' value='0x" DATA.LONG(A:0x200174) "' name='RPMH_PDC_APPS_IRQ_25_CFG_DRV0'/>"
WRITE #1 "        <register address='0xb200178' value='0x" DATA.LONG(A:0x200178) "' name='RPMH_PDC_APPS_IRQ_26_CFG_DRV0'/>"
WRITE #1 "        <register address='0xb20017c' value='0x" DATA.LONG(A:0x20017c) "' name='RPMH_PDC_APPS_IRQ_27_CFG_DRV0'/>"
WRITE #1 "        <register address='0xb200180' value='0x" DATA.LONG(A:0x200180) "' name='RPMH_PDC_APPS_IRQ_28_CFG_DRV0'/>"
WRITE #1 "        <register address='0xb200184' value='0x" DATA.LONG(A:0x200184) "' name='RPMH_PDC_APPS_IRQ_29_CFG_DRV0'/>"
WRITE #1 "        <register address='0xb200188' value='0x" DATA.LONG(A:0x200188) "' name='RPMH_PDC_APPS_IRQ_30_CFG_DRV0'/>"
WRITE #1 "        <register address='0xb20018c' value='0x" DATA.LONG(A:0x20018c) "' name='RPMH_PDC_APPS_IRQ_31_CFG_DRV0'/>"
WRITE #1 "        <register address='0xb200190' value='0x" DATA.LONG(A:0x200190) "' name='RPMH_PDC_APPS_IRQ_32_CFG_DRV0'/>"
WRITE #1 "        <register address='0xb200194' value='0x" DATA.LONG(A:0x200194) "' name='RPMH_PDC_APPS_IRQ_33_CFG_DRV0'/>"
WRITE #1 "        <register address='0xb200198' value='0x" DATA.LONG(A:0x200198) "' name='RPMH_PDC_APPS_IRQ_34_CFG_DRV0'/>"
WRITE #1 "        <register address='0xb20019c' value='0x" DATA.LONG(A:0x20019c) "' name='RPMH_PDC_APPS_IRQ_35_CFG_DRV0'/>"
WRITE #1 "        <register address='0xb2001a0' value='0x" DATA.LONG(A:0x2001a0) "' name='RPMH_PDC_APPS_IRQ_36_CFG_DRV0'/>"
WRITE #1 "        <register address='0xb2001a4' value='0x" DATA.LONG(A:0x2001a4) "' name='RPMH_PDC_APPS_IRQ_37_CFG_DRV0'/>"
WRITE #1 "        <register address='0xb2001a8' value='0x" DATA.LONG(A:0x2001a8) "' name='RPMH_PDC_APPS_IRQ_38_CFG_DRV0'/>"
WRITE #1 "        <register address='0xb2001ac' value='0x" DATA.LONG(A:0x2001ac) "' name='RPMH_PDC_APPS_IRQ_39_CFG_DRV0'/>"
WRITE #1 "        <register address='0xb2001b0' value='0x" DATA.LONG(A:0x2001b0) "' name='RPMH_PDC_APPS_IRQ_40_CFG_DRV0'/>"
WRITE #1 "        <register address='0xb2001b4' value='0x" DATA.LONG(A:0x2001b4) "' name='RPMH_PDC_APPS_IRQ_41_CFG_DRV0'/>"
WRITE #1 "        <register address='0xb2001b8' value='0x" DATA.LONG(A:0x2001b8) "' name='RPMH_PDC_APPS_IRQ_42_CFG_DRV0'/>"
WRITE #1 "        <register address='0xb2001bc' value='0x" DATA.LONG(A:0x2001bc) "' name='RPMH_PDC_APPS_IRQ_43_CFG_DRV0'/>"
WRITE #1 "        <register address='0xb2001c0' value='0x" DATA.LONG(A:0x2001c0) "' name='RPMH_PDC_APPS_IRQ_44_CFG_DRV0'/>"
WRITE #1 "        <register address='0xb2001c4' value='0x" DATA.LONG(A:0x2001c4) "' name='RPMH_PDC_APPS_IRQ_45_CFG_DRV0'/>"
WRITE #1 "        <register address='0xb2001c8' value='0x" DATA.LONG(A:0x2001c8) "' name='RPMH_PDC_APPS_IRQ_46_CFG_DRV0'/>"
WRITE #1 "        <register address='0xb2001cc' value='0x" DATA.LONG(A:0x2001cc) "' name='RPMH_PDC_APPS_IRQ_47_CFG_DRV0'/>"
WRITE #1 "        <register address='0xb2001d0' value='0x" DATA.LONG(A:0x2001d0) "' name='RPMH_PDC_APPS_IRQ_48_CFG_DRV0'/>"
WRITE #1 "        <register address='0xb2001d4' value='0x" DATA.LONG(A:0x2001d4) "' name='RPMH_PDC_APPS_IRQ_49_CFG_DRV0'/>"
WRITE #1 "        <register address='0xb2001d8' value='0x" DATA.LONG(A:0x2001d8) "' name='RPMH_PDC_APPS_IRQ_50_CFG_DRV0'/>"
WRITE #1 "        <register address='0xb2001dc' value='0x" DATA.LONG(A:0x2001dc) "' name='RPMH_PDC_APPS_IRQ_51_CFG_DRV0'/>"
WRITE #1 "        <register address='0xb2001e0' value='0x" DATA.LONG(A:0x2001e0) "' name='RPMH_PDC_APPS_IRQ_52_CFG_DRV0'/>"
WRITE #1 "        <register address='0xb2001e4' value='0x" DATA.LONG(A:0x2001e4) "' name='RPMH_PDC_APPS_IRQ_53_CFG_DRV0'/>"
WRITE #1 "        <register address='0xb2001e8' value='0x" DATA.LONG(A:0x2001e8) "' name='RPMH_PDC_APPS_IRQ_54_CFG_DRV0'/>"
WRITE #1 "        <register address='0xb2001ec' value='0x" DATA.LONG(A:0x2001ec) "' name='RPMH_PDC_APPS_IRQ_55_CFG_DRV0'/>"
WRITE #1 "        <register address='0xb2001f0' value='0x" DATA.LONG(A:0x2001f0) "' name='RPMH_PDC_APPS_IRQ_56_CFG_DRV0'/>"
WRITE #1 "        <register address='0xb2001f4' value='0x" DATA.LONG(A:0x2001f4) "' name='RPMH_PDC_APPS_IRQ_57_CFG_DRV0'/>"
WRITE #1 "        <register address='0xb2001f8' value='0x" DATA.LONG(A:0x2001f8) "' name='RPMH_PDC_APPS_IRQ_58_CFG_DRV0'/>"
WRITE #1 "        <register address='0xb2001fc' value='0x" DATA.LONG(A:0x2001fc) "' name='RPMH_PDC_APPS_IRQ_59_CFG_DRV0'/>"
WRITE #1 "        <register address='0xb200200' value='0x" DATA.LONG(A:0x200200) "' name='RPMH_PDC_APPS_IRQ_60_CFG_DRV0'/>"
WRITE #1 "        <register address='0xb200204' value='0x" DATA.LONG(A:0x200204) "' name='RPMH_PDC_APPS_IRQ_61_CFG_DRV0'/>"
WRITE #1 "        <register address='0xb200208' value='0x" DATA.LONG(A:0x200208) "' name='RPMH_PDC_APPS_IRQ_62_CFG_DRV0'/>"
WRITE #1 "        <register address='0xb20020c' value='0x" DATA.LONG(A:0x20020c) "' name='RPMH_PDC_APPS_IRQ_63_CFG_DRV0'/>"
WRITE #1 "        <register address='0xb200210' value='0x" DATA.LONG(A:0x200210) "' name='RPMH_PDC_APPS_IRQ_64_CFG_DRV0'/>"
WRITE #1 "        <register address='0xb200214' value='0x" DATA.LONG(A:0x200214) "' name='RPMH_PDC_APPS_IRQ_65_CFG_DRV0'/>"
WRITE #1 "        <register address='0xb200218' value='0x" DATA.LONG(A:0x200218) "' name='RPMH_PDC_APPS_IRQ_66_CFG_DRV0'/>"
WRITE #1 "        <register address='0xb20021c' value='0x" DATA.LONG(A:0x20021c) "' name='RPMH_PDC_APPS_IRQ_67_CFG_DRV0'/>"
WRITE #1 "        <register address='0xb200220' value='0x" DATA.LONG(A:0x200220) "' name='RPMH_PDC_APPS_IRQ_68_CFG_DRV0'/>"
WRITE #1 "        <register address='0xb200224' value='0x" DATA.LONG(A:0x200224) "' name='RPMH_PDC_APPS_IRQ_69_CFG_DRV0'/>"
WRITE #1 "        <register address='0xb200228' value='0x" DATA.LONG(A:0x200228) "' name='RPMH_PDC_APPS_IRQ_70_CFG_DRV0'/>"
WRITE #1 "        <register address='0xb20022c' value='0x" DATA.LONG(A:0x20022c) "' name='RPMH_PDC_APPS_IRQ_71_CFG_DRV0'/>"
WRITE #1 "        <register address='0xb200230' value='0x" DATA.LONG(A:0x200230) "' name='RPMH_PDC_APPS_IRQ_72_CFG_DRV0'/>"
WRITE #1 "        <register address='0xb200234' value='0x" DATA.LONG(A:0x200234) "' name='RPMH_PDC_APPS_IRQ_73_CFG_DRV0'/>"
WRITE #1 "        <register address='0xb200238' value='0x" DATA.LONG(A:0x200238) "' name='RPMH_PDC_APPS_IRQ_74_CFG_DRV0'/>"
WRITE #1 "        <register address='0xb20023c' value='0x" DATA.LONG(A:0x20023c) "' name='RPMH_PDC_APPS_IRQ_75_CFG_DRV0'/>"
WRITE #1 "        <register address='0xb200240' value='0x" DATA.LONG(A:0x200240) "' name='RPMH_PDC_APPS_IRQ_76_CFG_DRV0'/>"
WRITE #1 "        <register address='0xb200244' value='0x" DATA.LONG(A:0x200244) "' name='RPMH_PDC_APPS_IRQ_77_CFG_DRV0'/>"
WRITE #1 "        <register address='0xb200248' value='0x" DATA.LONG(A:0x200248) "' name='RPMH_PDC_APPS_IRQ_78_CFG_DRV0'/>"
WRITE #1 "        <register address='0xb20024c' value='0x" DATA.LONG(A:0x20024c) "' name='RPMH_PDC_APPS_IRQ_79_CFG_DRV0'/>"
WRITE #1 "        <register address='0xb200250' value='0x" DATA.LONG(A:0x200250) "' name='RPMH_PDC_APPS_IRQ_80_CFG_DRV0'/>"
WRITE #1 "        <register address='0xb200254' value='0x" DATA.LONG(A:0x200254) "' name='RPMH_PDC_APPS_IRQ_81_CFG_DRV0'/>"
WRITE #1 "        <register address='0xb200258' value='0x" DATA.LONG(A:0x200258) "' name='RPMH_PDC_APPS_IRQ_82_CFG_DRV0'/>"
WRITE #1 "        <register address='0xb20025c' value='0x" DATA.LONG(A:0x20025c) "' name='RPMH_PDC_APPS_IRQ_83_CFG_DRV0'/>"
WRITE #1 "        <register address='0xb200260' value='0x" DATA.LONG(A:0x200260) "' name='RPMH_PDC_APPS_IRQ_84_CFG_DRV0'/>"
WRITE #1 "        <register address='0xb200264' value='0x" DATA.LONG(A:0x200264) "' name='RPMH_PDC_APPS_IRQ_85_CFG_DRV0'/>"
WRITE #1 "        <register address='0xb200268' value='0x" DATA.LONG(A:0x200268) "' name='RPMH_PDC_APPS_IRQ_86_CFG_DRV0'/>"
WRITE #1 "        <register address='0xb20026c' value='0x" DATA.LONG(A:0x20026c) "' name='RPMH_PDC_APPS_IRQ_87_CFG_DRV0'/>"
WRITE #1 "        <register address='0xb200270' value='0x" DATA.LONG(A:0x200270) "' name='RPMH_PDC_APPS_IRQ_88_CFG_DRV0'/>"
WRITE #1 "        <register address='0xb200274' value='0x" DATA.LONG(A:0x200274) "' name='RPMH_PDC_APPS_IRQ_89_CFG_DRV0'/>"
WRITE #1 "        <register address='0xb200278' value='0x" DATA.LONG(A:0x200278) "' name='RPMH_PDC_APPS_IRQ_90_CFG_DRV0'/>"
WRITE #1 "        <register address='0xb20027c' value='0x" DATA.LONG(A:0x20027c) "' name='RPMH_PDC_APPS_IRQ_91_CFG_DRV0'/>"
WRITE #1 "        <register address='0xb200280' value='0x" DATA.LONG(A:0x200280) "' name='RPMH_PDC_APPS_IRQ_92_CFG_DRV0'/>"
WRITE #1 "        <register address='0xb200284' value='0x" DATA.LONG(A:0x200284) "' name='RPMH_PDC_APPS_IRQ_93_CFG_DRV0'/>"
WRITE #1 "        <register address='0xb200288' value='0x" DATA.LONG(A:0x200288) "' name='RPMH_PDC_APPS_IRQ_94_CFG_DRV0'/>"
WRITE #1 "        <register address='0xb20028c' value='0x" DATA.LONG(A:0x20028c) "' name='RPMH_PDC_APPS_IRQ_95_CFG_DRV0'/>"
WRITE #1 "        <register address='0xb200290' value='0x" DATA.LONG(A:0x200290) "' name='RPMH_PDC_APPS_IRQ_96_CFG_DRV0'/>"
WRITE #1 "        <register address='0xb200294' value='0x" DATA.LONG(A:0x200294) "' name='RPMH_PDC_APPS_IRQ_97_CFG_DRV0'/>"
WRITE #1 "        <register address='0xb200298' value='0x" DATA.LONG(A:0x200298) "' name='RPMH_PDC_APPS_IRQ_98_CFG_DRV0'/>"
WRITE #1 "        <register address='0xb20029c' value='0x" DATA.LONG(A:0x20029c) "' name='RPMH_PDC_APPS_IRQ_99_CFG_DRV0'/>"
WRITE #1 "        <register address='0xb2002a0' value='0x" DATA.LONG(A:0x2002a0) "' name='RPMH_PDC_APPS_IRQ_100_CFG_DRV0'/>"
WRITE #1 "        <register address='0xb2002a4' value='0x" DATA.LONG(A:0x2002a4) "' name='RPMH_PDC_APPS_IRQ_101_CFG_DRV0'/>"
WRITE #1 "        <register address='0xb2002a8' value='0x" DATA.LONG(A:0x2002a8) "' name='RPMH_PDC_APPS_IRQ_102_CFG_DRV0'/>"
WRITE #1 "        <register address='0xb2002ac' value='0x" DATA.LONG(A:0x2002ac) "' name='RPMH_PDC_APPS_IRQ_103_CFG_DRV0'/>"
WRITE #1 "        <register address='0xb2002b0' value='0x" DATA.LONG(A:0x2002b0) "' name='RPMH_PDC_APPS_IRQ_104_CFG_DRV0'/>"
WRITE #1 "        <register address='0xb2002b4' value='0x" DATA.LONG(A:0x2002b4) "' name='RPMH_PDC_APPS_IRQ_105_CFG_DRV0'/>"
WRITE #1 "        <register address='0xb2002b8' value='0x" DATA.LONG(A:0x2002b8) "' name='RPMH_PDC_APPS_IRQ_106_CFG_DRV0'/>"
WRITE #1 "        <register address='0xb2002bc' value='0x" DATA.LONG(A:0x2002bc) "' name='RPMH_PDC_APPS_IRQ_107_CFG_DRV0'/>"
WRITE #1 "        <register address='0xb2002c0' value='0x" DATA.LONG(A:0x2002c0) "' name='RPMH_PDC_APPS_IRQ_108_CFG_DRV0'/>"
WRITE #1 "        <register address='0xb2002c4' value='0x" DATA.LONG(A:0x2002c4) "' name='RPMH_PDC_APPS_IRQ_109_CFG_DRV0'/>"
WRITE #1 "        <register address='0xb2002c8' value='0x" DATA.LONG(A:0x2002c8) "' name='RPMH_PDC_APPS_IRQ_110_CFG_DRV0'/>"
WRITE #1 "        <register address='0xb2002cc' value='0x" DATA.LONG(A:0x2002cc) "' name='RPMH_PDC_APPS_IRQ_111_CFG_DRV0'/>"
WRITE #1 "        <register address='0xb2002d0' value='0x" DATA.LONG(A:0x2002d0) "' name='RPMH_PDC_APPS_IRQ_112_CFG_DRV0'/>"
WRITE #1 "        <register address='0xb2002d4' value='0x" DATA.LONG(A:0x2002d4) "' name='RPMH_PDC_APPS_IRQ_113_CFG_DRV0'/>"
WRITE #1 "        <register address='0xb2002d8' value='0x" DATA.LONG(A:0x2002d8) "' name='RPMH_PDC_APPS_IRQ_114_CFG_DRV0'/>"
WRITE #1 "        <register address='0xb2002dc' value='0x" DATA.LONG(A:0x2002dc) "' name='RPMH_PDC_APPS_IRQ_115_CFG_DRV0'/>"
WRITE #1 "        <register address='0xb2002e0' value='0x" DATA.LONG(A:0x2002e0) "' name='RPMH_PDC_APPS_IRQ_116_CFG_DRV0'/>"
WRITE #1 "        <register address='0xb2002e4' value='0x" DATA.LONG(A:0x2002e4) "' name='RPMH_PDC_APPS_IRQ_117_CFG_DRV0'/>"
WRITE #1 "        <register address='0xb2002e8' value='0x" DATA.LONG(A:0x2002e8) "' name='RPMH_PDC_APPS_IRQ_118_CFG_DRV0'/>"
WRITE #1 "        <register address='0xb2002ec' value='0x" DATA.LONG(A:0x2002ec) "' name='RPMH_PDC_APPS_IRQ_119_CFG_DRV0'/>"
WRITE #1 "        <register address='0xb2002f0' value='0x" DATA.LONG(A:0x2002f0) "' name='RPMH_PDC_APPS_IRQ_120_CFG_DRV0'/>"
WRITE #1 "        <register address='0xb2002f4' value='0x" DATA.LONG(A:0x2002f4) "' name='RPMH_PDC_APPS_IRQ_121_CFG_DRV0'/>"
WRITE #1 "        <register address='0xb2002f8' value='0x" DATA.LONG(A:0x2002f8) "' name='RPMH_PDC_APPS_IRQ_122_CFG_DRV0'/>"
WRITE #1 "        <register address='0xb2002fc' value='0x" DATA.LONG(A:0x2002fc) "' name='RPMH_PDC_APPS_IRQ_123_CFG_DRV0'/>"
WRITE #1 "        <register address='0xb200300' value='0x" DATA.LONG(A:0x200300) "' name='RPMH_PDC_APPS_IRQ_124_CFG_DRV0'/>"
WRITE #1 "        <register address='0xb200304' value='0x" DATA.LONG(A:0x200304) "' name='RPMH_PDC_APPS_IRQ_125_CFG_DRV0'/>"
WRITE #1 "        <register address='0xb210110' value='0x" DATA.LONG(A:0x210110) "' name='RPMH_PDC_APPS_IRQ_0_CFG_DRV1'/>"
WRITE #1 "        <register address='0xb210114' value='0x" DATA.LONG(A:0x210114) "' name='RPMH_PDC_APPS_IRQ_1_CFG_DRV1'/>"
WRITE #1 "        <register address='0xb210118' value='0x" DATA.LONG(A:0x210118) "' name='RPMH_PDC_APPS_IRQ_2_CFG_DRV1'/>"
WRITE #1 "        <register address='0xb21011c' value='0x" DATA.LONG(A:0x21011c) "' name='RPMH_PDC_APPS_IRQ_3_CFG_DRV1'/>"
WRITE #1 "        <register address='0xb210120' value='0x" DATA.LONG(A:0x210120) "' name='RPMH_PDC_APPS_IRQ_4_CFG_DRV1'/>"
WRITE #1 "        <register address='0xb210124' value='0x" DATA.LONG(A:0x210124) "' name='RPMH_PDC_APPS_IRQ_5_CFG_DRV1'/>"
WRITE #1 "        <register address='0xb210128' value='0x" DATA.LONG(A:0x210128) "' name='RPMH_PDC_APPS_IRQ_6_CFG_DRV1'/>"
WRITE #1 "        <register address='0xb21012c' value='0x" DATA.LONG(A:0x21012c) "' name='RPMH_PDC_APPS_IRQ_7_CFG_DRV1'/>"
WRITE #1 "        <register address='0xb210130' value='0x" DATA.LONG(A:0x210130) "' name='RPMH_PDC_APPS_IRQ_8_CFG_DRV1'/>"
WRITE #1 "        <register address='0xb210134' value='0x" DATA.LONG(A:0x210134) "' name='RPMH_PDC_APPS_IRQ_9_CFG_DRV1'/>"
WRITE #1 "        <register address='0xb210138' value='0x" DATA.LONG(A:0x210138) "' name='RPMH_PDC_APPS_IRQ_10_CFG_DRV1'/>"
WRITE #1 "        <register address='0xb21013c' value='0x" DATA.LONG(A:0x21013c) "' name='RPMH_PDC_APPS_IRQ_11_CFG_DRV1'/>"
WRITE #1 "        <register address='0xb210140' value='0x" DATA.LONG(A:0x210140) "' name='RPMH_PDC_APPS_IRQ_12_CFG_DRV1'/>"
WRITE #1 "        <register address='0xb210144' value='0x" DATA.LONG(A:0x210144) "' name='RPMH_PDC_APPS_IRQ_13_CFG_DRV1'/>"
WRITE #1 "        <register address='0xb210148' value='0x" DATA.LONG(A:0x210148) "' name='RPMH_PDC_APPS_IRQ_14_CFG_DRV1'/>"
WRITE #1 "        <register address='0xb21014c' value='0x" DATA.LONG(A:0x21014c) "' name='RPMH_PDC_APPS_IRQ_15_CFG_DRV1'/>"
WRITE #1 "        <register address='0xb210150' value='0x" DATA.LONG(A:0x210150) "' name='RPMH_PDC_APPS_IRQ_16_CFG_DRV1'/>"
WRITE #1 "        <register address='0xb210154' value='0x" DATA.LONG(A:0x210154) "' name='RPMH_PDC_APPS_IRQ_17_CFG_DRV1'/>"
WRITE #1 "        <register address='0xb210158' value='0x" DATA.LONG(A:0x210158) "' name='RPMH_PDC_APPS_IRQ_18_CFG_DRV1'/>"
WRITE #1 "        <register address='0xb21015c' value='0x" DATA.LONG(A:0x21015c) "' name='RPMH_PDC_APPS_IRQ_19_CFG_DRV1'/>"
WRITE #1 "        <register address='0xb210160' value='0x" DATA.LONG(A:0x210160) "' name='RPMH_PDC_APPS_IRQ_20_CFG_DRV1'/>"
WRITE #1 "        <register address='0xb210164' value='0x" DATA.LONG(A:0x210164) "' name='RPMH_PDC_APPS_IRQ_21_CFG_DRV1'/>"
WRITE #1 "        <register address='0xb210168' value='0x" DATA.LONG(A:0x210168) "' name='RPMH_PDC_APPS_IRQ_22_CFG_DRV1'/>"
WRITE #1 "        <register address='0xb21016c' value='0x" DATA.LONG(A:0x21016c) "' name='RPMH_PDC_APPS_IRQ_23_CFG_DRV1'/>"
WRITE #1 "        <register address='0xb210170' value='0x" DATA.LONG(A:0x210170) "' name='RPMH_PDC_APPS_IRQ_24_CFG_DRV1'/>"
WRITE #1 "        <register address='0xb210174' value='0x" DATA.LONG(A:0x210174) "' name='RPMH_PDC_APPS_IRQ_25_CFG_DRV1'/>"
WRITE #1 "        <register address='0xb210178' value='0x" DATA.LONG(A:0x210178) "' name='RPMH_PDC_APPS_IRQ_26_CFG_DRV1'/>"
WRITE #1 "        <register address='0xb21017c' value='0x" DATA.LONG(A:0x21017c) "' name='RPMH_PDC_APPS_IRQ_27_CFG_DRV1'/>"
WRITE #1 "        <register address='0xb210180' value='0x" DATA.LONG(A:0x210180) "' name='RPMH_PDC_APPS_IRQ_28_CFG_DRV1'/>"
WRITE #1 "        <register address='0xb210184' value='0x" DATA.LONG(A:0x210184) "' name='RPMH_PDC_APPS_IRQ_29_CFG_DRV1'/>"
WRITE #1 "        <register address='0xb210188' value='0x" DATA.LONG(A:0x210188) "' name='RPMH_PDC_APPS_IRQ_30_CFG_DRV1'/>"
WRITE #1 "        <register address='0xb21018c' value='0x" DATA.LONG(A:0x21018c) "' name='RPMH_PDC_APPS_IRQ_31_CFG_DRV1'/>"
WRITE #1 "        <register address='0xb210190' value='0x" DATA.LONG(A:0x210190) "' name='RPMH_PDC_APPS_IRQ_32_CFG_DRV1'/>"
WRITE #1 "        <register address='0xb210194' value='0x" DATA.LONG(A:0x210194) "' name='RPMH_PDC_APPS_IRQ_33_CFG_DRV1'/>"
WRITE #1 "        <register address='0xb210198' value='0x" DATA.LONG(A:0x210198) "' name='RPMH_PDC_APPS_IRQ_34_CFG_DRV1'/>"
WRITE #1 "        <register address='0xb21019c' value='0x" DATA.LONG(A:0x21019c) "' name='RPMH_PDC_APPS_IRQ_35_CFG_DRV1'/>"
WRITE #1 "        <register address='0xb2101a0' value='0x" DATA.LONG(A:0x2101a0) "' name='RPMH_PDC_APPS_IRQ_36_CFG_DRV1'/>"
WRITE #1 "        <register address='0xb2101a4' value='0x" DATA.LONG(A:0x2101a4) "' name='RPMH_PDC_APPS_IRQ_37_CFG_DRV1'/>"
WRITE #1 "        <register address='0xb2101a8' value='0x" DATA.LONG(A:0x2101a8) "' name='RPMH_PDC_APPS_IRQ_38_CFG_DRV1'/>"
WRITE #1 "        <register address='0xb2101ac' value='0x" DATA.LONG(A:0x2101ac) "' name='RPMH_PDC_APPS_IRQ_39_CFG_DRV1'/>"
WRITE #1 "        <register address='0xb2101b0' value='0x" DATA.LONG(A:0x2101b0) "' name='RPMH_PDC_APPS_IRQ_40_CFG_DRV1'/>"
WRITE #1 "        <register address='0xb2101b4' value='0x" DATA.LONG(A:0x2101b4) "' name='RPMH_PDC_APPS_IRQ_41_CFG_DRV1'/>"
WRITE #1 "        <register address='0xb2101b8' value='0x" DATA.LONG(A:0x2101b8) "' name='RPMH_PDC_APPS_IRQ_42_CFG_DRV1'/>"
WRITE #1 "        <register address='0xb2101bc' value='0x" DATA.LONG(A:0x2101bc) "' name='RPMH_PDC_APPS_IRQ_43_CFG_DRV1'/>"
WRITE #1 "        <register address='0xb2101c0' value='0x" DATA.LONG(A:0x2101c0) "' name='RPMH_PDC_APPS_IRQ_44_CFG_DRV1'/>"
WRITE #1 "        <register address='0xb2101c4' value='0x" DATA.LONG(A:0x2101c4) "' name='RPMH_PDC_APPS_IRQ_45_CFG_DRV1'/>"
WRITE #1 "        <register address='0xb2101c8' value='0x" DATA.LONG(A:0x2101c8) "' name='RPMH_PDC_APPS_IRQ_46_CFG_DRV1'/>"
WRITE #1 "        <register address='0xb2101cc' value='0x" DATA.LONG(A:0x2101cc) "' name='RPMH_PDC_APPS_IRQ_47_CFG_DRV1'/>"
WRITE #1 "        <register address='0xb2101d0' value='0x" DATA.LONG(A:0x2101d0) "' name='RPMH_PDC_APPS_IRQ_48_CFG_DRV1'/>"
WRITE #1 "        <register address='0xb2101d4' value='0x" DATA.LONG(A:0x2101d4) "' name='RPMH_PDC_APPS_IRQ_49_CFG_DRV1'/>"
WRITE #1 "        <register address='0xb2101d8' value='0x" DATA.LONG(A:0x2101d8) "' name='RPMH_PDC_APPS_IRQ_50_CFG_DRV1'/>"
WRITE #1 "        <register address='0xb2101dc' value='0x" DATA.LONG(A:0x2101dc) "' name='RPMH_PDC_APPS_IRQ_51_CFG_DRV1'/>"
WRITE #1 "        <register address='0xb2101e0' value='0x" DATA.LONG(A:0x2101e0) "' name='RPMH_PDC_APPS_IRQ_52_CFG_DRV1'/>"
WRITE #1 "        <register address='0xb2101e4' value='0x" DATA.LONG(A:0x2101e4) "' name='RPMH_PDC_APPS_IRQ_53_CFG_DRV1'/>"
WRITE #1 "        <register address='0xb2101e8' value='0x" DATA.LONG(A:0x2101e8) "' name='RPMH_PDC_APPS_IRQ_54_CFG_DRV1'/>"
WRITE #1 "        <register address='0xb2101ec' value='0x" DATA.LONG(A:0x2101ec) "' name='RPMH_PDC_APPS_IRQ_55_CFG_DRV1'/>"
WRITE #1 "        <register address='0xb2101f0' value='0x" DATA.LONG(A:0x2101f0) "' name='RPMH_PDC_APPS_IRQ_56_CFG_DRV1'/>"
WRITE #1 "        <register address='0xb2101f4' value='0x" DATA.LONG(A:0x2101f4) "' name='RPMH_PDC_APPS_IRQ_57_CFG_DRV1'/>"
WRITE #1 "        <register address='0xb2101f8' value='0x" DATA.LONG(A:0x2101f8) "' name='RPMH_PDC_APPS_IRQ_58_CFG_DRV1'/>"
WRITE #1 "        <register address='0xb2101fc' value='0x" DATA.LONG(A:0x2101fc) "' name='RPMH_PDC_APPS_IRQ_59_CFG_DRV1'/>"
WRITE #1 "        <register address='0xb210200' value='0x" DATA.LONG(A:0x210200) "' name='RPMH_PDC_APPS_IRQ_60_CFG_DRV1'/>"
WRITE #1 "        <register address='0xb210204' value='0x" DATA.LONG(A:0x210204) "' name='RPMH_PDC_APPS_IRQ_61_CFG_DRV1'/>"
WRITE #1 "        <register address='0xb210208' value='0x" DATA.LONG(A:0x210208) "' name='RPMH_PDC_APPS_IRQ_62_CFG_DRV1'/>"
WRITE #1 "        <register address='0xb21020c' value='0x" DATA.LONG(A:0x21020c) "' name='RPMH_PDC_APPS_IRQ_63_CFG_DRV1'/>"
WRITE #1 "        <register address='0xb210210' value='0x" DATA.LONG(A:0x210210) "' name='RPMH_PDC_APPS_IRQ_64_CFG_DRV1'/>"
WRITE #1 "        <register address='0xb210214' value='0x" DATA.LONG(A:0x210214) "' name='RPMH_PDC_APPS_IRQ_65_CFG_DRV1'/>"
WRITE #1 "        <register address='0xb210218' value='0x" DATA.LONG(A:0x210218) "' name='RPMH_PDC_APPS_IRQ_66_CFG_DRV1'/>"
WRITE #1 "        <register address='0xb21021c' value='0x" DATA.LONG(A:0x21021c) "' name='RPMH_PDC_APPS_IRQ_67_CFG_DRV1'/>"
WRITE #1 "        <register address='0xb210220' value='0x" DATA.LONG(A:0x210220) "' name='RPMH_PDC_APPS_IRQ_68_CFG_DRV1'/>"
WRITE #1 "        <register address='0xb210224' value='0x" DATA.LONG(A:0x210224) "' name='RPMH_PDC_APPS_IRQ_69_CFG_DRV1'/>"
WRITE #1 "        <register address='0xb210228' value='0x" DATA.LONG(A:0x210228) "' name='RPMH_PDC_APPS_IRQ_70_CFG_DRV1'/>"
WRITE #1 "        <register address='0xb21022c' value='0x" DATA.LONG(A:0x21022c) "' name='RPMH_PDC_APPS_IRQ_71_CFG_DRV1'/>"
WRITE #1 "        <register address='0xb210230' value='0x" DATA.LONG(A:0x210230) "' name='RPMH_PDC_APPS_IRQ_72_CFG_DRV1'/>"
WRITE #1 "        <register address='0xb210234' value='0x" DATA.LONG(A:0x210234) "' name='RPMH_PDC_APPS_IRQ_73_CFG_DRV1'/>"
WRITE #1 "        <register address='0xb210238' value='0x" DATA.LONG(A:0x210238) "' name='RPMH_PDC_APPS_IRQ_74_CFG_DRV1'/>"
WRITE #1 "        <register address='0xb21023c' value='0x" DATA.LONG(A:0x21023c) "' name='RPMH_PDC_APPS_IRQ_75_CFG_DRV1'/>"
WRITE #1 "        <register address='0xb210240' value='0x" DATA.LONG(A:0x210240) "' name='RPMH_PDC_APPS_IRQ_76_CFG_DRV1'/>"
WRITE #1 "        <register address='0xb210244' value='0x" DATA.LONG(A:0x210244) "' name='RPMH_PDC_APPS_IRQ_77_CFG_DRV1'/>"
WRITE #1 "        <register address='0xb210248' value='0x" DATA.LONG(A:0x210248) "' name='RPMH_PDC_APPS_IRQ_78_CFG_DRV1'/>"
WRITE #1 "        <register address='0xb21024c' value='0x" DATA.LONG(A:0x21024c) "' name='RPMH_PDC_APPS_IRQ_79_CFG_DRV1'/>"
WRITE #1 "        <register address='0xb210250' value='0x" DATA.LONG(A:0x210250) "' name='RPMH_PDC_APPS_IRQ_80_CFG_DRV1'/>"
WRITE #1 "        <register address='0xb210254' value='0x" DATA.LONG(A:0x210254) "' name='RPMH_PDC_APPS_IRQ_81_CFG_DRV1'/>"
WRITE #1 "        <register address='0xb210258' value='0x" DATA.LONG(A:0x210258) "' name='RPMH_PDC_APPS_IRQ_82_CFG_DRV1'/>"
WRITE #1 "        <register address='0xb21025c' value='0x" DATA.LONG(A:0x21025c) "' name='RPMH_PDC_APPS_IRQ_83_CFG_DRV1'/>"
WRITE #1 "        <register address='0xb210260' value='0x" DATA.LONG(A:0x210260) "' name='RPMH_PDC_APPS_IRQ_84_CFG_DRV1'/>"
WRITE #1 "        <register address='0xb210264' value='0x" DATA.LONG(A:0x210264) "' name='RPMH_PDC_APPS_IRQ_85_CFG_DRV1'/>"
WRITE #1 "        <register address='0xb210268' value='0x" DATA.LONG(A:0x210268) "' name='RPMH_PDC_APPS_IRQ_86_CFG_DRV1'/>"
WRITE #1 "        <register address='0xb21026c' value='0x" DATA.LONG(A:0x21026c) "' name='RPMH_PDC_APPS_IRQ_87_CFG_DRV1'/>"
WRITE #1 "        <register address='0xb210270' value='0x" DATA.LONG(A:0x210270) "' name='RPMH_PDC_APPS_IRQ_88_CFG_DRV1'/>"
WRITE #1 "        <register address='0xb210274' value='0x" DATA.LONG(A:0x210274) "' name='RPMH_PDC_APPS_IRQ_89_CFG_DRV1'/>"
WRITE #1 "        <register address='0xb210278' value='0x" DATA.LONG(A:0x210278) "' name='RPMH_PDC_APPS_IRQ_90_CFG_DRV1'/>"
WRITE #1 "        <register address='0xb21027c' value='0x" DATA.LONG(A:0x21027c) "' name='RPMH_PDC_APPS_IRQ_91_CFG_DRV1'/>"
WRITE #1 "        <register address='0xb210280' value='0x" DATA.LONG(A:0x210280) "' name='RPMH_PDC_APPS_IRQ_92_CFG_DRV1'/>"
WRITE #1 "        <register address='0xb210284' value='0x" DATA.LONG(A:0x210284) "' name='RPMH_PDC_APPS_IRQ_93_CFG_DRV1'/>"
WRITE #1 "        <register address='0xb210288' value='0x" DATA.LONG(A:0x210288) "' name='RPMH_PDC_APPS_IRQ_94_CFG_DRV1'/>"
WRITE #1 "        <register address='0xb21028c' value='0x" DATA.LONG(A:0x21028c) "' name='RPMH_PDC_APPS_IRQ_95_CFG_DRV1'/>"
WRITE #1 "        <register address='0xb210290' value='0x" DATA.LONG(A:0x210290) "' name='RPMH_PDC_APPS_IRQ_96_CFG_DRV1'/>"
WRITE #1 "        <register address='0xb210294' value='0x" DATA.LONG(A:0x210294) "' name='RPMH_PDC_APPS_IRQ_97_CFG_DRV1'/>"
WRITE #1 "        <register address='0xb210298' value='0x" DATA.LONG(A:0x210298) "' name='RPMH_PDC_APPS_IRQ_98_CFG_DRV1'/>"
WRITE #1 "        <register address='0xb21029c' value='0x" DATA.LONG(A:0x21029c) "' name='RPMH_PDC_APPS_IRQ_99_CFG_DRV1'/>"
WRITE #1 "        <register address='0xb2102a0' value='0x" DATA.LONG(A:0x2102a0) "' name='RPMH_PDC_APPS_IRQ_100_CFG_DRV1'/>"
WRITE #1 "        <register address='0xb2102a4' value='0x" DATA.LONG(A:0x2102a4) "' name='RPMH_PDC_APPS_IRQ_101_CFG_DRV1'/>"
WRITE #1 "        <register address='0xb2102a8' value='0x" DATA.LONG(A:0x2102a8) "' name='RPMH_PDC_APPS_IRQ_102_CFG_DRV1'/>"
WRITE #1 "        <register address='0xb2102ac' value='0x" DATA.LONG(A:0x2102ac) "' name='RPMH_PDC_APPS_IRQ_103_CFG_DRV1'/>"
WRITE #1 "        <register address='0xb2102b0' value='0x" DATA.LONG(A:0x2102b0) "' name='RPMH_PDC_APPS_IRQ_104_CFG_DRV1'/>"
WRITE #1 "        <register address='0xb2102b4' value='0x" DATA.LONG(A:0x2102b4) "' name='RPMH_PDC_APPS_IRQ_105_CFG_DRV1'/>"
WRITE #1 "        <register address='0xb2102b8' value='0x" DATA.LONG(A:0x2102b8) "' name='RPMH_PDC_APPS_IRQ_106_CFG_DRV1'/>"
WRITE #1 "        <register address='0xb2102bc' value='0x" DATA.LONG(A:0x2102bc) "' name='RPMH_PDC_APPS_IRQ_107_CFG_DRV1'/>"
WRITE #1 "        <register address='0xb2102c0' value='0x" DATA.LONG(A:0x2102c0) "' name='RPMH_PDC_APPS_IRQ_108_CFG_DRV1'/>"
WRITE #1 "        <register address='0xb2102c4' value='0x" DATA.LONG(A:0x2102c4) "' name='RPMH_PDC_APPS_IRQ_109_CFG_DRV1'/>"
WRITE #1 "        <register address='0xb2102c8' value='0x" DATA.LONG(A:0x2102c8) "' name='RPMH_PDC_APPS_IRQ_110_CFG_DRV1'/>"
WRITE #1 "        <register address='0xb2102cc' value='0x" DATA.LONG(A:0x2102cc) "' name='RPMH_PDC_APPS_IRQ_111_CFG_DRV1'/>"
WRITE #1 "        <register address='0xb2102d0' value='0x" DATA.LONG(A:0x2102d0) "' name='RPMH_PDC_APPS_IRQ_112_CFG_DRV1'/>"
WRITE #1 "        <register address='0xb2102d4' value='0x" DATA.LONG(A:0x2102d4) "' name='RPMH_PDC_APPS_IRQ_113_CFG_DRV1'/>"
WRITE #1 "        <register address='0xb2102d8' value='0x" DATA.LONG(A:0x2102d8) "' name='RPMH_PDC_APPS_IRQ_114_CFG_DRV1'/>"
WRITE #1 "        <register address='0xb2102dc' value='0x" DATA.LONG(A:0x2102dc) "' name='RPMH_PDC_APPS_IRQ_115_CFG_DRV1'/>"
WRITE #1 "        <register address='0xb2102e0' value='0x" DATA.LONG(A:0x2102e0) "' name='RPMH_PDC_APPS_IRQ_116_CFG_DRV1'/>"
WRITE #1 "        <register address='0xb2102e4' value='0x" DATA.LONG(A:0x2102e4) "' name='RPMH_PDC_APPS_IRQ_117_CFG_DRV1'/>"
WRITE #1 "        <register address='0xb2102e8' value='0x" DATA.LONG(A:0x2102e8) "' name='RPMH_PDC_APPS_IRQ_118_CFG_DRV1'/>"
WRITE #1 "        <register address='0xb2102ec' value='0x" DATA.LONG(A:0x2102ec) "' name='RPMH_PDC_APPS_IRQ_119_CFG_DRV1'/>"
WRITE #1 "        <register address='0xb2102f0' value='0x" DATA.LONG(A:0x2102f0) "' name='RPMH_PDC_APPS_IRQ_120_CFG_DRV1'/>"
WRITE #1 "        <register address='0xb2102f4' value='0x" DATA.LONG(A:0x2102f4) "' name='RPMH_PDC_APPS_IRQ_121_CFG_DRV1'/>"
WRITE #1 "        <register address='0xb2102f8' value='0x" DATA.LONG(A:0x2102f8) "' name='RPMH_PDC_APPS_IRQ_122_CFG_DRV1'/>"
WRITE #1 "        <register address='0xb2102fc' value='0x" DATA.LONG(A:0x2102fc) "' name='RPMH_PDC_APPS_IRQ_123_CFG_DRV1'/>"
WRITE #1 "        <register address='0xb210300' value='0x" DATA.LONG(A:0x210300) "' name='RPMH_PDC_APPS_IRQ_124_CFG_DRV1'/>"
WRITE #1 "        <register address='0xb210304' value='0x" DATA.LONG(A:0x210304) "' name='RPMH_PDC_APPS_IRQ_125_CFG_DRV1'/>"
WRITE #1 "        <register address='0xb220110' value='0x" DATA.LONG(A:0x220110) "' name='RPMH_PDC_APPS_IRQ_0_CFG_DRV2'/>"
WRITE #1 "        <register address='0xb220114' value='0x" DATA.LONG(A:0x220114) "' name='RPMH_PDC_APPS_IRQ_1_CFG_DRV2'/>"
WRITE #1 "        <register address='0xb220118' value='0x" DATA.LONG(A:0x220118) "' name='RPMH_PDC_APPS_IRQ_2_CFG_DRV2'/>"
WRITE #1 "        <register address='0xb22011c' value='0x" DATA.LONG(A:0x22011c) "' name='RPMH_PDC_APPS_IRQ_3_CFG_DRV2'/>"
WRITE #1 "        <register address='0xb220120' value='0x" DATA.LONG(A:0x220120) "' name='RPMH_PDC_APPS_IRQ_4_CFG_DRV2'/>"
WRITE #1 "        <register address='0xb220124' value='0x" DATA.LONG(A:0x220124) "' name='RPMH_PDC_APPS_IRQ_5_CFG_DRV2'/>"
WRITE #1 "        <register address='0xb220128' value='0x" DATA.LONG(A:0x220128) "' name='RPMH_PDC_APPS_IRQ_6_CFG_DRV2'/>"
WRITE #1 "        <register address='0xb22012c' value='0x" DATA.LONG(A:0x22012c) "' name='RPMH_PDC_APPS_IRQ_7_CFG_DRV2'/>"
WRITE #1 "        <register address='0xb220130' value='0x" DATA.LONG(A:0x220130) "' name='RPMH_PDC_APPS_IRQ_8_CFG_DRV2'/>"
WRITE #1 "        <register address='0xb220134' value='0x" DATA.LONG(A:0x220134) "' name='RPMH_PDC_APPS_IRQ_9_CFG_DRV2'/>"
WRITE #1 "        <register address='0xb220138' value='0x" DATA.LONG(A:0x220138) "' name='RPMH_PDC_APPS_IRQ_10_CFG_DRV2'/>"
WRITE #1 "        <register address='0xb22013c' value='0x" DATA.LONG(A:0x22013c) "' name='RPMH_PDC_APPS_IRQ_11_CFG_DRV2'/>"
WRITE #1 "        <register address='0xb220140' value='0x" DATA.LONG(A:0x220140) "' name='RPMH_PDC_APPS_IRQ_12_CFG_DRV2'/>"
WRITE #1 "        <register address='0xb220144' value='0x" DATA.LONG(A:0x220144) "' name='RPMH_PDC_APPS_IRQ_13_CFG_DRV2'/>"
WRITE #1 "        <register address='0xb220148' value='0x" DATA.LONG(A:0x220148) "' name='RPMH_PDC_APPS_IRQ_14_CFG_DRV2'/>"
WRITE #1 "        <register address='0xb22014c' value='0x" DATA.LONG(A:0x22014c) "' name='RPMH_PDC_APPS_IRQ_15_CFG_DRV2'/>"
WRITE #1 "        <register address='0xb220150' value='0x" DATA.LONG(A:0x220150) "' name='RPMH_PDC_APPS_IRQ_16_CFG_DRV2'/>"
WRITE #1 "        <register address='0xb220154' value='0x" DATA.LONG(A:0x220154) "' name='RPMH_PDC_APPS_IRQ_17_CFG_DRV2'/>"
WRITE #1 "        <register address='0xb220158' value='0x" DATA.LONG(A:0x220158) "' name='RPMH_PDC_APPS_IRQ_18_CFG_DRV2'/>"
WRITE #1 "        <register address='0xb22015c' value='0x" DATA.LONG(A:0x22015c) "' name='RPMH_PDC_APPS_IRQ_19_CFG_DRV2'/>"
WRITE #1 "        <register address='0xb220160' value='0x" DATA.LONG(A:0x220160) "' name='RPMH_PDC_APPS_IRQ_20_CFG_DRV2'/>"
WRITE #1 "        <register address='0xb220164' value='0x" DATA.LONG(A:0x220164) "' name='RPMH_PDC_APPS_IRQ_21_CFG_DRV2'/>"
WRITE #1 "        <register address='0xb220168' value='0x" DATA.LONG(A:0x220168) "' name='RPMH_PDC_APPS_IRQ_22_CFG_DRV2'/>"
WRITE #1 "        <register address='0xb22016c' value='0x" DATA.LONG(A:0x22016c) "' name='RPMH_PDC_APPS_IRQ_23_CFG_DRV2'/>"
WRITE #1 "        <register address='0xb220170' value='0x" DATA.LONG(A:0x220170) "' name='RPMH_PDC_APPS_IRQ_24_CFG_DRV2'/>"
WRITE #1 "        <register address='0xb220174' value='0x" DATA.LONG(A:0x220174) "' name='RPMH_PDC_APPS_IRQ_25_CFG_DRV2'/>"
WRITE #1 "        <register address='0xb220178' value='0x" DATA.LONG(A:0x220178) "' name='RPMH_PDC_APPS_IRQ_26_CFG_DRV2'/>"
WRITE #1 "        <register address='0xb22017c' value='0x" DATA.LONG(A:0x22017c) "' name='RPMH_PDC_APPS_IRQ_27_CFG_DRV2'/>"
WRITE #1 "        <register address='0xb220180' value='0x" DATA.LONG(A:0x220180) "' name='RPMH_PDC_APPS_IRQ_28_CFG_DRV2'/>"
WRITE #1 "        <register address='0xb220184' value='0x" DATA.LONG(A:0x220184) "' name='RPMH_PDC_APPS_IRQ_29_CFG_DRV2'/>"
WRITE #1 "        <register address='0xb220188' value='0x" DATA.LONG(A:0x220188) "' name='RPMH_PDC_APPS_IRQ_30_CFG_DRV2'/>"
WRITE #1 "        <register address='0xb22018c' value='0x" DATA.LONG(A:0x22018c) "' name='RPMH_PDC_APPS_IRQ_31_CFG_DRV2'/>"
WRITE #1 "        <register address='0xb220190' value='0x" DATA.LONG(A:0x220190) "' name='RPMH_PDC_APPS_IRQ_32_CFG_DRV2'/>"
WRITE #1 "        <register address='0xb220194' value='0x" DATA.LONG(A:0x220194) "' name='RPMH_PDC_APPS_IRQ_33_CFG_DRV2'/>"
WRITE #1 "        <register address='0xb220198' value='0x" DATA.LONG(A:0x220198) "' name='RPMH_PDC_APPS_IRQ_34_CFG_DRV2'/>"
WRITE #1 "        <register address='0xb22019c' value='0x" DATA.LONG(A:0x22019c) "' name='RPMH_PDC_APPS_IRQ_35_CFG_DRV2'/>"
WRITE #1 "        <register address='0xb2201a0' value='0x" DATA.LONG(A:0x2201a0) "' name='RPMH_PDC_APPS_IRQ_36_CFG_DRV2'/>"
WRITE #1 "        <register address='0xb2201a4' value='0x" DATA.LONG(A:0x2201a4) "' name='RPMH_PDC_APPS_IRQ_37_CFG_DRV2'/>"
WRITE #1 "        <register address='0xb2201a8' value='0x" DATA.LONG(A:0x2201a8) "' name='RPMH_PDC_APPS_IRQ_38_CFG_DRV2'/>"
WRITE #1 "        <register address='0xb2201ac' value='0x" DATA.LONG(A:0x2201ac) "' name='RPMH_PDC_APPS_IRQ_39_CFG_DRV2'/>"
WRITE #1 "        <register address='0xb2201b0' value='0x" DATA.LONG(A:0x2201b0) "' name='RPMH_PDC_APPS_IRQ_40_CFG_DRV2'/>"
WRITE #1 "        <register address='0xb2201b4' value='0x" DATA.LONG(A:0x2201b4) "' name='RPMH_PDC_APPS_IRQ_41_CFG_DRV2'/>"
WRITE #1 "        <register address='0xb2201b8' value='0x" DATA.LONG(A:0x2201b8) "' name='RPMH_PDC_APPS_IRQ_42_CFG_DRV2'/>"
WRITE #1 "        <register address='0xb2201bc' value='0x" DATA.LONG(A:0x2201bc) "' name='RPMH_PDC_APPS_IRQ_43_CFG_DRV2'/>"
WRITE #1 "        <register address='0xb2201c0' value='0x" DATA.LONG(A:0x2201c0) "' name='RPMH_PDC_APPS_IRQ_44_CFG_DRV2'/>"
WRITE #1 "        <register address='0xb2201c4' value='0x" DATA.LONG(A:0x2201c4) "' name='RPMH_PDC_APPS_IRQ_45_CFG_DRV2'/>"
WRITE #1 "        <register address='0xb2201c8' value='0x" DATA.LONG(A:0x2201c8) "' name='RPMH_PDC_APPS_IRQ_46_CFG_DRV2'/>"
WRITE #1 "        <register address='0xb2201cc' value='0x" DATA.LONG(A:0x2201cc) "' name='RPMH_PDC_APPS_IRQ_47_CFG_DRV2'/>"
WRITE #1 "        <register address='0xb2201d0' value='0x" DATA.LONG(A:0x2201d0) "' name='RPMH_PDC_APPS_IRQ_48_CFG_DRV2'/>"
WRITE #1 "        <register address='0xb2201d4' value='0x" DATA.LONG(A:0x2201d4) "' name='RPMH_PDC_APPS_IRQ_49_CFG_DRV2'/>"
WRITE #1 "        <register address='0xb2201d8' value='0x" DATA.LONG(A:0x2201d8) "' name='RPMH_PDC_APPS_IRQ_50_CFG_DRV2'/>"
WRITE #1 "        <register address='0xb2201dc' value='0x" DATA.LONG(A:0x2201dc) "' name='RPMH_PDC_APPS_IRQ_51_CFG_DRV2'/>"
WRITE #1 "        <register address='0xb2201e0' value='0x" DATA.LONG(A:0x2201e0) "' name='RPMH_PDC_APPS_IRQ_52_CFG_DRV2'/>"
WRITE #1 "        <register address='0xb2201e4' value='0x" DATA.LONG(A:0x2201e4) "' name='RPMH_PDC_APPS_IRQ_53_CFG_DRV2'/>"
WRITE #1 "        <register address='0xb2201e8' value='0x" DATA.LONG(A:0x2201e8) "' name='RPMH_PDC_APPS_IRQ_54_CFG_DRV2'/>"
WRITE #1 "        <register address='0xb2201ec' value='0x" DATA.LONG(A:0x2201ec) "' name='RPMH_PDC_APPS_IRQ_55_CFG_DRV2'/>"
WRITE #1 "        <register address='0xb2201f0' value='0x" DATA.LONG(A:0x2201f0) "' name='RPMH_PDC_APPS_IRQ_56_CFG_DRV2'/>"
WRITE #1 "        <register address='0xb2201f4' value='0x" DATA.LONG(A:0x2201f4) "' name='RPMH_PDC_APPS_IRQ_57_CFG_DRV2'/>"
WRITE #1 "        <register address='0xb2201f8' value='0x" DATA.LONG(A:0x2201f8) "' name='RPMH_PDC_APPS_IRQ_58_CFG_DRV2'/>"
WRITE #1 "        <register address='0xb2201fc' value='0x" DATA.LONG(A:0x2201fc) "' name='RPMH_PDC_APPS_IRQ_59_CFG_DRV2'/>"
WRITE #1 "        <register address='0xb220200' value='0x" DATA.LONG(A:0x220200) "' name='RPMH_PDC_APPS_IRQ_60_CFG_DRV2'/>"
WRITE #1 "        <register address='0xb220204' value='0x" DATA.LONG(A:0x220204) "' name='RPMH_PDC_APPS_IRQ_61_CFG_DRV2'/>"
WRITE #1 "        <register address='0xb220208' value='0x" DATA.LONG(A:0x220208) "' name='RPMH_PDC_APPS_IRQ_62_CFG_DRV2'/>"
WRITE #1 "        <register address='0xb22020c' value='0x" DATA.LONG(A:0x22020c) "' name='RPMH_PDC_APPS_IRQ_63_CFG_DRV2'/>"
WRITE #1 "        <register address='0xb220210' value='0x" DATA.LONG(A:0x220210) "' name='RPMH_PDC_APPS_IRQ_64_CFG_DRV2'/>"
WRITE #1 "        <register address='0xb220214' value='0x" DATA.LONG(A:0x220214) "' name='RPMH_PDC_APPS_IRQ_65_CFG_DRV2'/>"
WRITE #1 "        <register address='0xb220218' value='0x" DATA.LONG(A:0x220218) "' name='RPMH_PDC_APPS_IRQ_66_CFG_DRV2'/>"
WRITE #1 "        <register address='0xb22021c' value='0x" DATA.LONG(A:0x22021c) "' name='RPMH_PDC_APPS_IRQ_67_CFG_DRV2'/>"
WRITE #1 "        <register address='0xb220220' value='0x" DATA.LONG(A:0x220220) "' name='RPMH_PDC_APPS_IRQ_68_CFG_DRV2'/>"
WRITE #1 "        <register address='0xb220224' value='0x" DATA.LONG(A:0x220224) "' name='RPMH_PDC_APPS_IRQ_69_CFG_DRV2'/>"
WRITE #1 "        <register address='0xb220228' value='0x" DATA.LONG(A:0x220228) "' name='RPMH_PDC_APPS_IRQ_70_CFG_DRV2'/>"
WRITE #1 "        <register address='0xb22022c' value='0x" DATA.LONG(A:0x22022c) "' name='RPMH_PDC_APPS_IRQ_71_CFG_DRV2'/>"
WRITE #1 "        <register address='0xb220230' value='0x" DATA.LONG(A:0x220230) "' name='RPMH_PDC_APPS_IRQ_72_CFG_DRV2'/>"
WRITE #1 "        <register address='0xb220234' value='0x" DATA.LONG(A:0x220234) "' name='RPMH_PDC_APPS_IRQ_73_CFG_DRV2'/>"
WRITE #1 "        <register address='0xb220238' value='0x" DATA.LONG(A:0x220238) "' name='RPMH_PDC_APPS_IRQ_74_CFG_DRV2'/>"
WRITE #1 "        <register address='0xb22023c' value='0x" DATA.LONG(A:0x22023c) "' name='RPMH_PDC_APPS_IRQ_75_CFG_DRV2'/>"
WRITE #1 "        <register address='0xb220240' value='0x" DATA.LONG(A:0x220240) "' name='RPMH_PDC_APPS_IRQ_76_CFG_DRV2'/>"
WRITE #1 "        <register address='0xb220244' value='0x" DATA.LONG(A:0x220244) "' name='RPMH_PDC_APPS_IRQ_77_CFG_DRV2'/>"
WRITE #1 "        <register address='0xb220248' value='0x" DATA.LONG(A:0x220248) "' name='RPMH_PDC_APPS_IRQ_78_CFG_DRV2'/>"
WRITE #1 "        <register address='0xb22024c' value='0x" DATA.LONG(A:0x22024c) "' name='RPMH_PDC_APPS_IRQ_79_CFG_DRV2'/>"
WRITE #1 "        <register address='0xb220250' value='0x" DATA.LONG(A:0x220250) "' name='RPMH_PDC_APPS_IRQ_80_CFG_DRV2'/>"
WRITE #1 "        <register address='0xb220254' value='0x" DATA.LONG(A:0x220254) "' name='RPMH_PDC_APPS_IRQ_81_CFG_DRV2'/>"
WRITE #1 "        <register address='0xb220258' value='0x" DATA.LONG(A:0x220258) "' name='RPMH_PDC_APPS_IRQ_82_CFG_DRV2'/>"
WRITE #1 "        <register address='0xb22025c' value='0x" DATA.LONG(A:0x22025c) "' name='RPMH_PDC_APPS_IRQ_83_CFG_DRV2'/>"
WRITE #1 "        <register address='0xb220260' value='0x" DATA.LONG(A:0x220260) "' name='RPMH_PDC_APPS_IRQ_84_CFG_DRV2'/>"
WRITE #1 "        <register address='0xb220264' value='0x" DATA.LONG(A:0x220264) "' name='RPMH_PDC_APPS_IRQ_85_CFG_DRV2'/>"
WRITE #1 "        <register address='0xb220268' value='0x" DATA.LONG(A:0x220268) "' name='RPMH_PDC_APPS_IRQ_86_CFG_DRV2'/>"
WRITE #1 "        <register address='0xb22026c' value='0x" DATA.LONG(A:0x22026c) "' name='RPMH_PDC_APPS_IRQ_87_CFG_DRV2'/>"
WRITE #1 "        <register address='0xb220270' value='0x" DATA.LONG(A:0x220270) "' name='RPMH_PDC_APPS_IRQ_88_CFG_DRV2'/>"
WRITE #1 "        <register address='0xb220274' value='0x" DATA.LONG(A:0x220274) "' name='RPMH_PDC_APPS_IRQ_89_CFG_DRV2'/>"
WRITE #1 "        <register address='0xb220278' value='0x" DATA.LONG(A:0x220278) "' name='RPMH_PDC_APPS_IRQ_90_CFG_DRV2'/>"
WRITE #1 "        <register address='0xb22027c' value='0x" DATA.LONG(A:0x22027c) "' name='RPMH_PDC_APPS_IRQ_91_CFG_DRV2'/>"
WRITE #1 "        <register address='0xb220280' value='0x" DATA.LONG(A:0x220280) "' name='RPMH_PDC_APPS_IRQ_92_CFG_DRV2'/>"
WRITE #1 "        <register address='0xb220284' value='0x" DATA.LONG(A:0x220284) "' name='RPMH_PDC_APPS_IRQ_93_CFG_DRV2'/>"
WRITE #1 "        <register address='0xb220288' value='0x" DATA.LONG(A:0x220288) "' name='RPMH_PDC_APPS_IRQ_94_CFG_DRV2'/>"
WRITE #1 "        <register address='0xb22028c' value='0x" DATA.LONG(A:0x22028c) "' name='RPMH_PDC_APPS_IRQ_95_CFG_DRV2'/>"
WRITE #1 "        <register address='0xb220290' value='0x" DATA.LONG(A:0x220290) "' name='RPMH_PDC_APPS_IRQ_96_CFG_DRV2'/>"
WRITE #1 "        <register address='0xb220294' value='0x" DATA.LONG(A:0x220294) "' name='RPMH_PDC_APPS_IRQ_97_CFG_DRV2'/>"
WRITE #1 "        <register address='0xb220298' value='0x" DATA.LONG(A:0x220298) "' name='RPMH_PDC_APPS_IRQ_98_CFG_DRV2'/>"
WRITE #1 "        <register address='0xb22029c' value='0x" DATA.LONG(A:0x22029c) "' name='RPMH_PDC_APPS_IRQ_99_CFG_DRV2'/>"
WRITE #1 "        <register address='0xb2202a0' value='0x" DATA.LONG(A:0x2202a0) "' name='RPMH_PDC_APPS_IRQ_100_CFG_DRV2'/>"
WRITE #1 "        <register address='0xb2202a4' value='0x" DATA.LONG(A:0x2202a4) "' name='RPMH_PDC_APPS_IRQ_101_CFG_DRV2'/>"
WRITE #1 "        <register address='0xb2202a8' value='0x" DATA.LONG(A:0x2202a8) "' name='RPMH_PDC_APPS_IRQ_102_CFG_DRV2'/>"
WRITE #1 "        <register address='0xb2202ac' value='0x" DATA.LONG(A:0x2202ac) "' name='RPMH_PDC_APPS_IRQ_103_CFG_DRV2'/>"
WRITE #1 "        <register address='0xb2202b0' value='0x" DATA.LONG(A:0x2202b0) "' name='RPMH_PDC_APPS_IRQ_104_CFG_DRV2'/>"
WRITE #1 "        <register address='0xb2202b4' value='0x" DATA.LONG(A:0x2202b4) "' name='RPMH_PDC_APPS_IRQ_105_CFG_DRV2'/>"
WRITE #1 "        <register address='0xb2202b8' value='0x" DATA.LONG(A:0x2202b8) "' name='RPMH_PDC_APPS_IRQ_106_CFG_DRV2'/>"
WRITE #1 "        <register address='0xb2202bc' value='0x" DATA.LONG(A:0x2202bc) "' name='RPMH_PDC_APPS_IRQ_107_CFG_DRV2'/>"
WRITE #1 "        <register address='0xb2202c0' value='0x" DATA.LONG(A:0x2202c0) "' name='RPMH_PDC_APPS_IRQ_108_CFG_DRV2'/>"
WRITE #1 "        <register address='0xb2202c4' value='0x" DATA.LONG(A:0x2202c4) "' name='RPMH_PDC_APPS_IRQ_109_CFG_DRV2'/>"
WRITE #1 "        <register address='0xb2202c8' value='0x" DATA.LONG(A:0x2202c8) "' name='RPMH_PDC_APPS_IRQ_110_CFG_DRV2'/>"
WRITE #1 "        <register address='0xb2202cc' value='0x" DATA.LONG(A:0x2202cc) "' name='RPMH_PDC_APPS_IRQ_111_CFG_DRV2'/>"
WRITE #1 "        <register address='0xb2202d0' value='0x" DATA.LONG(A:0x2202d0) "' name='RPMH_PDC_APPS_IRQ_112_CFG_DRV2'/>"
WRITE #1 "        <register address='0xb2202d4' value='0x" DATA.LONG(A:0x2202d4) "' name='RPMH_PDC_APPS_IRQ_113_CFG_DRV2'/>"
WRITE #1 "        <register address='0xb2202d8' value='0x" DATA.LONG(A:0x2202d8) "' name='RPMH_PDC_APPS_IRQ_114_CFG_DRV2'/>"
WRITE #1 "        <register address='0xb2202dc' value='0x" DATA.LONG(A:0x2202dc) "' name='RPMH_PDC_APPS_IRQ_115_CFG_DRV2'/>"
WRITE #1 "        <register address='0xb2202e0' value='0x" DATA.LONG(A:0x2202e0) "' name='RPMH_PDC_APPS_IRQ_116_CFG_DRV2'/>"
WRITE #1 "        <register address='0xb2202e4' value='0x" DATA.LONG(A:0x2202e4) "' name='RPMH_PDC_APPS_IRQ_117_CFG_DRV2'/>"
WRITE #1 "        <register address='0xb2202e8' value='0x" DATA.LONG(A:0x2202e8) "' name='RPMH_PDC_APPS_IRQ_118_CFG_DRV2'/>"
WRITE #1 "        <register address='0xb2202ec' value='0x" DATA.LONG(A:0x2202ec) "' name='RPMH_PDC_APPS_IRQ_119_CFG_DRV2'/>"
WRITE #1 "        <register address='0xb2202f0' value='0x" DATA.LONG(A:0x2202f0) "' name='RPMH_PDC_APPS_IRQ_120_CFG_DRV2'/>"
WRITE #1 "        <register address='0xb2202f4' value='0x" DATA.LONG(A:0x2202f4) "' name='RPMH_PDC_APPS_IRQ_121_CFG_DRV2'/>"
WRITE #1 "        <register address='0xb2202f8' value='0x" DATA.LONG(A:0x2202f8) "' name='RPMH_PDC_APPS_IRQ_122_CFG_DRV2'/>"
WRITE #1 "        <register address='0xb2202fc' value='0x" DATA.LONG(A:0x2202fc) "' name='RPMH_PDC_APPS_IRQ_123_CFG_DRV2'/>"
WRITE #1 "        <register address='0xb220300' value='0x" DATA.LONG(A:0x220300) "' name='RPMH_PDC_APPS_IRQ_124_CFG_DRV2'/>"
WRITE #1 "        <register address='0xb220304' value='0x" DATA.LONG(A:0x220304) "' name='RPMH_PDC_APPS_IRQ_125_CFG_DRV2'/>"
WRITE #1 "        <register address='0xb200900' value='0x" DATA.LONG(A:0x200900) "' name='RPMH_PDC_APPS_IRQ_STATUS_BANK0_DRV0'/>"
WRITE #1 "        <register address='0xb200904' value='0x" DATA.LONG(A:0x200904) "' name='RPMH_PDC_APPS_IRQ_STATUS_BANK1_DRV0'/>"
WRITE #1 "        <register address='0xb200908' value='0x" DATA.LONG(A:0x200908) "' name='RPMH_PDC_APPS_IRQ_STATUS_BANK2_DRV0'/>"
WRITE #1 "        <register address='0xb20090c' value='0x" DATA.LONG(A:0x20090c) "' name='RPMH_PDC_APPS_IRQ_STATUS_BANK3_DRV0'/>"
WRITE #1 "        <register address='0xb210900' value='0x" DATA.LONG(A:0x210900) "' name='RPMH_PDC_APPS_IRQ_STATUS_BANK0_DRV1'/>"
WRITE #1 "        <register address='0xb210904' value='0x" DATA.LONG(A:0x210904) "' name='RPMH_PDC_APPS_IRQ_STATUS_BANK1_DRV1'/>"
WRITE #1 "        <register address='0xb210908' value='0x" DATA.LONG(A:0x210908) "' name='RPMH_PDC_APPS_IRQ_STATUS_BANK2_DRV1'/>"
WRITE #1 "        <register address='0xb21090c' value='0x" DATA.LONG(A:0x21090c) "' name='RPMH_PDC_APPS_IRQ_STATUS_BANK3_DRV1'/>"
WRITE #1 "        <register address='0xb220900' value='0x" DATA.LONG(A:0x220900) "' name='RPMH_PDC_APPS_IRQ_STATUS_BANK0_DRV2'/>"
WRITE #1 "        <register address='0xb220904' value='0x" DATA.LONG(A:0x220904) "' name='RPMH_PDC_APPS_IRQ_STATUS_BANK1_DRV2'/>"
WRITE #1 "        <register address='0xb220908' value='0x" DATA.LONG(A:0x220908) "' name='RPMH_PDC_APPS_IRQ_STATUS_BANK2_DRV2'/>"
WRITE #1 "        <register address='0xb22090c' value='0x" DATA.LONG(A:0x22090c) "' name='RPMH_PDC_APPS_IRQ_STATUS_BANK3_DRV2'/>"
WRITE #1 "        <register address='0xb201000' value='0x" DATA.LONG(A:0x201000) "' name='RPMH_PDC_APPS_PDC_VERSION_DRV0'/>"
WRITE #1 "        <register address='0xb211000' value='0x" DATA.LONG(A:0x211000) "' name='RPMH_PDC_APPS_PDC_VERSION_DRV1'/>"
WRITE #1 "        <register address='0xb221000' value='0x" DATA.LONG(A:0x221000) "' name='RPMH_PDC_APPS_PDC_VERSION_DRV2'/>"
WRITE #1 "        <register address='0xb201004' value='0x" DATA.LONG(A:0x201004) "' name='RPMH_PDC_APPS_PDC_PARAM_RESOURCE_DRV0'/>"
WRITE #1 "        <register address='0xb211004' value='0x" DATA.LONG(A:0x211004) "' name='RPMH_PDC_APPS_PDC_PARAM_RESOURCE_DRV1'/>"
WRITE #1 "        <register address='0xb221004' value='0x" DATA.LONG(A:0x221004) "' name='RPMH_PDC_APPS_PDC_PARAM_RESOURCE_DRV2'/>"
WRITE #1 "        <register address='0xb201008' value='0x" DATA.LONG(A:0x201008) "' name='RPMH_PDC_APPS_PDC_PARAM_SEQ_CONFIG_DRV0'/>"
WRITE #1 "        <register address='0xb211008' value='0x" DATA.LONG(A:0x211008) "' name='RPMH_PDC_APPS_PDC_PARAM_SEQ_CONFIG_DRV1'/>"
WRITE #1 "        <register address='0xb221008' value='0x" DATA.LONG(A:0x221008) "' name='RPMH_PDC_APPS_PDC_PARAM_SEQ_CONFIG_DRV2'/>"
WRITE #1 "        <register address='0xb20100c' value='0x" DATA.LONG(A:0x20100c) "' name='RPMH_PDC_APPS_PDC_PARAM_IRQ_CONFIG_DRV0'/>"
WRITE #1 "        <register address='0xb21100c' value='0x" DATA.LONG(A:0x21100c) "' name='RPMH_PDC_APPS_PDC_PARAM_IRQ_CONFIG_DRV1'/>"
WRITE #1 "        <register address='0xb22100c' value='0x" DATA.LONG(A:0x22100c) "' name='RPMH_PDC_APPS_PDC_PARAM_IRQ_CONFIG_DRV2'/>"
WRITE #1 "        <register address='0xb201020' value='0x" DATA.LONG(A:0x201020) "' name='RPMH_PDC_APPS_SEQ_BUSY_DRV0'/>"
WRITE #1 "        <register address='0xb211020' value='0x" DATA.LONG(A:0x211020) "' name='RPMH_PDC_APPS_SEQ_BUSY_DRV1'/>"
WRITE #1 "        <register address='0xb221020' value='0x" DATA.LONG(A:0x221020) "' name='RPMH_PDC_APPS_SEQ_BUSY_DRV2'/>"
WRITE #1 "        <register address='0xb201024' value='0x" DATA.LONG(A:0x201024) "' name='RPMH_PDC_APPS_SEQ_DBG_PROGRAM_COUNTER_DRV0'/>"
WRITE #1 "        <register address='0xb211024' value='0x" DATA.LONG(A:0x211024) "' name='RPMH_PDC_APPS_SEQ_DBG_PROGRAM_COUNTER_DRV1'/>"
WRITE #1 "        <register address='0xb221024' value='0x" DATA.LONG(A:0x221024) "' name='RPMH_PDC_APPS_SEQ_DBG_PROGRAM_COUNTER_DRV2'/>"
WRITE #1 "        <register address='0xb201028' value='0x" DATA.LONG(A:0x201028) "' name='RPMH_PDC_APPS_SEQ_DBG_STAT_DRV0'/>"
WRITE #1 "        <register address='0xb211028' value='0x" DATA.LONG(A:0x211028) "' name='RPMH_PDC_APPS_SEQ_DBG_STAT_DRV1'/>"
WRITE #1 "        <register address='0xb221028' value='0x" DATA.LONG(A:0x221028) "' name='RPMH_PDC_APPS_SEQ_DBG_STAT_DRV2'/>"
WRITE #1 "        <register address='0xb20102c' value='0x" DATA.LONG(A:0x20102c) "' name='RPMH_PDC_APPS_SEQ_DBG_WAIT_EVNT_DRV0'/>"
WRITE #1 "        <register address='0xb21102c' value='0x" DATA.LONG(A:0x21102c) "' name='RPMH_PDC_APPS_SEQ_DBG_WAIT_EVNT_DRV1'/>"
WRITE #1 "        <register address='0xb22102c' value='0x" DATA.LONG(A:0x22102c) "' name='RPMH_PDC_APPS_SEQ_DBG_WAIT_EVNT_DRV2'/>"
WRITE #1 "        <register address='0xb201030' value='0x" DATA.LONG(A:0x201030) "' name='RPMH_PDC_APPS_PDC_MODE_STATUS_DRV0'/>"
WRITE #1 "        <register address='0xb211030' value='0x" DATA.LONG(A:0x211030) "' name='RPMH_PDC_APPS_PDC_MODE_STATUS_DRV1'/>"
WRITE #1 "        <register address='0xb221030' value='0x" DATA.LONG(A:0x221030) "' name='RPMH_PDC_APPS_PDC_MODE_STATUS_DRV2'/>"
WRITE #1 "        <register address='0xb201034' value='0x" DATA.LONG(A:0x201034) "' name='RPMH_PDC_APPS_DBG_EPCB_RX_ADDR0'/>"
WRITE #1 "        <register address='0xb211034' value='0x" DATA.LONG(A:0x211034) "' name='RPMH_PDC_APPS_DBG_EPCB_RX_ADDR1'/>"
WRITE #1 "        <register address='0xb221034' value='0x" DATA.LONG(A:0x221034) "' name='RPMH_PDC_APPS_DBG_EPCB_RX_ADDR2'/>"
WRITE #1 "        <register address='0xb201038' value='0x" DATA.LONG(A:0x201038) "' name='RPMH_PDC_APPS_DBG_EPCB_RX_DATA0'/>"
WRITE #1 "        <register address='0xb211038' value='0x" DATA.LONG(A:0x211038) "' name='RPMH_PDC_APPS_DBG_EPCB_RX_DATA1'/>"
WRITE #1 "        <register address='0xb221038' value='0x" DATA.LONG(A:0x221038) "' name='RPMH_PDC_APPS_DBG_EPCB_RX_DATA2'/>"
WRITE #1 "        <register address='0xb201200' value='0x" DATA.LONG(A:0x201200) "' name='RPMH_PDC_APPS_PROFILING_UNIT0_DRV0_OUTPUT'/>"
WRITE #1 "        <register address='0xb201214' value='0x" DATA.LONG(A:0x201214) "' name='RPMH_PDC_APPS_PROFILING_UNIT1_DRV0_OUTPUT'/>"
WRITE #1 "        <register address='0xb201228' value='0x" DATA.LONG(A:0x201228) "' name='RPMH_PDC_APPS_PROFILING_UNIT2_DRV0_OUTPUT'/>"
WRITE #1 "        <register address='0xb20123c' value='0x" DATA.LONG(A:0x20123c) "' name='RPMH_PDC_APPS_PROFILING_UNIT3_DRV0_OUTPUT'/>"
WRITE #1 "        <register address='0xb201250' value='0x" DATA.LONG(A:0x201250) "' name='RPMH_PDC_APPS_PROFILING_UNIT4_DRV0_OUTPUT'/>"
WRITE #1 "        <register address='0xb211200' value='0x" DATA.LONG(A:0x211200) "' name='RPMH_PDC_APPS_PROFILING_UNIT0_DRV1_OUTPUT'/>"
WRITE #1 "        <register address='0xb211214' value='0x" DATA.LONG(A:0x211214) "' name='RPMH_PDC_APPS_PROFILING_UNIT1_DRV1_OUTPUT'/>"
WRITE #1 "        <register address='0xb211228' value='0x" DATA.LONG(A:0x211228) "' name='RPMH_PDC_APPS_PROFILING_UNIT2_DRV1_OUTPUT'/>"
WRITE #1 "        <register address='0xb21123c' value='0x" DATA.LONG(A:0x21123c) "' name='RPMH_PDC_APPS_PROFILING_UNIT3_DRV1_OUTPUT'/>"
WRITE #1 "        <register address='0xb211250' value='0x" DATA.LONG(A:0x211250) "' name='RPMH_PDC_APPS_PROFILING_UNIT4_DRV1_OUTPUT'/>"
WRITE #1 "        <register address='0xb221200' value='0x" DATA.LONG(A:0x221200) "' name='RPMH_PDC_APPS_PROFILING_UNIT0_DRV2_OUTPUT'/>"
WRITE #1 "        <register address='0xb221214' value='0x" DATA.LONG(A:0x221214) "' name='RPMH_PDC_APPS_PROFILING_UNIT1_DRV2_OUTPUT'/>"
WRITE #1 "        <register address='0xb221228' value='0x" DATA.LONG(A:0x221228) "' name='RPMH_PDC_APPS_PROFILING_UNIT2_DRV2_OUTPUT'/>"
WRITE #1 "        <register address='0xb22123c' value='0x" DATA.LONG(A:0x22123c) "' name='RPMH_PDC_APPS_PROFILING_UNIT3_DRV2_OUTPUT'/>"
WRITE #1 "        <register address='0xb221250' value='0x" DATA.LONG(A:0x221250) "' name='RPMH_PDC_APPS_PROFILING_UNIT4_DRV2_OUTPUT'/>"
WRITE #1 "        <register address='0xb201204' value='0x" DATA.LONG(A:0x201204) "' name='RPMH_PDC_APPS_PROFILING_UNIT0_DRV0_TIMESTAMP_LO'/>"
WRITE #1 "        <register address='0xb201218' value='0x" DATA.LONG(A:0x201218) "' name='RPMH_PDC_APPS_PROFILING_UNIT1_DRV0_TIMESTAMP_LO'/>"
WRITE #1 "        <register address='0xb20122c' value='0x" DATA.LONG(A:0x20122c) "' name='RPMH_PDC_APPS_PROFILING_UNIT2_DRV0_TIMESTAMP_LO'/>"
WRITE #1 "        <register address='0xb201240' value='0x" DATA.LONG(A:0x201240) "' name='RPMH_PDC_APPS_PROFILING_UNIT3_DRV0_TIMESTAMP_LO'/>"
WRITE #1 "        <register address='0xb201254' value='0x" DATA.LONG(A:0x201254) "' name='RPMH_PDC_APPS_PROFILING_UNIT4_DRV0_TIMESTAMP_LO'/>"
WRITE #1 "        <register address='0xb211204' value='0x" DATA.LONG(A:0x211204) "' name='RPMH_PDC_APPS_PROFILING_UNIT0_DRV1_TIMESTAMP_LO'/>"
WRITE #1 "        <register address='0xb211218' value='0x" DATA.LONG(A:0x211218) "' name='RPMH_PDC_APPS_PROFILING_UNIT1_DRV1_TIMESTAMP_LO'/>"
WRITE #1 "        <register address='0xb21122c' value='0x" DATA.LONG(A:0x21122c) "' name='RPMH_PDC_APPS_PROFILING_UNIT2_DRV1_TIMESTAMP_LO'/>"
WRITE #1 "        <register address='0xb211240' value='0x" DATA.LONG(A:0x211240) "' name='RPMH_PDC_APPS_PROFILING_UNIT3_DRV1_TIMESTAMP_LO'/>"
WRITE #1 "        <register address='0xb211254' value='0x" DATA.LONG(A:0x211254) "' name='RPMH_PDC_APPS_PROFILING_UNIT4_DRV1_TIMESTAMP_LO'/>"
WRITE #1 "        <register address='0xb221204' value='0x" DATA.LONG(A:0x221204) "' name='RPMH_PDC_APPS_PROFILING_UNIT0_DRV2_TIMESTAMP_LO'/>"
WRITE #1 "        <register address='0xb221218' value='0x" DATA.LONG(A:0x221218) "' name='RPMH_PDC_APPS_PROFILING_UNIT1_DRV2_TIMESTAMP_LO'/>"
WRITE #1 "        <register address='0xb22122c' value='0x" DATA.LONG(A:0x22122c) "' name='RPMH_PDC_APPS_PROFILING_UNIT2_DRV2_TIMESTAMP_LO'/>"
WRITE #1 "        <register address='0xb221240' value='0x" DATA.LONG(A:0x221240) "' name='RPMH_PDC_APPS_PROFILING_UNIT3_DRV2_TIMESTAMP_LO'/>"
WRITE #1 "        <register address='0xb221254' value='0x" DATA.LONG(A:0x221254) "' name='RPMH_PDC_APPS_PROFILING_UNIT4_DRV2_TIMESTAMP_LO'/>"
WRITE #1 "        <register address='0xb201208' value='0x" DATA.LONG(A:0x201208) "' name='RPMH_PDC_APPS_PROFILING_UNIT0_DRV0_TIMESTAMP_HI'/>"
WRITE #1 "        <register address='0xb20121c' value='0x" DATA.LONG(A:0x20121c) "' name='RPMH_PDC_APPS_PROFILING_UNIT1_DRV0_TIMESTAMP_HI'/>"
WRITE #1 "        <register address='0xb201230' value='0x" DATA.LONG(A:0x201230) "' name='RPMH_PDC_APPS_PROFILING_UNIT2_DRV0_TIMESTAMP_HI'/>"
WRITE #1 "        <register address='0xb201244' value='0x" DATA.LONG(A:0x201244) "' name='RPMH_PDC_APPS_PROFILING_UNIT3_DRV0_TIMESTAMP_HI'/>"
WRITE #1 "        <register address='0xb201258' value='0x" DATA.LONG(A:0x201258) "' name='RPMH_PDC_APPS_PROFILING_UNIT4_DRV0_TIMESTAMP_HI'/>"
WRITE #1 "        <register address='0xb211208' value='0x" DATA.LONG(A:0x211208) "' name='RPMH_PDC_APPS_PROFILING_UNIT0_DRV1_TIMESTAMP_HI'/>"
WRITE #1 "        <register address='0xb21121c' value='0x" DATA.LONG(A:0x21121c) "' name='RPMH_PDC_APPS_PROFILING_UNIT1_DRV1_TIMESTAMP_HI'/>"
WRITE #1 "        <register address='0xb211230' value='0x" DATA.LONG(A:0x211230) "' name='RPMH_PDC_APPS_PROFILING_UNIT2_DRV1_TIMESTAMP_HI'/>"
WRITE #1 "        <register address='0xb211244' value='0x" DATA.LONG(A:0x211244) "' name='RPMH_PDC_APPS_PROFILING_UNIT3_DRV1_TIMESTAMP_HI'/>"
WRITE #1 "        <register address='0xb211258' value='0x" DATA.LONG(A:0x211258) "' name='RPMH_PDC_APPS_PROFILING_UNIT4_DRV1_TIMESTAMP_HI'/>"
WRITE #1 "        <register address='0xb221208' value='0x" DATA.LONG(A:0x221208) "' name='RPMH_PDC_APPS_PROFILING_UNIT0_DRV2_TIMESTAMP_HI'/>"
WRITE #1 "        <register address='0xb22121c' value='0x" DATA.LONG(A:0x22121c) "' name='RPMH_PDC_APPS_PROFILING_UNIT1_DRV2_TIMESTAMP_HI'/>"
WRITE #1 "        <register address='0xb221230' value='0x" DATA.LONG(A:0x221230) "' name='RPMH_PDC_APPS_PROFILING_UNIT2_DRV2_TIMESTAMP_HI'/>"
WRITE #1 "        <register address='0xb221244' value='0x" DATA.LONG(A:0x221244) "' name='RPMH_PDC_APPS_PROFILING_UNIT3_DRV2_TIMESTAMP_HI'/>"
WRITE #1 "        <register address='0xb221258' value='0x" DATA.LONG(A:0x221258) "' name='RPMH_PDC_APPS_PROFILING_UNIT4_DRV2_TIMESTAMP_HI'/>"
WRITE #1 "        <register address='0xb201300' value='0x" DATA.LONG(A:0x201300) "' name='RPMH_PDC_APPS_TCS0_DRV0_STATUS'/>"
WRITE #1 "        <register address='0xb2013c8' value='0x" DATA.LONG(A:0x2013c8) "' name='RPMH_PDC_APPS_TCS1_DRV0_STATUS'/>"
WRITE #1 "        <register address='0xb201490' value='0x" DATA.LONG(A:0x201490) "' name='RPMH_PDC_APPS_TCS2_DRV0_STATUS'/>"
WRITE #1 "        <register address='0xb201558' value='0x" DATA.LONG(A:0x201558) "' name='RPMH_PDC_APPS_TCS3_DRV0_STATUS'/>"
WRITE #1 "        <register address='0xb211300' value='0x" DATA.LONG(A:0x211300) "' name='RPMH_PDC_APPS_TCS0_DRV1_STATUS'/>"
WRITE #1 "        <register address='0xb2113c8' value='0x" DATA.LONG(A:0x2113c8) "' name='RPMH_PDC_APPS_TCS1_DRV1_STATUS'/>"
WRITE #1 "        <register address='0xb211490' value='0x" DATA.LONG(A:0x211490) "' name='RPMH_PDC_APPS_TCS2_DRV1_STATUS'/>"
WRITE #1 "        <register address='0xb211558' value='0x" DATA.LONG(A:0x211558) "' name='RPMH_PDC_APPS_TCS3_DRV1_STATUS'/>"
WRITE #1 "        <register address='0xb221300' value='0x" DATA.LONG(A:0x221300) "' name='RPMH_PDC_APPS_TCS0_DRV2_STATUS'/>"
WRITE #1 "        <register address='0xb2213c8' value='0x" DATA.LONG(A:0x2213c8) "' name='RPMH_PDC_APPS_TCS1_DRV2_STATUS'/>"
WRITE #1 "        <register address='0xb221490' value='0x" DATA.LONG(A:0x221490) "' name='RPMH_PDC_APPS_TCS2_DRV2_STATUS'/>"
WRITE #1 "        <register address='0xb221558' value='0x" DATA.LONG(A:0x221558) "' name='RPMH_PDC_APPS_TCS3_DRV2_STATUS'/>"
WRITE #1 "        <register address='0xb201304' value='0x" DATA.LONG(A:0x201304) "' name='RPMH_PDC_APPS_TCS0_CMD0_DRV0_STATUS'/>"
WRITE #1 "        <register address='0xb20130c' value='0x" DATA.LONG(A:0x20130c) "' name='RPMH_PDC_APPS_TCS0_CMD1_DRV0_STATUS'/>"
WRITE #1 "        <register address='0xb201314' value='0x" DATA.LONG(A:0x201314) "' name='RPMH_PDC_APPS_TCS0_CMD2_DRV0_STATUS'/>"
WRITE #1 "        <register address='0xb20131c' value='0x" DATA.LONG(A:0x20131c) "' name='RPMH_PDC_APPS_TCS0_CMD3_DRV0_STATUS'/>"
WRITE #1 "        <register address='0xb2013cc' value='0x" DATA.LONG(A:0x2013cc) "' name='RPMH_PDC_APPS_TCS1_CMD0_DRV0_STATUS'/>"
WRITE #1 "        <register address='0xb2013d4' value='0x" DATA.LONG(A:0x2013d4) "' name='RPMH_PDC_APPS_TCS1_CMD1_DRV0_STATUS'/>"
WRITE #1 "        <register address='0xb2013dc' value='0x" DATA.LONG(A:0x2013dc) "' name='RPMH_PDC_APPS_TCS1_CMD2_DRV0_STATUS'/>"
WRITE #1 "        <register address='0xb2013e4' value='0x" DATA.LONG(A:0x2013e4) "' name='RPMH_PDC_APPS_TCS1_CMD3_DRV0_STATUS'/>"
WRITE #1 "        <register address='0xb201494' value='0x" DATA.LONG(A:0x201494) "' name='RPMH_PDC_APPS_TCS2_CMD0_DRV0_STATUS'/>"
WRITE #1 "        <register address='0xb20149c' value='0x" DATA.LONG(A:0x20149c) "' name='RPMH_PDC_APPS_TCS2_CMD1_DRV0_STATUS'/>"
WRITE #1 "        <register address='0xb2014a4' value='0x" DATA.LONG(A:0x2014a4) "' name='RPMH_PDC_APPS_TCS2_CMD2_DRV0_STATUS'/>"
WRITE #1 "        <register address='0xb2014ac' value='0x" DATA.LONG(A:0x2014ac) "' name='RPMH_PDC_APPS_TCS2_CMD3_DRV0_STATUS'/>"
WRITE #1 "        <register address='0xb20155c' value='0x" DATA.LONG(A:0x20155c) "' name='RPMH_PDC_APPS_TCS3_CMD0_DRV0_STATUS'/>"
WRITE #1 "        <register address='0xb201564' value='0x" DATA.LONG(A:0x201564) "' name='RPMH_PDC_APPS_TCS3_CMD1_DRV0_STATUS'/>"
WRITE #1 "        <register address='0xb20156c' value='0x" DATA.LONG(A:0x20156c) "' name='RPMH_PDC_APPS_TCS3_CMD2_DRV0_STATUS'/>"
WRITE #1 "        <register address='0xb201574' value='0x" DATA.LONG(A:0x201574) "' name='RPMH_PDC_APPS_TCS3_CMD3_DRV0_STATUS'/>"
WRITE #1 "        <register address='0xb211304' value='0x" DATA.LONG(A:0x211304) "' name='RPMH_PDC_APPS_TCS0_CMD0_DRV1_STATUS'/>"
WRITE #1 "        <register address='0xb21130c' value='0x" DATA.LONG(A:0x21130c) "' name='RPMH_PDC_APPS_TCS0_CMD1_DRV1_STATUS'/>"
WRITE #1 "        <register address='0xb211314' value='0x" DATA.LONG(A:0x211314) "' name='RPMH_PDC_APPS_TCS0_CMD2_DRV1_STATUS'/>"
WRITE #1 "        <register address='0xb21131c' value='0x" DATA.LONG(A:0x21131c) "' name='RPMH_PDC_APPS_TCS0_CMD3_DRV1_STATUS'/>"
WRITE #1 "        <register address='0xb2113cc' value='0x" DATA.LONG(A:0x2113cc) "' name='RPMH_PDC_APPS_TCS1_CMD0_DRV1_STATUS'/>"
WRITE #1 "        <register address='0xb2113d4' value='0x" DATA.LONG(A:0x2113d4) "' name='RPMH_PDC_APPS_TCS1_CMD1_DRV1_STATUS'/>"
WRITE #1 "        <register address='0xb2113dc' value='0x" DATA.LONG(A:0x2113dc) "' name='RPMH_PDC_APPS_TCS1_CMD2_DRV1_STATUS'/>"
WRITE #1 "        <register address='0xb2113e4' value='0x" DATA.LONG(A:0x2113e4) "' name='RPMH_PDC_APPS_TCS1_CMD3_DRV1_STATUS'/>"
WRITE #1 "        <register address='0xb211494' value='0x" DATA.LONG(A:0x211494) "' name='RPMH_PDC_APPS_TCS2_CMD0_DRV1_STATUS'/>"
WRITE #1 "        <register address='0xb21149c' value='0x" DATA.LONG(A:0x21149c) "' name='RPMH_PDC_APPS_TCS2_CMD1_DRV1_STATUS'/>"
WRITE #1 "        <register address='0xb2114a4' value='0x" DATA.LONG(A:0x2114a4) "' name='RPMH_PDC_APPS_TCS2_CMD2_DRV1_STATUS'/>"
WRITE #1 "        <register address='0xb2114ac' value='0x" DATA.LONG(A:0x2114ac) "' name='RPMH_PDC_APPS_TCS2_CMD3_DRV1_STATUS'/>"
WRITE #1 "        <register address='0xb21155c' value='0x" DATA.LONG(A:0x21155c) "' name='RPMH_PDC_APPS_TCS3_CMD0_DRV1_STATUS'/>"
WRITE #1 "        <register address='0xb211564' value='0x" DATA.LONG(A:0x211564) "' name='RPMH_PDC_APPS_TCS3_CMD1_DRV1_STATUS'/>"
WRITE #1 "        <register address='0xb21156c' value='0x" DATA.LONG(A:0x21156c) "' name='RPMH_PDC_APPS_TCS3_CMD2_DRV1_STATUS'/>"
WRITE #1 "        <register address='0xb211574' value='0x" DATA.LONG(A:0x211574) "' name='RPMH_PDC_APPS_TCS3_CMD3_DRV1_STATUS'/>"
WRITE #1 "        <register address='0xb221304' value='0x" DATA.LONG(A:0x221304) "' name='RPMH_PDC_APPS_TCS0_CMD0_DRV2_STATUS'/>"
WRITE #1 "        <register address='0xb22130c' value='0x" DATA.LONG(A:0x22130c) "' name='RPMH_PDC_APPS_TCS0_CMD1_DRV2_STATUS'/>"
WRITE #1 "        <register address='0xb221314' value='0x" DATA.LONG(A:0x221314) "' name='RPMH_PDC_APPS_TCS0_CMD2_DRV2_STATUS'/>"
WRITE #1 "        <register address='0xb22131c' value='0x" DATA.LONG(A:0x22131c) "' name='RPMH_PDC_APPS_TCS0_CMD3_DRV2_STATUS'/>"
WRITE #1 "        <register address='0xb2213cc' value='0x" DATA.LONG(A:0x2213cc) "' name='RPMH_PDC_APPS_TCS1_CMD0_DRV2_STATUS'/>"
WRITE #1 "        <register address='0xb2213d4' value='0x" DATA.LONG(A:0x2213d4) "' name='RPMH_PDC_APPS_TCS1_CMD1_DRV2_STATUS'/>"
WRITE #1 "        <register address='0xb2213dc' value='0x" DATA.LONG(A:0x2213dc) "' name='RPMH_PDC_APPS_TCS1_CMD2_DRV2_STATUS'/>"
WRITE #1 "        <register address='0xb2213e4' value='0x" DATA.LONG(A:0x2213e4) "' name='RPMH_PDC_APPS_TCS1_CMD3_DRV2_STATUS'/>"
WRITE #1 "        <register address='0xb221494' value='0x" DATA.LONG(A:0x221494) "' name='RPMH_PDC_APPS_TCS2_CMD0_DRV2_STATUS'/>"
WRITE #1 "        <register address='0xb22149c' value='0x" DATA.LONG(A:0x22149c) "' name='RPMH_PDC_APPS_TCS2_CMD1_DRV2_STATUS'/>"
WRITE #1 "        <register address='0xb2214a4' value='0x" DATA.LONG(A:0x2214a4) "' name='RPMH_PDC_APPS_TCS2_CMD2_DRV2_STATUS'/>"
WRITE #1 "        <register address='0xb2214ac' value='0x" DATA.LONG(A:0x2214ac) "' name='RPMH_PDC_APPS_TCS2_CMD3_DRV2_STATUS'/>"
WRITE #1 "        <register address='0xb22155c' value='0x" DATA.LONG(A:0x22155c) "' name='RPMH_PDC_APPS_TCS3_CMD0_DRV2_STATUS'/>"
WRITE #1 "        <register address='0xb221564' value='0x" DATA.LONG(A:0x221564) "' name='RPMH_PDC_APPS_TCS3_CMD1_DRV2_STATUS'/>"
WRITE #1 "        <register address='0xb22156c' value='0x" DATA.LONG(A:0x22156c) "' name='RPMH_PDC_APPS_TCS3_CMD2_DRV2_STATUS'/>"
WRITE #1 "        <register address='0xb221574' value='0x" DATA.LONG(A:0x221574) "' name='RPMH_PDC_APPS_TCS3_CMD3_DRV2_STATUS'/>"
WRITE #1 "        <register address='0xb204500' value='0x" DATA.LONG(A:0x204500) "' name='RPMH_PDC_APPS_ENABLE_PDC'/>"
WRITE #1 "        <register address='0xb204510' value='0x" DATA.LONG(A:0x204510) "' name='RPMH_PDC_APPS_TIMER_MATCH_VALUE_LO'/>"
WRITE #1 "        <register address='0xb204514' value='0x" DATA.LONG(A:0x204514) "' name='RPMH_PDC_APPS_TIMER_MATCH_VALUE_HI'/>"
WRITE #1 "        <register address='0xb204518' value='0x" DATA.LONG(A:0x204518) "' name='RPMH_PDC_APPS_TIMER_DISABLED_FOR_ARC'/>"
WRITE #1 "        <register address='0xb204520' value='0x" DATA.LONG(A:0x204520) "' name='RPMH_PDC_APPS_SEQ_START_ADDR'/>"
WRITE #1 "        <register address='0xb204524' value='0x" DATA.LONG(A:0x204524) "' name='RPMH_PDC_APPS_SEQ_OVERRIDE_START_ADDR'/>"
WRITE #1 "        <register address='0xb20452c' value='0x" DATA.LONG(A:0x20452c) "' name='RPMH_PDC_APPS_SEQ_OVERRIDE_TRIGGER'/>"
WRITE #1 "        <register address='0xb204530' value='0x" DATA.LONG(A:0x204530) "' name='RPMH_PDC_APPS_SEQ_PWR_CTRL_OVERRIDE_MASK'/>"
WRITE #1 "        <register address='0xb204534' value='0x" DATA.LONG(A:0x204534) "' name='RPMH_PDC_APPS_SEQ_PWR_CTRL_OVERRIDE_VAL'/>"
WRITE #1 "        <register address='0xb204540' value='0x" DATA.LONG(A:0x204540) "' name='RPMH_PDC_APPS_SEQ_WAIT_EVENT_OVERRIDE_MASK'/>"
WRITE #1 "        <register address='0xb204544' value='0x" DATA.LONG(A:0x204544) "' name='RPMH_PDC_APPS_SEQ_WAIT_EVENT_OVERRIDE_VAL'/>"
WRITE #1 "        <register address='0xb204550' value='0x" DATA.LONG(A:0x204550) "' name='RPMH_PDC_APPS_SEQ_BR_EVENT_OVERRIDE_MASK'/>"
WRITE #1 "        <register address='0xb204554' value='0x" DATA.LONG(A:0x204554) "' name='RPMH_PDC_APPS_SEQ_BR_EVENT_OVERRIDE_VAL'/>"
WRITE #1 "        <register address='0xb204590' value='0x" DATA.LONG(A:0x204590) "' name='RPMH_PDC_APPS_SEQ_CFG_BR_ADDR_0'/>"
WRITE #1 "        <register address='0xb204594' value='0x" DATA.LONG(A:0x204594) "' name='RPMH_PDC_APPS_SEQ_CFG_BR_ADDR_1'/>"
WRITE #1 "        <register address='0xb204598' value='0x" DATA.LONG(A:0x204598) "' name='RPMH_PDC_APPS_SEQ_CFG_BR_ADDR_2'/>"
WRITE #1 "        <register address='0xb20459c' value='0x" DATA.LONG(A:0x20459c) "' name='RPMH_PDC_APPS_SEQ_CFG_BR_ADDR_3'/>"
WRITE #1 "        <register address='0xb2045a0' value='0x" DATA.LONG(A:0x2045a0) "' name='RPMH_PDC_APPS_SEQ_CFG_DELAY_VAL_0'/>"
WRITE #1 "        <register address='0xb2045a4' value='0x" DATA.LONG(A:0x2045a4) "' name='RPMH_PDC_APPS_SEQ_CFG_DELAY_VAL_1'/>"
WRITE #1 "        <register address='0xb2045a8' value='0x" DATA.LONG(A:0x2045a8) "' name='RPMH_PDC_APPS_SEQ_CFG_DELAY_VAL_2'/>"
WRITE #1 "        <register address='0xb2045ac' value='0x" DATA.LONG(A:0x2045ac) "' name='RPMH_PDC_APPS_SEQ_CFG_DELAY_VAL_3'/>"
WRITE #1 "        <register address='0xb2045b0' value='0x" DATA.LONG(A:0x2045b0) "' name='RPMH_PDC_APPS_SEQ_CFG_DELAY_VAL_4'/>"
WRITE #1 "        <register address='0xb2045b4' value='0x" DATA.LONG(A:0x2045b4) "' name='RPMH_PDC_APPS_SEQ_CFG_DELAY_VAL_5'/>"
WRITE #1 "        <register address='0xb2045b8' value='0x" DATA.LONG(A:0x2045b8) "' name='RPMH_PDC_APPS_SEQ_CFG_DELAY_VAL_6'/>"
WRITE #1 "        <register address='0xb2045bc' value='0x" DATA.LONG(A:0x2045bc) "' name='RPMH_PDC_APPS_SEQ_CFG_DELAY_VAL_7'/>"
WRITE #1 "        <register address='0xb2045c0' value='0x" DATA.LONG(A:0x2045c0) "' name='RPMH_PDC_APPS_SEQ_CFG_DELAY_VAL_8'/>"
WRITE #1 "        <register address='0xb2045c4' value='0x" DATA.LONG(A:0x2045c4) "' name='RPMH_PDC_APPS_SEQ_CFG_DELAY_VAL_9'/>"
WRITE #1 "        <register address='0xb2045c8' value='0x" DATA.LONG(A:0x2045c8) "' name='RPMH_PDC_APPS_SEQ_CFG_DELAY_VAL_10'/>"
WRITE #1 "        <register address='0xb2045cc' value='0x" DATA.LONG(A:0x2045cc) "' name='RPMH_PDC_APPS_SEQ_CFG_DELAY_VAL_11'/>"
WRITE #1 "        <register address='0xb2045d0' value='0x" DATA.LONG(A:0x2045d0) "' name='RPMH_PDC_APPS_SEQ_CFG_DELAY_VAL_12'/>"
WRITE #1 "        <register address='0xb2045d4' value='0x" DATA.LONG(A:0x2045d4) "' name='RPMH_PDC_APPS_SEQ_CFG_DELAY_VAL_13'/>"
WRITE #1 "        <register address='0xb2045d8' value='0x" DATA.LONG(A:0x2045d8) "' name='RPMH_PDC_APPS_SEQ_CFG_DELAY_VAL_14'/>"
WRITE #1 "        <register address='0xb2045dc' value='0x" DATA.LONG(A:0x2045dc) "' name='RPMH_PDC_APPS_SEQ_CFG_DELAY_VAL_15'/>"
WRITE #1 "        <register address='0xb2045e0' value='0x" DATA.LONG(A:0x2045e0) "' name='RPMH_PDC_APPS_SEQ_DBG_BREAKPOINT_ADDR'/>"
WRITE #1 "        <register address='0xb2045e4' value='0x" DATA.LONG(A:0x2045e4) "' name='RPMH_PDC_APPS_SEQ_DBG_STEP'/>"
WRITE #1 "        <register address='0xb204600' value='0x" DATA.LONG(A:0x204600) "' name='RPMH_PDC_APPS_IRQ_0_OWNER'/>"
WRITE #1 "        <register address='0xb204604' value='0x" DATA.LONG(A:0x204604) "' name='RPMH_PDC_APPS_IRQ_1_OWNER'/>"
WRITE #1 "        <register address='0xb204608' value='0x" DATA.LONG(A:0x204608) "' name='RPMH_PDC_APPS_IRQ_2_OWNER'/>"
WRITE #1 "        <register address='0xb20460c' value='0x" DATA.LONG(A:0x20460c) "' name='RPMH_PDC_APPS_IRQ_3_OWNER'/>"
WRITE #1 "        <register address='0xb204610' value='0x" DATA.LONG(A:0x204610) "' name='RPMH_PDC_APPS_IRQ_4_OWNER'/>"
WRITE #1 "        <register address='0xb204614' value='0x" DATA.LONG(A:0x204614) "' name='RPMH_PDC_APPS_IRQ_5_OWNER'/>"
WRITE #1 "        <register address='0xb204618' value='0x" DATA.LONG(A:0x204618) "' name='RPMH_PDC_APPS_IRQ_6_OWNER'/>"
WRITE #1 "        <register address='0xb20461c' value='0x" DATA.LONG(A:0x20461c) "' name='RPMH_PDC_APPS_IRQ_7_OWNER'/>"
WRITE #1 "        <register address='0xb204620' value='0x" DATA.LONG(A:0x204620) "' name='RPMH_PDC_APPS_IRQ_8_OWNER'/>"
WRITE #1 "        <register address='0xb204624' value='0x" DATA.LONG(A:0x204624) "' name='RPMH_PDC_APPS_IRQ_9_OWNER'/>"
WRITE #1 "        <register address='0xb204628' value='0x" DATA.LONG(A:0x204628) "' name='RPMH_PDC_APPS_IRQ_10_OWNER'/>"
WRITE #1 "        <register address='0xb20462c' value='0x" DATA.LONG(A:0x20462c) "' name='RPMH_PDC_APPS_IRQ_11_OWNER'/>"
WRITE #1 "        <register address='0xb204630' value='0x" DATA.LONG(A:0x204630) "' name='RPMH_PDC_APPS_IRQ_12_OWNER'/>"
WRITE #1 "        <register address='0xb204634' value='0x" DATA.LONG(A:0x204634) "' name='RPMH_PDC_APPS_IRQ_13_OWNER'/>"
WRITE #1 "        <register address='0xb204638' value='0x" DATA.LONG(A:0x204638) "' name='RPMH_PDC_APPS_IRQ_14_OWNER'/>"
WRITE #1 "        <register address='0xb20463c' value='0x" DATA.LONG(A:0x20463c) "' name='RPMH_PDC_APPS_IRQ_15_OWNER'/>"
WRITE #1 "        <register address='0xb204640' value='0x" DATA.LONG(A:0x204640) "' name='RPMH_PDC_APPS_IRQ_16_OWNER'/>"
WRITE #1 "        <register address='0xb204644' value='0x" DATA.LONG(A:0x204644) "' name='RPMH_PDC_APPS_IRQ_17_OWNER'/>"
WRITE #1 "        <register address='0xb204648' value='0x" DATA.LONG(A:0x204648) "' name='RPMH_PDC_APPS_IRQ_18_OWNER'/>"
WRITE #1 "        <register address='0xb20464c' value='0x" DATA.LONG(A:0x20464c) "' name='RPMH_PDC_APPS_IRQ_19_OWNER'/>"
WRITE #1 "        <register address='0xb204650' value='0x" DATA.LONG(A:0x204650) "' name='RPMH_PDC_APPS_IRQ_20_OWNER'/>"
WRITE #1 "        <register address='0xb204654' value='0x" DATA.LONG(A:0x204654) "' name='RPMH_PDC_APPS_IRQ_21_OWNER'/>"
WRITE #1 "        <register address='0xb204658' value='0x" DATA.LONG(A:0x204658) "' name='RPMH_PDC_APPS_IRQ_22_OWNER'/>"
WRITE #1 "        <register address='0xb20465c' value='0x" DATA.LONG(A:0x20465c) "' name='RPMH_PDC_APPS_IRQ_23_OWNER'/>"
WRITE #1 "        <register address='0xb204660' value='0x" DATA.LONG(A:0x204660) "' name='RPMH_PDC_APPS_IRQ_24_OWNER'/>"
WRITE #1 "        <register address='0xb204664' value='0x" DATA.LONG(A:0x204664) "' name='RPMH_PDC_APPS_IRQ_25_OWNER'/>"
WRITE #1 "        <register address='0xb204668' value='0x" DATA.LONG(A:0x204668) "' name='RPMH_PDC_APPS_IRQ_26_OWNER'/>"
WRITE #1 "        <register address='0xb20466c' value='0x" DATA.LONG(A:0x20466c) "' name='RPMH_PDC_APPS_IRQ_27_OWNER'/>"
WRITE #1 "        <register address='0xb204670' value='0x" DATA.LONG(A:0x204670) "' name='RPMH_PDC_APPS_IRQ_28_OWNER'/>"
WRITE #1 "        <register address='0xb204674' value='0x" DATA.LONG(A:0x204674) "' name='RPMH_PDC_APPS_IRQ_29_OWNER'/>"
WRITE #1 "        <register address='0xb204678' value='0x" DATA.LONG(A:0x204678) "' name='RPMH_PDC_APPS_IRQ_30_OWNER'/>"
WRITE #1 "        <register address='0xb20467c' value='0x" DATA.LONG(A:0x20467c) "' name='RPMH_PDC_APPS_IRQ_31_OWNER'/>"
WRITE #1 "        <register address='0xb204680' value='0x" DATA.LONG(A:0x204680) "' name='RPMH_PDC_APPS_IRQ_32_OWNER'/>"
WRITE #1 "        <register address='0xb204684' value='0x" DATA.LONG(A:0x204684) "' name='RPMH_PDC_APPS_IRQ_33_OWNER'/>"
WRITE #1 "        <register address='0xb204688' value='0x" DATA.LONG(A:0x204688) "' name='RPMH_PDC_APPS_IRQ_34_OWNER'/>"
WRITE #1 "        <register address='0xb20468c' value='0x" DATA.LONG(A:0x20468c) "' name='RPMH_PDC_APPS_IRQ_35_OWNER'/>"
WRITE #1 "        <register address='0xb204690' value='0x" DATA.LONG(A:0x204690) "' name='RPMH_PDC_APPS_IRQ_36_OWNER'/>"
WRITE #1 "        <register address='0xb204694' value='0x" DATA.LONG(A:0x204694) "' name='RPMH_PDC_APPS_IRQ_37_OWNER'/>"
WRITE #1 "        <register address='0xb204698' value='0x" DATA.LONG(A:0x204698) "' name='RPMH_PDC_APPS_IRQ_38_OWNER'/>"
WRITE #1 "        <register address='0xb20469c' value='0x" DATA.LONG(A:0x20469c) "' name='RPMH_PDC_APPS_IRQ_39_OWNER'/>"
WRITE #1 "        <register address='0xb2046a0' value='0x" DATA.LONG(A:0x2046a0) "' name='RPMH_PDC_APPS_IRQ_40_OWNER'/>"
WRITE #1 "        <register address='0xb2046a4' value='0x" DATA.LONG(A:0x2046a4) "' name='RPMH_PDC_APPS_IRQ_41_OWNER'/>"
WRITE #1 "        <register address='0xb2046a8' value='0x" DATA.LONG(A:0x2046a8) "' name='RPMH_PDC_APPS_IRQ_42_OWNER'/>"
WRITE #1 "        <register address='0xb2046ac' value='0x" DATA.LONG(A:0x2046ac) "' name='RPMH_PDC_APPS_IRQ_43_OWNER'/>"
WRITE #1 "        <register address='0xb2046b0' value='0x" DATA.LONG(A:0x2046b0) "' name='RPMH_PDC_APPS_IRQ_44_OWNER'/>"
WRITE #1 "        <register address='0xb2046b4' value='0x" DATA.LONG(A:0x2046b4) "' name='RPMH_PDC_APPS_IRQ_45_OWNER'/>"
WRITE #1 "        <register address='0xb2046b8' value='0x" DATA.LONG(A:0x2046b8) "' name='RPMH_PDC_APPS_IRQ_46_OWNER'/>"
WRITE #1 "        <register address='0xb2046bc' value='0x" DATA.LONG(A:0x2046bc) "' name='RPMH_PDC_APPS_IRQ_47_OWNER'/>"
WRITE #1 "        <register address='0xb2046c0' value='0x" DATA.LONG(A:0x2046c0) "' name='RPMH_PDC_APPS_IRQ_48_OWNER'/>"
WRITE #1 "        <register address='0xb2046c4' value='0x" DATA.LONG(A:0x2046c4) "' name='RPMH_PDC_APPS_IRQ_49_OWNER'/>"
WRITE #1 "        <register address='0xb2046c8' value='0x" DATA.LONG(A:0x2046c8) "' name='RPMH_PDC_APPS_IRQ_50_OWNER'/>"
WRITE #1 "        <register address='0xb2046cc' value='0x" DATA.LONG(A:0x2046cc) "' name='RPMH_PDC_APPS_IRQ_51_OWNER'/>"
WRITE #1 "        <register address='0xb2046d0' value='0x" DATA.LONG(A:0x2046d0) "' name='RPMH_PDC_APPS_IRQ_52_OWNER'/>"
WRITE #1 "        <register address='0xb2046d4' value='0x" DATA.LONG(A:0x2046d4) "' name='RPMH_PDC_APPS_IRQ_53_OWNER'/>"
WRITE #1 "        <register address='0xb2046d8' value='0x" DATA.LONG(A:0x2046d8) "' name='RPMH_PDC_APPS_IRQ_54_OWNER'/>"
WRITE #1 "        <register address='0xb2046dc' value='0x" DATA.LONG(A:0x2046dc) "' name='RPMH_PDC_APPS_IRQ_55_OWNER'/>"
WRITE #1 "        <register address='0xb2046e0' value='0x" DATA.LONG(A:0x2046e0) "' name='RPMH_PDC_APPS_IRQ_56_OWNER'/>"
WRITE #1 "        <register address='0xb2046e4' value='0x" DATA.LONG(A:0x2046e4) "' name='RPMH_PDC_APPS_IRQ_57_OWNER'/>"
WRITE #1 "        <register address='0xb2046e8' value='0x" DATA.LONG(A:0x2046e8) "' name='RPMH_PDC_APPS_IRQ_58_OWNER'/>"
WRITE #1 "        <register address='0xb2046ec' value='0x" DATA.LONG(A:0x2046ec) "' name='RPMH_PDC_APPS_IRQ_59_OWNER'/>"
WRITE #1 "        <register address='0xb2046f0' value='0x" DATA.LONG(A:0x2046f0) "' name='RPMH_PDC_APPS_IRQ_60_OWNER'/>"
WRITE #1 "        <register address='0xb2046f4' value='0x" DATA.LONG(A:0x2046f4) "' name='RPMH_PDC_APPS_IRQ_61_OWNER'/>"
WRITE #1 "        <register address='0xb2046f8' value='0x" DATA.LONG(A:0x2046f8) "' name='RPMH_PDC_APPS_IRQ_62_OWNER'/>"
WRITE #1 "        <register address='0xb2046fc' value='0x" DATA.LONG(A:0x2046fc) "' name='RPMH_PDC_APPS_IRQ_63_OWNER'/>"
WRITE #1 "        <register address='0xb204700' value='0x" DATA.LONG(A:0x204700) "' name='RPMH_PDC_APPS_IRQ_64_OWNER'/>"
WRITE #1 "        <register address='0xb204704' value='0x" DATA.LONG(A:0x204704) "' name='RPMH_PDC_APPS_IRQ_65_OWNER'/>"
WRITE #1 "        <register address='0xb204708' value='0x" DATA.LONG(A:0x204708) "' name='RPMH_PDC_APPS_IRQ_66_OWNER'/>"
WRITE #1 "        <register address='0xb20470c' value='0x" DATA.LONG(A:0x20470c) "' name='RPMH_PDC_APPS_IRQ_67_OWNER'/>"
WRITE #1 "        <register address='0xb204710' value='0x" DATA.LONG(A:0x204710) "' name='RPMH_PDC_APPS_IRQ_68_OWNER'/>"
WRITE #1 "        <register address='0xb204714' value='0x" DATA.LONG(A:0x204714) "' name='RPMH_PDC_APPS_IRQ_69_OWNER'/>"
WRITE #1 "        <register address='0xb204718' value='0x" DATA.LONG(A:0x204718) "' name='RPMH_PDC_APPS_IRQ_70_OWNER'/>"
WRITE #1 "        <register address='0xb20471c' value='0x" DATA.LONG(A:0x20471c) "' name='RPMH_PDC_APPS_IRQ_71_OWNER'/>"
WRITE #1 "        <register address='0xb204720' value='0x" DATA.LONG(A:0x204720) "' name='RPMH_PDC_APPS_IRQ_72_OWNER'/>"
WRITE #1 "        <register address='0xb204724' value='0x" DATA.LONG(A:0x204724) "' name='RPMH_PDC_APPS_IRQ_73_OWNER'/>"
WRITE #1 "        <register address='0xb204728' value='0x" DATA.LONG(A:0x204728) "' name='RPMH_PDC_APPS_IRQ_74_OWNER'/>"
WRITE #1 "        <register address='0xb20472c' value='0x" DATA.LONG(A:0x20472c) "' name='RPMH_PDC_APPS_IRQ_75_OWNER'/>"
WRITE #1 "        <register address='0xb204730' value='0x" DATA.LONG(A:0x204730) "' name='RPMH_PDC_APPS_IRQ_76_OWNER'/>"
WRITE #1 "        <register address='0xb204734' value='0x" DATA.LONG(A:0x204734) "' name='RPMH_PDC_APPS_IRQ_77_OWNER'/>"
WRITE #1 "        <register address='0xb204738' value='0x" DATA.LONG(A:0x204738) "' name='RPMH_PDC_APPS_IRQ_78_OWNER'/>"
WRITE #1 "        <register address='0xb20473c' value='0x" DATA.LONG(A:0x20473c) "' name='RPMH_PDC_APPS_IRQ_79_OWNER'/>"
WRITE #1 "        <register address='0xb204740' value='0x" DATA.LONG(A:0x204740) "' name='RPMH_PDC_APPS_IRQ_80_OWNER'/>"
WRITE #1 "        <register address='0xb204744' value='0x" DATA.LONG(A:0x204744) "' name='RPMH_PDC_APPS_IRQ_81_OWNER'/>"
WRITE #1 "        <register address='0xb204748' value='0x" DATA.LONG(A:0x204748) "' name='RPMH_PDC_APPS_IRQ_82_OWNER'/>"
WRITE #1 "        <register address='0xb20474c' value='0x" DATA.LONG(A:0x20474c) "' name='RPMH_PDC_APPS_IRQ_83_OWNER'/>"
WRITE #1 "        <register address='0xb204750' value='0x" DATA.LONG(A:0x204750) "' name='RPMH_PDC_APPS_IRQ_84_OWNER'/>"
WRITE #1 "        <register address='0xb204754' value='0x" DATA.LONG(A:0x204754) "' name='RPMH_PDC_APPS_IRQ_85_OWNER'/>"
WRITE #1 "        <register address='0xb204758' value='0x" DATA.LONG(A:0x204758) "' name='RPMH_PDC_APPS_IRQ_86_OWNER'/>"
WRITE #1 "        <register address='0xb20475c' value='0x" DATA.LONG(A:0x20475c) "' name='RPMH_PDC_APPS_IRQ_87_OWNER'/>"
WRITE #1 "        <register address='0xb204760' value='0x" DATA.LONG(A:0x204760) "' name='RPMH_PDC_APPS_IRQ_88_OWNER'/>"
WRITE #1 "        <register address='0xb204764' value='0x" DATA.LONG(A:0x204764) "' name='RPMH_PDC_APPS_IRQ_89_OWNER'/>"
WRITE #1 "        <register address='0xb204768' value='0x" DATA.LONG(A:0x204768) "' name='RPMH_PDC_APPS_IRQ_90_OWNER'/>"
WRITE #1 "        <register address='0xb20476c' value='0x" DATA.LONG(A:0x20476c) "' name='RPMH_PDC_APPS_IRQ_91_OWNER'/>"
WRITE #1 "        <register address='0xb204770' value='0x" DATA.LONG(A:0x204770) "' name='RPMH_PDC_APPS_IRQ_92_OWNER'/>"
WRITE #1 "        <register address='0xb204774' value='0x" DATA.LONG(A:0x204774) "' name='RPMH_PDC_APPS_IRQ_93_OWNER'/>"
WRITE #1 "        <register address='0xb204778' value='0x" DATA.LONG(A:0x204778) "' name='RPMH_PDC_APPS_IRQ_94_OWNER'/>"
WRITE #1 "        <register address='0xb20477c' value='0x" DATA.LONG(A:0x20477c) "' name='RPMH_PDC_APPS_IRQ_95_OWNER'/>"
WRITE #1 "        <register address='0xb204780' value='0x" DATA.LONG(A:0x204780) "' name='RPMH_PDC_APPS_IRQ_96_OWNER'/>"
WRITE #1 "        <register address='0xb204784' value='0x" DATA.LONG(A:0x204784) "' name='RPMH_PDC_APPS_IRQ_97_OWNER'/>"
WRITE #1 "        <register address='0xb204788' value='0x" DATA.LONG(A:0x204788) "' name='RPMH_PDC_APPS_IRQ_98_OWNER'/>"
WRITE #1 "        <register address='0xb20478c' value='0x" DATA.LONG(A:0x20478c) "' name='RPMH_PDC_APPS_IRQ_99_OWNER'/>"
WRITE #1 "        <register address='0xb204790' value='0x" DATA.LONG(A:0x204790) "' name='RPMH_PDC_APPS_IRQ_100_OWNER'/>"
WRITE #1 "        <register address='0xb204794' value='0x" DATA.LONG(A:0x204794) "' name='RPMH_PDC_APPS_IRQ_101_OWNER'/>"
WRITE #1 "        <register address='0xb204798' value='0x" DATA.LONG(A:0x204798) "' name='RPMH_PDC_APPS_IRQ_102_OWNER'/>"
WRITE #1 "        <register address='0xb20479c' value='0x" DATA.LONG(A:0x20479c) "' name='RPMH_PDC_APPS_IRQ_103_OWNER'/>"
WRITE #1 "        <register address='0xb2047a0' value='0x" DATA.LONG(A:0x2047a0) "' name='RPMH_PDC_APPS_IRQ_104_OWNER'/>"
WRITE #1 "        <register address='0xb2047a4' value='0x" DATA.LONG(A:0x2047a4) "' name='RPMH_PDC_APPS_IRQ_105_OWNER'/>"
WRITE #1 "        <register address='0xb2047a8' value='0x" DATA.LONG(A:0x2047a8) "' name='RPMH_PDC_APPS_IRQ_106_OWNER'/>"
WRITE #1 "        <register address='0xb2047ac' value='0x" DATA.LONG(A:0x2047ac) "' name='RPMH_PDC_APPS_IRQ_107_OWNER'/>"
WRITE #1 "        <register address='0xb2047b0' value='0x" DATA.LONG(A:0x2047b0) "' name='RPMH_PDC_APPS_IRQ_108_OWNER'/>"
WRITE #1 "        <register address='0xb2047b4' value='0x" DATA.LONG(A:0x2047b4) "' name='RPMH_PDC_APPS_IRQ_109_OWNER'/>"
WRITE #1 "        <register address='0xb2047b8' value='0x" DATA.LONG(A:0x2047b8) "' name='RPMH_PDC_APPS_IRQ_110_OWNER'/>"
WRITE #1 "        <register address='0xb2047bc' value='0x" DATA.LONG(A:0x2047bc) "' name='RPMH_PDC_APPS_IRQ_111_OWNER'/>"
WRITE #1 "        <register address='0xb2047c0' value='0x" DATA.LONG(A:0x2047c0) "' name='RPMH_PDC_APPS_IRQ_112_OWNER'/>"
WRITE #1 "        <register address='0xb2047c4' value='0x" DATA.LONG(A:0x2047c4) "' name='RPMH_PDC_APPS_IRQ_113_OWNER'/>"
WRITE #1 "        <register address='0xb2047c8' value='0x" DATA.LONG(A:0x2047c8) "' name='RPMH_PDC_APPS_IRQ_114_OWNER'/>"
WRITE #1 "        <register address='0xb2047cc' value='0x" DATA.LONG(A:0x2047cc) "' name='RPMH_PDC_APPS_IRQ_115_OWNER'/>"
WRITE #1 "        <register address='0xb2047d0' value='0x" DATA.LONG(A:0x2047d0) "' name='RPMH_PDC_APPS_IRQ_116_OWNER'/>"
WRITE #1 "        <register address='0xb2047d4' value='0x" DATA.LONG(A:0x2047d4) "' name='RPMH_PDC_APPS_IRQ_117_OWNER'/>"
WRITE #1 "        <register address='0xb2047d8' value='0x" DATA.LONG(A:0x2047d8) "' name='RPMH_PDC_APPS_IRQ_118_OWNER'/>"
WRITE #1 "        <register address='0xb2047dc' value='0x" DATA.LONG(A:0x2047dc) "' name='RPMH_PDC_APPS_IRQ_119_OWNER'/>"
WRITE #1 "        <register address='0xb2047e0' value='0x" DATA.LONG(A:0x2047e0) "' name='RPMH_PDC_APPS_IRQ_120_OWNER'/>"
WRITE #1 "        <register address='0xb2047e4' value='0x" DATA.LONG(A:0x2047e4) "' name='RPMH_PDC_APPS_IRQ_121_OWNER'/>"
WRITE #1 "        <register address='0xb2047e8' value='0x" DATA.LONG(A:0x2047e8) "' name='RPMH_PDC_APPS_IRQ_122_OWNER'/>"
WRITE #1 "        <register address='0xb2047ec' value='0x" DATA.LONG(A:0x2047ec) "' name='RPMH_PDC_APPS_IRQ_123_OWNER'/>"
WRITE #1 "        <register address='0xb2047f0' value='0x" DATA.LONG(A:0x2047f0) "' name='RPMH_PDC_APPS_IRQ_124_OWNER'/>"
WRITE #1 "        <register address='0xb2047f4' value='0x" DATA.LONG(A:0x2047f4) "' name='RPMH_PDC_APPS_IRQ_125_OWNER'/>"
WRITE #1 "        <register address='0xb205000' value='0x" DATA.LONG(A:0x205000) "' name='RPMH_PDC_APPS_PROFILING_UNIT0_EN'/>"
WRITE #1 "        <register address='0xb205014' value='0x" DATA.LONG(A:0x205014) "' name='RPMH_PDC_APPS_PROFILING_UNIT1_EN'/>"
WRITE #1 "        <register address='0xb205028' value='0x" DATA.LONG(A:0x205028) "' name='RPMH_PDC_APPS_PROFILING_UNIT2_EN'/>"
WRITE #1 "        <register address='0xb20503c' value='0x" DATA.LONG(A:0x20503c) "' name='RPMH_PDC_APPS_PROFILING_UNIT3_EN'/>"
WRITE #1 "        <register address='0xb205050' value='0x" DATA.LONG(A:0x205050) "' name='RPMH_PDC_APPS_PROFILING_UNIT4_EN'/>"
WRITE #1 "        <register address='0xb205500' value='0x" DATA.LONG(A:0x205500) "' name='RPMH_PDC_APPS_TCS0_CONTROL'/>"
WRITE #1 "        <register address='0xb2055c8' value='0x" DATA.LONG(A:0x2055c8) "' name='RPMH_PDC_APPS_TCS1_CONTROL'/>"
WRITE #1 "        <register address='0xb205690' value='0x" DATA.LONG(A:0x205690) "' name='RPMH_PDC_APPS_TCS2_CONTROL'/>"
WRITE #1 "        <register address='0xb205758' value='0x" DATA.LONG(A:0x205758) "' name='RPMH_PDC_APPS_TCS3_CONTROL'/>"
WRITE #1 "        <register address='0xb205504' value='0x" DATA.LONG(A:0x205504) "' name='RPMH_PDC_APPS_TCS0_CMD_ENABLE_BANK'/>"
WRITE #1 "        <register address='0xb2055cc' value='0x" DATA.LONG(A:0x2055cc) "' name='RPMH_PDC_APPS_TCS1_CMD_ENABLE_BANK'/>"
WRITE #1 "        <register address='0xb205694' value='0x" DATA.LONG(A:0x205694) "' name='RPMH_PDC_APPS_TCS2_CMD_ENABLE_BANK'/>"
WRITE #1 "        <register address='0xb20575c' value='0x" DATA.LONG(A:0x20575c) "' name='RPMH_PDC_APPS_TCS3_CMD_ENABLE_BANK'/>"
WRITE #1 "        <register address='0xb205508' value='0x" DATA.LONG(A:0x205508) "' name='RPMH_PDC_APPS_TCS0_CMD_WAIT_FOR_CMPL_BANK'/>"
WRITE #1 "        <register address='0xb2055d0' value='0x" DATA.LONG(A:0x2055d0) "' name='RPMH_PDC_APPS_TCS1_CMD_WAIT_FOR_CMPL_BANK'/>"
WRITE #1 "        <register address='0xb205698' value='0x" DATA.LONG(A:0x205698) "' name='RPMH_PDC_APPS_TCS2_CMD_WAIT_FOR_CMPL_BANK'/>"
WRITE #1 "        <register address='0xb205760' value='0x" DATA.LONG(A:0x205760) "' name='RPMH_PDC_APPS_TCS3_CMD_WAIT_FOR_CMPL_BANK'/>"
WRITE #1 "        <register address='0xb20550c' value='0x" DATA.LONG(A:0x20550c) "' name='RPMH_PDC_APPS_TCS0_CMD0_MSGID'/>"
WRITE #1 "        <register address='0xb20551c' value='0x" DATA.LONG(A:0x20551c) "' name='RPMH_PDC_APPS_TCS0_CMD1_MSGID'/>"
WRITE #1 "        <register address='0xb20552c' value='0x" DATA.LONG(A:0x20552c) "' name='RPMH_PDC_APPS_TCS0_CMD2_MSGID'/>"
WRITE #1 "        <register address='0xb20553c' value='0x" DATA.LONG(A:0x20553c) "' name='RPMH_PDC_APPS_TCS0_CMD3_MSGID'/>"
WRITE #1 "        <register address='0xb2055d4' value='0x" DATA.LONG(A:0x2055d4) "' name='RPMH_PDC_APPS_TCS1_CMD0_MSGID'/>"
WRITE #1 "        <register address='0xb2055e4' value='0x" DATA.LONG(A:0x2055e4) "' name='RPMH_PDC_APPS_TCS1_CMD1_MSGID'/>"
WRITE #1 "        <register address='0xb2055f4' value='0x" DATA.LONG(A:0x2055f4) "' name='RPMH_PDC_APPS_TCS1_CMD2_MSGID'/>"
WRITE #1 "        <register address='0xb205604' value='0x" DATA.LONG(A:0x205604) "' name='RPMH_PDC_APPS_TCS1_CMD3_MSGID'/>"
WRITE #1 "        <register address='0xb20569c' value='0x" DATA.LONG(A:0x20569c) "' name='RPMH_PDC_APPS_TCS2_CMD0_MSGID'/>"
WRITE #1 "        <register address='0xb2056ac' value='0x" DATA.LONG(A:0x2056ac) "' name='RPMH_PDC_APPS_TCS2_CMD1_MSGID'/>"
WRITE #1 "        <register address='0xb2056bc' value='0x" DATA.LONG(A:0x2056bc) "' name='RPMH_PDC_APPS_TCS2_CMD2_MSGID'/>"
WRITE #1 "        <register address='0xb2056cc' value='0x" DATA.LONG(A:0x2056cc) "' name='RPMH_PDC_APPS_TCS2_CMD3_MSGID'/>"
WRITE #1 "        <register address='0xb205764' value='0x" DATA.LONG(A:0x205764) "' name='RPMH_PDC_APPS_TCS3_CMD0_MSGID'/>"
WRITE #1 "        <register address='0xb205774' value='0x" DATA.LONG(A:0x205774) "' name='RPMH_PDC_APPS_TCS3_CMD1_MSGID'/>"
WRITE #1 "        <register address='0xb205784' value='0x" DATA.LONG(A:0x205784) "' name='RPMH_PDC_APPS_TCS3_CMD2_MSGID'/>"
WRITE #1 "        <register address='0xb205794' value='0x" DATA.LONG(A:0x205794) "' name='RPMH_PDC_APPS_TCS3_CMD3_MSGID'/>"
WRITE #1 "        <register address='0xb205510' value='0x" DATA.LONG(A:0x205510) "' name='RPMH_PDC_APPS_TCS0_CMD0_ADDR'/>"
WRITE #1 "        <register address='0xb205520' value='0x" DATA.LONG(A:0x205520) "' name='RPMH_PDC_APPS_TCS0_CMD1_ADDR'/>"
WRITE #1 "        <register address='0xb205530' value='0x" DATA.LONG(A:0x205530) "' name='RPMH_PDC_APPS_TCS0_CMD2_ADDR'/>"
WRITE #1 "        <register address='0xb205540' value='0x" DATA.LONG(A:0x205540) "' name='RPMH_PDC_APPS_TCS0_CMD3_ADDR'/>"
WRITE #1 "        <register address='0xb2055d8' value='0x" DATA.LONG(A:0x2055d8) "' name='RPMH_PDC_APPS_TCS1_CMD0_ADDR'/>"
WRITE #1 "        <register address='0xb2055e8' value='0x" DATA.LONG(A:0x2055e8) "' name='RPMH_PDC_APPS_TCS1_CMD1_ADDR'/>"
WRITE #1 "        <register address='0xb2055f8' value='0x" DATA.LONG(A:0x2055f8) "' name='RPMH_PDC_APPS_TCS1_CMD2_ADDR'/>"
WRITE #1 "        <register address='0xb205608' value='0x" DATA.LONG(A:0x205608) "' name='RPMH_PDC_APPS_TCS1_CMD3_ADDR'/>"
WRITE #1 "        <register address='0xb2056a0' value='0x" DATA.LONG(A:0x2056a0) "' name='RPMH_PDC_APPS_TCS2_CMD0_ADDR'/>"
WRITE #1 "        <register address='0xb2056b0' value='0x" DATA.LONG(A:0x2056b0) "' name='RPMH_PDC_APPS_TCS2_CMD1_ADDR'/>"
WRITE #1 "        <register address='0xb2056c0' value='0x" DATA.LONG(A:0x2056c0) "' name='RPMH_PDC_APPS_TCS2_CMD2_ADDR'/>"
WRITE #1 "        <register address='0xb2056d0' value='0x" DATA.LONG(A:0x2056d0) "' name='RPMH_PDC_APPS_TCS2_CMD3_ADDR'/>"
WRITE #1 "        <register address='0xb205768' value='0x" DATA.LONG(A:0x205768) "' name='RPMH_PDC_APPS_TCS3_CMD0_ADDR'/>"
WRITE #1 "        <register address='0xb205778' value='0x" DATA.LONG(A:0x205778) "' name='RPMH_PDC_APPS_TCS3_CMD1_ADDR'/>"
WRITE #1 "        <register address='0xb205788' value='0x" DATA.LONG(A:0x205788) "' name='RPMH_PDC_APPS_TCS3_CMD2_ADDR'/>"
WRITE #1 "        <register address='0xb205798' value='0x" DATA.LONG(A:0x205798) "' name='RPMH_PDC_APPS_TCS3_CMD3_ADDR'/>"
WRITE #1 "        <register address='0xb205514' value='0x" DATA.LONG(A:0x205514) "' name='RPMH_PDC_APPS_TCS0_CMD0_DATA'/>"
WRITE #1 "        <register address='0xb205524' value='0x" DATA.LONG(A:0x205524) "' name='RPMH_PDC_APPS_TCS0_CMD1_DATA'/>"
WRITE #1 "        <register address='0xb205534' value='0x" DATA.LONG(A:0x205534) "' name='RPMH_PDC_APPS_TCS0_CMD2_DATA'/>"
WRITE #1 "        <register address='0xb205544' value='0x" DATA.LONG(A:0x205544) "' name='RPMH_PDC_APPS_TCS0_CMD3_DATA'/>"
WRITE #1 "        <register address='0xb2055dc' value='0x" DATA.LONG(A:0x2055dc) "' name='RPMH_PDC_APPS_TCS1_CMD0_DATA'/>"
WRITE #1 "        <register address='0xb2055ec' value='0x" DATA.LONG(A:0x2055ec) "' name='RPMH_PDC_APPS_TCS1_CMD1_DATA'/>"
WRITE #1 "        <register address='0xb2055fc' value='0x" DATA.LONG(A:0x2055fc) "' name='RPMH_PDC_APPS_TCS1_CMD2_DATA'/>"
WRITE #1 "        <register address='0xb20560c' value='0x" DATA.LONG(A:0x20560c) "' name='RPMH_PDC_APPS_TCS1_CMD3_DATA'/>"
WRITE #1 "        <register address='0xb2056a4' value='0x" DATA.LONG(A:0x2056a4) "' name='RPMH_PDC_APPS_TCS2_CMD0_DATA'/>"
WRITE #1 "        <register address='0xb2056b4' value='0x" DATA.LONG(A:0x2056b4) "' name='RPMH_PDC_APPS_TCS2_CMD1_DATA'/>"
WRITE #1 "        <register address='0xb2056c4' value='0x" DATA.LONG(A:0x2056c4) "' name='RPMH_PDC_APPS_TCS2_CMD2_DATA'/>"
WRITE #1 "        <register address='0xb2056d4' value='0x" DATA.LONG(A:0x2056d4) "' name='RPMH_PDC_APPS_TCS2_CMD3_DATA'/>"
WRITE #1 "        <register address='0xb20576c' value='0x" DATA.LONG(A:0x20576c) "' name='RPMH_PDC_APPS_TCS3_CMD0_DATA'/>"
WRITE #1 "        <register address='0xb20577c' value='0x" DATA.LONG(A:0x20577c) "' name='RPMH_PDC_APPS_TCS3_CMD1_DATA'/>"
WRITE #1 "        <register address='0xb20578c' value='0x" DATA.LONG(A:0x20578c) "' name='RPMH_PDC_APPS_TCS3_CMD2_DATA'/>"
WRITE #1 "        <register address='0xb20579c' value='0x" DATA.LONG(A:0x20579c) "' name='RPMH_PDC_APPS_TCS3_CMD3_DATA'/>"
WRITE #1 "        <register address='0xb230000' value='0x" DATA.LONG(A:0x230000) "' name='RPMH_PDC_AUDIO_SENSORS_VOTE_CMP_DATA_DRV0'/>"
WRITE #1 "        <register address='0xb230010' value='0x" DATA.LONG(A:0x230010) "' name='RPMH_PDC_AUDIO_SENSORS_IRQ_ENABLE_BANK0_DRV0'/>"
WRITE #1 "        <register address='0xb230014' value='0x" DATA.LONG(A:0x230014) "' name='RPMH_PDC_AUDIO_SENSORS_IRQ_ENABLE_BANK1_DRV0'/>"
WRITE #1 "        <register address='0xb230018' value='0x" DATA.LONG(A:0x230018) "' name='RPMH_PDC_AUDIO_SENSORS_IRQ_ENABLE_BANK2_DRV0'/>"
WRITE #1 "        <register address='0xb230110' value='0x" DATA.LONG(A:0x230110) "' name='RPMH_PDC_AUDIO_SENSORS_IRQ_0_CFG_DRV0'/>"
WRITE #1 "        <register address='0xb230114' value='0x" DATA.LONG(A:0x230114) "' name='RPMH_PDC_AUDIO_SENSORS_IRQ_1_CFG_DRV0'/>"
WRITE #1 "        <register address='0xb230118' value='0x" DATA.LONG(A:0x230118) "' name='RPMH_PDC_AUDIO_SENSORS_IRQ_2_CFG_DRV0'/>"
WRITE #1 "        <register address='0xb23011c' value='0x" DATA.LONG(A:0x23011c) "' name='RPMH_PDC_AUDIO_SENSORS_IRQ_3_CFG_DRV0'/>"
WRITE #1 "        <register address='0xb230120' value='0x" DATA.LONG(A:0x230120) "' name='RPMH_PDC_AUDIO_SENSORS_IRQ_4_CFG_DRV0'/>"
WRITE #1 "        <register address='0xb230124' value='0x" DATA.LONG(A:0x230124) "' name='RPMH_PDC_AUDIO_SENSORS_IRQ_5_CFG_DRV0'/>"
WRITE #1 "        <register address='0xb230128' value='0x" DATA.LONG(A:0x230128) "' name='RPMH_PDC_AUDIO_SENSORS_IRQ_6_CFG_DRV0'/>"
WRITE #1 "        <register address='0xb23012c' value='0x" DATA.LONG(A:0x23012c) "' name='RPMH_PDC_AUDIO_SENSORS_IRQ_7_CFG_DRV0'/>"
WRITE #1 "        <register address='0xb230130' value='0x" DATA.LONG(A:0x230130) "' name='RPMH_PDC_AUDIO_SENSORS_IRQ_8_CFG_DRV0'/>"
WRITE #1 "        <register address='0xb230134' value='0x" DATA.LONG(A:0x230134) "' name='RPMH_PDC_AUDIO_SENSORS_IRQ_9_CFG_DRV0'/>"
WRITE #1 "        <register address='0xb230138' value='0x" DATA.LONG(A:0x230138) "' name='RPMH_PDC_AUDIO_SENSORS_IRQ_10_CFG_DRV0'/>"
WRITE #1 "        <register address='0xb23013c' value='0x" DATA.LONG(A:0x23013c) "' name='RPMH_PDC_AUDIO_SENSORS_IRQ_11_CFG_DRV0'/>"
WRITE #1 "        <register address='0xb230140' value='0x" DATA.LONG(A:0x230140) "' name='RPMH_PDC_AUDIO_SENSORS_IRQ_12_CFG_DRV0'/>"
WRITE #1 "        <register address='0xb230144' value='0x" DATA.LONG(A:0x230144) "' name='RPMH_PDC_AUDIO_SENSORS_IRQ_13_CFG_DRV0'/>"
WRITE #1 "        <register address='0xb230148' value='0x" DATA.LONG(A:0x230148) "' name='RPMH_PDC_AUDIO_SENSORS_IRQ_14_CFG_DRV0'/>"
WRITE #1 "        <register address='0xb23014c' value='0x" DATA.LONG(A:0x23014c) "' name='RPMH_PDC_AUDIO_SENSORS_IRQ_15_CFG_DRV0'/>"
WRITE #1 "        <register address='0xb230150' value='0x" DATA.LONG(A:0x230150) "' name='RPMH_PDC_AUDIO_SENSORS_IRQ_16_CFG_DRV0'/>"
WRITE #1 "        <register address='0xb230154' value='0x" DATA.LONG(A:0x230154) "' name='RPMH_PDC_AUDIO_SENSORS_IRQ_17_CFG_DRV0'/>"
WRITE #1 "        <register address='0xb230158' value='0x" DATA.LONG(A:0x230158) "' name='RPMH_PDC_AUDIO_SENSORS_IRQ_18_CFG_DRV0'/>"
WRITE #1 "        <register address='0xb23015c' value='0x" DATA.LONG(A:0x23015c) "' name='RPMH_PDC_AUDIO_SENSORS_IRQ_19_CFG_DRV0'/>"
WRITE #1 "        <register address='0xb230160' value='0x" DATA.LONG(A:0x230160) "' name='RPMH_PDC_AUDIO_SENSORS_IRQ_20_CFG_DRV0'/>"
WRITE #1 "        <register address='0xb230164' value='0x" DATA.LONG(A:0x230164) "' name='RPMH_PDC_AUDIO_SENSORS_IRQ_21_CFG_DRV0'/>"
WRITE #1 "        <register address='0xb230168' value='0x" DATA.LONG(A:0x230168) "' name='RPMH_PDC_AUDIO_SENSORS_IRQ_22_CFG_DRV0'/>"
WRITE #1 "        <register address='0xb23016c' value='0x" DATA.LONG(A:0x23016c) "' name='RPMH_PDC_AUDIO_SENSORS_IRQ_23_CFG_DRV0'/>"
WRITE #1 "        <register address='0xb230170' value='0x" DATA.LONG(A:0x230170) "' name='RPMH_PDC_AUDIO_SENSORS_IRQ_24_CFG_DRV0'/>"
WRITE #1 "        <register address='0xb230174' value='0x" DATA.LONG(A:0x230174) "' name='RPMH_PDC_AUDIO_SENSORS_IRQ_25_CFG_DRV0'/>"
WRITE #1 "        <register address='0xb230178' value='0x" DATA.LONG(A:0x230178) "' name='RPMH_PDC_AUDIO_SENSORS_IRQ_26_CFG_DRV0'/>"
WRITE #1 "        <register address='0xb23017c' value='0x" DATA.LONG(A:0x23017c) "' name='RPMH_PDC_AUDIO_SENSORS_IRQ_27_CFG_DRV0'/>"
WRITE #1 "        <register address='0xb230180' value='0x" DATA.LONG(A:0x230180) "' name='RPMH_PDC_AUDIO_SENSORS_IRQ_28_CFG_DRV0'/>"
WRITE #1 "        <register address='0xb230184' value='0x" DATA.LONG(A:0x230184) "' name='RPMH_PDC_AUDIO_SENSORS_IRQ_29_CFG_DRV0'/>"
WRITE #1 "        <register address='0xb230188' value='0x" DATA.LONG(A:0x230188) "' name='RPMH_PDC_AUDIO_SENSORS_IRQ_30_CFG_DRV0'/>"
WRITE #1 "        <register address='0xb23018c' value='0x" DATA.LONG(A:0x23018c) "' name='RPMH_PDC_AUDIO_SENSORS_IRQ_31_CFG_DRV0'/>"
WRITE #1 "        <register address='0xb230190' value='0x" DATA.LONG(A:0x230190) "' name='RPMH_PDC_AUDIO_SENSORS_IRQ_32_CFG_DRV0'/>"
WRITE #1 "        <register address='0xb230194' value='0x" DATA.LONG(A:0x230194) "' name='RPMH_PDC_AUDIO_SENSORS_IRQ_33_CFG_DRV0'/>"
WRITE #1 "        <register address='0xb230198' value='0x" DATA.LONG(A:0x230198) "' name='RPMH_PDC_AUDIO_SENSORS_IRQ_34_CFG_DRV0'/>"
WRITE #1 "        <register address='0xb23019c' value='0x" DATA.LONG(A:0x23019c) "' name='RPMH_PDC_AUDIO_SENSORS_IRQ_35_CFG_DRV0'/>"
WRITE #1 "        <register address='0xb2301a0' value='0x" DATA.LONG(A:0x2301a0) "' name='RPMH_PDC_AUDIO_SENSORS_IRQ_36_CFG_DRV0'/>"
WRITE #1 "        <register address='0xb2301a4' value='0x" DATA.LONG(A:0x2301a4) "' name='RPMH_PDC_AUDIO_SENSORS_IRQ_37_CFG_DRV0'/>"
WRITE #1 "        <register address='0xb2301a8' value='0x" DATA.LONG(A:0x2301a8) "' name='RPMH_PDC_AUDIO_SENSORS_IRQ_38_CFG_DRV0'/>"
WRITE #1 "        <register address='0xb2301ac' value='0x" DATA.LONG(A:0x2301ac) "' name='RPMH_PDC_AUDIO_SENSORS_IRQ_39_CFG_DRV0'/>"
WRITE #1 "        <register address='0xb2301b0' value='0x" DATA.LONG(A:0x2301b0) "' name='RPMH_PDC_AUDIO_SENSORS_IRQ_40_CFG_DRV0'/>"
WRITE #1 "        <register address='0xb2301b4' value='0x" DATA.LONG(A:0x2301b4) "' name='RPMH_PDC_AUDIO_SENSORS_IRQ_41_CFG_DRV0'/>"
WRITE #1 "        <register address='0xb2301b8' value='0x" DATA.LONG(A:0x2301b8) "' name='RPMH_PDC_AUDIO_SENSORS_IRQ_42_CFG_DRV0'/>"
WRITE #1 "        <register address='0xb2301bc' value='0x" DATA.LONG(A:0x2301bc) "' name='RPMH_PDC_AUDIO_SENSORS_IRQ_43_CFG_DRV0'/>"
WRITE #1 "        <register address='0xb2301c0' value='0x" DATA.LONG(A:0x2301c0) "' name='RPMH_PDC_AUDIO_SENSORS_IRQ_44_CFG_DRV0'/>"
WRITE #1 "        <register address='0xb2301c4' value='0x" DATA.LONG(A:0x2301c4) "' name='RPMH_PDC_AUDIO_SENSORS_IRQ_45_CFG_DRV0'/>"
WRITE #1 "        <register address='0xb2301c8' value='0x" DATA.LONG(A:0x2301c8) "' name='RPMH_PDC_AUDIO_SENSORS_IRQ_46_CFG_DRV0'/>"
WRITE #1 "        <register address='0xb2301cc' value='0x" DATA.LONG(A:0x2301cc) "' name='RPMH_PDC_AUDIO_SENSORS_IRQ_47_CFG_DRV0'/>"
WRITE #1 "        <register address='0xb2301d0' value='0x" DATA.LONG(A:0x2301d0) "' name='RPMH_PDC_AUDIO_SENSORS_IRQ_48_CFG_DRV0'/>"
WRITE #1 "        <register address='0xb2301d4' value='0x" DATA.LONG(A:0x2301d4) "' name='RPMH_PDC_AUDIO_SENSORS_IRQ_49_CFG_DRV0'/>"
WRITE #1 "        <register address='0xb2301d8' value='0x" DATA.LONG(A:0x2301d8) "' name='RPMH_PDC_AUDIO_SENSORS_IRQ_50_CFG_DRV0'/>"
WRITE #1 "        <register address='0xb2301dc' value='0x" DATA.LONG(A:0x2301dc) "' name='RPMH_PDC_AUDIO_SENSORS_IRQ_51_CFG_DRV0'/>"
WRITE #1 "        <register address='0xb2301e0' value='0x" DATA.LONG(A:0x2301e0) "' name='RPMH_PDC_AUDIO_SENSORS_IRQ_52_CFG_DRV0'/>"
WRITE #1 "        <register address='0xb2301e4' value='0x" DATA.LONG(A:0x2301e4) "' name='RPMH_PDC_AUDIO_SENSORS_IRQ_53_CFG_DRV0'/>"
WRITE #1 "        <register address='0xb2301e8' value='0x" DATA.LONG(A:0x2301e8) "' name='RPMH_PDC_AUDIO_SENSORS_IRQ_54_CFG_DRV0'/>"
WRITE #1 "        <register address='0xb2301ec' value='0x" DATA.LONG(A:0x2301ec) "' name='RPMH_PDC_AUDIO_SENSORS_IRQ_55_CFG_DRV0'/>"
WRITE #1 "        <register address='0xb2301f0' value='0x" DATA.LONG(A:0x2301f0) "' name='RPMH_PDC_AUDIO_SENSORS_IRQ_56_CFG_DRV0'/>"
WRITE #1 "        <register address='0xb2301f4' value='0x" DATA.LONG(A:0x2301f4) "' name='RPMH_PDC_AUDIO_SENSORS_IRQ_57_CFG_DRV0'/>"
WRITE #1 "        <register address='0xb2301f8' value='0x" DATA.LONG(A:0x2301f8) "' name='RPMH_PDC_AUDIO_SENSORS_IRQ_58_CFG_DRV0'/>"
WRITE #1 "        <register address='0xb2301fc' value='0x" DATA.LONG(A:0x2301fc) "' name='RPMH_PDC_AUDIO_SENSORS_IRQ_59_CFG_DRV0'/>"
WRITE #1 "        <register address='0xb230200' value='0x" DATA.LONG(A:0x230200) "' name='RPMH_PDC_AUDIO_SENSORS_IRQ_60_CFG_DRV0'/>"
WRITE #1 "        <register address='0xb230204' value='0x" DATA.LONG(A:0x230204) "' name='RPMH_PDC_AUDIO_SENSORS_IRQ_61_CFG_DRV0'/>"
WRITE #1 "        <register address='0xb230208' value='0x" DATA.LONG(A:0x230208) "' name='RPMH_PDC_AUDIO_SENSORS_IRQ_62_CFG_DRV0'/>"
WRITE #1 "        <register address='0xb23020c' value='0x" DATA.LONG(A:0x23020c) "' name='RPMH_PDC_AUDIO_SENSORS_IRQ_63_CFG_DRV0'/>"
WRITE #1 "        <register address='0xb230210' value='0x" DATA.LONG(A:0x230210) "' name='RPMH_PDC_AUDIO_SENSORS_IRQ_64_CFG_DRV0'/>"
WRITE #1 "        <register address='0xb230214' value='0x" DATA.LONG(A:0x230214) "' name='RPMH_PDC_AUDIO_SENSORS_IRQ_65_CFG_DRV0'/>"
WRITE #1 "        <register address='0xb230218' value='0x" DATA.LONG(A:0x230218) "' name='RPMH_PDC_AUDIO_SENSORS_IRQ_66_CFG_DRV0'/>"
WRITE #1 "        <register address='0xb23021c' value='0x" DATA.LONG(A:0x23021c) "' name='RPMH_PDC_AUDIO_SENSORS_IRQ_67_CFG_DRV0'/>"
WRITE #1 "        <register address='0xb230220' value='0x" DATA.LONG(A:0x230220) "' name='RPMH_PDC_AUDIO_SENSORS_IRQ_68_CFG_DRV0'/>"
WRITE #1 "        <register address='0xb230224' value='0x" DATA.LONG(A:0x230224) "' name='RPMH_PDC_AUDIO_SENSORS_IRQ_69_CFG_DRV0'/>"
WRITE #1 "        <register address='0xb230228' value='0x" DATA.LONG(A:0x230228) "' name='RPMH_PDC_AUDIO_SENSORS_IRQ_70_CFG_DRV0'/>"
WRITE #1 "        <register address='0xb23022c' value='0x" DATA.LONG(A:0x23022c) "' name='RPMH_PDC_AUDIO_SENSORS_IRQ_71_CFG_DRV0'/>"
WRITE #1 "        <register address='0xb230230' value='0x" DATA.LONG(A:0x230230) "' name='RPMH_PDC_AUDIO_SENSORS_IRQ_72_CFG_DRV0'/>"
WRITE #1 "        <register address='0xb230234' value='0x" DATA.LONG(A:0x230234) "' name='RPMH_PDC_AUDIO_SENSORS_IRQ_73_CFG_DRV0'/>"
WRITE #1 "        <register address='0xb230238' value='0x" DATA.LONG(A:0x230238) "' name='RPMH_PDC_AUDIO_SENSORS_IRQ_74_CFG_DRV0'/>"
WRITE #1 "        <register address='0xb23023c' value='0x" DATA.LONG(A:0x23023c) "' name='RPMH_PDC_AUDIO_SENSORS_IRQ_75_CFG_DRV0'/>"
WRITE #1 "        <register address='0xb230240' value='0x" DATA.LONG(A:0x230240) "' name='RPMH_PDC_AUDIO_SENSORS_IRQ_76_CFG_DRV0'/>"
WRITE #1 "        <register address='0xb230244' value='0x" DATA.LONG(A:0x230244) "' name='RPMH_PDC_AUDIO_SENSORS_IRQ_77_CFG_DRV0'/>"
WRITE #1 "        <register address='0xb230248' value='0x" DATA.LONG(A:0x230248) "' name='RPMH_PDC_AUDIO_SENSORS_IRQ_78_CFG_DRV0'/>"
WRITE #1 "        <register address='0xb23024c' value='0x" DATA.LONG(A:0x23024c) "' name='RPMH_PDC_AUDIO_SENSORS_IRQ_79_CFG_DRV0'/>"
WRITE #1 "        <register address='0xb230250' value='0x" DATA.LONG(A:0x230250) "' name='RPMH_PDC_AUDIO_SENSORS_IRQ_80_CFG_DRV0'/>"
WRITE #1 "        <register address='0xb230254' value='0x" DATA.LONG(A:0x230254) "' name='RPMH_PDC_AUDIO_SENSORS_IRQ_81_CFG_DRV0'/>"
WRITE #1 "        <register address='0xb230258' value='0x" DATA.LONG(A:0x230258) "' name='RPMH_PDC_AUDIO_SENSORS_IRQ_82_CFG_DRV0'/>"
WRITE #1 "        <register address='0xb230900' value='0x" DATA.LONG(A:0x230900) "' name='RPMH_PDC_AUDIO_SENSORS_IRQ_STATUS_BANK0_DRV0'/>"
WRITE #1 "        <register address='0xb230904' value='0x" DATA.LONG(A:0x230904) "' name='RPMH_PDC_AUDIO_SENSORS_IRQ_STATUS_BANK1_DRV0'/>"
WRITE #1 "        <register address='0xb230908' value='0x" DATA.LONG(A:0x230908) "' name='RPMH_PDC_AUDIO_SENSORS_IRQ_STATUS_BANK2_DRV0'/>"
WRITE #1 "        <register address='0xb231000' value='0x" DATA.LONG(A:0x231000) "' name='RPMH_PDC_AUDIO_SENSORS_PDC_VERSION_DRV0'/>"
WRITE #1 "        <register address='0xb231004' value='0x" DATA.LONG(A:0x231004) "' name='RPMH_PDC_AUDIO_SENSORS_PDC_PARAM_RESOURCE_DRV0'/>"
WRITE #1 "        <register address='0xb231008' value='0x" DATA.LONG(A:0x231008) "' name='RPMH_PDC_AUDIO_SENSORS_PDC_PARAM_SEQ_CONFIG_DRV0'/>"
WRITE #1 "        <register address='0xb23100c' value='0x" DATA.LONG(A:0x23100c) "' name='RPMH_PDC_AUDIO_SENSORS_PDC_PARAM_IRQ_CONFIG_DRV0'/>"
WRITE #1 "        <register address='0xb231020' value='0x" DATA.LONG(A:0x231020) "' name='RPMH_PDC_AUDIO_SENSORS_SEQ_BUSY_DRV0'/>"
WRITE #1 "        <register address='0xb231024' value='0x" DATA.LONG(A:0x231024) "' name='RPMH_PDC_AUDIO_SENSORS_SEQ_DBG_PROGRAM_COUNTER_DRV0'/>"
WRITE #1 "        <register address='0xb231028' value='0x" DATA.LONG(A:0x231028) "' name='RPMH_PDC_AUDIO_SENSORS_SEQ_DBG_STAT_DRV0'/>"
WRITE #1 "        <register address='0xb23102c' value='0x" DATA.LONG(A:0x23102c) "' name='RPMH_PDC_AUDIO_SENSORS_SEQ_DBG_WAIT_EVNT_DRV0'/>"
WRITE #1 "        <register address='0xb231030' value='0x" DATA.LONG(A:0x231030) "' name='RPMH_PDC_AUDIO_SENSORS_PDC_MODE_STATUS_DRV0'/>"
WRITE #1 "        <register address='0xb231034' value='0x" DATA.LONG(A:0x231034) "' name='RPMH_PDC_AUDIO_SENSORS_DBG_EPCB_RX_ADDR0'/>"
WRITE #1 "        <register address='0xb231038' value='0x" DATA.LONG(A:0x231038) "' name='RPMH_PDC_AUDIO_SENSORS_DBG_EPCB_RX_DATA0'/>"
WRITE #1 "        <register address='0xb231040' value='0x" DATA.LONG(A:0x231040) "' name='RPMH_PDC_AUDIO_SENSORS_TIMESTAMP_UNIT0_DRV0_OUTPUT'/>"
WRITE #1 "        <register address='0xb231054' value='0x" DATA.LONG(A:0x231054) "' name='RPMH_PDC_AUDIO_SENSORS_TIMESTAMP_UNIT1_DRV0_OUTPUT'/>"
WRITE #1 "        <register address='0xb231068' value='0x" DATA.LONG(A:0x231068) "' name='RPMH_PDC_AUDIO_SENSORS_TIMESTAMP_UNIT2_DRV0_OUTPUT'/>"
WRITE #1 "        <register address='0xb23107c' value='0x" DATA.LONG(A:0x23107c) "' name='RPMH_PDC_AUDIO_SENSORS_TIMESTAMP_UNIT3_DRV0_OUTPUT'/>"
WRITE #1 "        <register address='0xb231090' value='0x" DATA.LONG(A:0x231090) "' name='RPMH_PDC_AUDIO_SENSORS_TIMESTAMP_UNIT4_DRV0_OUTPUT'/>"
WRITE #1 "        <register address='0xb231044' value='0x" DATA.LONG(A:0x231044) "' name='RPMH_PDC_AUDIO_SENSORS_TIMESTAMP_UNIT0_DRV0_TIMESTAMP_LO'/>"
WRITE #1 "        <register address='0xb231058' value='0x" DATA.LONG(A:0x231058) "' name='RPMH_PDC_AUDIO_SENSORS_TIMESTAMP_UNIT1_DRV0_TIMESTAMP_LO'/>"
WRITE #1 "        <register address='0xb23106c' value='0x" DATA.LONG(A:0x23106c) "' name='RPMH_PDC_AUDIO_SENSORS_TIMESTAMP_UNIT2_DRV0_TIMESTAMP_LO'/>"
WRITE #1 "        <register address='0xb231080' value='0x" DATA.LONG(A:0x231080) "' name='RPMH_PDC_AUDIO_SENSORS_TIMESTAMP_UNIT3_DRV0_TIMESTAMP_LO'/>"
WRITE #1 "        <register address='0xb231094' value='0x" DATA.LONG(A:0x231094) "' name='RPMH_PDC_AUDIO_SENSORS_TIMESTAMP_UNIT4_DRV0_TIMESTAMP_LO'/>"
WRITE #1 "        <register address='0xb231048' value='0x" DATA.LONG(A:0x231048) "' name='RPMH_PDC_AUDIO_SENSORS_TIMESTAMP_UNIT0_DRV0_TIMESTAMP_HI'/>"
WRITE #1 "        <register address='0xb23105c' value='0x" DATA.LONG(A:0x23105c) "' name='RPMH_PDC_AUDIO_SENSORS_TIMESTAMP_UNIT1_DRV0_TIMESTAMP_HI'/>"
WRITE #1 "        <register address='0xb231070' value='0x" DATA.LONG(A:0x231070) "' name='RPMH_PDC_AUDIO_SENSORS_TIMESTAMP_UNIT2_DRV0_TIMESTAMP_HI'/>"
WRITE #1 "        <register address='0xb231084' value='0x" DATA.LONG(A:0x231084) "' name='RPMH_PDC_AUDIO_SENSORS_TIMESTAMP_UNIT3_DRV0_TIMESTAMP_HI'/>"
WRITE #1 "        <register address='0xb231098' value='0x" DATA.LONG(A:0x231098) "' name='RPMH_PDC_AUDIO_SENSORS_TIMESTAMP_UNIT4_DRV0_TIMESTAMP_HI'/>"
WRITE #1 "        <register address='0xb231200' value='0x" DATA.LONG(A:0x231200) "' name='RPMH_PDC_AUDIO_SENSORS_PROFILING_UNIT0_DRV0_OUTPUT'/>"
WRITE #1 "        <register address='0xb231214' value='0x" DATA.LONG(A:0x231214) "' name='RPMH_PDC_AUDIO_SENSORS_PROFILING_UNIT1_DRV0_OUTPUT'/>"
WRITE #1 "        <register address='0xb231228' value='0x" DATA.LONG(A:0x231228) "' name='RPMH_PDC_AUDIO_SENSORS_PROFILING_UNIT2_DRV0_OUTPUT'/>"
WRITE #1 "        <register address='0xb23123c' value='0x" DATA.LONG(A:0x23123c) "' name='RPMH_PDC_AUDIO_SENSORS_PROFILING_UNIT3_DRV0_OUTPUT'/>"
WRITE #1 "        <register address='0xb231250' value='0x" DATA.LONG(A:0x231250) "' name='RPMH_PDC_AUDIO_SENSORS_PROFILING_UNIT4_DRV0_OUTPUT'/>"
WRITE #1 "        <register address='0xb231204' value='0x" DATA.LONG(A:0x231204) "' name='RPMH_PDC_AUDIO_SENSORS_PROFILING_UNIT0_DRV0_TIMESTAMP_LO'/>"
WRITE #1 "        <register address='0xb231218' value='0x" DATA.LONG(A:0x231218) "' name='RPMH_PDC_AUDIO_SENSORS_PROFILING_UNIT1_DRV0_TIMESTAMP_LO'/>"
WRITE #1 "        <register address='0xb23122c' value='0x" DATA.LONG(A:0x23122c) "' name='RPMH_PDC_AUDIO_SENSORS_PROFILING_UNIT2_DRV0_TIMESTAMP_LO'/>"
WRITE #1 "        <register address='0xb231240' value='0x" DATA.LONG(A:0x231240) "' name='RPMH_PDC_AUDIO_SENSORS_PROFILING_UNIT3_DRV0_TIMESTAMP_LO'/>"
WRITE #1 "        <register address='0xb231254' value='0x" DATA.LONG(A:0x231254) "' name='RPMH_PDC_AUDIO_SENSORS_PROFILING_UNIT4_DRV0_TIMESTAMP_LO'/>"
WRITE #1 "        <register address='0xb231208' value='0x" DATA.LONG(A:0x231208) "' name='RPMH_PDC_AUDIO_SENSORS_PROFILING_UNIT0_DRV0_TIMESTAMP_HI'/>"
WRITE #1 "        <register address='0xb23121c' value='0x" DATA.LONG(A:0x23121c) "' name='RPMH_PDC_AUDIO_SENSORS_PROFILING_UNIT1_DRV0_TIMESTAMP_HI'/>"
WRITE #1 "        <register address='0xb231230' value='0x" DATA.LONG(A:0x231230) "' name='RPMH_PDC_AUDIO_SENSORS_PROFILING_UNIT2_DRV0_TIMESTAMP_HI'/>"
WRITE #1 "        <register address='0xb231244' value='0x" DATA.LONG(A:0x231244) "' name='RPMH_PDC_AUDIO_SENSORS_PROFILING_UNIT3_DRV0_TIMESTAMP_HI'/>"
WRITE #1 "        <register address='0xb231258' value='0x" DATA.LONG(A:0x231258) "' name='RPMH_PDC_AUDIO_SENSORS_PROFILING_UNIT4_DRV0_TIMESTAMP_HI'/>"
WRITE #1 "        <register address='0xb231300' value='0x" DATA.LONG(A:0x231300) "' name='RPMH_PDC_AUDIO_SENSORS_TCS0_DRV0_STATUS'/>"
WRITE #1 "        <register address='0xb2313c8' value='0x" DATA.LONG(A:0x2313c8) "' name='RPMH_PDC_AUDIO_SENSORS_TCS1_DRV0_STATUS'/>"
WRITE #1 "        <register address='0xb231490' value='0x" DATA.LONG(A:0x231490) "' name='RPMH_PDC_AUDIO_SENSORS_TCS2_DRV0_STATUS'/>"
WRITE #1 "        <register address='0xb231304' value='0x" DATA.LONG(A:0x231304) "' name='RPMH_PDC_AUDIO_SENSORS_TCS0_CMD0_DRV0_STATUS'/>"
WRITE #1 "        <register address='0xb23130c' value='0x" DATA.LONG(A:0x23130c) "' name='RPMH_PDC_AUDIO_SENSORS_TCS0_CMD1_DRV0_STATUS'/>"
WRITE #1 "        <register address='0xb231314' value='0x" DATA.LONG(A:0x231314) "' name='RPMH_PDC_AUDIO_SENSORS_TCS0_CMD2_DRV0_STATUS'/>"
WRITE #1 "        <register address='0xb23131c' value='0x" DATA.LONG(A:0x23131c) "' name='RPMH_PDC_AUDIO_SENSORS_TCS0_CMD3_DRV0_STATUS'/>"
WRITE #1 "        <register address='0xb2313cc' value='0x" DATA.LONG(A:0x2313cc) "' name='RPMH_PDC_AUDIO_SENSORS_TCS1_CMD0_DRV0_STATUS'/>"
WRITE #1 "        <register address='0xb2313d4' value='0x" DATA.LONG(A:0x2313d4) "' name='RPMH_PDC_AUDIO_SENSORS_TCS1_CMD1_DRV0_STATUS'/>"
WRITE #1 "        <register address='0xb2313dc' value='0x" DATA.LONG(A:0x2313dc) "' name='RPMH_PDC_AUDIO_SENSORS_TCS1_CMD2_DRV0_STATUS'/>"
WRITE #1 "        <register address='0xb2313e4' value='0x" DATA.LONG(A:0x2313e4) "' name='RPMH_PDC_AUDIO_SENSORS_TCS1_CMD3_DRV0_STATUS'/>"
WRITE #1 "        <register address='0xb231494' value='0x" DATA.LONG(A:0x231494) "' name='RPMH_PDC_AUDIO_SENSORS_TCS2_CMD0_DRV0_STATUS'/>"
WRITE #1 "        <register address='0xb23149c' value='0x" DATA.LONG(A:0x23149c) "' name='RPMH_PDC_AUDIO_SENSORS_TCS2_CMD1_DRV0_STATUS'/>"
WRITE #1 "        <register address='0xb2314a4' value='0x" DATA.LONG(A:0x2314a4) "' name='RPMH_PDC_AUDIO_SENSORS_TCS2_CMD2_DRV0_STATUS'/>"
WRITE #1 "        <register address='0xb2314ac' value='0x" DATA.LONG(A:0x2314ac) "' name='RPMH_PDC_AUDIO_SENSORS_TCS2_CMD3_DRV0_STATUS'/>"
WRITE #1 "        <register address='0xb234500' value='0x" DATA.LONG(A:0x234500) "' name='RPMH_PDC_AUDIO_SENSORS_ENABLE_PDC'/>"
WRITE #1 "        <register address='0xb234510' value='0x" DATA.LONG(A:0x234510) "' name='RPMH_PDC_AUDIO_SENSORS_TIMER_MATCH_VALUE_LO'/>"
WRITE #1 "        <register address='0xb234514' value='0x" DATA.LONG(A:0x234514) "' name='RPMH_PDC_AUDIO_SENSORS_TIMER_MATCH_VALUE_HI'/>"
WRITE #1 "        <register address='0xb234518' value='0x" DATA.LONG(A:0x234518) "' name='RPMH_PDC_AUDIO_SENSORS_TIMER_DISABLED_FOR_ARC'/>"
WRITE #1 "        <register address='0xb234520' value='0x" DATA.LONG(A:0x234520) "' name='RPMH_PDC_AUDIO_SENSORS_SEQ_START_ADDR'/>"
WRITE #1 "        <register address='0xb234524' value='0x" DATA.LONG(A:0x234524) "' name='RPMH_PDC_AUDIO_SENSORS_SEQ_OVERRIDE_START_ADDR'/>"
WRITE #1 "        <register address='0xb23452c' value='0x" DATA.LONG(A:0x23452c) "' name='RPMH_PDC_AUDIO_SENSORS_SEQ_OVERRIDE_TRIGGER'/>"
WRITE #1 "        <register address='0xb234530' value='0x" DATA.LONG(A:0x234530) "' name='RPMH_PDC_AUDIO_SENSORS_SEQ_PWR_CTRL_OVERRIDE_MASK'/>"
WRITE #1 "        <register address='0xb234534' value='0x" DATA.LONG(A:0x234534) "' name='RPMH_PDC_AUDIO_SENSORS_SEQ_PWR_CTRL_OVERRIDE_VAL'/>"
WRITE #1 "        <register address='0xb234540' value='0x" DATA.LONG(A:0x234540) "' name='RPMH_PDC_AUDIO_SENSORS_SEQ_WAIT_EVENT_OVERRIDE_MASK'/>"
WRITE #1 "        <register address='0xb234544' value='0x" DATA.LONG(A:0x234544) "' name='RPMH_PDC_AUDIO_SENSORS_SEQ_WAIT_EVENT_OVERRIDE_VAL'/>"
WRITE #1 "        <register address='0xb234550' value='0x" DATA.LONG(A:0x234550) "' name='RPMH_PDC_AUDIO_SENSORS_SEQ_BR_EVENT_OVERRIDE_MASK'/>"
WRITE #1 "        <register address='0xb234554' value='0x" DATA.LONG(A:0x234554) "' name='RPMH_PDC_AUDIO_SENSORS_SEQ_BR_EVENT_OVERRIDE_VAL'/>"
WRITE #1 "        <register address='0xb234590' value='0x" DATA.LONG(A:0x234590) "' name='RPMH_PDC_AUDIO_SENSORS_SEQ_CFG_BR_ADDR_0'/>"
WRITE #1 "        <register address='0xb234594' value='0x" DATA.LONG(A:0x234594) "' name='RPMH_PDC_AUDIO_SENSORS_SEQ_CFG_BR_ADDR_1'/>"
WRITE #1 "        <register address='0xb234598' value='0x" DATA.LONG(A:0x234598) "' name='RPMH_PDC_AUDIO_SENSORS_SEQ_CFG_BR_ADDR_2'/>"
WRITE #1 "        <register address='0xb23459c' value='0x" DATA.LONG(A:0x23459c) "' name='RPMH_PDC_AUDIO_SENSORS_SEQ_CFG_BR_ADDR_3'/>"
WRITE #1 "        <register address='0xb2345a0' value='0x" DATA.LONG(A:0x2345a0) "' name='RPMH_PDC_AUDIO_SENSORS_SEQ_CFG_DELAY_VAL_0'/>"
WRITE #1 "        <register address='0xb2345a4' value='0x" DATA.LONG(A:0x2345a4) "' name='RPMH_PDC_AUDIO_SENSORS_SEQ_CFG_DELAY_VAL_1'/>"
WRITE #1 "        <register address='0xb2345a8' value='0x" DATA.LONG(A:0x2345a8) "' name='RPMH_PDC_AUDIO_SENSORS_SEQ_CFG_DELAY_VAL_2'/>"
WRITE #1 "        <register address='0xb2345ac' value='0x" DATA.LONG(A:0x2345ac) "' name='RPMH_PDC_AUDIO_SENSORS_SEQ_CFG_DELAY_VAL_3'/>"
WRITE #1 "        <register address='0xb2345b0' value='0x" DATA.LONG(A:0x2345b0) "' name='RPMH_PDC_AUDIO_SENSORS_SEQ_CFG_DELAY_VAL_4'/>"
WRITE #1 "        <register address='0xb2345b4' value='0x" DATA.LONG(A:0x2345b4) "' name='RPMH_PDC_AUDIO_SENSORS_SEQ_CFG_DELAY_VAL_5'/>"
WRITE #1 "        <register address='0xb2345b8' value='0x" DATA.LONG(A:0x2345b8) "' name='RPMH_PDC_AUDIO_SENSORS_SEQ_CFG_DELAY_VAL_6'/>"
WRITE #1 "        <register address='0xb2345bc' value='0x" DATA.LONG(A:0x2345bc) "' name='RPMH_PDC_AUDIO_SENSORS_SEQ_CFG_DELAY_VAL_7'/>"
WRITE #1 "        <register address='0xb2345c0' value='0x" DATA.LONG(A:0x2345c0) "' name='RPMH_PDC_AUDIO_SENSORS_SEQ_CFG_DELAY_VAL_8'/>"
WRITE #1 "        <register address='0xb2345c4' value='0x" DATA.LONG(A:0x2345c4) "' name='RPMH_PDC_AUDIO_SENSORS_SEQ_CFG_DELAY_VAL_9'/>"
WRITE #1 "        <register address='0xb2345c8' value='0x" DATA.LONG(A:0x2345c8) "' name='RPMH_PDC_AUDIO_SENSORS_SEQ_CFG_DELAY_VAL_10'/>"
WRITE #1 "        <register address='0xb2345cc' value='0x" DATA.LONG(A:0x2345cc) "' name='RPMH_PDC_AUDIO_SENSORS_SEQ_CFG_DELAY_VAL_11'/>"
WRITE #1 "        <register address='0xb2345d0' value='0x" DATA.LONG(A:0x2345d0) "' name='RPMH_PDC_AUDIO_SENSORS_SEQ_CFG_DELAY_VAL_12'/>"
WRITE #1 "        <register address='0xb2345d4' value='0x" DATA.LONG(A:0x2345d4) "' name='RPMH_PDC_AUDIO_SENSORS_SEQ_CFG_DELAY_VAL_13'/>"
WRITE #1 "        <register address='0xb2345d8' value='0x" DATA.LONG(A:0x2345d8) "' name='RPMH_PDC_AUDIO_SENSORS_SEQ_CFG_DELAY_VAL_14'/>"
WRITE #1 "        <register address='0xb2345dc' value='0x" DATA.LONG(A:0x2345dc) "' name='RPMH_PDC_AUDIO_SENSORS_SEQ_CFG_DELAY_VAL_15'/>"
WRITE #1 "        <register address='0xb2345e0' value='0x" DATA.LONG(A:0x2345e0) "' name='RPMH_PDC_AUDIO_SENSORS_SEQ_DBG_BREAKPOINT_ADDR'/>"
WRITE #1 "        <register address='0xb2345e4' value='0x" DATA.LONG(A:0x2345e4) "' name='RPMH_PDC_AUDIO_SENSORS_SEQ_DBG_STEP'/>"
WRITE #1 "        <register address='0xb234900' value='0x" DATA.LONG(A:0x234900) "' name='RPMH_PDC_AUDIO_SENSORS_GP_IRQ_SELECT0'/>"
WRITE #1 "        <register address='0xb234914' value='0x" DATA.LONG(A:0x234914) "' name='RPMH_PDC_AUDIO_SENSORS_GP_IRQ_SELECT1'/>"
WRITE #1 "        <register address='0xb234928' value='0x" DATA.LONG(A:0x234928) "' name='RPMH_PDC_AUDIO_SENSORS_GP_IRQ_SELECT2'/>"
WRITE #1 "        <register address='0xb23493c' value='0x" DATA.LONG(A:0x23493c) "' name='RPMH_PDC_AUDIO_SENSORS_GP_IRQ_SELECT3'/>"
WRITE #1 "        <register address='0xb234950' value='0x" DATA.LONG(A:0x234950) "' name='RPMH_PDC_AUDIO_SENSORS_GP_IRQ_SELECT4'/>"
WRITE #1 "        <register address='0xb234964' value='0x" DATA.LONG(A:0x234964) "' name='RPMH_PDC_AUDIO_SENSORS_GP_IRQ_SELECT5'/>"
WRITE #1 "        <register address='0xb234978' value='0x" DATA.LONG(A:0x234978) "' name='RPMH_PDC_AUDIO_SENSORS_GP_IRQ_SELECT6'/>"
WRITE #1 "        <register address='0xb23498c' value='0x" DATA.LONG(A:0x23498c) "' name='RPMH_PDC_AUDIO_SENSORS_GP_IRQ_SELECT7'/>"
WRITE #1 "        <register address='0xb2349a0' value='0x" DATA.LONG(A:0x2349a0) "' name='RPMH_PDC_AUDIO_SENSORS_GP_IRQ_SELECT8'/>"
WRITE #1 "        <register address='0xb2349b4' value='0x" DATA.LONG(A:0x2349b4) "' name='RPMH_PDC_AUDIO_SENSORS_GP_IRQ_SELECT9'/>"
WRITE #1 "        <register address='0xb2349c8' value='0x" DATA.LONG(A:0x2349c8) "' name='RPMH_PDC_AUDIO_SENSORS_GP_IRQ_SELECT10'/>"
WRITE #1 "        <register address='0xb2349dc' value='0x" DATA.LONG(A:0x2349dc) "' name='RPMH_PDC_AUDIO_SENSORS_GP_IRQ_SELECT11'/>"
WRITE #1 "        <register address='0xb2349f0' value='0x" DATA.LONG(A:0x2349f0) "' name='RPMH_PDC_AUDIO_SENSORS_GP_IRQ_SELECT12'/>"
WRITE #1 "        <register address='0xb234a04' value='0x" DATA.LONG(A:0x234a04) "' name='RPMH_PDC_AUDIO_SENSORS_GP_IRQ_SELECT13'/>"
WRITE #1 "        <register address='0xb234a18' value='0x" DATA.LONG(A:0x234a18) "' name='RPMH_PDC_AUDIO_SENSORS_GP_IRQ_SELECT14'/>"
WRITE #1 "        <register address='0xb234a2c' value='0x" DATA.LONG(A:0x234a2c) "' name='RPMH_PDC_AUDIO_SENSORS_GP_IRQ_SELECT15'/>"
WRITE #1 "        <register address='0xb234a40' value='0x" DATA.LONG(A:0x234a40) "' name='RPMH_PDC_AUDIO_SENSORS_GP_IRQ_SELECT16'/>"
WRITE #1 "        <register address='0xb234a54' value='0x" DATA.LONG(A:0x234a54) "' name='RPMH_PDC_AUDIO_SENSORS_GP_IRQ_SELECT17'/>"
WRITE #1 "        <register address='0xb234a68' value='0x" DATA.LONG(A:0x234a68) "' name='RPMH_PDC_AUDIO_SENSORS_GP_IRQ_SELECT18'/>"
WRITE #1 "        <register address='0xb234a7c' value='0x" DATA.LONG(A:0x234a7c) "' name='RPMH_PDC_AUDIO_SENSORS_GP_IRQ_SELECT19'/>"
WRITE #1 "        <register address='0xb234f00' value='0x" DATA.LONG(A:0x234f00) "' name='RPMH_PDC_AUDIO_SENSORS_TIMESTAMP_UNIT0_EN'/>"
WRITE #1 "        <register address='0xb234f14' value='0x" DATA.LONG(A:0x234f14) "' name='RPMH_PDC_AUDIO_SENSORS_TIMESTAMP_UNIT1_EN'/>"
WRITE #1 "        <register address='0xb234f28' value='0x" DATA.LONG(A:0x234f28) "' name='RPMH_PDC_AUDIO_SENSORS_TIMESTAMP_UNIT2_EN'/>"
WRITE #1 "        <register address='0xb234f3c' value='0x" DATA.LONG(A:0x234f3c) "' name='RPMH_PDC_AUDIO_SENSORS_TIMESTAMP_UNIT3_EN'/>"
WRITE #1 "        <register address='0xb234f50' value='0x" DATA.LONG(A:0x234f50) "' name='RPMH_PDC_AUDIO_SENSORS_TIMESTAMP_UNIT4_EN'/>"
WRITE #1 "        <register address='0xb234f04' value='0x" DATA.LONG(A:0x234f04) "' name='RPMH_PDC_AUDIO_SENSORS_TIMESTAMP_UNIT0_EVENT_SELECT'/>"
WRITE #1 "        <register address='0xb234f18' value='0x" DATA.LONG(A:0x234f18) "' name='RPMH_PDC_AUDIO_SENSORS_TIMESTAMP_UNIT1_EVENT_SELECT'/>"
WRITE #1 "        <register address='0xb234f2c' value='0x" DATA.LONG(A:0x234f2c) "' name='RPMH_PDC_AUDIO_SENSORS_TIMESTAMP_UNIT2_EVENT_SELECT'/>"
WRITE #1 "        <register address='0xb234f40' value='0x" DATA.LONG(A:0x234f40) "' name='RPMH_PDC_AUDIO_SENSORS_TIMESTAMP_UNIT3_EVENT_SELECT'/>"
WRITE #1 "        <register address='0xb234f54' value='0x" DATA.LONG(A:0x234f54) "' name='RPMH_PDC_AUDIO_SENSORS_TIMESTAMP_UNIT4_EVENT_SELECT'/>"
WRITE #1 "        <register address='0xb235000' value='0x" DATA.LONG(A:0x235000) "' name='RPMH_PDC_AUDIO_SENSORS_PROFILING_UNIT0_EN'/>"
WRITE #1 "        <register address='0xb235014' value='0x" DATA.LONG(A:0x235014) "' name='RPMH_PDC_AUDIO_SENSORS_PROFILING_UNIT1_EN'/>"
WRITE #1 "        <register address='0xb235028' value='0x" DATA.LONG(A:0x235028) "' name='RPMH_PDC_AUDIO_SENSORS_PROFILING_UNIT2_EN'/>"
WRITE #1 "        <register address='0xb23503c' value='0x" DATA.LONG(A:0x23503c) "' name='RPMH_PDC_AUDIO_SENSORS_PROFILING_UNIT3_EN'/>"
WRITE #1 "        <register address='0xb235050' value='0x" DATA.LONG(A:0x235050) "' name='RPMH_PDC_AUDIO_SENSORS_PROFILING_UNIT4_EN'/>"
WRITE #1 "        <register address='0xb235500' value='0x" DATA.LONG(A:0x235500) "' name='RPMH_PDC_AUDIO_SENSORS_TCS0_CONTROL'/>"
WRITE #1 "        <register address='0xb2355c8' value='0x" DATA.LONG(A:0x2355c8) "' name='RPMH_PDC_AUDIO_SENSORS_TCS1_CONTROL'/>"
WRITE #1 "        <register address='0xb235690' value='0x" DATA.LONG(A:0x235690) "' name='RPMH_PDC_AUDIO_SENSORS_TCS2_CONTROL'/>"
WRITE #1 "        <register address='0xb235504' value='0x" DATA.LONG(A:0x235504) "' name='RPMH_PDC_AUDIO_SENSORS_TCS0_CMD_ENABLE_BANK'/>"
WRITE #1 "        <register address='0xb2355cc' value='0x" DATA.LONG(A:0x2355cc) "' name='RPMH_PDC_AUDIO_SENSORS_TCS1_CMD_ENABLE_BANK'/>"
WRITE #1 "        <register address='0xb235694' value='0x" DATA.LONG(A:0x235694) "' name='RPMH_PDC_AUDIO_SENSORS_TCS2_CMD_ENABLE_BANK'/>"
WRITE #1 "        <register address='0xb235508' value='0x" DATA.LONG(A:0x235508) "' name='RPMH_PDC_AUDIO_SENSORS_TCS0_CMD_WAIT_FOR_CMPL_BANK'/>"
WRITE #1 "        <register address='0xb2355d0' value='0x" DATA.LONG(A:0x2355d0) "' name='RPMH_PDC_AUDIO_SENSORS_TCS1_CMD_WAIT_FOR_CMPL_BANK'/>"
WRITE #1 "        <register address='0xb235698' value='0x" DATA.LONG(A:0x235698) "' name='RPMH_PDC_AUDIO_SENSORS_TCS2_CMD_WAIT_FOR_CMPL_BANK'/>"
WRITE #1 "        <register address='0xb23550c' value='0x" DATA.LONG(A:0x23550c) "' name='RPMH_PDC_AUDIO_SENSORS_TCS0_CMD0_MSGID'/>"
WRITE #1 "        <register address='0xb23551c' value='0x" DATA.LONG(A:0x23551c) "' name='RPMH_PDC_AUDIO_SENSORS_TCS0_CMD1_MSGID'/>"
WRITE #1 "        <register address='0xb23552c' value='0x" DATA.LONG(A:0x23552c) "' name='RPMH_PDC_AUDIO_SENSORS_TCS0_CMD2_MSGID'/>"
WRITE #1 "        <register address='0xb23553c' value='0x" DATA.LONG(A:0x23553c) "' name='RPMH_PDC_AUDIO_SENSORS_TCS0_CMD3_MSGID'/>"
WRITE #1 "        <register address='0xb2355d4' value='0x" DATA.LONG(A:0x2355d4) "' name='RPMH_PDC_AUDIO_SENSORS_TCS1_CMD0_MSGID'/>"
WRITE #1 "        <register address='0xb2355e4' value='0x" DATA.LONG(A:0x2355e4) "' name='RPMH_PDC_AUDIO_SENSORS_TCS1_CMD1_MSGID'/>"
WRITE #1 "        <register address='0xb2355f4' value='0x" DATA.LONG(A:0x2355f4) "' name='RPMH_PDC_AUDIO_SENSORS_TCS1_CMD2_MSGID'/>"
WRITE #1 "        <register address='0xb235604' value='0x" DATA.LONG(A:0x235604) "' name='RPMH_PDC_AUDIO_SENSORS_TCS1_CMD3_MSGID'/>"
WRITE #1 "        <register address='0xb23569c' value='0x" DATA.LONG(A:0x23569c) "' name='RPMH_PDC_AUDIO_SENSORS_TCS2_CMD0_MSGID'/>"
WRITE #1 "        <register address='0xb2356ac' value='0x" DATA.LONG(A:0x2356ac) "' name='RPMH_PDC_AUDIO_SENSORS_TCS2_CMD1_MSGID'/>"
WRITE #1 "        <register address='0xb2356bc' value='0x" DATA.LONG(A:0x2356bc) "' name='RPMH_PDC_AUDIO_SENSORS_TCS2_CMD2_MSGID'/>"
WRITE #1 "        <register address='0xb2356cc' value='0x" DATA.LONG(A:0x2356cc) "' name='RPMH_PDC_AUDIO_SENSORS_TCS2_CMD3_MSGID'/>"
WRITE #1 "        <register address='0xb235510' value='0x" DATA.LONG(A:0x235510) "' name='RPMH_PDC_AUDIO_SENSORS_TCS0_CMD0_ADDR'/>"
WRITE #1 "        <register address='0xb235520' value='0x" DATA.LONG(A:0x235520) "' name='RPMH_PDC_AUDIO_SENSORS_TCS0_CMD1_ADDR'/>"
WRITE #1 "        <register address='0xb235530' value='0x" DATA.LONG(A:0x235530) "' name='RPMH_PDC_AUDIO_SENSORS_TCS0_CMD2_ADDR'/>"
WRITE #1 "        <register address='0xb235540' value='0x" DATA.LONG(A:0x235540) "' name='RPMH_PDC_AUDIO_SENSORS_TCS0_CMD3_ADDR'/>"
WRITE #1 "        <register address='0xb2355d8' value='0x" DATA.LONG(A:0x2355d8) "' name='RPMH_PDC_AUDIO_SENSORS_TCS1_CMD0_ADDR'/>"
WRITE #1 "        <register address='0xb2355e8' value='0x" DATA.LONG(A:0x2355e8) "' name='RPMH_PDC_AUDIO_SENSORS_TCS1_CMD1_ADDR'/>"
WRITE #1 "        <register address='0xb2355f8' value='0x" DATA.LONG(A:0x2355f8) "' name='RPMH_PDC_AUDIO_SENSORS_TCS1_CMD2_ADDR'/>"
WRITE #1 "        <register address='0xb235608' value='0x" DATA.LONG(A:0x235608) "' name='RPMH_PDC_AUDIO_SENSORS_TCS1_CMD3_ADDR'/>"
WRITE #1 "        <register address='0xb2356a0' value='0x" DATA.LONG(A:0x2356a0) "' name='RPMH_PDC_AUDIO_SENSORS_TCS2_CMD0_ADDR'/>"
WRITE #1 "        <register address='0xb2356b0' value='0x" DATA.LONG(A:0x2356b0) "' name='RPMH_PDC_AUDIO_SENSORS_TCS2_CMD1_ADDR'/>"
WRITE #1 "        <register address='0xb2356c0' value='0x" DATA.LONG(A:0x2356c0) "' name='RPMH_PDC_AUDIO_SENSORS_TCS2_CMD2_ADDR'/>"
WRITE #1 "        <register address='0xb2356d0' value='0x" DATA.LONG(A:0x2356d0) "' name='RPMH_PDC_AUDIO_SENSORS_TCS2_CMD3_ADDR'/>"
WRITE #1 "        <register address='0xb235514' value='0x" DATA.LONG(A:0x235514) "' name='RPMH_PDC_AUDIO_SENSORS_TCS0_CMD0_DATA'/>"
WRITE #1 "        <register address='0xb235524' value='0x" DATA.LONG(A:0x235524) "' name='RPMH_PDC_AUDIO_SENSORS_TCS0_CMD1_DATA'/>"
WRITE #1 "        <register address='0xb235534' value='0x" DATA.LONG(A:0x235534) "' name='RPMH_PDC_AUDIO_SENSORS_TCS0_CMD2_DATA'/>"
WRITE #1 "        <register address='0xb235544' value='0x" DATA.LONG(A:0x235544) "' name='RPMH_PDC_AUDIO_SENSORS_TCS0_CMD3_DATA'/>"
WRITE #1 "        <register address='0xb2355dc' value='0x" DATA.LONG(A:0x2355dc) "' name='RPMH_PDC_AUDIO_SENSORS_TCS1_CMD0_DATA'/>"
WRITE #1 "        <register address='0xb2355ec' value='0x" DATA.LONG(A:0x2355ec) "' name='RPMH_PDC_AUDIO_SENSORS_TCS1_CMD1_DATA'/>"
WRITE #1 "        <register address='0xb2355fc' value='0x" DATA.LONG(A:0x2355fc) "' name='RPMH_PDC_AUDIO_SENSORS_TCS1_CMD2_DATA'/>"
WRITE #1 "        <register address='0xb23560c' value='0x" DATA.LONG(A:0x23560c) "' name='RPMH_PDC_AUDIO_SENSORS_TCS1_CMD3_DATA'/>"
WRITE #1 "        <register address='0xb2356a4' value='0x" DATA.LONG(A:0x2356a4) "' name='RPMH_PDC_AUDIO_SENSORS_TCS2_CMD0_DATA'/>"
WRITE #1 "        <register address='0xb2356b4' value='0x" DATA.LONG(A:0x2356b4) "' name='RPMH_PDC_AUDIO_SENSORS_TCS2_CMD1_DATA'/>"
WRITE #1 "        <register address='0xb2356c4' value='0x" DATA.LONG(A:0x2356c4) "' name='RPMH_PDC_AUDIO_SENSORS_TCS2_CMD2_DATA'/>"
WRITE #1 "        <register address='0xb2356d4' value='0x" DATA.LONG(A:0x2356d4) "' name='RPMH_PDC_AUDIO_SENSORS_TCS2_CMD3_DATA'/>"
WRITE #1 "        <register address='0xb240000' value='0x" DATA.LONG(A:0x240000) "' name='RPMH_PDC_AOP_VOTE_CMP_DATA_DRV0'/>"
WRITE #1 "        <register address='0xb240010' value='0x" DATA.LONG(A:0x240010) "' name='RPMH_PDC_AOP_IRQ_ENABLE_BANK0_DRV0'/>"
WRITE #1 "        <register address='0xb240110' value='0x" DATA.LONG(A:0x240110) "' name='RPMH_PDC_AOP_IRQ_0_CFG_DRV0'/>"
WRITE #1 "        <register address='0xb240114' value='0x" DATA.LONG(A:0x240114) "' name='RPMH_PDC_AOP_IRQ_1_CFG_DRV0'/>"
WRITE #1 "        <register address='0xb240118' value='0x" DATA.LONG(A:0x240118) "' name='RPMH_PDC_AOP_IRQ_2_CFG_DRV0'/>"
WRITE #1 "        <register address='0xb24011c' value='0x" DATA.LONG(A:0x24011c) "' name='RPMH_PDC_AOP_IRQ_3_CFG_DRV0'/>"
WRITE #1 "        <register address='0xb240120' value='0x" DATA.LONG(A:0x240120) "' name='RPMH_PDC_AOP_IRQ_4_CFG_DRV0'/>"
WRITE #1 "        <register address='0xb240124' value='0x" DATA.LONG(A:0x240124) "' name='RPMH_PDC_AOP_IRQ_5_CFG_DRV0'/>"
WRITE #1 "        <register address='0xb240128' value='0x" DATA.LONG(A:0x240128) "' name='RPMH_PDC_AOP_IRQ_6_CFG_DRV0'/>"
WRITE #1 "        <register address='0xb24012c' value='0x" DATA.LONG(A:0x24012c) "' name='RPMH_PDC_AOP_IRQ_7_CFG_DRV0'/>"
WRITE #1 "        <register address='0xb240130' value='0x" DATA.LONG(A:0x240130) "' name='RPMH_PDC_AOP_IRQ_8_CFG_DRV0'/>"
WRITE #1 "        <register address='0xb240134' value='0x" DATA.LONG(A:0x240134) "' name='RPMH_PDC_AOP_IRQ_9_CFG_DRV0'/>"
WRITE #1 "        <register address='0xb240138' value='0x" DATA.LONG(A:0x240138) "' name='RPMH_PDC_AOP_IRQ_10_CFG_DRV0'/>"
WRITE #1 "        <register address='0xb24013c' value='0x" DATA.LONG(A:0x24013c) "' name='RPMH_PDC_AOP_IRQ_11_CFG_DRV0'/>"
WRITE #1 "        <register address='0xb240140' value='0x" DATA.LONG(A:0x240140) "' name='RPMH_PDC_AOP_IRQ_12_CFG_DRV0'/>"
WRITE #1 "        <register address='0xb240144' value='0x" DATA.LONG(A:0x240144) "' name='RPMH_PDC_AOP_IRQ_13_CFG_DRV0'/>"
WRITE #1 "        <register address='0xb240148' value='0x" DATA.LONG(A:0x240148) "' name='RPMH_PDC_AOP_IRQ_14_CFG_DRV0'/>"
WRITE #1 "        <register address='0xb24014c' value='0x" DATA.LONG(A:0x24014c) "' name='RPMH_PDC_AOP_IRQ_15_CFG_DRV0'/>"
WRITE #1 "        <register address='0xb240150' value='0x" DATA.LONG(A:0x240150) "' name='RPMH_PDC_AOP_IRQ_16_CFG_DRV0'/>"
WRITE #1 "        <register address='0xb240154' value='0x" DATA.LONG(A:0x240154) "' name='RPMH_PDC_AOP_IRQ_17_CFG_DRV0'/>"
WRITE #1 "        <register address='0xb240158' value='0x" DATA.LONG(A:0x240158) "' name='RPMH_PDC_AOP_IRQ_18_CFG_DRV0'/>"
WRITE #1 "        <register address='0xb24015c' value='0x" DATA.LONG(A:0x24015c) "' name='RPMH_PDC_AOP_IRQ_19_CFG_DRV0'/>"
WRITE #1 "        <register address='0xb240160' value='0x" DATA.LONG(A:0x240160) "' name='RPMH_PDC_AOP_IRQ_20_CFG_DRV0'/>"
WRITE #1 "        <register address='0xb240164' value='0x" DATA.LONG(A:0x240164) "' name='RPMH_PDC_AOP_IRQ_21_CFG_DRV0'/>"
WRITE #1 "        <register address='0xb240168' value='0x" DATA.LONG(A:0x240168) "' name='RPMH_PDC_AOP_IRQ_22_CFG_DRV0'/>"
WRITE #1 "        <register address='0xb24016c' value='0x" DATA.LONG(A:0x24016c) "' name='RPMH_PDC_AOP_IRQ_23_CFG_DRV0'/>"
WRITE #1 "        <register address='0xb240170' value='0x" DATA.LONG(A:0x240170) "' name='RPMH_PDC_AOP_IRQ_24_CFG_DRV0'/>"
WRITE #1 "        <register address='0xb240900' value='0x" DATA.LONG(A:0x240900) "' name='RPMH_PDC_AOP_IRQ_STATUS_BANK0_DRV0'/>"
WRITE #1 "        <register address='0xb241000' value='0x" DATA.LONG(A:0x241000) "' name='RPMH_PDC_AOP_PDC_VERSION_DRV0'/>"
WRITE #1 "        <register address='0xb241004' value='0x" DATA.LONG(A:0x241004) "' name='RPMH_PDC_AOP_PDC_PARAM_RESOURCE_DRV0'/>"
WRITE #1 "        <register address='0xb241008' value='0x" DATA.LONG(A:0x241008) "' name='RPMH_PDC_AOP_PDC_PARAM_SEQ_CONFIG_DRV0'/>"
WRITE #1 "        <register address='0xb24100c' value='0x" DATA.LONG(A:0x24100c) "' name='RPMH_PDC_AOP_PDC_PARAM_IRQ_CONFIG_DRV0'/>"
WRITE #1 "        <register address='0xb241020' value='0x" DATA.LONG(A:0x241020) "' name='RPMH_PDC_AOP_SEQ_BUSY_DRV0'/>"
WRITE #1 "        <register address='0xb241024' value='0x" DATA.LONG(A:0x241024) "' name='RPMH_PDC_AOP_SEQ_DBG_PROGRAM_COUNTER_DRV0'/>"
WRITE #1 "        <register address='0xb241028' value='0x" DATA.LONG(A:0x241028) "' name='RPMH_PDC_AOP_SEQ_DBG_STAT_DRV0'/>"
WRITE #1 "        <register address='0xb24102c' value='0x" DATA.LONG(A:0x24102c) "' name='RPMH_PDC_AOP_SEQ_DBG_WAIT_EVNT_DRV0'/>"
WRITE #1 "        <register address='0xb241030' value='0x" DATA.LONG(A:0x241030) "' name='RPMH_PDC_AOP_PDC_MODE_STATUS_DRV0'/>"
WRITE #1 "        <register address='0xb241034' value='0x" DATA.LONG(A:0x241034) "' name='RPMH_PDC_AOP_DBG_EPCB_RX_ADDR0'/>"
WRITE #1 "        <register address='0xb241038' value='0x" DATA.LONG(A:0x241038) "' name='RPMH_PDC_AOP_DBG_EPCB_RX_DATA0'/>"
WRITE #1 "        <register address='0xb241200' value='0x" DATA.LONG(A:0x241200) "' name='RPMH_PDC_AOP_PROFILING_UNIT0_DRV0_OUTPUT'/>"
WRITE #1 "        <register address='0xb241214' value='0x" DATA.LONG(A:0x241214) "' name='RPMH_PDC_AOP_PROFILING_UNIT1_DRV0_OUTPUT'/>"
WRITE #1 "        <register address='0xb241228' value='0x" DATA.LONG(A:0x241228) "' name='RPMH_PDC_AOP_PROFILING_UNIT2_DRV0_OUTPUT'/>"
WRITE #1 "        <register address='0xb24123c' value='0x" DATA.LONG(A:0x24123c) "' name='RPMH_PDC_AOP_PROFILING_UNIT3_DRV0_OUTPUT'/>"
WRITE #1 "        <register address='0xb241250' value='0x" DATA.LONG(A:0x241250) "' name='RPMH_PDC_AOP_PROFILING_UNIT4_DRV0_OUTPUT'/>"
WRITE #1 "        <register address='0xb241204' value='0x" DATA.LONG(A:0x241204) "' name='RPMH_PDC_AOP_PROFILING_UNIT0_DRV0_TIMESTAMP_LO'/>"
WRITE #1 "        <register address='0xb241218' value='0x" DATA.LONG(A:0x241218) "' name='RPMH_PDC_AOP_PROFILING_UNIT1_DRV0_TIMESTAMP_LO'/>"
WRITE #1 "        <register address='0xb24122c' value='0x" DATA.LONG(A:0x24122c) "' name='RPMH_PDC_AOP_PROFILING_UNIT2_DRV0_TIMESTAMP_LO'/>"
WRITE #1 "        <register address='0xb241240' value='0x" DATA.LONG(A:0x241240) "' name='RPMH_PDC_AOP_PROFILING_UNIT3_DRV0_TIMESTAMP_LO'/>"
WRITE #1 "        <register address='0xb241254' value='0x" DATA.LONG(A:0x241254) "' name='RPMH_PDC_AOP_PROFILING_UNIT4_DRV0_TIMESTAMP_LO'/>"
WRITE #1 "        <register address='0xb241208' value='0x" DATA.LONG(A:0x241208) "' name='RPMH_PDC_AOP_PROFILING_UNIT0_DRV0_TIMESTAMP_HI'/>"
WRITE #1 "        <register address='0xb24121c' value='0x" DATA.LONG(A:0x24121c) "' name='RPMH_PDC_AOP_PROFILING_UNIT1_DRV0_TIMESTAMP_HI'/>"
WRITE #1 "        <register address='0xb241230' value='0x" DATA.LONG(A:0x241230) "' name='RPMH_PDC_AOP_PROFILING_UNIT2_DRV0_TIMESTAMP_HI'/>"
WRITE #1 "        <register address='0xb241244' value='0x" DATA.LONG(A:0x241244) "' name='RPMH_PDC_AOP_PROFILING_UNIT3_DRV0_TIMESTAMP_HI'/>"
WRITE #1 "        <register address='0xb241258' value='0x" DATA.LONG(A:0x241258) "' name='RPMH_PDC_AOP_PROFILING_UNIT4_DRV0_TIMESTAMP_HI'/>"
WRITE #1 "        <register address='0xb241300' value='0x" DATA.LONG(A:0x241300) "' name='RPMH_PDC_AOP_TCS0_DRV0_STATUS'/>"
WRITE #1 "        <register address='0xb2413c8' value='0x" DATA.LONG(A:0x2413c8) "' name='RPMH_PDC_AOP_TCS1_DRV0_STATUS'/>"
WRITE #1 "        <register address='0xb241490' value='0x" DATA.LONG(A:0x241490) "' name='RPMH_PDC_AOP_TCS2_DRV0_STATUS'/>"
WRITE #1 "        <register address='0xb241558' value='0x" DATA.LONG(A:0x241558) "' name='RPMH_PDC_AOP_TCS3_DRV0_STATUS'/>"
WRITE #1 "        <register address='0xb241304' value='0x" DATA.LONG(A:0x241304) "' name='RPMH_PDC_AOP_TCS0_CMD0_DRV0_STATUS'/>"
WRITE #1 "        <register address='0xb24130c' value='0x" DATA.LONG(A:0x24130c) "' name='RPMH_PDC_AOP_TCS0_CMD1_DRV0_STATUS'/>"
WRITE #1 "        <register address='0xb241314' value='0x" DATA.LONG(A:0x241314) "' name='RPMH_PDC_AOP_TCS0_CMD2_DRV0_STATUS'/>"
WRITE #1 "        <register address='0xb24131c' value='0x" DATA.LONG(A:0x24131c) "' name='RPMH_PDC_AOP_TCS0_CMD3_DRV0_STATUS'/>"
WRITE #1 "        <register address='0xb2413cc' value='0x" DATA.LONG(A:0x2413cc) "' name='RPMH_PDC_AOP_TCS1_CMD0_DRV0_STATUS'/>"
WRITE #1 "        <register address='0xb2413d4' value='0x" DATA.LONG(A:0x2413d4) "' name='RPMH_PDC_AOP_TCS1_CMD1_DRV0_STATUS'/>"
WRITE #1 "        <register address='0xb2413dc' value='0x" DATA.LONG(A:0x2413dc) "' name='RPMH_PDC_AOP_TCS1_CMD2_DRV0_STATUS'/>"
WRITE #1 "        <register address='0xb2413e4' value='0x" DATA.LONG(A:0x2413e4) "' name='RPMH_PDC_AOP_TCS1_CMD3_DRV0_STATUS'/>"
WRITE #1 "        <register address='0xb241494' value='0x" DATA.LONG(A:0x241494) "' name='RPMH_PDC_AOP_TCS2_CMD0_DRV0_STATUS'/>"
WRITE #1 "        <register address='0xb24149c' value='0x" DATA.LONG(A:0x24149c) "' name='RPMH_PDC_AOP_TCS2_CMD1_DRV0_STATUS'/>"
WRITE #1 "        <register address='0xb2414a4' value='0x" DATA.LONG(A:0x2414a4) "' name='RPMH_PDC_AOP_TCS2_CMD2_DRV0_STATUS'/>"
WRITE #1 "        <register address='0xb2414ac' value='0x" DATA.LONG(A:0x2414ac) "' name='RPMH_PDC_AOP_TCS2_CMD3_DRV0_STATUS'/>"
WRITE #1 "        <register address='0xb24155c' value='0x" DATA.LONG(A:0x24155c) "' name='RPMH_PDC_AOP_TCS3_CMD0_DRV0_STATUS'/>"
WRITE #1 "        <register address='0xb241564' value='0x" DATA.LONG(A:0x241564) "' name='RPMH_PDC_AOP_TCS3_CMD1_DRV0_STATUS'/>"
WRITE #1 "        <register address='0xb24156c' value='0x" DATA.LONG(A:0x24156c) "' name='RPMH_PDC_AOP_TCS3_CMD2_DRV0_STATUS'/>"
WRITE #1 "        <register address='0xb241574' value='0x" DATA.LONG(A:0x241574) "' name='RPMH_PDC_AOP_TCS3_CMD3_DRV0_STATUS'/>"
WRITE #1 "        <register address='0xb244500' value='0x" DATA.LONG(A:0x244500) "' name='RPMH_PDC_AOP_ENABLE_PDC'/>"
WRITE #1 "        <register address='0xb244510' value='0x" DATA.LONG(A:0x244510) "' name='RPMH_PDC_AOP_TIMER_MATCH_VALUE_LO'/>"
WRITE #1 "        <register address='0xb244514' value='0x" DATA.LONG(A:0x244514) "' name='RPMH_PDC_AOP_TIMER_MATCH_VALUE_HI'/>"
WRITE #1 "        <register address='0xb244518' value='0x" DATA.LONG(A:0x244518) "' name='RPMH_PDC_AOP_TIMER_DISABLED_FOR_ARC'/>"
WRITE #1 "        <register address='0xb244520' value='0x" DATA.LONG(A:0x244520) "' name='RPMH_PDC_AOP_SEQ_START_ADDR'/>"
WRITE #1 "        <register address='0xb244524' value='0x" DATA.LONG(A:0x244524) "' name='RPMH_PDC_AOP_SEQ_OVERRIDE_START_ADDR'/>"
WRITE #1 "        <register address='0xb24452c' value='0x" DATA.LONG(A:0x24452c) "' name='RPMH_PDC_AOP_SEQ_OVERRIDE_TRIGGER'/>"
WRITE #1 "        <register address='0xb244530' value='0x" DATA.LONG(A:0x244530) "' name='RPMH_PDC_AOP_SEQ_PWR_CTRL_OVERRIDE_MASK'/>"
WRITE #1 "        <register address='0xb244534' value='0x" DATA.LONG(A:0x244534) "' name='RPMH_PDC_AOP_SEQ_PWR_CTRL_OVERRIDE_VAL'/>"
WRITE #1 "        <register address='0xb244540' value='0x" DATA.LONG(A:0x244540) "' name='RPMH_PDC_AOP_SEQ_WAIT_EVENT_OVERRIDE_MASK'/>"
WRITE #1 "        <register address='0xb244544' value='0x" DATA.LONG(A:0x244544) "' name='RPMH_PDC_AOP_SEQ_WAIT_EVENT_OVERRIDE_VAL'/>"
WRITE #1 "        <register address='0xb244550' value='0x" DATA.LONG(A:0x244550) "' name='RPMH_PDC_AOP_SEQ_BR_EVENT_OVERRIDE_MASK'/>"
WRITE #1 "        <register address='0xb244554' value='0x" DATA.LONG(A:0x244554) "' name='RPMH_PDC_AOP_SEQ_BR_EVENT_OVERRIDE_VAL'/>"
WRITE #1 "        <register address='0xb244590' value='0x" DATA.LONG(A:0x244590) "' name='RPMH_PDC_AOP_SEQ_CFG_BR_ADDR_0'/>"
WRITE #1 "        <register address='0xb244594' value='0x" DATA.LONG(A:0x244594) "' name='RPMH_PDC_AOP_SEQ_CFG_BR_ADDR_1'/>"
WRITE #1 "        <register address='0xb244598' value='0x" DATA.LONG(A:0x244598) "' name='RPMH_PDC_AOP_SEQ_CFG_BR_ADDR_2'/>"
WRITE #1 "        <register address='0xb24459c' value='0x" DATA.LONG(A:0x24459c) "' name='RPMH_PDC_AOP_SEQ_CFG_BR_ADDR_3'/>"
WRITE #1 "        <register address='0xb2445a0' value='0x" DATA.LONG(A:0x2445a0) "' name='RPMH_PDC_AOP_SEQ_CFG_DELAY_VAL_0'/>"
WRITE #1 "        <register address='0xb2445a4' value='0x" DATA.LONG(A:0x2445a4) "' name='RPMH_PDC_AOP_SEQ_CFG_DELAY_VAL_1'/>"
WRITE #1 "        <register address='0xb2445a8' value='0x" DATA.LONG(A:0x2445a8) "' name='RPMH_PDC_AOP_SEQ_CFG_DELAY_VAL_2'/>"
WRITE #1 "        <register address='0xb2445ac' value='0x" DATA.LONG(A:0x2445ac) "' name='RPMH_PDC_AOP_SEQ_CFG_DELAY_VAL_3'/>"
WRITE #1 "        <register address='0xb2445b0' value='0x" DATA.LONG(A:0x2445b0) "' name='RPMH_PDC_AOP_SEQ_CFG_DELAY_VAL_4'/>"
WRITE #1 "        <register address='0xb2445b4' value='0x" DATA.LONG(A:0x2445b4) "' name='RPMH_PDC_AOP_SEQ_CFG_DELAY_VAL_5'/>"
WRITE #1 "        <register address='0xb2445b8' value='0x" DATA.LONG(A:0x2445b8) "' name='RPMH_PDC_AOP_SEQ_CFG_DELAY_VAL_6'/>"
WRITE #1 "        <register address='0xb2445bc' value='0x" DATA.LONG(A:0x2445bc) "' name='RPMH_PDC_AOP_SEQ_CFG_DELAY_VAL_7'/>"
WRITE #1 "        <register address='0xb2445c0' value='0x" DATA.LONG(A:0x2445c0) "' name='RPMH_PDC_AOP_SEQ_CFG_DELAY_VAL_8'/>"
WRITE #1 "        <register address='0xb2445c4' value='0x" DATA.LONG(A:0x2445c4) "' name='RPMH_PDC_AOP_SEQ_CFG_DELAY_VAL_9'/>"
WRITE #1 "        <register address='0xb2445c8' value='0x" DATA.LONG(A:0x2445c8) "' name='RPMH_PDC_AOP_SEQ_CFG_DELAY_VAL_10'/>"
WRITE #1 "        <register address='0xb2445cc' value='0x" DATA.LONG(A:0x2445cc) "' name='RPMH_PDC_AOP_SEQ_CFG_DELAY_VAL_11'/>"
WRITE #1 "        <register address='0xb2445d0' value='0x" DATA.LONG(A:0x2445d0) "' name='RPMH_PDC_AOP_SEQ_CFG_DELAY_VAL_12'/>"
WRITE #1 "        <register address='0xb2445d4' value='0x" DATA.LONG(A:0x2445d4) "' name='RPMH_PDC_AOP_SEQ_CFG_DELAY_VAL_13'/>"
WRITE #1 "        <register address='0xb2445d8' value='0x" DATA.LONG(A:0x2445d8) "' name='RPMH_PDC_AOP_SEQ_CFG_DELAY_VAL_14'/>"
WRITE #1 "        <register address='0xb2445dc' value='0x" DATA.LONG(A:0x2445dc) "' name='RPMH_PDC_AOP_SEQ_CFG_DELAY_VAL_15'/>"
WRITE #1 "        <register address='0xb2445e0' value='0x" DATA.LONG(A:0x2445e0) "' name='RPMH_PDC_AOP_SEQ_DBG_BREAKPOINT_ADDR'/>"
WRITE #1 "        <register address='0xb2445e4' value='0x" DATA.LONG(A:0x2445e4) "' name='RPMH_PDC_AOP_SEQ_DBG_STEP'/>"
WRITE #1 "        <register address='0xb244900' value='0x" DATA.LONG(A:0x244900) "' name='RPMH_PDC_AOP_GP_IRQ_SELECT0'/>"
WRITE #1 "        <register address='0xb244914' value='0x" DATA.LONG(A:0x244914) "' name='RPMH_PDC_AOP_GP_IRQ_SELECT1'/>"
WRITE #1 "        <register address='0xb244928' value='0x" DATA.LONG(A:0x244928) "' name='RPMH_PDC_AOP_GP_IRQ_SELECT2'/>"
WRITE #1 "        <register address='0xb24493c' value='0x" DATA.LONG(A:0x24493c) "' name='RPMH_PDC_AOP_GP_IRQ_SELECT3'/>"
WRITE #1 "        <register address='0xb244950' value='0x" DATA.LONG(A:0x244950) "' name='RPMH_PDC_AOP_GP_IRQ_SELECT4'/>"
WRITE #1 "        <register address='0xb244964' value='0x" DATA.LONG(A:0x244964) "' name='RPMH_PDC_AOP_GP_IRQ_SELECT5'/>"
WRITE #1 "        <register address='0xb244978' value='0x" DATA.LONG(A:0x244978) "' name='RPMH_PDC_AOP_GP_IRQ_SELECT6'/>"
WRITE #1 "        <register address='0xb24498c' value='0x" DATA.LONG(A:0x24498c) "' name='RPMH_PDC_AOP_GP_IRQ_SELECT7'/>"
WRITE #1 "        <register address='0xb2449a0' value='0x" DATA.LONG(A:0x2449a0) "' name='RPMH_PDC_AOP_GP_IRQ_SELECT8'/>"
WRITE #1 "        <register address='0xb2449b4' value='0x" DATA.LONG(A:0x2449b4) "' name='RPMH_PDC_AOP_GP_IRQ_SELECT9'/>"
WRITE #1 "        <register address='0xb245000' value='0x" DATA.LONG(A:0x245000) "' name='RPMH_PDC_AOP_PROFILING_UNIT0_EN'/>"
WRITE #1 "        <register address='0xb245014' value='0x" DATA.LONG(A:0x245014) "' name='RPMH_PDC_AOP_PROFILING_UNIT1_EN'/>"
WRITE #1 "        <register address='0xb245028' value='0x" DATA.LONG(A:0x245028) "' name='RPMH_PDC_AOP_PROFILING_UNIT2_EN'/>"
WRITE #1 "        <register address='0xb24503c' value='0x" DATA.LONG(A:0x24503c) "' name='RPMH_PDC_AOP_PROFILING_UNIT3_EN'/>"
WRITE #1 "        <register address='0xb245050' value='0x" DATA.LONG(A:0x245050) "' name='RPMH_PDC_AOP_PROFILING_UNIT4_EN'/>"
WRITE #1 "        <register address='0xb245500' value='0x" DATA.LONG(A:0x245500) "' name='RPMH_PDC_AOP_TCS0_CONTROL'/>"
WRITE #1 "        <register address='0xb2455c8' value='0x" DATA.LONG(A:0x2455c8) "' name='RPMH_PDC_AOP_TCS1_CONTROL'/>"
WRITE #1 "        <register address='0xb245690' value='0x" DATA.LONG(A:0x245690) "' name='RPMH_PDC_AOP_TCS2_CONTROL'/>"
WRITE #1 "        <register address='0xb245758' value='0x" DATA.LONG(A:0x245758) "' name='RPMH_PDC_AOP_TCS3_CONTROL'/>"
WRITE #1 "        <register address='0xb245504' value='0x" DATA.LONG(A:0x245504) "' name='RPMH_PDC_AOP_TCS0_CMD_ENABLE_BANK'/>"
WRITE #1 "        <register address='0xb2455cc' value='0x" DATA.LONG(A:0x2455cc) "' name='RPMH_PDC_AOP_TCS1_CMD_ENABLE_BANK'/>"
WRITE #1 "        <register address='0xb245694' value='0x" DATA.LONG(A:0x245694) "' name='RPMH_PDC_AOP_TCS2_CMD_ENABLE_BANK'/>"
WRITE #1 "        <register address='0xb24575c' value='0x" DATA.LONG(A:0x24575c) "' name='RPMH_PDC_AOP_TCS3_CMD_ENABLE_BANK'/>"
WRITE #1 "        <register address='0xb245508' value='0x" DATA.LONG(A:0x245508) "' name='RPMH_PDC_AOP_TCS0_CMD_WAIT_FOR_CMPL_BANK'/>"
WRITE #1 "        <register address='0xb2455d0' value='0x" DATA.LONG(A:0x2455d0) "' name='RPMH_PDC_AOP_TCS1_CMD_WAIT_FOR_CMPL_BANK'/>"
WRITE #1 "        <register address='0xb245698' value='0x" DATA.LONG(A:0x245698) "' name='RPMH_PDC_AOP_TCS2_CMD_WAIT_FOR_CMPL_BANK'/>"
WRITE #1 "        <register address='0xb245760' value='0x" DATA.LONG(A:0x245760) "' name='RPMH_PDC_AOP_TCS3_CMD_WAIT_FOR_CMPL_BANK'/>"
WRITE #1 "        <register address='0xb24550c' value='0x" DATA.LONG(A:0x24550c) "' name='RPMH_PDC_AOP_TCS0_CMD0_MSGID'/>"
WRITE #1 "        <register address='0xb24551c' value='0x" DATA.LONG(A:0x24551c) "' name='RPMH_PDC_AOP_TCS0_CMD1_MSGID'/>"
WRITE #1 "        <register address='0xb24552c' value='0x" DATA.LONG(A:0x24552c) "' name='RPMH_PDC_AOP_TCS0_CMD2_MSGID'/>"
WRITE #1 "        <register address='0xb24553c' value='0x" DATA.LONG(A:0x24553c) "' name='RPMH_PDC_AOP_TCS0_CMD3_MSGID'/>"
WRITE #1 "        <register address='0xb2455d4' value='0x" DATA.LONG(A:0x2455d4) "' name='RPMH_PDC_AOP_TCS1_CMD0_MSGID'/>"
WRITE #1 "        <register address='0xb2455e4' value='0x" DATA.LONG(A:0x2455e4) "' name='RPMH_PDC_AOP_TCS1_CMD1_MSGID'/>"
WRITE #1 "        <register address='0xb2455f4' value='0x" DATA.LONG(A:0x2455f4) "' name='RPMH_PDC_AOP_TCS1_CMD2_MSGID'/>"
WRITE #1 "        <register address='0xb245604' value='0x" DATA.LONG(A:0x245604) "' name='RPMH_PDC_AOP_TCS1_CMD3_MSGID'/>"
WRITE #1 "        <register address='0xb24569c' value='0x" DATA.LONG(A:0x24569c) "' name='RPMH_PDC_AOP_TCS2_CMD0_MSGID'/>"
WRITE #1 "        <register address='0xb2456ac' value='0x" DATA.LONG(A:0x2456ac) "' name='RPMH_PDC_AOP_TCS2_CMD1_MSGID'/>"
WRITE #1 "        <register address='0xb2456bc' value='0x" DATA.LONG(A:0x2456bc) "' name='RPMH_PDC_AOP_TCS2_CMD2_MSGID'/>"
WRITE #1 "        <register address='0xb2456cc' value='0x" DATA.LONG(A:0x2456cc) "' name='RPMH_PDC_AOP_TCS2_CMD3_MSGID'/>"
WRITE #1 "        <register address='0xb245764' value='0x" DATA.LONG(A:0x245764) "' name='RPMH_PDC_AOP_TCS3_CMD0_MSGID'/>"
WRITE #1 "        <register address='0xb245774' value='0x" DATA.LONG(A:0x245774) "' name='RPMH_PDC_AOP_TCS3_CMD1_MSGID'/>"
WRITE #1 "        <register address='0xb245784' value='0x" DATA.LONG(A:0x245784) "' name='RPMH_PDC_AOP_TCS3_CMD2_MSGID'/>"
WRITE #1 "        <register address='0xb245794' value='0x" DATA.LONG(A:0x245794) "' name='RPMH_PDC_AOP_TCS3_CMD3_MSGID'/>"
WRITE #1 "        <register address='0xb245510' value='0x" DATA.LONG(A:0x245510) "' name='RPMH_PDC_AOP_TCS0_CMD0_ADDR'/>"
WRITE #1 "        <register address='0xb245520' value='0x" DATA.LONG(A:0x245520) "' name='RPMH_PDC_AOP_TCS0_CMD1_ADDR'/>"
WRITE #1 "        <register address='0xb245530' value='0x" DATA.LONG(A:0x245530) "' name='RPMH_PDC_AOP_TCS0_CMD2_ADDR'/>"
WRITE #1 "        <register address='0xb245540' value='0x" DATA.LONG(A:0x245540) "' name='RPMH_PDC_AOP_TCS0_CMD3_ADDR'/>"
WRITE #1 "        <register address='0xb2455d8' value='0x" DATA.LONG(A:0x2455d8) "' name='RPMH_PDC_AOP_TCS1_CMD0_ADDR'/>"
WRITE #1 "        <register address='0xb2455e8' value='0x" DATA.LONG(A:0x2455e8) "' name='RPMH_PDC_AOP_TCS1_CMD1_ADDR'/>"
WRITE #1 "        <register address='0xb2455f8' value='0x" DATA.LONG(A:0x2455f8) "' name='RPMH_PDC_AOP_TCS1_CMD2_ADDR'/>"
WRITE #1 "        <register address='0xb245608' value='0x" DATA.LONG(A:0x245608) "' name='RPMH_PDC_AOP_TCS1_CMD3_ADDR'/>"
WRITE #1 "        <register address='0xb2456a0' value='0x" DATA.LONG(A:0x2456a0) "' name='RPMH_PDC_AOP_TCS2_CMD0_ADDR'/>"
WRITE #1 "        <register address='0xb2456b0' value='0x" DATA.LONG(A:0x2456b0) "' name='RPMH_PDC_AOP_TCS2_CMD1_ADDR'/>"
WRITE #1 "        <register address='0xb2456c0' value='0x" DATA.LONG(A:0x2456c0) "' name='RPMH_PDC_AOP_TCS2_CMD2_ADDR'/>"
WRITE #1 "        <register address='0xb2456d0' value='0x" DATA.LONG(A:0x2456d0) "' name='RPMH_PDC_AOP_TCS2_CMD3_ADDR'/>"
WRITE #1 "        <register address='0xb245768' value='0x" DATA.LONG(A:0x245768) "' name='RPMH_PDC_AOP_TCS3_CMD0_ADDR'/>"
WRITE #1 "        <register address='0xb245778' value='0x" DATA.LONG(A:0x245778) "' name='RPMH_PDC_AOP_TCS3_CMD1_ADDR'/>"
WRITE #1 "        <register address='0xb245788' value='0x" DATA.LONG(A:0x245788) "' name='RPMH_PDC_AOP_TCS3_CMD2_ADDR'/>"
WRITE #1 "        <register address='0xb245798' value='0x" DATA.LONG(A:0x245798) "' name='RPMH_PDC_AOP_TCS3_CMD3_ADDR'/>"
WRITE #1 "        <register address='0xb245514' value='0x" DATA.LONG(A:0x245514) "' name='RPMH_PDC_AOP_TCS0_CMD0_DATA'/>"
WRITE #1 "        <register address='0xb245524' value='0x" DATA.LONG(A:0x245524) "' name='RPMH_PDC_AOP_TCS0_CMD1_DATA'/>"
WRITE #1 "        <register address='0xb245534' value='0x" DATA.LONG(A:0x245534) "' name='RPMH_PDC_AOP_TCS0_CMD2_DATA'/>"
WRITE #1 "        <register address='0xb245544' value='0x" DATA.LONG(A:0x245544) "' name='RPMH_PDC_AOP_TCS0_CMD3_DATA'/>"
WRITE #1 "        <register address='0xb2455dc' value='0x" DATA.LONG(A:0x2455dc) "' name='RPMH_PDC_AOP_TCS1_CMD0_DATA'/>"
WRITE #1 "        <register address='0xb2455ec' value='0x" DATA.LONG(A:0x2455ec) "' name='RPMH_PDC_AOP_TCS1_CMD1_DATA'/>"
WRITE #1 "        <register address='0xb2455fc' value='0x" DATA.LONG(A:0x2455fc) "' name='RPMH_PDC_AOP_TCS1_CMD2_DATA'/>"
WRITE #1 "        <register address='0xb24560c' value='0x" DATA.LONG(A:0x24560c) "' name='RPMH_PDC_AOP_TCS1_CMD3_DATA'/>"
WRITE #1 "        <register address='0xb2456a4' value='0x" DATA.LONG(A:0x2456a4) "' name='RPMH_PDC_AOP_TCS2_CMD0_DATA'/>"
WRITE #1 "        <register address='0xb2456b4' value='0x" DATA.LONG(A:0x2456b4) "' name='RPMH_PDC_AOP_TCS2_CMD1_DATA'/>"
WRITE #1 "        <register address='0xb2456c4' value='0x" DATA.LONG(A:0x2456c4) "' name='RPMH_PDC_AOP_TCS2_CMD2_DATA'/>"
WRITE #1 "        <register address='0xb2456d4' value='0x" DATA.LONG(A:0x2456d4) "' name='RPMH_PDC_AOP_TCS2_CMD3_DATA'/>"
WRITE #1 "        <register address='0xb24576c' value='0x" DATA.LONG(A:0x24576c) "' name='RPMH_PDC_AOP_TCS3_CMD0_DATA'/>"
WRITE #1 "        <register address='0xb24577c' value='0x" DATA.LONG(A:0x24577c) "' name='RPMH_PDC_AOP_TCS3_CMD1_DATA'/>"
WRITE #1 "        <register address='0xb24578c' value='0x" DATA.LONG(A:0x24578c) "' name='RPMH_PDC_AOP_TCS3_CMD2_DATA'/>"
WRITE #1 "        <register address='0xb24579c' value='0x" DATA.LONG(A:0x24579c) "' name='RPMH_PDC_AOP_TCS3_CMD3_DATA'/>"
WRITE #1 "        <register address='0xb250000' value='0x" DATA.LONG(A:0x250000) "' name='RPMH_PDC_DEBUG_VOTE_CMP_DATA_DRV0'/>"
WRITE #1 "        <register address='0xb250010' value='0x" DATA.LONG(A:0x250010) "' name='RPMH_PDC_DEBUG_IRQ_ENABLE_BANK0_DRV0'/>"
WRITE #1 "        <register address='0xb250110' value='0x" DATA.LONG(A:0x250110) "' name='RPMH_PDC_DEBUG_IRQ_0_CFG_DRV0'/>"
WRITE #1 "        <register address='0xb250900' value='0x" DATA.LONG(A:0x250900) "' name='RPMH_PDC_DEBUG_IRQ_STATUS_BANK0_DRV0'/>"
WRITE #1 "        <register address='0xb251000' value='0x" DATA.LONG(A:0x251000) "' name='RPMH_PDC_DEBUG_PDC_VERSION_DRV0'/>"
WRITE #1 "        <register address='0xb251004' value='0x" DATA.LONG(A:0x251004) "' name='RPMH_PDC_DEBUG_PDC_PARAM_RESOURCE_DRV0'/>"
WRITE #1 "        <register address='0xb251008' value='0x" DATA.LONG(A:0x251008) "' name='RPMH_PDC_DEBUG_PDC_PARAM_SEQ_CONFIG_DRV0'/>"
WRITE #1 "        <register address='0xb25100c' value='0x" DATA.LONG(A:0x25100c) "' name='RPMH_PDC_DEBUG_PDC_PARAM_IRQ_CONFIG_DRV0'/>"
WRITE #1 "        <register address='0xb251020' value='0x" DATA.LONG(A:0x251020) "' name='RPMH_PDC_DEBUG_SEQ_BUSY_DRV0'/>"
WRITE #1 "        <register address='0xb251024' value='0x" DATA.LONG(A:0x251024) "' name='RPMH_PDC_DEBUG_SEQ_DBG_PROGRAM_COUNTER_DRV0'/>"
WRITE #1 "        <register address='0xb251028' value='0x" DATA.LONG(A:0x251028) "' name='RPMH_PDC_DEBUG_SEQ_DBG_STAT_DRV0'/>"
WRITE #1 "        <register address='0xb25102c' value='0x" DATA.LONG(A:0x25102c) "' name='RPMH_PDC_DEBUG_SEQ_DBG_WAIT_EVNT_DRV0'/>"
WRITE #1 "        <register address='0xb251030' value='0x" DATA.LONG(A:0x251030) "' name='RPMH_PDC_DEBUG_PDC_MODE_STATUS_DRV0'/>"
WRITE #1 "        <register address='0xb251034' value='0x" DATA.LONG(A:0x251034) "' name='RPMH_PDC_DEBUG_DBG_EPCB_RX_ADDR0'/>"
WRITE #1 "        <register address='0xb251038' value='0x" DATA.LONG(A:0x251038) "' name='RPMH_PDC_DEBUG_DBG_EPCB_RX_DATA0'/>"
WRITE #1 "        <register address='0xb251300' value='0x" DATA.LONG(A:0x251300) "' name='RPMH_PDC_DEBUG_TCS0_DRV0_STATUS'/>"
WRITE #1 "        <register address='0xb2513c8' value='0x" DATA.LONG(A:0x2513c8) "' name='RPMH_PDC_DEBUG_TCS1_DRV0_STATUS'/>"
WRITE #1 "        <register address='0xb251490' value='0x" DATA.LONG(A:0x251490) "' name='RPMH_PDC_DEBUG_TCS2_DRV0_STATUS'/>"
WRITE #1 "        <register address='0xb251558' value='0x" DATA.LONG(A:0x251558) "' name='RPMH_PDC_DEBUG_TCS3_DRV0_STATUS'/>"
WRITE #1 "        <register address='0xb251304' value='0x" DATA.LONG(A:0x251304) "' name='RPMH_PDC_DEBUG_TCS0_CMD0_DRV0_STATUS'/>"
WRITE #1 "        <register address='0xb25130c' value='0x" DATA.LONG(A:0x25130c) "' name='RPMH_PDC_DEBUG_TCS0_CMD1_DRV0_STATUS'/>"
WRITE #1 "        <register address='0xb251314' value='0x" DATA.LONG(A:0x251314) "' name='RPMH_PDC_DEBUG_TCS0_CMD2_DRV0_STATUS'/>"
WRITE #1 "        <register address='0xb25131c' value='0x" DATA.LONG(A:0x25131c) "' name='RPMH_PDC_DEBUG_TCS0_CMD3_DRV0_STATUS'/>"
WRITE #1 "        <register address='0xb2513cc' value='0x" DATA.LONG(A:0x2513cc) "' name='RPMH_PDC_DEBUG_TCS1_CMD0_DRV0_STATUS'/>"
WRITE #1 "        <register address='0xb2513d4' value='0x" DATA.LONG(A:0x2513d4) "' name='RPMH_PDC_DEBUG_TCS1_CMD1_DRV0_STATUS'/>"
WRITE #1 "        <register address='0xb2513dc' value='0x" DATA.LONG(A:0x2513dc) "' name='RPMH_PDC_DEBUG_TCS1_CMD2_DRV0_STATUS'/>"
WRITE #1 "        <register address='0xb2513e4' value='0x" DATA.LONG(A:0x2513e4) "' name='RPMH_PDC_DEBUG_TCS1_CMD3_DRV0_STATUS'/>"
WRITE #1 "        <register address='0xb251494' value='0x" DATA.LONG(A:0x251494) "' name='RPMH_PDC_DEBUG_TCS2_CMD0_DRV0_STATUS'/>"
WRITE #1 "        <register address='0xb25149c' value='0x" DATA.LONG(A:0x25149c) "' name='RPMH_PDC_DEBUG_TCS2_CMD1_DRV0_STATUS'/>"
WRITE #1 "        <register address='0xb2514a4' value='0x" DATA.LONG(A:0x2514a4) "' name='RPMH_PDC_DEBUG_TCS2_CMD2_DRV0_STATUS'/>"
WRITE #1 "        <register address='0xb2514ac' value='0x" DATA.LONG(A:0x2514ac) "' name='RPMH_PDC_DEBUG_TCS2_CMD3_DRV0_STATUS'/>"
WRITE #1 "        <register address='0xb25155c' value='0x" DATA.LONG(A:0x25155c) "' name='RPMH_PDC_DEBUG_TCS3_CMD0_DRV0_STATUS'/>"
WRITE #1 "        <register address='0xb251564' value='0x" DATA.LONG(A:0x251564) "' name='RPMH_PDC_DEBUG_TCS3_CMD1_DRV0_STATUS'/>"
WRITE #1 "        <register address='0xb25156c' value='0x" DATA.LONG(A:0x25156c) "' name='RPMH_PDC_DEBUG_TCS3_CMD2_DRV0_STATUS'/>"
WRITE #1 "        <register address='0xb251574' value='0x" DATA.LONG(A:0x251574) "' name='RPMH_PDC_DEBUG_TCS3_CMD3_DRV0_STATUS'/>"
WRITE #1 "        <register address='0xb254500' value='0x" DATA.LONG(A:0x254500) "' name='RPMH_PDC_DEBUG_ENABLE_PDC'/>"
WRITE #1 "        <register address='0xb254510' value='0x" DATA.LONG(A:0x254510) "' name='RPMH_PDC_DEBUG_TIMER_MATCH_VALUE_LO'/>"
WRITE #1 "        <register address='0xb254514' value='0x" DATA.LONG(A:0x254514) "' name='RPMH_PDC_DEBUG_TIMER_MATCH_VALUE_HI'/>"
WRITE #1 "        <register address='0xb254518' value='0x" DATA.LONG(A:0x254518) "' name='RPMH_PDC_DEBUG_TIMER_DISABLED_FOR_ARC'/>"
WRITE #1 "        <register address='0xb254520' value='0x" DATA.LONG(A:0x254520) "' name='RPMH_PDC_DEBUG_SEQ_START_ADDR'/>"
WRITE #1 "        <register address='0xb254524' value='0x" DATA.LONG(A:0x254524) "' name='RPMH_PDC_DEBUG_SEQ_OVERRIDE_START_ADDR'/>"
WRITE #1 "        <register address='0xb25452c' value='0x" DATA.LONG(A:0x25452c) "' name='RPMH_PDC_DEBUG_SEQ_OVERRIDE_TRIGGER'/>"
WRITE #1 "        <register address='0xb254530' value='0x" DATA.LONG(A:0x254530) "' name='RPMH_PDC_DEBUG_SEQ_PWR_CTRL_OVERRIDE_MASK'/>"
WRITE #1 "        <register address='0xb254534' value='0x" DATA.LONG(A:0x254534) "' name='RPMH_PDC_DEBUG_SEQ_PWR_CTRL_OVERRIDE_VAL'/>"
WRITE #1 "        <register address='0xb254540' value='0x" DATA.LONG(A:0x254540) "' name='RPMH_PDC_DEBUG_SEQ_WAIT_EVENT_OVERRIDE_MASK'/>"
WRITE #1 "        <register address='0xb254544' value='0x" DATA.LONG(A:0x254544) "' name='RPMH_PDC_DEBUG_SEQ_WAIT_EVENT_OVERRIDE_VAL'/>"
WRITE #1 "        <register address='0xb254550' value='0x" DATA.LONG(A:0x254550) "' name='RPMH_PDC_DEBUG_SEQ_BR_EVENT_OVERRIDE_MASK'/>"
WRITE #1 "        <register address='0xb254554' value='0x" DATA.LONG(A:0x254554) "' name='RPMH_PDC_DEBUG_SEQ_BR_EVENT_OVERRIDE_VAL'/>"
WRITE #1 "        <register address='0xb254590' value='0x" DATA.LONG(A:0x254590) "' name='RPMH_PDC_DEBUG_SEQ_CFG_BR_ADDR_0'/>"
WRITE #1 "        <register address='0xb254594' value='0x" DATA.LONG(A:0x254594) "' name='RPMH_PDC_DEBUG_SEQ_CFG_BR_ADDR_1'/>"
WRITE #1 "        <register address='0xb254598' value='0x" DATA.LONG(A:0x254598) "' name='RPMH_PDC_DEBUG_SEQ_CFG_BR_ADDR_2'/>"
WRITE #1 "        <register address='0xb25459c' value='0x" DATA.LONG(A:0x25459c) "' name='RPMH_PDC_DEBUG_SEQ_CFG_BR_ADDR_3'/>"
WRITE #1 "        <register address='0xb2545a0' value='0x" DATA.LONG(A:0x2545a0) "' name='RPMH_PDC_DEBUG_SEQ_CFG_DELAY_VAL_0'/>"
WRITE #1 "        <register address='0xb2545a4' value='0x" DATA.LONG(A:0x2545a4) "' name='RPMH_PDC_DEBUG_SEQ_CFG_DELAY_VAL_1'/>"
WRITE #1 "        <register address='0xb2545a8' value='0x" DATA.LONG(A:0x2545a8) "' name='RPMH_PDC_DEBUG_SEQ_CFG_DELAY_VAL_2'/>"
WRITE #1 "        <register address='0xb2545ac' value='0x" DATA.LONG(A:0x2545ac) "' name='RPMH_PDC_DEBUG_SEQ_CFG_DELAY_VAL_3'/>"
WRITE #1 "        <register address='0xb2545b0' value='0x" DATA.LONG(A:0x2545b0) "' name='RPMH_PDC_DEBUG_SEQ_CFG_DELAY_VAL_4'/>"
WRITE #1 "        <register address='0xb2545b4' value='0x" DATA.LONG(A:0x2545b4) "' name='RPMH_PDC_DEBUG_SEQ_CFG_DELAY_VAL_5'/>"
WRITE #1 "        <register address='0xb2545b8' value='0x" DATA.LONG(A:0x2545b8) "' name='RPMH_PDC_DEBUG_SEQ_CFG_DELAY_VAL_6'/>"
WRITE #1 "        <register address='0xb2545bc' value='0x" DATA.LONG(A:0x2545bc) "' name='RPMH_PDC_DEBUG_SEQ_CFG_DELAY_VAL_7'/>"
WRITE #1 "        <register address='0xb2545c0' value='0x" DATA.LONG(A:0x2545c0) "' name='RPMH_PDC_DEBUG_SEQ_CFG_DELAY_VAL_8'/>"
WRITE #1 "        <register address='0xb2545c4' value='0x" DATA.LONG(A:0x2545c4) "' name='RPMH_PDC_DEBUG_SEQ_CFG_DELAY_VAL_9'/>"
WRITE #1 "        <register address='0xb2545c8' value='0x" DATA.LONG(A:0x2545c8) "' name='RPMH_PDC_DEBUG_SEQ_CFG_DELAY_VAL_10'/>"
WRITE #1 "        <register address='0xb2545cc' value='0x" DATA.LONG(A:0x2545cc) "' name='RPMH_PDC_DEBUG_SEQ_CFG_DELAY_VAL_11'/>"
WRITE #1 "        <register address='0xb2545d0' value='0x" DATA.LONG(A:0x2545d0) "' name='RPMH_PDC_DEBUG_SEQ_CFG_DELAY_VAL_12'/>"
WRITE #1 "        <register address='0xb2545d4' value='0x" DATA.LONG(A:0x2545d4) "' name='RPMH_PDC_DEBUG_SEQ_CFG_DELAY_VAL_13'/>"
WRITE #1 "        <register address='0xb2545d8' value='0x" DATA.LONG(A:0x2545d8) "' name='RPMH_PDC_DEBUG_SEQ_CFG_DELAY_VAL_14'/>"
WRITE #1 "        <register address='0xb2545dc' value='0x" DATA.LONG(A:0x2545dc) "' name='RPMH_PDC_DEBUG_SEQ_CFG_DELAY_VAL_15'/>"
WRITE #1 "        <register address='0xb2545e0' value='0x" DATA.LONG(A:0x2545e0) "' name='RPMH_PDC_DEBUG_SEQ_DBG_BREAKPOINT_ADDR'/>"
WRITE #1 "        <register address='0xb2545e4' value='0x" DATA.LONG(A:0x2545e4) "' name='RPMH_PDC_DEBUG_SEQ_DBG_STEP'/>"
WRITE #1 "        <register address='0xb255500' value='0x" DATA.LONG(A:0x255500) "' name='RPMH_PDC_DEBUG_TCS0_CONTROL'/>"
WRITE #1 "        <register address='0xb2555c8' value='0x" DATA.LONG(A:0x2555c8) "' name='RPMH_PDC_DEBUG_TCS1_CONTROL'/>"
WRITE #1 "        <register address='0xb255690' value='0x" DATA.LONG(A:0x255690) "' name='RPMH_PDC_DEBUG_TCS2_CONTROL'/>"
WRITE #1 "        <register address='0xb255758' value='0x" DATA.LONG(A:0x255758) "' name='RPMH_PDC_DEBUG_TCS3_CONTROL'/>"
WRITE #1 "        <register address='0xb255504' value='0x" DATA.LONG(A:0x255504) "' name='RPMH_PDC_DEBUG_TCS0_CMD_ENABLE_BANK'/>"
WRITE #1 "        <register address='0xb2555cc' value='0x" DATA.LONG(A:0x2555cc) "' name='RPMH_PDC_DEBUG_TCS1_CMD_ENABLE_BANK'/>"
WRITE #1 "        <register address='0xb255694' value='0x" DATA.LONG(A:0x255694) "' name='RPMH_PDC_DEBUG_TCS2_CMD_ENABLE_BANK'/>"
WRITE #1 "        <register address='0xb25575c' value='0x" DATA.LONG(A:0x25575c) "' name='RPMH_PDC_DEBUG_TCS3_CMD_ENABLE_BANK'/>"
WRITE #1 "        <register address='0xb255508' value='0x" DATA.LONG(A:0x255508) "' name='RPMH_PDC_DEBUG_TCS0_CMD_WAIT_FOR_CMPL_BANK'/>"
WRITE #1 "        <register address='0xb2555d0' value='0x" DATA.LONG(A:0x2555d0) "' name='RPMH_PDC_DEBUG_TCS1_CMD_WAIT_FOR_CMPL_BANK'/>"
WRITE #1 "        <register address='0xb255698' value='0x" DATA.LONG(A:0x255698) "' name='RPMH_PDC_DEBUG_TCS2_CMD_WAIT_FOR_CMPL_BANK'/>"
WRITE #1 "        <register address='0xb255760' value='0x" DATA.LONG(A:0x255760) "' name='RPMH_PDC_DEBUG_TCS3_CMD_WAIT_FOR_CMPL_BANK'/>"
WRITE #1 "        <register address='0xb25550c' value='0x" DATA.LONG(A:0x25550c) "' name='RPMH_PDC_DEBUG_TCS0_CMD0_MSGID'/>"
WRITE #1 "        <register address='0xb25551c' value='0x" DATA.LONG(A:0x25551c) "' name='RPMH_PDC_DEBUG_TCS0_CMD1_MSGID'/>"
WRITE #1 "        <register address='0xb25552c' value='0x" DATA.LONG(A:0x25552c) "' name='RPMH_PDC_DEBUG_TCS0_CMD2_MSGID'/>"
WRITE #1 "        <register address='0xb25553c' value='0x" DATA.LONG(A:0x25553c) "' name='RPMH_PDC_DEBUG_TCS0_CMD3_MSGID'/>"
WRITE #1 "        <register address='0xb2555d4' value='0x" DATA.LONG(A:0x2555d4) "' name='RPMH_PDC_DEBUG_TCS1_CMD0_MSGID'/>"
WRITE #1 "        <register address='0xb2555e4' value='0x" DATA.LONG(A:0x2555e4) "' name='RPMH_PDC_DEBUG_TCS1_CMD1_MSGID'/>"
WRITE #1 "        <register address='0xb2555f4' value='0x" DATA.LONG(A:0x2555f4) "' name='RPMH_PDC_DEBUG_TCS1_CMD2_MSGID'/>"
WRITE #1 "        <register address='0xb255604' value='0x" DATA.LONG(A:0x255604) "' name='RPMH_PDC_DEBUG_TCS1_CMD3_MSGID'/>"
WRITE #1 "        <register address='0xb25569c' value='0x" DATA.LONG(A:0x25569c) "' name='RPMH_PDC_DEBUG_TCS2_CMD0_MSGID'/>"
WRITE #1 "        <register address='0xb2556ac' value='0x" DATA.LONG(A:0x2556ac) "' name='RPMH_PDC_DEBUG_TCS2_CMD1_MSGID'/>"
WRITE #1 "        <register address='0xb2556bc' value='0x" DATA.LONG(A:0x2556bc) "' name='RPMH_PDC_DEBUG_TCS2_CMD2_MSGID'/>"
WRITE #1 "        <register address='0xb2556cc' value='0x" DATA.LONG(A:0x2556cc) "' name='RPMH_PDC_DEBUG_TCS2_CMD3_MSGID'/>"
WRITE #1 "        <register address='0xb255764' value='0x" DATA.LONG(A:0x255764) "' name='RPMH_PDC_DEBUG_TCS3_CMD0_MSGID'/>"
WRITE #1 "        <register address='0xb255774' value='0x" DATA.LONG(A:0x255774) "' name='RPMH_PDC_DEBUG_TCS3_CMD1_MSGID'/>"
WRITE #1 "        <register address='0xb255784' value='0x" DATA.LONG(A:0x255784) "' name='RPMH_PDC_DEBUG_TCS3_CMD2_MSGID'/>"
WRITE #1 "        <register address='0xb255794' value='0x" DATA.LONG(A:0x255794) "' name='RPMH_PDC_DEBUG_TCS3_CMD3_MSGID'/>"
WRITE #1 "        <register address='0xb255510' value='0x" DATA.LONG(A:0x255510) "' name='RPMH_PDC_DEBUG_TCS0_CMD0_ADDR'/>"
WRITE #1 "        <register address='0xb255520' value='0x" DATA.LONG(A:0x255520) "' name='RPMH_PDC_DEBUG_TCS0_CMD1_ADDR'/>"
WRITE #1 "        <register address='0xb255530' value='0x" DATA.LONG(A:0x255530) "' name='RPMH_PDC_DEBUG_TCS0_CMD2_ADDR'/>"
WRITE #1 "        <register address='0xb255540' value='0x" DATA.LONG(A:0x255540) "' name='RPMH_PDC_DEBUG_TCS0_CMD3_ADDR'/>"
WRITE #1 "        <register address='0xb2555d8' value='0x" DATA.LONG(A:0x2555d8) "' name='RPMH_PDC_DEBUG_TCS1_CMD0_ADDR'/>"
WRITE #1 "        <register address='0xb2555e8' value='0x" DATA.LONG(A:0x2555e8) "' name='RPMH_PDC_DEBUG_TCS1_CMD1_ADDR'/>"
WRITE #1 "        <register address='0xb2555f8' value='0x" DATA.LONG(A:0x2555f8) "' name='RPMH_PDC_DEBUG_TCS1_CMD2_ADDR'/>"
WRITE #1 "        <register address='0xb255608' value='0x" DATA.LONG(A:0x255608) "' name='RPMH_PDC_DEBUG_TCS1_CMD3_ADDR'/>"
WRITE #1 "        <register address='0xb2556a0' value='0x" DATA.LONG(A:0x2556a0) "' name='RPMH_PDC_DEBUG_TCS2_CMD0_ADDR'/>"
WRITE #1 "        <register address='0xb2556b0' value='0x" DATA.LONG(A:0x2556b0) "' name='RPMH_PDC_DEBUG_TCS2_CMD1_ADDR'/>"
WRITE #1 "        <register address='0xb2556c0' value='0x" DATA.LONG(A:0x2556c0) "' name='RPMH_PDC_DEBUG_TCS2_CMD2_ADDR'/>"
WRITE #1 "        <register address='0xb2556d0' value='0x" DATA.LONG(A:0x2556d0) "' name='RPMH_PDC_DEBUG_TCS2_CMD3_ADDR'/>"
WRITE #1 "        <register address='0xb255768' value='0x" DATA.LONG(A:0x255768) "' name='RPMH_PDC_DEBUG_TCS3_CMD0_ADDR'/>"
WRITE #1 "        <register address='0xb255778' value='0x" DATA.LONG(A:0x255778) "' name='RPMH_PDC_DEBUG_TCS3_CMD1_ADDR'/>"
WRITE #1 "        <register address='0xb255788' value='0x" DATA.LONG(A:0x255788) "' name='RPMH_PDC_DEBUG_TCS3_CMD2_ADDR'/>"
WRITE #1 "        <register address='0xb255798' value='0x" DATA.LONG(A:0x255798) "' name='RPMH_PDC_DEBUG_TCS3_CMD3_ADDR'/>"
WRITE #1 "        <register address='0xb255514' value='0x" DATA.LONG(A:0x255514) "' name='RPMH_PDC_DEBUG_TCS0_CMD0_DATA'/>"
WRITE #1 "        <register address='0xb255524' value='0x" DATA.LONG(A:0x255524) "' name='RPMH_PDC_DEBUG_TCS0_CMD1_DATA'/>"
WRITE #1 "        <register address='0xb255534' value='0x" DATA.LONG(A:0x255534) "' name='RPMH_PDC_DEBUG_TCS0_CMD2_DATA'/>"
WRITE #1 "        <register address='0xb255544' value='0x" DATA.LONG(A:0x255544) "' name='RPMH_PDC_DEBUG_TCS0_CMD3_DATA'/>"
WRITE #1 "        <register address='0xb2555dc' value='0x" DATA.LONG(A:0x2555dc) "' name='RPMH_PDC_DEBUG_TCS1_CMD0_DATA'/>"
WRITE #1 "        <register address='0xb2555ec' value='0x" DATA.LONG(A:0x2555ec) "' name='RPMH_PDC_DEBUG_TCS1_CMD1_DATA'/>"
WRITE #1 "        <register address='0xb2555fc' value='0x" DATA.LONG(A:0x2555fc) "' name='RPMH_PDC_DEBUG_TCS1_CMD2_DATA'/>"
WRITE #1 "        <register address='0xb25560c' value='0x" DATA.LONG(A:0x25560c) "' name='RPMH_PDC_DEBUG_TCS1_CMD3_DATA'/>"
WRITE #1 "        <register address='0xb2556a4' value='0x" DATA.LONG(A:0x2556a4) "' name='RPMH_PDC_DEBUG_TCS2_CMD0_DATA'/>"
WRITE #1 "        <register address='0xb2556b4' value='0x" DATA.LONG(A:0x2556b4) "' name='RPMH_PDC_DEBUG_TCS2_CMD1_DATA'/>"
WRITE #1 "        <register address='0xb2556c4' value='0x" DATA.LONG(A:0x2556c4) "' name='RPMH_PDC_DEBUG_TCS2_CMD2_DATA'/>"
WRITE #1 "        <register address='0xb2556d4' value='0x" DATA.LONG(A:0x2556d4) "' name='RPMH_PDC_DEBUG_TCS2_CMD3_DATA'/>"
WRITE #1 "        <register address='0xb25576c' value='0x" DATA.LONG(A:0x25576c) "' name='RPMH_PDC_DEBUG_TCS3_CMD0_DATA'/>"
WRITE #1 "        <register address='0xb25577c' value='0x" DATA.LONG(A:0x25577c) "' name='RPMH_PDC_DEBUG_TCS3_CMD1_DATA'/>"
WRITE #1 "        <register address='0xb25578c' value='0x" DATA.LONG(A:0x25578c) "' name='RPMH_PDC_DEBUG_TCS3_CMD2_DATA'/>"
WRITE #1 "        <register address='0xb25579c' value='0x" DATA.LONG(A:0x25579c) "' name='RPMH_PDC_DEBUG_TCS3_CMD3_DATA'/>"
WRITE #1 "        <register address='0xb260000' value='0x" DATA.LONG(A:0x260000) "' name='RPMH_PDC_GPU_VOTE_CMP_DATA_DRV0'/>"
WRITE #1 "        <register address='0xb261000' value='0x" DATA.LONG(A:0x261000) "' name='RPMH_PDC_GPU_PDC_VERSION_DRV0'/>"
WRITE #1 "        <register address='0xb261004' value='0x" DATA.LONG(A:0x261004) "' name='RPMH_PDC_GPU_PDC_PARAM_RESOURCE_DRV0'/>"
WRITE #1 "        <register address='0xb261008' value='0x" DATA.LONG(A:0x261008) "' name='RPMH_PDC_GPU_PDC_PARAM_SEQ_CONFIG_DRV0'/>"
WRITE #1 "        <register address='0xb26100c' value='0x" DATA.LONG(A:0x26100c) "' name='RPMH_PDC_GPU_PDC_PARAM_IRQ_CONFIG_DRV0'/>"
WRITE #1 "        <register address='0xb261020' value='0x" DATA.LONG(A:0x261020) "' name='RPMH_PDC_GPU_SEQ_BUSY_DRV0'/>"
WRITE #1 "        <register address='0xb261024' value='0x" DATA.LONG(A:0x261024) "' name='RPMH_PDC_GPU_SEQ_DBG_PROGRAM_COUNTER_DRV0'/>"
WRITE #1 "        <register address='0xb261028' value='0x" DATA.LONG(A:0x261028) "' name='RPMH_PDC_GPU_SEQ_DBG_STAT_DRV0'/>"
WRITE #1 "        <register address='0xb26102c' value='0x" DATA.LONG(A:0x26102c) "' name='RPMH_PDC_GPU_SEQ_DBG_WAIT_EVNT_DRV0'/>"
WRITE #1 "        <register address='0xb261030' value='0x" DATA.LONG(A:0x261030) "' name='RPMH_PDC_GPU_PDC_MODE_STATUS_DRV0'/>"
WRITE #1 "        <register address='0xb261034' value='0x" DATA.LONG(A:0x261034) "' name='RPMH_PDC_GPU_DBG_EPCB_RX_ADDR0'/>"
WRITE #1 "        <register address='0xb261038' value='0x" DATA.LONG(A:0x261038) "' name='RPMH_PDC_GPU_DBG_EPCB_RX_DATA0'/>"
WRITE #1 "        <register address='0xb261200' value='0x" DATA.LONG(A:0x261200) "' name='RPMH_PDC_GPU_PROFILING_UNIT0_DRV0_OUTPUT'/>"
WRITE #1 "        <register address='0xb261214' value='0x" DATA.LONG(A:0x261214) "' name='RPMH_PDC_GPU_PROFILING_UNIT1_DRV0_OUTPUT'/>"
WRITE #1 "        <register address='0xb261228' value='0x" DATA.LONG(A:0x261228) "' name='RPMH_PDC_GPU_PROFILING_UNIT2_DRV0_OUTPUT'/>"
WRITE #1 "        <register address='0xb26123c' value='0x" DATA.LONG(A:0x26123c) "' name='RPMH_PDC_GPU_PROFILING_UNIT3_DRV0_OUTPUT'/>"
WRITE #1 "        <register address='0xb261250' value='0x" DATA.LONG(A:0x261250) "' name='RPMH_PDC_GPU_PROFILING_UNIT4_DRV0_OUTPUT'/>"
WRITE #1 "        <register address='0xb261204' value='0x" DATA.LONG(A:0x261204) "' name='RPMH_PDC_GPU_PROFILING_UNIT0_DRV0_TIMESTAMP_LO'/>"
WRITE #1 "        <register address='0xb261218' value='0x" DATA.LONG(A:0x261218) "' name='RPMH_PDC_GPU_PROFILING_UNIT1_DRV0_TIMESTAMP_LO'/>"
WRITE #1 "        <register address='0xb26122c' value='0x" DATA.LONG(A:0x26122c) "' name='RPMH_PDC_GPU_PROFILING_UNIT2_DRV0_TIMESTAMP_LO'/>"
WRITE #1 "        <register address='0xb261240' value='0x" DATA.LONG(A:0x261240) "' name='RPMH_PDC_GPU_PROFILING_UNIT3_DRV0_TIMESTAMP_LO'/>"
WRITE #1 "        <register address='0xb261254' value='0x" DATA.LONG(A:0x261254) "' name='RPMH_PDC_GPU_PROFILING_UNIT4_DRV0_TIMESTAMP_LO'/>"
WRITE #1 "        <register address='0xb261208' value='0x" DATA.LONG(A:0x261208) "' name='RPMH_PDC_GPU_PROFILING_UNIT0_DRV0_TIMESTAMP_HI'/>"
WRITE #1 "        <register address='0xb26121c' value='0x" DATA.LONG(A:0x26121c) "' name='RPMH_PDC_GPU_PROFILING_UNIT1_DRV0_TIMESTAMP_HI'/>"
WRITE #1 "        <register address='0xb261230' value='0x" DATA.LONG(A:0x261230) "' name='RPMH_PDC_GPU_PROFILING_UNIT2_DRV0_TIMESTAMP_HI'/>"
WRITE #1 "        <register address='0xb261244' value='0x" DATA.LONG(A:0x261244) "' name='RPMH_PDC_GPU_PROFILING_UNIT3_DRV0_TIMESTAMP_HI'/>"
WRITE #1 "        <register address='0xb261258' value='0x" DATA.LONG(A:0x261258) "' name='RPMH_PDC_GPU_PROFILING_UNIT4_DRV0_TIMESTAMP_HI'/>"
WRITE #1 "        <register address='0xb261300' value='0x" DATA.LONG(A:0x261300) "' name='RPMH_PDC_GPU_TCS0_DRV0_STATUS'/>"
WRITE #1 "        <register address='0xb2613c8' value='0x" DATA.LONG(A:0x2613c8) "' name='RPMH_PDC_GPU_TCS1_DRV0_STATUS'/>"
WRITE #1 "        <register address='0xb261490' value='0x" DATA.LONG(A:0x261490) "' name='RPMH_PDC_GPU_TCS2_DRV0_STATUS'/>"
WRITE #1 "        <register address='0xb261558' value='0x" DATA.LONG(A:0x261558) "' name='RPMH_PDC_GPU_TCS3_DRV0_STATUS'/>"
WRITE #1 "        <register address='0xb261304' value='0x" DATA.LONG(A:0x261304) "' name='RPMH_PDC_GPU_TCS0_CMD0_DRV0_STATUS'/>"
WRITE #1 "        <register address='0xb26130c' value='0x" DATA.LONG(A:0x26130c) "' name='RPMH_PDC_GPU_TCS0_CMD1_DRV0_STATUS'/>"
WRITE #1 "        <register address='0xb261314' value='0x" DATA.LONG(A:0x261314) "' name='RPMH_PDC_GPU_TCS0_CMD2_DRV0_STATUS'/>"
WRITE #1 "        <register address='0xb26131c' value='0x" DATA.LONG(A:0x26131c) "' name='RPMH_PDC_GPU_TCS0_CMD3_DRV0_STATUS'/>"
WRITE #1 "        <register address='0xb2613cc' value='0x" DATA.LONG(A:0x2613cc) "' name='RPMH_PDC_GPU_TCS1_CMD0_DRV0_STATUS'/>"
WRITE #1 "        <register address='0xb2613d4' value='0x" DATA.LONG(A:0x2613d4) "' name='RPMH_PDC_GPU_TCS1_CMD1_DRV0_STATUS'/>"
WRITE #1 "        <register address='0xb2613dc' value='0x" DATA.LONG(A:0x2613dc) "' name='RPMH_PDC_GPU_TCS1_CMD2_DRV0_STATUS'/>"
WRITE #1 "        <register address='0xb2613e4' value='0x" DATA.LONG(A:0x2613e4) "' name='RPMH_PDC_GPU_TCS1_CMD3_DRV0_STATUS'/>"
WRITE #1 "        <register address='0xb261494' value='0x" DATA.LONG(A:0x261494) "' name='RPMH_PDC_GPU_TCS2_CMD0_DRV0_STATUS'/>"
WRITE #1 "        <register address='0xb26149c' value='0x" DATA.LONG(A:0x26149c) "' name='RPMH_PDC_GPU_TCS2_CMD1_DRV0_STATUS'/>"
WRITE #1 "        <register address='0xb2614a4' value='0x" DATA.LONG(A:0x2614a4) "' name='RPMH_PDC_GPU_TCS2_CMD2_DRV0_STATUS'/>"
WRITE #1 "        <register address='0xb2614ac' value='0x" DATA.LONG(A:0x2614ac) "' name='RPMH_PDC_GPU_TCS2_CMD3_DRV0_STATUS'/>"
WRITE #1 "        <register address='0xb26155c' value='0x" DATA.LONG(A:0x26155c) "' name='RPMH_PDC_GPU_TCS3_CMD0_DRV0_STATUS'/>"
WRITE #1 "        <register address='0xb261564' value='0x" DATA.LONG(A:0x261564) "' name='RPMH_PDC_GPU_TCS3_CMD1_DRV0_STATUS'/>"
WRITE #1 "        <register address='0xb26156c' value='0x" DATA.LONG(A:0x26156c) "' name='RPMH_PDC_GPU_TCS3_CMD2_DRV0_STATUS'/>"
WRITE #1 "        <register address='0xb261574' value='0x" DATA.LONG(A:0x261574) "' name='RPMH_PDC_GPU_TCS3_CMD3_DRV0_STATUS'/>"
WRITE #1 "        <register address='0xb264500' value='0x" DATA.LONG(A:0x264500) "' name='RPMH_PDC_GPU_ENABLE_PDC'/>"
WRITE #1 "        <register address='0xb264510' value='0x" DATA.LONG(A:0x264510) "' name='RPMH_PDC_GPU_TIMER_MATCH_VALUE_LO'/>"
WRITE #1 "        <register address='0xb264514' value='0x" DATA.LONG(A:0x264514) "' name='RPMH_PDC_GPU_TIMER_MATCH_VALUE_HI'/>"
WRITE #1 "        <register address='0xb264518' value='0x" DATA.LONG(A:0x264518) "' name='RPMH_PDC_GPU_TIMER_DISABLED_FOR_ARC'/>"
WRITE #1 "        <register address='0xb264520' value='0x" DATA.LONG(A:0x264520) "' name='RPMH_PDC_GPU_SEQ_START_ADDR'/>"
WRITE #1 "        <register address='0xb264524' value='0x" DATA.LONG(A:0x264524) "' name='RPMH_PDC_GPU_SEQ_OVERRIDE_START_ADDR'/>"
WRITE #1 "        <register address='0xb26452c' value='0x" DATA.LONG(A:0x26452c) "' name='RPMH_PDC_GPU_SEQ_OVERRIDE_TRIGGER'/>"
WRITE #1 "        <register address='0xb264530' value='0x" DATA.LONG(A:0x264530) "' name='RPMH_PDC_GPU_SEQ_PWR_CTRL_OVERRIDE_MASK'/>"
WRITE #1 "        <register address='0xb264534' value='0x" DATA.LONG(A:0x264534) "' name='RPMH_PDC_GPU_SEQ_PWR_CTRL_OVERRIDE_VAL'/>"
WRITE #1 "        <register address='0xb264540' value='0x" DATA.LONG(A:0x264540) "' name='RPMH_PDC_GPU_SEQ_WAIT_EVENT_OVERRIDE_MASK'/>"
WRITE #1 "        <register address='0xb264544' value='0x" DATA.LONG(A:0x264544) "' name='RPMH_PDC_GPU_SEQ_WAIT_EVENT_OVERRIDE_VAL'/>"
WRITE #1 "        <register address='0xb264550' value='0x" DATA.LONG(A:0x264550) "' name='RPMH_PDC_GPU_SEQ_BR_EVENT_OVERRIDE_MASK'/>"
WRITE #1 "        <register address='0xb264554' value='0x" DATA.LONG(A:0x264554) "' name='RPMH_PDC_GPU_SEQ_BR_EVENT_OVERRIDE_VAL'/>"
WRITE #1 "        <register address='0xb264590' value='0x" DATA.LONG(A:0x264590) "' name='RPMH_PDC_GPU_SEQ_CFG_BR_ADDR_0'/>"
WRITE #1 "        <register address='0xb264594' value='0x" DATA.LONG(A:0x264594) "' name='RPMH_PDC_GPU_SEQ_CFG_BR_ADDR_1'/>"
WRITE #1 "        <register address='0xb264598' value='0x" DATA.LONG(A:0x264598) "' name='RPMH_PDC_GPU_SEQ_CFG_BR_ADDR_2'/>"
WRITE #1 "        <register address='0xb26459c' value='0x" DATA.LONG(A:0x26459c) "' name='RPMH_PDC_GPU_SEQ_CFG_BR_ADDR_3'/>"
WRITE #1 "        <register address='0xb2645a0' value='0x" DATA.LONG(A:0x2645a0) "' name='RPMH_PDC_GPU_SEQ_CFG_DELAY_VAL_0'/>"
WRITE #1 "        <register address='0xb2645a4' value='0x" DATA.LONG(A:0x2645a4) "' name='RPMH_PDC_GPU_SEQ_CFG_DELAY_VAL_1'/>"
WRITE #1 "        <register address='0xb2645a8' value='0x" DATA.LONG(A:0x2645a8) "' name='RPMH_PDC_GPU_SEQ_CFG_DELAY_VAL_2'/>"
WRITE #1 "        <register address='0xb2645ac' value='0x" DATA.LONG(A:0x2645ac) "' name='RPMH_PDC_GPU_SEQ_CFG_DELAY_VAL_3'/>"
WRITE #1 "        <register address='0xb2645b0' value='0x" DATA.LONG(A:0x2645b0) "' name='RPMH_PDC_GPU_SEQ_CFG_DELAY_VAL_4'/>"
WRITE #1 "        <register address='0xb2645b4' value='0x" DATA.LONG(A:0x2645b4) "' name='RPMH_PDC_GPU_SEQ_CFG_DELAY_VAL_5'/>"
WRITE #1 "        <register address='0xb2645b8' value='0x" DATA.LONG(A:0x2645b8) "' name='RPMH_PDC_GPU_SEQ_CFG_DELAY_VAL_6'/>"
WRITE #1 "        <register address='0xb2645bc' value='0x" DATA.LONG(A:0x2645bc) "' name='RPMH_PDC_GPU_SEQ_CFG_DELAY_VAL_7'/>"
WRITE #1 "        <register address='0xb2645c0' value='0x" DATA.LONG(A:0x2645c0) "' name='RPMH_PDC_GPU_SEQ_CFG_DELAY_VAL_8'/>"
WRITE #1 "        <register address='0xb2645c4' value='0x" DATA.LONG(A:0x2645c4) "' name='RPMH_PDC_GPU_SEQ_CFG_DELAY_VAL_9'/>"
WRITE #1 "        <register address='0xb2645c8' value='0x" DATA.LONG(A:0x2645c8) "' name='RPMH_PDC_GPU_SEQ_CFG_DELAY_VAL_10'/>"
WRITE #1 "        <register address='0xb2645cc' value='0x" DATA.LONG(A:0x2645cc) "' name='RPMH_PDC_GPU_SEQ_CFG_DELAY_VAL_11'/>"
WRITE #1 "        <register address='0xb2645d0' value='0x" DATA.LONG(A:0x2645d0) "' name='RPMH_PDC_GPU_SEQ_CFG_DELAY_VAL_12'/>"
WRITE #1 "        <register address='0xb2645d4' value='0x" DATA.LONG(A:0x2645d4) "' name='RPMH_PDC_GPU_SEQ_CFG_DELAY_VAL_13'/>"
WRITE #1 "        <register address='0xb2645d8' value='0x" DATA.LONG(A:0x2645d8) "' name='RPMH_PDC_GPU_SEQ_CFG_DELAY_VAL_14'/>"
WRITE #1 "        <register address='0xb2645dc' value='0x" DATA.LONG(A:0x2645dc) "' name='RPMH_PDC_GPU_SEQ_CFG_DELAY_VAL_15'/>"
WRITE #1 "        <register address='0xb2645e0' value='0x" DATA.LONG(A:0x2645e0) "' name='RPMH_PDC_GPU_SEQ_DBG_BREAKPOINT_ADDR'/>"
WRITE #1 "        <register address='0xb2645e4' value='0x" DATA.LONG(A:0x2645e4) "' name='RPMH_PDC_GPU_SEQ_DBG_STEP'/>"
WRITE #1 "        <register address='0xb265000' value='0x" DATA.LONG(A:0x265000) "' name='RPMH_PDC_GPU_PROFILING_UNIT0_EN'/>"
WRITE #1 "        <register address='0xb265014' value='0x" DATA.LONG(A:0x265014) "' name='RPMH_PDC_GPU_PROFILING_UNIT1_EN'/>"
WRITE #1 "        <register address='0xb265028' value='0x" DATA.LONG(A:0x265028) "' name='RPMH_PDC_GPU_PROFILING_UNIT2_EN'/>"
WRITE #1 "        <register address='0xb26503c' value='0x" DATA.LONG(A:0x26503c) "' name='RPMH_PDC_GPU_PROFILING_UNIT3_EN'/>"
WRITE #1 "        <register address='0xb265050' value='0x" DATA.LONG(A:0x265050) "' name='RPMH_PDC_GPU_PROFILING_UNIT4_EN'/>"
WRITE #1 "        <register address='0xb265500' value='0x" DATA.LONG(A:0x265500) "' name='RPMH_PDC_GPU_TCS0_CONTROL'/>"
WRITE #1 "        <register address='0xb2655c8' value='0x" DATA.LONG(A:0x2655c8) "' name='RPMH_PDC_GPU_TCS1_CONTROL'/>"
WRITE #1 "        <register address='0xb265690' value='0x" DATA.LONG(A:0x265690) "' name='RPMH_PDC_GPU_TCS2_CONTROL'/>"
WRITE #1 "        <register address='0xb265758' value='0x" DATA.LONG(A:0x265758) "' name='RPMH_PDC_GPU_TCS3_CONTROL'/>"
WRITE #1 "        <register address='0xb265504' value='0x" DATA.LONG(A:0x265504) "' name='RPMH_PDC_GPU_TCS0_CMD_ENABLE_BANK'/>"
WRITE #1 "        <register address='0xb2655cc' value='0x" DATA.LONG(A:0x2655cc) "' name='RPMH_PDC_GPU_TCS1_CMD_ENABLE_BANK'/>"
WRITE #1 "        <register address='0xb265694' value='0x" DATA.LONG(A:0x265694) "' name='RPMH_PDC_GPU_TCS2_CMD_ENABLE_BANK'/>"
WRITE #1 "        <register address='0xb26575c' value='0x" DATA.LONG(A:0x26575c) "' name='RPMH_PDC_GPU_TCS3_CMD_ENABLE_BANK'/>"
WRITE #1 "        <register address='0xb265508' value='0x" DATA.LONG(A:0x265508) "' name='RPMH_PDC_GPU_TCS0_CMD_WAIT_FOR_CMPL_BANK'/>"
WRITE #1 "        <register address='0xb2655d0' value='0x" DATA.LONG(A:0x2655d0) "' name='RPMH_PDC_GPU_TCS1_CMD_WAIT_FOR_CMPL_BANK'/>"
WRITE #1 "        <register address='0xb265698' value='0x" DATA.LONG(A:0x265698) "' name='RPMH_PDC_GPU_TCS2_CMD_WAIT_FOR_CMPL_BANK'/>"
WRITE #1 "        <register address='0xb265760' value='0x" DATA.LONG(A:0x265760) "' name='RPMH_PDC_GPU_TCS3_CMD_WAIT_FOR_CMPL_BANK'/>"
WRITE #1 "        <register address='0xb26550c' value='0x" DATA.LONG(A:0x26550c) "' name='RPMH_PDC_GPU_TCS0_CMD0_MSGID'/>"
WRITE #1 "        <register address='0xb26551c' value='0x" DATA.LONG(A:0x26551c) "' name='RPMH_PDC_GPU_TCS0_CMD1_MSGID'/>"
WRITE #1 "        <register address='0xb26552c' value='0x" DATA.LONG(A:0x26552c) "' name='RPMH_PDC_GPU_TCS0_CMD2_MSGID'/>"
WRITE #1 "        <register address='0xb26553c' value='0x" DATA.LONG(A:0x26553c) "' name='RPMH_PDC_GPU_TCS0_CMD3_MSGID'/>"
WRITE #1 "        <register address='0xb2655d4' value='0x" DATA.LONG(A:0x2655d4) "' name='RPMH_PDC_GPU_TCS1_CMD0_MSGID'/>"
WRITE #1 "        <register address='0xb2655e4' value='0x" DATA.LONG(A:0x2655e4) "' name='RPMH_PDC_GPU_TCS1_CMD1_MSGID'/>"
WRITE #1 "        <register address='0xb2655f4' value='0x" DATA.LONG(A:0x2655f4) "' name='RPMH_PDC_GPU_TCS1_CMD2_MSGID'/>"
WRITE #1 "        <register address='0xb265604' value='0x" DATA.LONG(A:0x265604) "' name='RPMH_PDC_GPU_TCS1_CMD3_MSGID'/>"
WRITE #1 "        <register address='0xb26569c' value='0x" DATA.LONG(A:0x26569c) "' name='RPMH_PDC_GPU_TCS2_CMD0_MSGID'/>"
WRITE #1 "        <register address='0xb2656ac' value='0x" DATA.LONG(A:0x2656ac) "' name='RPMH_PDC_GPU_TCS2_CMD1_MSGID'/>"
WRITE #1 "        <register address='0xb2656bc' value='0x" DATA.LONG(A:0x2656bc) "' name='RPMH_PDC_GPU_TCS2_CMD2_MSGID'/>"
WRITE #1 "        <register address='0xb2656cc' value='0x" DATA.LONG(A:0x2656cc) "' name='RPMH_PDC_GPU_TCS2_CMD3_MSGID'/>"
WRITE #1 "        <register address='0xb265764' value='0x" DATA.LONG(A:0x265764) "' name='RPMH_PDC_GPU_TCS3_CMD0_MSGID'/>"
WRITE #1 "        <register address='0xb265774' value='0x" DATA.LONG(A:0x265774) "' name='RPMH_PDC_GPU_TCS3_CMD1_MSGID'/>"
WRITE #1 "        <register address='0xb265784' value='0x" DATA.LONG(A:0x265784) "' name='RPMH_PDC_GPU_TCS3_CMD2_MSGID'/>"
WRITE #1 "        <register address='0xb265794' value='0x" DATA.LONG(A:0x265794) "' name='RPMH_PDC_GPU_TCS3_CMD3_MSGID'/>"
WRITE #1 "        <register address='0xb265510' value='0x" DATA.LONG(A:0x265510) "' name='RPMH_PDC_GPU_TCS0_CMD0_ADDR'/>"
WRITE #1 "        <register address='0xb265520' value='0x" DATA.LONG(A:0x265520) "' name='RPMH_PDC_GPU_TCS0_CMD1_ADDR'/>"
WRITE #1 "        <register address='0xb265530' value='0x" DATA.LONG(A:0x265530) "' name='RPMH_PDC_GPU_TCS0_CMD2_ADDR'/>"
WRITE #1 "        <register address='0xb265540' value='0x" DATA.LONG(A:0x265540) "' name='RPMH_PDC_GPU_TCS0_CMD3_ADDR'/>"
WRITE #1 "        <register address='0xb2655d8' value='0x" DATA.LONG(A:0x2655d8) "' name='RPMH_PDC_GPU_TCS1_CMD0_ADDR'/>"
WRITE #1 "        <register address='0xb2655e8' value='0x" DATA.LONG(A:0x2655e8) "' name='RPMH_PDC_GPU_TCS1_CMD1_ADDR'/>"
WRITE #1 "        <register address='0xb2655f8' value='0x" DATA.LONG(A:0x2655f8) "' name='RPMH_PDC_GPU_TCS1_CMD2_ADDR'/>"
WRITE #1 "        <register address='0xb265608' value='0x" DATA.LONG(A:0x265608) "' name='RPMH_PDC_GPU_TCS1_CMD3_ADDR'/>"
WRITE #1 "        <register address='0xb2656a0' value='0x" DATA.LONG(A:0x2656a0) "' name='RPMH_PDC_GPU_TCS2_CMD0_ADDR'/>"
WRITE #1 "        <register address='0xb2656b0' value='0x" DATA.LONG(A:0x2656b0) "' name='RPMH_PDC_GPU_TCS2_CMD1_ADDR'/>"
WRITE #1 "        <register address='0xb2656c0' value='0x" DATA.LONG(A:0x2656c0) "' name='RPMH_PDC_GPU_TCS2_CMD2_ADDR'/>"
WRITE #1 "        <register address='0xb2656d0' value='0x" DATA.LONG(A:0x2656d0) "' name='RPMH_PDC_GPU_TCS2_CMD3_ADDR'/>"
WRITE #1 "        <register address='0xb265768' value='0x" DATA.LONG(A:0x265768) "' name='RPMH_PDC_GPU_TCS3_CMD0_ADDR'/>"
WRITE #1 "        <register address='0xb265778' value='0x" DATA.LONG(A:0x265778) "' name='RPMH_PDC_GPU_TCS3_CMD1_ADDR'/>"
WRITE #1 "        <register address='0xb265788' value='0x" DATA.LONG(A:0x265788) "' name='RPMH_PDC_GPU_TCS3_CMD2_ADDR'/>"
WRITE #1 "        <register address='0xb265798' value='0x" DATA.LONG(A:0x265798) "' name='RPMH_PDC_GPU_TCS3_CMD3_ADDR'/>"
WRITE #1 "        <register address='0xb265514' value='0x" DATA.LONG(A:0x265514) "' name='RPMH_PDC_GPU_TCS0_CMD0_DATA'/>"
WRITE #1 "        <register address='0xb265524' value='0x" DATA.LONG(A:0x265524) "' name='RPMH_PDC_GPU_TCS0_CMD1_DATA'/>"
WRITE #1 "        <register address='0xb265534' value='0x" DATA.LONG(A:0x265534) "' name='RPMH_PDC_GPU_TCS0_CMD2_DATA'/>"
WRITE #1 "        <register address='0xb265544' value='0x" DATA.LONG(A:0x265544) "' name='RPMH_PDC_GPU_TCS0_CMD3_DATA'/>"
WRITE #1 "        <register address='0xb2655dc' value='0x" DATA.LONG(A:0x2655dc) "' name='RPMH_PDC_GPU_TCS1_CMD0_DATA'/>"
WRITE #1 "        <register address='0xb2655ec' value='0x" DATA.LONG(A:0x2655ec) "' name='RPMH_PDC_GPU_TCS1_CMD1_DATA'/>"
WRITE #1 "        <register address='0xb2655fc' value='0x" DATA.LONG(A:0x2655fc) "' name='RPMH_PDC_GPU_TCS1_CMD2_DATA'/>"
WRITE #1 "        <register address='0xb26560c' value='0x" DATA.LONG(A:0x26560c) "' name='RPMH_PDC_GPU_TCS1_CMD3_DATA'/>"
WRITE #1 "        <register address='0xb2656a4' value='0x" DATA.LONG(A:0x2656a4) "' name='RPMH_PDC_GPU_TCS2_CMD0_DATA'/>"
WRITE #1 "        <register address='0xb2656b4' value='0x" DATA.LONG(A:0x2656b4) "' name='RPMH_PDC_GPU_TCS2_CMD1_DATA'/>"
WRITE #1 "        <register address='0xb2656c4' value='0x" DATA.LONG(A:0x2656c4) "' name='RPMH_PDC_GPU_TCS2_CMD2_DATA'/>"
WRITE #1 "        <register address='0xb2656d4' value='0x" DATA.LONG(A:0x2656d4) "' name='RPMH_PDC_GPU_TCS2_CMD3_DATA'/>"
WRITE #1 "        <register address='0xb26576c' value='0x" DATA.LONG(A:0x26576c) "' name='RPMH_PDC_GPU_TCS3_CMD0_DATA'/>"
WRITE #1 "        <register address='0xb26577c' value='0x" DATA.LONG(A:0x26577c) "' name='RPMH_PDC_GPU_TCS3_CMD1_DATA'/>"
WRITE #1 "        <register address='0xb26578c' value='0x" DATA.LONG(A:0x26578c) "' name='RPMH_PDC_GPU_TCS3_CMD2_DATA'/>"
WRITE #1 "        <register address='0xb26579c' value='0x" DATA.LONG(A:0x26579c) "' name='RPMH_PDC_GPU_TCS3_CMD3_DATA'/>"
WRITE #1 "        <register address='0xb270000' value='0x" DATA.LONG(A:0x270000) "' name='RPMH_PDC_DISPLAY_VOTE_CMP_DATA_DRV0'/>"
WRITE #1 "        <register address='0xb271000' value='0x" DATA.LONG(A:0x271000) "' name='RPMH_PDC_DISPLAY_PDC_VERSION_DRV0'/>"
WRITE #1 "        <register address='0xb271004' value='0x" DATA.LONG(A:0x271004) "' name='RPMH_PDC_DISPLAY_PDC_PARAM_RESOURCE_DRV0'/>"
WRITE #1 "        <register address='0xb271008' value='0x" DATA.LONG(A:0x271008) "' name='RPMH_PDC_DISPLAY_PDC_PARAM_SEQ_CONFIG_DRV0'/>"
WRITE #1 "        <register address='0xb27100c' value='0x" DATA.LONG(A:0x27100c) "' name='RPMH_PDC_DISPLAY_PDC_PARAM_IRQ_CONFIG_DRV0'/>"
WRITE #1 "        <register address='0xb271020' value='0x" DATA.LONG(A:0x271020) "' name='RPMH_PDC_DISPLAY_SEQ_BUSY_DRV0'/>"
WRITE #1 "        <register address='0xb271024' value='0x" DATA.LONG(A:0x271024) "' name='RPMH_PDC_DISPLAY_SEQ_DBG_PROGRAM_COUNTER_DRV0'/>"
WRITE #1 "        <register address='0xb271028' value='0x" DATA.LONG(A:0x271028) "' name='RPMH_PDC_DISPLAY_SEQ_DBG_STAT_DRV0'/>"
WRITE #1 "        <register address='0xb27102c' value='0x" DATA.LONG(A:0x27102c) "' name='RPMH_PDC_DISPLAY_SEQ_DBG_WAIT_EVNT_DRV0'/>"
WRITE #1 "        <register address='0xb271030' value='0x" DATA.LONG(A:0x271030) "' name='RPMH_PDC_DISPLAY_PDC_MODE_STATUS_DRV0'/>"
WRITE #1 "        <register address='0xb271034' value='0x" DATA.LONG(A:0x271034) "' name='RPMH_PDC_DISPLAY_DBG_EPCB_RX_ADDR0'/>"
WRITE #1 "        <register address='0xb271038' value='0x" DATA.LONG(A:0x271038) "' name='RPMH_PDC_DISPLAY_DBG_EPCB_RX_DATA0'/>"
WRITE #1 "        <register address='0xb271200' value='0x" DATA.LONG(A:0x271200) "' name='RPMH_PDC_DISPLAY_PROFILING_UNIT0_DRV0_OUTPUT'/>"
WRITE #1 "        <register address='0xb271214' value='0x" DATA.LONG(A:0x271214) "' name='RPMH_PDC_DISPLAY_PROFILING_UNIT1_DRV0_OUTPUT'/>"
WRITE #1 "        <register address='0xb271228' value='0x" DATA.LONG(A:0x271228) "' name='RPMH_PDC_DISPLAY_PROFILING_UNIT2_DRV0_OUTPUT'/>"
WRITE #1 "        <register address='0xb27123c' value='0x" DATA.LONG(A:0x27123c) "' name='RPMH_PDC_DISPLAY_PROFILING_UNIT3_DRV0_OUTPUT'/>"
WRITE #1 "        <register address='0xb271250' value='0x" DATA.LONG(A:0x271250) "' name='RPMH_PDC_DISPLAY_PROFILING_UNIT4_DRV0_OUTPUT'/>"
WRITE #1 "        <register address='0xb271204' value='0x" DATA.LONG(A:0x271204) "' name='RPMH_PDC_DISPLAY_PROFILING_UNIT0_DRV0_TIMESTAMP_LO'/>"
WRITE #1 "        <register address='0xb271218' value='0x" DATA.LONG(A:0x271218) "' name='RPMH_PDC_DISPLAY_PROFILING_UNIT1_DRV0_TIMESTAMP_LO'/>"
WRITE #1 "        <register address='0xb27122c' value='0x" DATA.LONG(A:0x27122c) "' name='RPMH_PDC_DISPLAY_PROFILING_UNIT2_DRV0_TIMESTAMP_LO'/>"
WRITE #1 "        <register address='0xb271240' value='0x" DATA.LONG(A:0x271240) "' name='RPMH_PDC_DISPLAY_PROFILING_UNIT3_DRV0_TIMESTAMP_LO'/>"
WRITE #1 "        <register address='0xb271254' value='0x" DATA.LONG(A:0x271254) "' name='RPMH_PDC_DISPLAY_PROFILING_UNIT4_DRV0_TIMESTAMP_LO'/>"
WRITE #1 "        <register address='0xb271208' value='0x" DATA.LONG(A:0x271208) "' name='RPMH_PDC_DISPLAY_PROFILING_UNIT0_DRV0_TIMESTAMP_HI'/>"
WRITE #1 "        <register address='0xb27121c' value='0x" DATA.LONG(A:0x27121c) "' name='RPMH_PDC_DISPLAY_PROFILING_UNIT1_DRV0_TIMESTAMP_HI'/>"
WRITE #1 "        <register address='0xb271230' value='0x" DATA.LONG(A:0x271230) "' name='RPMH_PDC_DISPLAY_PROFILING_UNIT2_DRV0_TIMESTAMP_HI'/>"
WRITE #1 "        <register address='0xb271244' value='0x" DATA.LONG(A:0x271244) "' name='RPMH_PDC_DISPLAY_PROFILING_UNIT3_DRV0_TIMESTAMP_HI'/>"
WRITE #1 "        <register address='0xb271258' value='0x" DATA.LONG(A:0x271258) "' name='RPMH_PDC_DISPLAY_PROFILING_UNIT4_DRV0_TIMESTAMP_HI'/>"
WRITE #1 "        <register address='0xb271300' value='0x" DATA.LONG(A:0x271300) "' name='RPMH_PDC_DISPLAY_TCS0_DRV0_STATUS'/>"
WRITE #1 "        <register address='0xb2713c8' value='0x" DATA.LONG(A:0x2713c8) "' name='RPMH_PDC_DISPLAY_TCS1_DRV0_STATUS'/>"
WRITE #1 "        <register address='0xb271490' value='0x" DATA.LONG(A:0x271490) "' name='RPMH_PDC_DISPLAY_TCS2_DRV0_STATUS'/>"
WRITE #1 "        <register address='0xb271304' value='0x" DATA.LONG(A:0x271304) "' name='RPMH_PDC_DISPLAY_TCS0_CMD0_DRV0_STATUS'/>"
WRITE #1 "        <register address='0xb27130c' value='0x" DATA.LONG(A:0x27130c) "' name='RPMH_PDC_DISPLAY_TCS0_CMD1_DRV0_STATUS'/>"
WRITE #1 "        <register address='0xb271314' value='0x" DATA.LONG(A:0x271314) "' name='RPMH_PDC_DISPLAY_TCS0_CMD2_DRV0_STATUS'/>"
WRITE #1 "        <register address='0xb27131c' value='0x" DATA.LONG(A:0x27131c) "' name='RPMH_PDC_DISPLAY_TCS0_CMD3_DRV0_STATUS'/>"
WRITE #1 "        <register address='0xb2713cc' value='0x" DATA.LONG(A:0x2713cc) "' name='RPMH_PDC_DISPLAY_TCS1_CMD0_DRV0_STATUS'/>"
WRITE #1 "        <register address='0xb2713d4' value='0x" DATA.LONG(A:0x2713d4) "' name='RPMH_PDC_DISPLAY_TCS1_CMD1_DRV0_STATUS'/>"
WRITE #1 "        <register address='0xb2713dc' value='0x" DATA.LONG(A:0x2713dc) "' name='RPMH_PDC_DISPLAY_TCS1_CMD2_DRV0_STATUS'/>"
WRITE #1 "        <register address='0xb2713e4' value='0x" DATA.LONG(A:0x2713e4) "' name='RPMH_PDC_DISPLAY_TCS1_CMD3_DRV0_STATUS'/>"
WRITE #1 "        <register address='0xb271494' value='0x" DATA.LONG(A:0x271494) "' name='RPMH_PDC_DISPLAY_TCS2_CMD0_DRV0_STATUS'/>"
WRITE #1 "        <register address='0xb27149c' value='0x" DATA.LONG(A:0x27149c) "' name='RPMH_PDC_DISPLAY_TCS2_CMD1_DRV0_STATUS'/>"
WRITE #1 "        <register address='0xb2714a4' value='0x" DATA.LONG(A:0x2714a4) "' name='RPMH_PDC_DISPLAY_TCS2_CMD2_DRV0_STATUS'/>"
WRITE #1 "        <register address='0xb2714ac' value='0x" DATA.LONG(A:0x2714ac) "' name='RPMH_PDC_DISPLAY_TCS2_CMD3_DRV0_STATUS'/>"
WRITE #1 "        <register address='0xb274500' value='0x" DATA.LONG(A:0x274500) "' name='RPMH_PDC_DISPLAY_ENABLE_PDC'/>"
WRITE #1 "        <register address='0xb274510' value='0x" DATA.LONG(A:0x274510) "' name='RPMH_PDC_DISPLAY_TIMER_MATCH_VALUE_LO'/>"
WRITE #1 "        <register address='0xb274514' value='0x" DATA.LONG(A:0x274514) "' name='RPMH_PDC_DISPLAY_TIMER_MATCH_VALUE_HI'/>"
WRITE #1 "        <register address='0xb274518' value='0x" DATA.LONG(A:0x274518) "' name='RPMH_PDC_DISPLAY_TIMER_DISABLED_FOR_ARC'/>"
WRITE #1 "        <register address='0xb274520' value='0x" DATA.LONG(A:0x274520) "' name='RPMH_PDC_DISPLAY_SEQ_START_ADDR'/>"
WRITE #1 "        <register address='0xb274524' value='0x" DATA.LONG(A:0x274524) "' name='RPMH_PDC_DISPLAY_SEQ_OVERRIDE_START_ADDR'/>"
WRITE #1 "        <register address='0xb27452c' value='0x" DATA.LONG(A:0x27452c) "' name='RPMH_PDC_DISPLAY_SEQ_OVERRIDE_TRIGGER'/>"
WRITE #1 "        <register address='0xb274530' value='0x" DATA.LONG(A:0x274530) "' name='RPMH_PDC_DISPLAY_SEQ_PWR_CTRL_OVERRIDE_MASK'/>"
WRITE #1 "        <register address='0xb274534' value='0x" DATA.LONG(A:0x274534) "' name='RPMH_PDC_DISPLAY_SEQ_PWR_CTRL_OVERRIDE_VAL'/>"
WRITE #1 "        <register address='0xb274540' value='0x" DATA.LONG(A:0x274540) "' name='RPMH_PDC_DISPLAY_SEQ_WAIT_EVENT_OVERRIDE_MASK'/>"
WRITE #1 "        <register address='0xb274544' value='0x" DATA.LONG(A:0x274544) "' name='RPMH_PDC_DISPLAY_SEQ_WAIT_EVENT_OVERRIDE_VAL'/>"
WRITE #1 "        <register address='0xb274550' value='0x" DATA.LONG(A:0x274550) "' name='RPMH_PDC_DISPLAY_SEQ_BR_EVENT_OVERRIDE_MASK'/>"
WRITE #1 "        <register address='0xb274554' value='0x" DATA.LONG(A:0x274554) "' name='RPMH_PDC_DISPLAY_SEQ_BR_EVENT_OVERRIDE_VAL'/>"
WRITE #1 "        <register address='0xb274590' value='0x" DATA.LONG(A:0x274590) "' name='RPMH_PDC_DISPLAY_SEQ_CFG_BR_ADDR_0'/>"
WRITE #1 "        <register address='0xb274594' value='0x" DATA.LONG(A:0x274594) "' name='RPMH_PDC_DISPLAY_SEQ_CFG_BR_ADDR_1'/>"
WRITE #1 "        <register address='0xb274598' value='0x" DATA.LONG(A:0x274598) "' name='RPMH_PDC_DISPLAY_SEQ_CFG_BR_ADDR_2'/>"
WRITE #1 "        <register address='0xb27459c' value='0x" DATA.LONG(A:0x27459c) "' name='RPMH_PDC_DISPLAY_SEQ_CFG_BR_ADDR_3'/>"
WRITE #1 "        <register address='0xb2745a0' value='0x" DATA.LONG(A:0x2745a0) "' name='RPMH_PDC_DISPLAY_SEQ_CFG_DELAY_VAL_0'/>"
WRITE #1 "        <register address='0xb2745a4' value='0x" DATA.LONG(A:0x2745a4) "' name='RPMH_PDC_DISPLAY_SEQ_CFG_DELAY_VAL_1'/>"
WRITE #1 "        <register address='0xb2745a8' value='0x" DATA.LONG(A:0x2745a8) "' name='RPMH_PDC_DISPLAY_SEQ_CFG_DELAY_VAL_2'/>"
WRITE #1 "        <register address='0xb2745ac' value='0x" DATA.LONG(A:0x2745ac) "' name='RPMH_PDC_DISPLAY_SEQ_CFG_DELAY_VAL_3'/>"
WRITE #1 "        <register address='0xb2745b0' value='0x" DATA.LONG(A:0x2745b0) "' name='RPMH_PDC_DISPLAY_SEQ_CFG_DELAY_VAL_4'/>"
WRITE #1 "        <register address='0xb2745b4' value='0x" DATA.LONG(A:0x2745b4) "' name='RPMH_PDC_DISPLAY_SEQ_CFG_DELAY_VAL_5'/>"
WRITE #1 "        <register address='0xb2745b8' value='0x" DATA.LONG(A:0x2745b8) "' name='RPMH_PDC_DISPLAY_SEQ_CFG_DELAY_VAL_6'/>"
WRITE #1 "        <register address='0xb2745bc' value='0x" DATA.LONG(A:0x2745bc) "' name='RPMH_PDC_DISPLAY_SEQ_CFG_DELAY_VAL_7'/>"
WRITE #1 "        <register address='0xb2745c0' value='0x" DATA.LONG(A:0x2745c0) "' name='RPMH_PDC_DISPLAY_SEQ_CFG_DELAY_VAL_8'/>"
WRITE #1 "        <register address='0xb2745c4' value='0x" DATA.LONG(A:0x2745c4) "' name='RPMH_PDC_DISPLAY_SEQ_CFG_DELAY_VAL_9'/>"
WRITE #1 "        <register address='0xb2745c8' value='0x" DATA.LONG(A:0x2745c8) "' name='RPMH_PDC_DISPLAY_SEQ_CFG_DELAY_VAL_10'/>"
WRITE #1 "        <register address='0xb2745cc' value='0x" DATA.LONG(A:0x2745cc) "' name='RPMH_PDC_DISPLAY_SEQ_CFG_DELAY_VAL_11'/>"
WRITE #1 "        <register address='0xb2745d0' value='0x" DATA.LONG(A:0x2745d0) "' name='RPMH_PDC_DISPLAY_SEQ_CFG_DELAY_VAL_12'/>"
WRITE #1 "        <register address='0xb2745d4' value='0x" DATA.LONG(A:0x2745d4) "' name='RPMH_PDC_DISPLAY_SEQ_CFG_DELAY_VAL_13'/>"
WRITE #1 "        <register address='0xb2745d8' value='0x" DATA.LONG(A:0x2745d8) "' name='RPMH_PDC_DISPLAY_SEQ_CFG_DELAY_VAL_14'/>"
WRITE #1 "        <register address='0xb2745dc' value='0x" DATA.LONG(A:0x2745dc) "' name='RPMH_PDC_DISPLAY_SEQ_CFG_DELAY_VAL_15'/>"
WRITE #1 "        <register address='0xb2745e0' value='0x" DATA.LONG(A:0x2745e0) "' name='RPMH_PDC_DISPLAY_SEQ_DBG_BREAKPOINT_ADDR'/>"
WRITE #1 "        <register address='0xb2745e4' value='0x" DATA.LONG(A:0x2745e4) "' name='RPMH_PDC_DISPLAY_SEQ_DBG_STEP'/>"
WRITE #1 "        <register address='0xb275000' value='0x" DATA.LONG(A:0x275000) "' name='RPMH_PDC_DISPLAY_PROFILING_UNIT0_EN'/>"
WRITE #1 "        <register address='0xb275014' value='0x" DATA.LONG(A:0x275014) "' name='RPMH_PDC_DISPLAY_PROFILING_UNIT1_EN'/>"
WRITE #1 "        <register address='0xb275028' value='0x" DATA.LONG(A:0x275028) "' name='RPMH_PDC_DISPLAY_PROFILING_UNIT2_EN'/>"
WRITE #1 "        <register address='0xb27503c' value='0x" DATA.LONG(A:0x27503c) "' name='RPMH_PDC_DISPLAY_PROFILING_UNIT3_EN'/>"
WRITE #1 "        <register address='0xb275050' value='0x" DATA.LONG(A:0x275050) "' name='RPMH_PDC_DISPLAY_PROFILING_UNIT4_EN'/>"
WRITE #1 "        <register address='0xb275500' value='0x" DATA.LONG(A:0x275500) "' name='RPMH_PDC_DISPLAY_TCS0_CONTROL'/>"
WRITE #1 "        <register address='0xb2755c8' value='0x" DATA.LONG(A:0x2755c8) "' name='RPMH_PDC_DISPLAY_TCS1_CONTROL'/>"
WRITE #1 "        <register address='0xb275690' value='0x" DATA.LONG(A:0x275690) "' name='RPMH_PDC_DISPLAY_TCS2_CONTROL'/>"
WRITE #1 "        <register address='0xb275504' value='0x" DATA.LONG(A:0x275504) "' name='RPMH_PDC_DISPLAY_TCS0_CMD_ENABLE_BANK'/>"
WRITE #1 "        <register address='0xb2755cc' value='0x" DATA.LONG(A:0x2755cc) "' name='RPMH_PDC_DISPLAY_TCS1_CMD_ENABLE_BANK'/>"
WRITE #1 "        <register address='0xb275694' value='0x" DATA.LONG(A:0x275694) "' name='RPMH_PDC_DISPLAY_TCS2_CMD_ENABLE_BANK'/>"
WRITE #1 "        <register address='0xb275508' value='0x" DATA.LONG(A:0x275508) "' name='RPMH_PDC_DISPLAY_TCS0_CMD_WAIT_FOR_CMPL_BANK'/>"
WRITE #1 "        <register address='0xb2755d0' value='0x" DATA.LONG(A:0x2755d0) "' name='RPMH_PDC_DISPLAY_TCS1_CMD_WAIT_FOR_CMPL_BANK'/>"
WRITE #1 "        <register address='0xb275698' value='0x" DATA.LONG(A:0x275698) "' name='RPMH_PDC_DISPLAY_TCS2_CMD_WAIT_FOR_CMPL_BANK'/>"
WRITE #1 "        <register address='0xb27550c' value='0x" DATA.LONG(A:0x27550c) "' name='RPMH_PDC_DISPLAY_TCS0_CMD0_MSGID'/>"
WRITE #1 "        <register address='0xb27551c' value='0x" DATA.LONG(A:0x27551c) "' name='RPMH_PDC_DISPLAY_TCS0_CMD1_MSGID'/>"
WRITE #1 "        <register address='0xb27552c' value='0x" DATA.LONG(A:0x27552c) "' name='RPMH_PDC_DISPLAY_TCS0_CMD2_MSGID'/>"
WRITE #1 "        <register address='0xb27553c' value='0x" DATA.LONG(A:0x27553c) "' name='RPMH_PDC_DISPLAY_TCS0_CMD3_MSGID'/>"
WRITE #1 "        <register address='0xb2755d4' value='0x" DATA.LONG(A:0x2755d4) "' name='RPMH_PDC_DISPLAY_TCS1_CMD0_MSGID'/>"
WRITE #1 "        <register address='0xb2755e4' value='0x" DATA.LONG(A:0x2755e4) "' name='RPMH_PDC_DISPLAY_TCS1_CMD1_MSGID'/>"
WRITE #1 "        <register address='0xb2755f4' value='0x" DATA.LONG(A:0x2755f4) "' name='RPMH_PDC_DISPLAY_TCS1_CMD2_MSGID'/>"
WRITE #1 "        <register address='0xb275604' value='0x" DATA.LONG(A:0x275604) "' name='RPMH_PDC_DISPLAY_TCS1_CMD3_MSGID'/>"
WRITE #1 "        <register address='0xb27569c' value='0x" DATA.LONG(A:0x27569c) "' name='RPMH_PDC_DISPLAY_TCS2_CMD0_MSGID'/>"
WRITE #1 "        <register address='0xb2756ac' value='0x" DATA.LONG(A:0x2756ac) "' name='RPMH_PDC_DISPLAY_TCS2_CMD1_MSGID'/>"
WRITE #1 "        <register address='0xb2756bc' value='0x" DATA.LONG(A:0x2756bc) "' name='RPMH_PDC_DISPLAY_TCS2_CMD2_MSGID'/>"
WRITE #1 "        <register address='0xb2756cc' value='0x" DATA.LONG(A:0x2756cc) "' name='RPMH_PDC_DISPLAY_TCS2_CMD3_MSGID'/>"
WRITE #1 "        <register address='0xb275510' value='0x" DATA.LONG(A:0x275510) "' name='RPMH_PDC_DISPLAY_TCS0_CMD0_ADDR'/>"
WRITE #1 "        <register address='0xb275520' value='0x" DATA.LONG(A:0x275520) "' name='RPMH_PDC_DISPLAY_TCS0_CMD1_ADDR'/>"
WRITE #1 "        <register address='0xb275530' value='0x" DATA.LONG(A:0x275530) "' name='RPMH_PDC_DISPLAY_TCS0_CMD2_ADDR'/>"
WRITE #1 "        <register address='0xb275540' value='0x" DATA.LONG(A:0x275540) "' name='RPMH_PDC_DISPLAY_TCS0_CMD3_ADDR'/>"
WRITE #1 "        <register address='0xb2755d8' value='0x" DATA.LONG(A:0x2755d8) "' name='RPMH_PDC_DISPLAY_TCS1_CMD0_ADDR'/>"
WRITE #1 "        <register address='0xb2755e8' value='0x" DATA.LONG(A:0x2755e8) "' name='RPMH_PDC_DISPLAY_TCS1_CMD1_ADDR'/>"
WRITE #1 "        <register address='0xb2755f8' value='0x" DATA.LONG(A:0x2755f8) "' name='RPMH_PDC_DISPLAY_TCS1_CMD2_ADDR'/>"
WRITE #1 "        <register address='0xb275608' value='0x" DATA.LONG(A:0x275608) "' name='RPMH_PDC_DISPLAY_TCS1_CMD3_ADDR'/>"
WRITE #1 "        <register address='0xb2756a0' value='0x" DATA.LONG(A:0x2756a0) "' name='RPMH_PDC_DISPLAY_TCS2_CMD0_ADDR'/>"
WRITE #1 "        <register address='0xb2756b0' value='0x" DATA.LONG(A:0x2756b0) "' name='RPMH_PDC_DISPLAY_TCS2_CMD1_ADDR'/>"
WRITE #1 "        <register address='0xb2756c0' value='0x" DATA.LONG(A:0x2756c0) "' name='RPMH_PDC_DISPLAY_TCS2_CMD2_ADDR'/>"
WRITE #1 "        <register address='0xb2756d0' value='0x" DATA.LONG(A:0x2756d0) "' name='RPMH_PDC_DISPLAY_TCS2_CMD3_ADDR'/>"
WRITE #1 "        <register address='0xb275514' value='0x" DATA.LONG(A:0x275514) "' name='RPMH_PDC_DISPLAY_TCS0_CMD0_DATA'/>"
WRITE #1 "        <register address='0xb275524' value='0x" DATA.LONG(A:0x275524) "' name='RPMH_PDC_DISPLAY_TCS0_CMD1_DATA'/>"
WRITE #1 "        <register address='0xb275534' value='0x" DATA.LONG(A:0x275534) "' name='RPMH_PDC_DISPLAY_TCS0_CMD2_DATA'/>"
WRITE #1 "        <register address='0xb275544' value='0x" DATA.LONG(A:0x275544) "' name='RPMH_PDC_DISPLAY_TCS0_CMD3_DATA'/>"
WRITE #1 "        <register address='0xb2755dc' value='0x" DATA.LONG(A:0x2755dc) "' name='RPMH_PDC_DISPLAY_TCS1_CMD0_DATA'/>"
WRITE #1 "        <register address='0xb2755ec' value='0x" DATA.LONG(A:0x2755ec) "' name='RPMH_PDC_DISPLAY_TCS1_CMD1_DATA'/>"
WRITE #1 "        <register address='0xb2755fc' value='0x" DATA.LONG(A:0x2755fc) "' name='RPMH_PDC_DISPLAY_TCS1_CMD2_DATA'/>"
WRITE #1 "        <register address='0xb27560c' value='0x" DATA.LONG(A:0x27560c) "' name='RPMH_PDC_DISPLAY_TCS1_CMD3_DATA'/>"
WRITE #1 "        <register address='0xb2756a4' value='0x" DATA.LONG(A:0x2756a4) "' name='RPMH_PDC_DISPLAY_TCS2_CMD0_DATA'/>"
WRITE #1 "        <register address='0xb2756b4' value='0x" DATA.LONG(A:0x2756b4) "' name='RPMH_PDC_DISPLAY_TCS2_CMD1_DATA'/>"
WRITE #1 "        <register address='0xb2756c4' value='0x" DATA.LONG(A:0x2756c4) "' name='RPMH_PDC_DISPLAY_TCS2_CMD2_DATA'/>"
WRITE #1 "        <register address='0xb2756d4' value='0x" DATA.LONG(A:0x2756d4) "' name='RPMH_PDC_DISPLAY_TCS2_CMD3_DATA'/>"
WRITE #1 "        <register address='0xb280000' value='0x" DATA.LONG(A:0x280000) "' name='RPMH_PDC_COMPUTE_VOTE_CMP_DATA_DRV0'/>"
WRITE #1 "        <register address='0xb280010' value='0x" DATA.LONG(A:0x280010) "' name='RPMH_PDC_COMPUTE_IRQ_ENABLE_BANK0_DRV0'/>"
WRITE #1 "        <register address='0xb280110' value='0x" DATA.LONG(A:0x280110) "' name='RPMH_PDC_COMPUTE_IRQ_0_CFG_DRV0'/>"
WRITE #1 "        <register address='0xb280114' value='0x" DATA.LONG(A:0x280114) "' name='RPMH_PDC_COMPUTE_IRQ_1_CFG_DRV0'/>"
WRITE #1 "        <register address='0xb280118' value='0x" DATA.LONG(A:0x280118) "' name='RPMH_PDC_COMPUTE_IRQ_2_CFG_DRV0'/>"
WRITE #1 "        <register address='0xb28011c' value='0x" DATA.LONG(A:0x28011c) "' name='RPMH_PDC_COMPUTE_IRQ_3_CFG_DRV0'/>"
WRITE #1 "        <register address='0xb280120' value='0x" DATA.LONG(A:0x280120) "' name='RPMH_PDC_COMPUTE_IRQ_4_CFG_DRV0'/>"
WRITE #1 "        <register address='0xb280124' value='0x" DATA.LONG(A:0x280124) "' name='RPMH_PDC_COMPUTE_IRQ_5_CFG_DRV0'/>"
WRITE #1 "        <register address='0xb280128' value='0x" DATA.LONG(A:0x280128) "' name='RPMH_PDC_COMPUTE_IRQ_6_CFG_DRV0'/>"
WRITE #1 "        <register address='0xb28012c' value='0x" DATA.LONG(A:0x28012c) "' name='RPMH_PDC_COMPUTE_IRQ_7_CFG_DRV0'/>"
WRITE #1 "        <register address='0xb280130' value='0x" DATA.LONG(A:0x280130) "' name='RPMH_PDC_COMPUTE_IRQ_8_CFG_DRV0'/>"
WRITE #1 "        <register address='0xb280134' value='0x" DATA.LONG(A:0x280134) "' name='RPMH_PDC_COMPUTE_IRQ_9_CFG_DRV0'/>"
WRITE #1 "        <register address='0xb280138' value='0x" DATA.LONG(A:0x280138) "' name='RPMH_PDC_COMPUTE_IRQ_10_CFG_DRV0'/>"
WRITE #1 "        <register address='0xb28013c' value='0x" DATA.LONG(A:0x28013c) "' name='RPMH_PDC_COMPUTE_IRQ_11_CFG_DRV0'/>"
WRITE #1 "        <register address='0xb280140' value='0x" DATA.LONG(A:0x280140) "' name='RPMH_PDC_COMPUTE_IRQ_12_CFG_DRV0'/>"
WRITE #1 "        <register address='0xb280144' value='0x" DATA.LONG(A:0x280144) "' name='RPMH_PDC_COMPUTE_IRQ_13_CFG_DRV0'/>"
WRITE #1 "        <register address='0xb280148' value='0x" DATA.LONG(A:0x280148) "' name='RPMH_PDC_COMPUTE_IRQ_14_CFG_DRV0'/>"
WRITE #1 "        <register address='0xb28014c' value='0x" DATA.LONG(A:0x28014c) "' name='RPMH_PDC_COMPUTE_IRQ_15_CFG_DRV0'/>"
WRITE #1 "        <register address='0xb280150' value='0x" DATA.LONG(A:0x280150) "' name='RPMH_PDC_COMPUTE_IRQ_16_CFG_DRV0'/>"
WRITE #1 "        <register address='0xb280154' value='0x" DATA.LONG(A:0x280154) "' name='RPMH_PDC_COMPUTE_IRQ_17_CFG_DRV0'/>"
WRITE #1 "        <register address='0xb280158' value='0x" DATA.LONG(A:0x280158) "' name='RPMH_PDC_COMPUTE_IRQ_18_CFG_DRV0'/>"
WRITE #1 "        <register address='0xb28015c' value='0x" DATA.LONG(A:0x28015c) "' name='RPMH_PDC_COMPUTE_IRQ_19_CFG_DRV0'/>"
WRITE #1 "        <register address='0xb280900' value='0x" DATA.LONG(A:0x280900) "' name='RPMH_PDC_COMPUTE_IRQ_STATUS_BANK0_DRV0'/>"
WRITE #1 "        <register address='0xb281000' value='0x" DATA.LONG(A:0x281000) "' name='RPMH_PDC_COMPUTE_PDC_VERSION_DRV0'/>"
WRITE #1 "        <register address='0xb281004' value='0x" DATA.LONG(A:0x281004) "' name='RPMH_PDC_COMPUTE_PDC_PARAM_RESOURCE_DRV0'/>"
WRITE #1 "        <register address='0xb281008' value='0x" DATA.LONG(A:0x281008) "' name='RPMH_PDC_COMPUTE_PDC_PARAM_SEQ_CONFIG_DRV0'/>"
WRITE #1 "        <register address='0xb28100c' value='0x" DATA.LONG(A:0x28100c) "' name='RPMH_PDC_COMPUTE_PDC_PARAM_IRQ_CONFIG_DRV0'/>"
WRITE #1 "        <register address='0xb281020' value='0x" DATA.LONG(A:0x281020) "' name='RPMH_PDC_COMPUTE_SEQ_BUSY_DRV0'/>"
WRITE #1 "        <register address='0xb281024' value='0x" DATA.LONG(A:0x281024) "' name='RPMH_PDC_COMPUTE_SEQ_DBG_PROGRAM_COUNTER_DRV0'/>"
WRITE #1 "        <register address='0xb281028' value='0x" DATA.LONG(A:0x281028) "' name='RPMH_PDC_COMPUTE_SEQ_DBG_STAT_DRV0'/>"
WRITE #1 "        <register address='0xb28102c' value='0x" DATA.LONG(A:0x28102c) "' name='RPMH_PDC_COMPUTE_SEQ_DBG_WAIT_EVNT_DRV0'/>"
WRITE #1 "        <register address='0xb281030' value='0x" DATA.LONG(A:0x281030) "' name='RPMH_PDC_COMPUTE_PDC_MODE_STATUS_DRV0'/>"
WRITE #1 "        <register address='0xb281034' value='0x" DATA.LONG(A:0x281034) "' name='RPMH_PDC_COMPUTE_DBG_EPCB_RX_ADDR0'/>"
WRITE #1 "        <register address='0xb281038' value='0x" DATA.LONG(A:0x281038) "' name='RPMH_PDC_COMPUTE_DBG_EPCB_RX_DATA0'/>"
WRITE #1 "        <register address='0xb281200' value='0x" DATA.LONG(A:0x281200) "' name='RPMH_PDC_COMPUTE_PROFILING_UNIT0_DRV0_OUTPUT'/>"
WRITE #1 "        <register address='0xb281214' value='0x" DATA.LONG(A:0x281214) "' name='RPMH_PDC_COMPUTE_PROFILING_UNIT1_DRV0_OUTPUT'/>"
WRITE #1 "        <register address='0xb281228' value='0x" DATA.LONG(A:0x281228) "' name='RPMH_PDC_COMPUTE_PROFILING_UNIT2_DRV0_OUTPUT'/>"
WRITE #1 "        <register address='0xb28123c' value='0x" DATA.LONG(A:0x28123c) "' name='RPMH_PDC_COMPUTE_PROFILING_UNIT3_DRV0_OUTPUT'/>"
WRITE #1 "        <register address='0xb281250' value='0x" DATA.LONG(A:0x281250) "' name='RPMH_PDC_COMPUTE_PROFILING_UNIT4_DRV0_OUTPUT'/>"
WRITE #1 "        <register address='0xb281204' value='0x" DATA.LONG(A:0x281204) "' name='RPMH_PDC_COMPUTE_PROFILING_UNIT0_DRV0_TIMESTAMP_LO'/>"
WRITE #1 "        <register address='0xb281218' value='0x" DATA.LONG(A:0x281218) "' name='RPMH_PDC_COMPUTE_PROFILING_UNIT1_DRV0_TIMESTAMP_LO'/>"
WRITE #1 "        <register address='0xb28122c' value='0x" DATA.LONG(A:0x28122c) "' name='RPMH_PDC_COMPUTE_PROFILING_UNIT2_DRV0_TIMESTAMP_LO'/>"
WRITE #1 "        <register address='0xb281240' value='0x" DATA.LONG(A:0x281240) "' name='RPMH_PDC_COMPUTE_PROFILING_UNIT3_DRV0_TIMESTAMP_LO'/>"
WRITE #1 "        <register address='0xb281254' value='0x" DATA.LONG(A:0x281254) "' name='RPMH_PDC_COMPUTE_PROFILING_UNIT4_DRV0_TIMESTAMP_LO'/>"
WRITE #1 "        <register address='0xb281208' value='0x" DATA.LONG(A:0x281208) "' name='RPMH_PDC_COMPUTE_PROFILING_UNIT0_DRV0_TIMESTAMP_HI'/>"
WRITE #1 "        <register address='0xb28121c' value='0x" DATA.LONG(A:0x28121c) "' name='RPMH_PDC_COMPUTE_PROFILING_UNIT1_DRV0_TIMESTAMP_HI'/>"
WRITE #1 "        <register address='0xb281230' value='0x" DATA.LONG(A:0x281230) "' name='RPMH_PDC_COMPUTE_PROFILING_UNIT2_DRV0_TIMESTAMP_HI'/>"
WRITE #1 "        <register address='0xb281244' value='0x" DATA.LONG(A:0x281244) "' name='RPMH_PDC_COMPUTE_PROFILING_UNIT3_DRV0_TIMESTAMP_HI'/>"
WRITE #1 "        <register address='0xb281258' value='0x" DATA.LONG(A:0x281258) "' name='RPMH_PDC_COMPUTE_PROFILING_UNIT4_DRV0_TIMESTAMP_HI'/>"
WRITE #1 "        <register address='0xb281300' value='0x" DATA.LONG(A:0x281300) "' name='RPMH_PDC_COMPUTE_TCS0_DRV0_STATUS'/>"
WRITE #1 "        <register address='0xb2813c8' value='0x" DATA.LONG(A:0x2813c8) "' name='RPMH_PDC_COMPUTE_TCS1_DRV0_STATUS'/>"
WRITE #1 "        <register address='0xb281490' value='0x" DATA.LONG(A:0x281490) "' name='RPMH_PDC_COMPUTE_TCS2_DRV0_STATUS'/>"
WRITE #1 "        <register address='0xb281304' value='0x" DATA.LONG(A:0x281304) "' name='RPMH_PDC_COMPUTE_TCS0_CMD0_DRV0_STATUS'/>"
WRITE #1 "        <register address='0xb28130c' value='0x" DATA.LONG(A:0x28130c) "' name='RPMH_PDC_COMPUTE_TCS0_CMD1_DRV0_STATUS'/>"
WRITE #1 "        <register address='0xb281314' value='0x" DATA.LONG(A:0x281314) "' name='RPMH_PDC_COMPUTE_TCS0_CMD2_DRV0_STATUS'/>"
WRITE #1 "        <register address='0xb28131c' value='0x" DATA.LONG(A:0x28131c) "' name='RPMH_PDC_COMPUTE_TCS0_CMD3_DRV0_STATUS'/>"
WRITE #1 "        <register address='0xb2813cc' value='0x" DATA.LONG(A:0x2813cc) "' name='RPMH_PDC_COMPUTE_TCS1_CMD0_DRV0_STATUS'/>"
WRITE #1 "        <register address='0xb2813d4' value='0x" DATA.LONG(A:0x2813d4) "' name='RPMH_PDC_COMPUTE_TCS1_CMD1_DRV0_STATUS'/>"
WRITE #1 "        <register address='0xb2813dc' value='0x" DATA.LONG(A:0x2813dc) "' name='RPMH_PDC_COMPUTE_TCS1_CMD2_DRV0_STATUS'/>"
WRITE #1 "        <register address='0xb2813e4' value='0x" DATA.LONG(A:0x2813e4) "' name='RPMH_PDC_COMPUTE_TCS1_CMD3_DRV0_STATUS'/>"
WRITE #1 "        <register address='0xb281494' value='0x" DATA.LONG(A:0x281494) "' name='RPMH_PDC_COMPUTE_TCS2_CMD0_DRV0_STATUS'/>"
WRITE #1 "        <register address='0xb28149c' value='0x" DATA.LONG(A:0x28149c) "' name='RPMH_PDC_COMPUTE_TCS2_CMD1_DRV0_STATUS'/>"
WRITE #1 "        <register address='0xb2814a4' value='0x" DATA.LONG(A:0x2814a4) "' name='RPMH_PDC_COMPUTE_TCS2_CMD2_DRV0_STATUS'/>"
WRITE #1 "        <register address='0xb2814ac' value='0x" DATA.LONG(A:0x2814ac) "' name='RPMH_PDC_COMPUTE_TCS2_CMD3_DRV0_STATUS'/>"
WRITE #1 "        <register address='0xb284500' value='0x" DATA.LONG(A:0x284500) "' name='RPMH_PDC_COMPUTE_ENABLE_PDC'/>"
WRITE #1 "        <register address='0xb284510' value='0x" DATA.LONG(A:0x284510) "' name='RPMH_PDC_COMPUTE_TIMER_MATCH_VALUE_LO'/>"
WRITE #1 "        <register address='0xb284514' value='0x" DATA.LONG(A:0x284514) "' name='RPMH_PDC_COMPUTE_TIMER_MATCH_VALUE_HI'/>"
WRITE #1 "        <register address='0xb284518' value='0x" DATA.LONG(A:0x284518) "' name='RPMH_PDC_COMPUTE_TIMER_DISABLED_FOR_ARC'/>"
WRITE #1 "        <register address='0xb284520' value='0x" DATA.LONG(A:0x284520) "' name='RPMH_PDC_COMPUTE_SEQ_START_ADDR'/>"
WRITE #1 "        <register address='0xb284524' value='0x" DATA.LONG(A:0x284524) "' name='RPMH_PDC_COMPUTE_SEQ_OVERRIDE_START_ADDR'/>"
WRITE #1 "        <register address='0xb28452c' value='0x" DATA.LONG(A:0x28452c) "' name='RPMH_PDC_COMPUTE_SEQ_OVERRIDE_TRIGGER'/>"
WRITE #1 "        <register address='0xb284530' value='0x" DATA.LONG(A:0x284530) "' name='RPMH_PDC_COMPUTE_SEQ_PWR_CTRL_OVERRIDE_MASK'/>"
WRITE #1 "        <register address='0xb284534' value='0x" DATA.LONG(A:0x284534) "' name='RPMH_PDC_COMPUTE_SEQ_PWR_CTRL_OVERRIDE_VAL'/>"
WRITE #1 "        <register address='0xb284540' value='0x" DATA.LONG(A:0x284540) "' name='RPMH_PDC_COMPUTE_SEQ_WAIT_EVENT_OVERRIDE_MASK'/>"
WRITE #1 "        <register address='0xb284544' value='0x" DATA.LONG(A:0x284544) "' name='RPMH_PDC_COMPUTE_SEQ_WAIT_EVENT_OVERRIDE_VAL'/>"
WRITE #1 "        <register address='0xb284550' value='0x" DATA.LONG(A:0x284550) "' name='RPMH_PDC_COMPUTE_SEQ_BR_EVENT_OVERRIDE_MASK'/>"
WRITE #1 "        <register address='0xb284554' value='0x" DATA.LONG(A:0x284554) "' name='RPMH_PDC_COMPUTE_SEQ_BR_EVENT_OVERRIDE_VAL'/>"
WRITE #1 "        <register address='0xb284590' value='0x" DATA.LONG(A:0x284590) "' name='RPMH_PDC_COMPUTE_SEQ_CFG_BR_ADDR_0'/>"
WRITE #1 "        <register address='0xb284594' value='0x" DATA.LONG(A:0x284594) "' name='RPMH_PDC_COMPUTE_SEQ_CFG_BR_ADDR_1'/>"
WRITE #1 "        <register address='0xb284598' value='0x" DATA.LONG(A:0x284598) "' name='RPMH_PDC_COMPUTE_SEQ_CFG_BR_ADDR_2'/>"
WRITE #1 "        <register address='0xb28459c' value='0x" DATA.LONG(A:0x28459c) "' name='RPMH_PDC_COMPUTE_SEQ_CFG_BR_ADDR_3'/>"
WRITE #1 "        <register address='0xb2845a0' value='0x" DATA.LONG(A:0x2845a0) "' name='RPMH_PDC_COMPUTE_SEQ_CFG_DELAY_VAL_0'/>"
WRITE #1 "        <register address='0xb2845a4' value='0x" DATA.LONG(A:0x2845a4) "' name='RPMH_PDC_COMPUTE_SEQ_CFG_DELAY_VAL_1'/>"
WRITE #1 "        <register address='0xb2845a8' value='0x" DATA.LONG(A:0x2845a8) "' name='RPMH_PDC_COMPUTE_SEQ_CFG_DELAY_VAL_2'/>"
WRITE #1 "        <register address='0xb2845ac' value='0x" DATA.LONG(A:0x2845ac) "' name='RPMH_PDC_COMPUTE_SEQ_CFG_DELAY_VAL_3'/>"
WRITE #1 "        <register address='0xb2845b0' value='0x" DATA.LONG(A:0x2845b0) "' name='RPMH_PDC_COMPUTE_SEQ_CFG_DELAY_VAL_4'/>"
WRITE #1 "        <register address='0xb2845b4' value='0x" DATA.LONG(A:0x2845b4) "' name='RPMH_PDC_COMPUTE_SEQ_CFG_DELAY_VAL_5'/>"
WRITE #1 "        <register address='0xb2845b8' value='0x" DATA.LONG(A:0x2845b8) "' name='RPMH_PDC_COMPUTE_SEQ_CFG_DELAY_VAL_6'/>"
WRITE #1 "        <register address='0xb2845bc' value='0x" DATA.LONG(A:0x2845bc) "' name='RPMH_PDC_COMPUTE_SEQ_CFG_DELAY_VAL_7'/>"
WRITE #1 "        <register address='0xb2845c0' value='0x" DATA.LONG(A:0x2845c0) "' name='RPMH_PDC_COMPUTE_SEQ_CFG_DELAY_VAL_8'/>"
WRITE #1 "        <register address='0xb2845c4' value='0x" DATA.LONG(A:0x2845c4) "' name='RPMH_PDC_COMPUTE_SEQ_CFG_DELAY_VAL_9'/>"
WRITE #1 "        <register address='0xb2845c8' value='0x" DATA.LONG(A:0x2845c8) "' name='RPMH_PDC_COMPUTE_SEQ_CFG_DELAY_VAL_10'/>"
WRITE #1 "        <register address='0xb2845cc' value='0x" DATA.LONG(A:0x2845cc) "' name='RPMH_PDC_COMPUTE_SEQ_CFG_DELAY_VAL_11'/>"
WRITE #1 "        <register address='0xb2845d0' value='0x" DATA.LONG(A:0x2845d0) "' name='RPMH_PDC_COMPUTE_SEQ_CFG_DELAY_VAL_12'/>"
WRITE #1 "        <register address='0xb2845d4' value='0x" DATA.LONG(A:0x2845d4) "' name='RPMH_PDC_COMPUTE_SEQ_CFG_DELAY_VAL_13'/>"
WRITE #1 "        <register address='0xb2845d8' value='0x" DATA.LONG(A:0x2845d8) "' name='RPMH_PDC_COMPUTE_SEQ_CFG_DELAY_VAL_14'/>"
WRITE #1 "        <register address='0xb2845dc' value='0x" DATA.LONG(A:0x2845dc) "' name='RPMH_PDC_COMPUTE_SEQ_CFG_DELAY_VAL_15'/>"
WRITE #1 "        <register address='0xb2845e0' value='0x" DATA.LONG(A:0x2845e0) "' name='RPMH_PDC_COMPUTE_SEQ_DBG_BREAKPOINT_ADDR'/>"
WRITE #1 "        <register address='0xb2845e4' value='0x" DATA.LONG(A:0x2845e4) "' name='RPMH_PDC_COMPUTE_SEQ_DBG_STEP'/>"
WRITE #1 "        <register address='0xb284900' value='0x" DATA.LONG(A:0x284900) "' name='RPMH_PDC_COMPUTE_GP_IRQ_SELECT0'/>"
WRITE #1 "        <register address='0xb284914' value='0x" DATA.LONG(A:0x284914) "' name='RPMH_PDC_COMPUTE_GP_IRQ_SELECT1'/>"
WRITE #1 "        <register address='0xb284928' value='0x" DATA.LONG(A:0x284928) "' name='RPMH_PDC_COMPUTE_GP_IRQ_SELECT2'/>"
WRITE #1 "        <register address='0xb28493c' value='0x" DATA.LONG(A:0x28493c) "' name='RPMH_PDC_COMPUTE_GP_IRQ_SELECT3'/>"
WRITE #1 "        <register address='0xb284950' value='0x" DATA.LONG(A:0x284950) "' name='RPMH_PDC_COMPUTE_GP_IRQ_SELECT4'/>"
WRITE #1 "        <register address='0xb284964' value='0x" DATA.LONG(A:0x284964) "' name='RPMH_PDC_COMPUTE_GP_IRQ_SELECT5'/>"
WRITE #1 "        <register address='0xb284978' value='0x" DATA.LONG(A:0x284978) "' name='RPMH_PDC_COMPUTE_GP_IRQ_SELECT6'/>"
WRITE #1 "        <register address='0xb28498c' value='0x" DATA.LONG(A:0x28498c) "' name='RPMH_PDC_COMPUTE_GP_IRQ_SELECT7'/>"
WRITE #1 "        <register address='0xb2849a0' value='0x" DATA.LONG(A:0x2849a0) "' name='RPMH_PDC_COMPUTE_GP_IRQ_SELECT8'/>"
WRITE #1 "        <register address='0xb2849b4' value='0x" DATA.LONG(A:0x2849b4) "' name='RPMH_PDC_COMPUTE_GP_IRQ_SELECT9'/>"
WRITE #1 "        <register address='0xb285000' value='0x" DATA.LONG(A:0x285000) "' name='RPMH_PDC_COMPUTE_PROFILING_UNIT0_EN'/>"
WRITE #1 "        <register address='0xb285014' value='0x" DATA.LONG(A:0x285014) "' name='RPMH_PDC_COMPUTE_PROFILING_UNIT1_EN'/>"
WRITE #1 "        <register address='0xb285028' value='0x" DATA.LONG(A:0x285028) "' name='RPMH_PDC_COMPUTE_PROFILING_UNIT2_EN'/>"
WRITE #1 "        <register address='0xb28503c' value='0x" DATA.LONG(A:0x28503c) "' name='RPMH_PDC_COMPUTE_PROFILING_UNIT3_EN'/>"
WRITE #1 "        <register address='0xb285050' value='0x" DATA.LONG(A:0x285050) "' name='RPMH_PDC_COMPUTE_PROFILING_UNIT4_EN'/>"
WRITE #1 "        <register address='0xb285500' value='0x" DATA.LONG(A:0x285500) "' name='RPMH_PDC_COMPUTE_TCS0_CONTROL'/>"
WRITE #1 "        <register address='0xb2855c8' value='0x" DATA.LONG(A:0x2855c8) "' name='RPMH_PDC_COMPUTE_TCS1_CONTROL'/>"
WRITE #1 "        <register address='0xb285690' value='0x" DATA.LONG(A:0x285690) "' name='RPMH_PDC_COMPUTE_TCS2_CONTROL'/>"
WRITE #1 "        <register address='0xb285504' value='0x" DATA.LONG(A:0x285504) "' name='RPMH_PDC_COMPUTE_TCS0_CMD_ENABLE_BANK'/>"
WRITE #1 "        <register address='0xb2855cc' value='0x" DATA.LONG(A:0x2855cc) "' name='RPMH_PDC_COMPUTE_TCS1_CMD_ENABLE_BANK'/>"
WRITE #1 "        <register address='0xb285694' value='0x" DATA.LONG(A:0x285694) "' name='RPMH_PDC_COMPUTE_TCS2_CMD_ENABLE_BANK'/>"
WRITE #1 "        <register address='0xb285508' value='0x" DATA.LONG(A:0x285508) "' name='RPMH_PDC_COMPUTE_TCS0_CMD_WAIT_FOR_CMPL_BANK'/>"
WRITE #1 "        <register address='0xb2855d0' value='0x" DATA.LONG(A:0x2855d0) "' name='RPMH_PDC_COMPUTE_TCS1_CMD_WAIT_FOR_CMPL_BANK'/>"
WRITE #1 "        <register address='0xb285698' value='0x" DATA.LONG(A:0x285698) "' name='RPMH_PDC_COMPUTE_TCS2_CMD_WAIT_FOR_CMPL_BANK'/>"
WRITE #1 "        <register address='0xb28550c' value='0x" DATA.LONG(A:0x28550c) "' name='RPMH_PDC_COMPUTE_TCS0_CMD0_MSGID'/>"
WRITE #1 "        <register address='0xb28551c' value='0x" DATA.LONG(A:0x28551c) "' name='RPMH_PDC_COMPUTE_TCS0_CMD1_MSGID'/>"
WRITE #1 "        <register address='0xb28552c' value='0x" DATA.LONG(A:0x28552c) "' name='RPMH_PDC_COMPUTE_TCS0_CMD2_MSGID'/>"
WRITE #1 "        <register address='0xb28553c' value='0x" DATA.LONG(A:0x28553c) "' name='RPMH_PDC_COMPUTE_TCS0_CMD3_MSGID'/>"
WRITE #1 "        <register address='0xb2855d4' value='0x" DATA.LONG(A:0x2855d4) "' name='RPMH_PDC_COMPUTE_TCS1_CMD0_MSGID'/>"
WRITE #1 "        <register address='0xb2855e4' value='0x" DATA.LONG(A:0x2855e4) "' name='RPMH_PDC_COMPUTE_TCS1_CMD1_MSGID'/>"
WRITE #1 "        <register address='0xb2855f4' value='0x" DATA.LONG(A:0x2855f4) "' name='RPMH_PDC_COMPUTE_TCS1_CMD2_MSGID'/>"
WRITE #1 "        <register address='0xb285604' value='0x" DATA.LONG(A:0x285604) "' name='RPMH_PDC_COMPUTE_TCS1_CMD3_MSGID'/>"
WRITE #1 "        <register address='0xb28569c' value='0x" DATA.LONG(A:0x28569c) "' name='RPMH_PDC_COMPUTE_TCS2_CMD0_MSGID'/>"
WRITE #1 "        <register address='0xb2856ac' value='0x" DATA.LONG(A:0x2856ac) "' name='RPMH_PDC_COMPUTE_TCS2_CMD1_MSGID'/>"
WRITE #1 "        <register address='0xb2856bc' value='0x" DATA.LONG(A:0x2856bc) "' name='RPMH_PDC_COMPUTE_TCS2_CMD2_MSGID'/>"
WRITE #1 "        <register address='0xb2856cc' value='0x" DATA.LONG(A:0x2856cc) "' name='RPMH_PDC_COMPUTE_TCS2_CMD3_MSGID'/>"
WRITE #1 "        <register address='0xb285510' value='0x" DATA.LONG(A:0x285510) "' name='RPMH_PDC_COMPUTE_TCS0_CMD0_ADDR'/>"
WRITE #1 "        <register address='0xb285520' value='0x" DATA.LONG(A:0x285520) "' name='RPMH_PDC_COMPUTE_TCS0_CMD1_ADDR'/>"
WRITE #1 "        <register address='0xb285530' value='0x" DATA.LONG(A:0x285530) "' name='RPMH_PDC_COMPUTE_TCS0_CMD2_ADDR'/>"
WRITE #1 "        <register address='0xb285540' value='0x" DATA.LONG(A:0x285540) "' name='RPMH_PDC_COMPUTE_TCS0_CMD3_ADDR'/>"
WRITE #1 "        <register address='0xb2855d8' value='0x" DATA.LONG(A:0x2855d8) "' name='RPMH_PDC_COMPUTE_TCS1_CMD0_ADDR'/>"
WRITE #1 "        <register address='0xb2855e8' value='0x" DATA.LONG(A:0x2855e8) "' name='RPMH_PDC_COMPUTE_TCS1_CMD1_ADDR'/>"
WRITE #1 "        <register address='0xb2855f8' value='0x" DATA.LONG(A:0x2855f8) "' name='RPMH_PDC_COMPUTE_TCS1_CMD2_ADDR'/>"
WRITE #1 "        <register address='0xb285608' value='0x" DATA.LONG(A:0x285608) "' name='RPMH_PDC_COMPUTE_TCS1_CMD3_ADDR'/>"
WRITE #1 "        <register address='0xb2856a0' value='0x" DATA.LONG(A:0x2856a0) "' name='RPMH_PDC_COMPUTE_TCS2_CMD0_ADDR'/>"
WRITE #1 "        <register address='0xb2856b0' value='0x" DATA.LONG(A:0x2856b0) "' name='RPMH_PDC_COMPUTE_TCS2_CMD1_ADDR'/>"
WRITE #1 "        <register address='0xb2856c0' value='0x" DATA.LONG(A:0x2856c0) "' name='RPMH_PDC_COMPUTE_TCS2_CMD2_ADDR'/>"
WRITE #1 "        <register address='0xb2856d0' value='0x" DATA.LONG(A:0x2856d0) "' name='RPMH_PDC_COMPUTE_TCS2_CMD3_ADDR'/>"
WRITE #1 "        <register address='0xb285514' value='0x" DATA.LONG(A:0x285514) "' name='RPMH_PDC_COMPUTE_TCS0_CMD0_DATA'/>"
WRITE #1 "        <register address='0xb285524' value='0x" DATA.LONG(A:0x285524) "' name='RPMH_PDC_COMPUTE_TCS0_CMD1_DATA'/>"
WRITE #1 "        <register address='0xb285534' value='0x" DATA.LONG(A:0x285534) "' name='RPMH_PDC_COMPUTE_TCS0_CMD2_DATA'/>"
WRITE #1 "        <register address='0xb285544' value='0x" DATA.LONG(A:0x285544) "' name='RPMH_PDC_COMPUTE_TCS0_CMD3_DATA'/>"
WRITE #1 "        <register address='0xb2855dc' value='0x" DATA.LONG(A:0x2855dc) "' name='RPMH_PDC_COMPUTE_TCS1_CMD0_DATA'/>"
WRITE #1 "        <register address='0xb2855ec' value='0x" DATA.LONG(A:0x2855ec) "' name='RPMH_PDC_COMPUTE_TCS1_CMD1_DATA'/>"
WRITE #1 "        <register address='0xb2855fc' value='0x" DATA.LONG(A:0x2855fc) "' name='RPMH_PDC_COMPUTE_TCS1_CMD2_DATA'/>"
WRITE #1 "        <register address='0xb28560c' value='0x" DATA.LONG(A:0x28560c) "' name='RPMH_PDC_COMPUTE_TCS1_CMD3_DATA'/>"
WRITE #1 "        <register address='0xb2856a4' value='0x" DATA.LONG(A:0x2856a4) "' name='RPMH_PDC_COMPUTE_TCS2_CMD0_DATA'/>"
WRITE #1 "        <register address='0xb2856b4' value='0x" DATA.LONG(A:0x2856b4) "' name='RPMH_PDC_COMPUTE_TCS2_CMD1_DATA'/>"
WRITE #1 "        <register address='0xb2856c4' value='0x" DATA.LONG(A:0x2856c4) "' name='RPMH_PDC_COMPUTE_TCS2_CMD2_DATA'/>"
WRITE #1 "        <register address='0xb2856d4' value='0x" DATA.LONG(A:0x2856d4) "' name='RPMH_PDC_COMPUTE_TCS2_CMD3_DATA'/>"
WRITE #1 "        <register address='0xb290000' value='0x" DATA.LONG(A:0x290000) "' name='RPMH_PDC_MODEM_VOTE_CMP_DATA_DRV0'/>"
WRITE #1 "        <register address='0xb2a0000' value='0x" DATA.LONG(A:0x2a0000) "' name='RPMH_PDC_MODEM_VOTE_CMP_DATA_DRV1'/>"
WRITE #1 "        <register address='0xb290010' value='0x" DATA.LONG(A:0x290010) "' name='RPMH_PDC_MODEM_IRQ_ENABLE_BANK0_DRV0'/>"
WRITE #1 "        <register address='0xb290014' value='0x" DATA.LONG(A:0x290014) "' name='RPMH_PDC_MODEM_IRQ_ENABLE_BANK1_DRV0'/>"
WRITE #1 "        <register address='0xb2a0010' value='0x" DATA.LONG(A:0x2a0010) "' name='RPMH_PDC_MODEM_IRQ_ENABLE_BANK0_DRV1'/>"
WRITE #1 "        <register address='0xb2a0014' value='0x" DATA.LONG(A:0x2a0014) "' name='RPMH_PDC_MODEM_IRQ_ENABLE_BANK1_DRV1'/>"
WRITE #1 "        <register address='0xb290110' value='0x" DATA.LONG(A:0x290110) "' name='RPMH_PDC_MODEM_IRQ_0_CFG_DRV0'/>"
WRITE #1 "        <register address='0xb290114' value='0x" DATA.LONG(A:0x290114) "' name='RPMH_PDC_MODEM_IRQ_1_CFG_DRV0'/>"
WRITE #1 "        <register address='0xb290118' value='0x" DATA.LONG(A:0x290118) "' name='RPMH_PDC_MODEM_IRQ_2_CFG_DRV0'/>"
WRITE #1 "        <register address='0xb29011c' value='0x" DATA.LONG(A:0x29011c) "' name='RPMH_PDC_MODEM_IRQ_3_CFG_DRV0'/>"
WRITE #1 "        <register address='0xb290120' value='0x" DATA.LONG(A:0x290120) "' name='RPMH_PDC_MODEM_IRQ_4_CFG_DRV0'/>"
WRITE #1 "        <register address='0xb290124' value='0x" DATA.LONG(A:0x290124) "' name='RPMH_PDC_MODEM_IRQ_5_CFG_DRV0'/>"
WRITE #1 "        <register address='0xb290128' value='0x" DATA.LONG(A:0x290128) "' name='RPMH_PDC_MODEM_IRQ_6_CFG_DRV0'/>"
WRITE #1 "        <register address='0xb29012c' value='0x" DATA.LONG(A:0x29012c) "' name='RPMH_PDC_MODEM_IRQ_7_CFG_DRV0'/>"
WRITE #1 "        <register address='0xb290130' value='0x" DATA.LONG(A:0x290130) "' name='RPMH_PDC_MODEM_IRQ_8_CFG_DRV0'/>"
WRITE #1 "        <register address='0xb290134' value='0x" DATA.LONG(A:0x290134) "' name='RPMH_PDC_MODEM_IRQ_9_CFG_DRV0'/>"
WRITE #1 "        <register address='0xb290138' value='0x" DATA.LONG(A:0x290138) "' name='RPMH_PDC_MODEM_IRQ_10_CFG_DRV0'/>"
WRITE #1 "        <register address='0xb29013c' value='0x" DATA.LONG(A:0x29013c) "' name='RPMH_PDC_MODEM_IRQ_11_CFG_DRV0'/>"
WRITE #1 "        <register address='0xb290140' value='0x" DATA.LONG(A:0x290140) "' name='RPMH_PDC_MODEM_IRQ_12_CFG_DRV0'/>"
WRITE #1 "        <register address='0xb290144' value='0x" DATA.LONG(A:0x290144) "' name='RPMH_PDC_MODEM_IRQ_13_CFG_DRV0'/>"
WRITE #1 "        <register address='0xb290148' value='0x" DATA.LONG(A:0x290148) "' name='RPMH_PDC_MODEM_IRQ_14_CFG_DRV0'/>"
WRITE #1 "        <register address='0xb29014c' value='0x" DATA.LONG(A:0x29014c) "' name='RPMH_PDC_MODEM_IRQ_15_CFG_DRV0'/>"
WRITE #1 "        <register address='0xb290150' value='0x" DATA.LONG(A:0x290150) "' name='RPMH_PDC_MODEM_IRQ_16_CFG_DRV0'/>"
WRITE #1 "        <register address='0xb290154' value='0x" DATA.LONG(A:0x290154) "' name='RPMH_PDC_MODEM_IRQ_17_CFG_DRV0'/>"
WRITE #1 "        <register address='0xb290158' value='0x" DATA.LONG(A:0x290158) "' name='RPMH_PDC_MODEM_IRQ_18_CFG_DRV0'/>"
WRITE #1 "        <register address='0xb29015c' value='0x" DATA.LONG(A:0x29015c) "' name='RPMH_PDC_MODEM_IRQ_19_CFG_DRV0'/>"
WRITE #1 "        <register address='0xb290160' value='0x" DATA.LONG(A:0x290160) "' name='RPMH_PDC_MODEM_IRQ_20_CFG_DRV0'/>"
WRITE #1 "        <register address='0xb290164' value='0x" DATA.LONG(A:0x290164) "' name='RPMH_PDC_MODEM_IRQ_21_CFG_DRV0'/>"
WRITE #1 "        <register address='0xb290168' value='0x" DATA.LONG(A:0x290168) "' name='RPMH_PDC_MODEM_IRQ_22_CFG_DRV0'/>"
WRITE #1 "        <register address='0xb29016c' value='0x" DATA.LONG(A:0x29016c) "' name='RPMH_PDC_MODEM_IRQ_23_CFG_DRV0'/>"
WRITE #1 "        <register address='0xb290170' value='0x" DATA.LONG(A:0x290170) "' name='RPMH_PDC_MODEM_IRQ_24_CFG_DRV0'/>"
WRITE #1 "        <register address='0xb290174' value='0x" DATA.LONG(A:0x290174) "' name='RPMH_PDC_MODEM_IRQ_25_CFG_DRV0'/>"
WRITE #1 "        <register address='0xb290178' value='0x" DATA.LONG(A:0x290178) "' name='RPMH_PDC_MODEM_IRQ_26_CFG_DRV0'/>"
WRITE #1 "        <register address='0xb29017c' value='0x" DATA.LONG(A:0x29017c) "' name='RPMH_PDC_MODEM_IRQ_27_CFG_DRV0'/>"
WRITE #1 "        <register address='0xb290180' value='0x" DATA.LONG(A:0x290180) "' name='RPMH_PDC_MODEM_IRQ_28_CFG_DRV0'/>"
WRITE #1 "        <register address='0xb290184' value='0x" DATA.LONG(A:0x290184) "' name='RPMH_PDC_MODEM_IRQ_29_CFG_DRV0'/>"
WRITE #1 "        <register address='0xb290188' value='0x" DATA.LONG(A:0x290188) "' name='RPMH_PDC_MODEM_IRQ_30_CFG_DRV0'/>"
WRITE #1 "        <register address='0xb29018c' value='0x" DATA.LONG(A:0x29018c) "' name='RPMH_PDC_MODEM_IRQ_31_CFG_DRV0'/>"
WRITE #1 "        <register address='0xb290190' value='0x" DATA.LONG(A:0x290190) "' name='RPMH_PDC_MODEM_IRQ_32_CFG_DRV0'/>"
WRITE #1 "        <register address='0xb290194' value='0x" DATA.LONG(A:0x290194) "' name='RPMH_PDC_MODEM_IRQ_33_CFG_DRV0'/>"
WRITE #1 "        <register address='0xb290198' value='0x" DATA.LONG(A:0x290198) "' name='RPMH_PDC_MODEM_IRQ_34_CFG_DRV0'/>"
WRITE #1 "        <register address='0xb29019c' value='0x" DATA.LONG(A:0x29019c) "' name='RPMH_PDC_MODEM_IRQ_35_CFG_DRV0'/>"
WRITE #1 "        <register address='0xb2901a0' value='0x" DATA.LONG(A:0x2901a0) "' name='RPMH_PDC_MODEM_IRQ_36_CFG_DRV0'/>"
WRITE #1 "        <register address='0xb2901a4' value='0x" DATA.LONG(A:0x2901a4) "' name='RPMH_PDC_MODEM_IRQ_37_CFG_DRV0'/>"
WRITE #1 "        <register address='0xb2901a8' value='0x" DATA.LONG(A:0x2901a8) "' name='RPMH_PDC_MODEM_IRQ_38_CFG_DRV0'/>"
WRITE #1 "        <register address='0xb2901ac' value='0x" DATA.LONG(A:0x2901ac) "' name='RPMH_PDC_MODEM_IRQ_39_CFG_DRV0'/>"
WRITE #1 "        <register address='0xb2901b0' value='0x" DATA.LONG(A:0x2901b0) "' name='RPMH_PDC_MODEM_IRQ_40_CFG_DRV0'/>"
WRITE #1 "        <register address='0xb2901b4' value='0x" DATA.LONG(A:0x2901b4) "' name='RPMH_PDC_MODEM_IRQ_41_CFG_DRV0'/>"
WRITE #1 "        <register address='0xb2901b8' value='0x" DATA.LONG(A:0x2901b8) "' name='RPMH_PDC_MODEM_IRQ_42_CFG_DRV0'/>"
WRITE #1 "        <register address='0xb2901bc' value='0x" DATA.LONG(A:0x2901bc) "' name='RPMH_PDC_MODEM_IRQ_43_CFG_DRV0'/>"
WRITE #1 "        <register address='0xb2901c0' value='0x" DATA.LONG(A:0x2901c0) "' name='RPMH_PDC_MODEM_IRQ_44_CFG_DRV0'/>"
WRITE #1 "        <register address='0xb2a0110' value='0x" DATA.LONG(A:0x2a0110) "' name='RPMH_PDC_MODEM_IRQ_0_CFG_DRV1'/>"
WRITE #1 "        <register address='0xb2a0114' value='0x" DATA.LONG(A:0x2a0114) "' name='RPMH_PDC_MODEM_IRQ_1_CFG_DRV1'/>"
WRITE #1 "        <register address='0xb2a0118' value='0x" DATA.LONG(A:0x2a0118) "' name='RPMH_PDC_MODEM_IRQ_2_CFG_DRV1'/>"
WRITE #1 "        <register address='0xb2a011c' value='0x" DATA.LONG(A:0x2a011c) "' name='RPMH_PDC_MODEM_IRQ_3_CFG_DRV1'/>"
WRITE #1 "        <register address='0xb2a0120' value='0x" DATA.LONG(A:0x2a0120) "' name='RPMH_PDC_MODEM_IRQ_4_CFG_DRV1'/>"
WRITE #1 "        <register address='0xb2a0124' value='0x" DATA.LONG(A:0x2a0124) "' name='RPMH_PDC_MODEM_IRQ_5_CFG_DRV1'/>"
WRITE #1 "        <register address='0xb2a0128' value='0x" DATA.LONG(A:0x2a0128) "' name='RPMH_PDC_MODEM_IRQ_6_CFG_DRV1'/>"
WRITE #1 "        <register address='0xb2a012c' value='0x" DATA.LONG(A:0x2a012c) "' name='RPMH_PDC_MODEM_IRQ_7_CFG_DRV1'/>"
WRITE #1 "        <register address='0xb2a0130' value='0x" DATA.LONG(A:0x2a0130) "' name='RPMH_PDC_MODEM_IRQ_8_CFG_DRV1'/>"
WRITE #1 "        <register address='0xb2a0134' value='0x" DATA.LONG(A:0x2a0134) "' name='RPMH_PDC_MODEM_IRQ_9_CFG_DRV1'/>"
WRITE #1 "        <register address='0xb2a0138' value='0x" DATA.LONG(A:0x2a0138) "' name='RPMH_PDC_MODEM_IRQ_10_CFG_DRV1'/>"
WRITE #1 "        <register address='0xb2a013c' value='0x" DATA.LONG(A:0x2a013c) "' name='RPMH_PDC_MODEM_IRQ_11_CFG_DRV1'/>"
WRITE #1 "        <register address='0xb2a0140' value='0x" DATA.LONG(A:0x2a0140) "' name='RPMH_PDC_MODEM_IRQ_12_CFG_DRV1'/>"
WRITE #1 "        <register address='0xb2a0144' value='0x" DATA.LONG(A:0x2a0144) "' name='RPMH_PDC_MODEM_IRQ_13_CFG_DRV1'/>"
WRITE #1 "        <register address='0xb2a0148' value='0x" DATA.LONG(A:0x2a0148) "' name='RPMH_PDC_MODEM_IRQ_14_CFG_DRV1'/>"
WRITE #1 "        <register address='0xb2a014c' value='0x" DATA.LONG(A:0x2a014c) "' name='RPMH_PDC_MODEM_IRQ_15_CFG_DRV1'/>"
WRITE #1 "        <register address='0xb2a0150' value='0x" DATA.LONG(A:0x2a0150) "' name='RPMH_PDC_MODEM_IRQ_16_CFG_DRV1'/>"
WRITE #1 "        <register address='0xb2a0154' value='0x" DATA.LONG(A:0x2a0154) "' name='RPMH_PDC_MODEM_IRQ_17_CFG_DRV1'/>"
WRITE #1 "        <register address='0xb2a0158' value='0x" DATA.LONG(A:0x2a0158) "' name='RPMH_PDC_MODEM_IRQ_18_CFG_DRV1'/>"
WRITE #1 "        <register address='0xb2a015c' value='0x" DATA.LONG(A:0x2a015c) "' name='RPMH_PDC_MODEM_IRQ_19_CFG_DRV1'/>"
WRITE #1 "        <register address='0xb2a0160' value='0x" DATA.LONG(A:0x2a0160) "' name='RPMH_PDC_MODEM_IRQ_20_CFG_DRV1'/>"
WRITE #1 "        <register address='0xb2a0164' value='0x" DATA.LONG(A:0x2a0164) "' name='RPMH_PDC_MODEM_IRQ_21_CFG_DRV1'/>"
WRITE #1 "        <register address='0xb2a0168' value='0x" DATA.LONG(A:0x2a0168) "' name='RPMH_PDC_MODEM_IRQ_22_CFG_DRV1'/>"
WRITE #1 "        <register address='0xb2a016c' value='0x" DATA.LONG(A:0x2a016c) "' name='RPMH_PDC_MODEM_IRQ_23_CFG_DRV1'/>"
WRITE #1 "        <register address='0xb2a0170' value='0x" DATA.LONG(A:0x2a0170) "' name='RPMH_PDC_MODEM_IRQ_24_CFG_DRV1'/>"
WRITE #1 "        <register address='0xb2a0174' value='0x" DATA.LONG(A:0x2a0174) "' name='RPMH_PDC_MODEM_IRQ_25_CFG_DRV1'/>"
WRITE #1 "        <register address='0xb2a0178' value='0x" DATA.LONG(A:0x2a0178) "' name='RPMH_PDC_MODEM_IRQ_26_CFG_DRV1'/>"
WRITE #1 "        <register address='0xb2a017c' value='0x" DATA.LONG(A:0x2a017c) "' name='RPMH_PDC_MODEM_IRQ_27_CFG_DRV1'/>"
WRITE #1 "        <register address='0xb2a0180' value='0x" DATA.LONG(A:0x2a0180) "' name='RPMH_PDC_MODEM_IRQ_28_CFG_DRV1'/>"
WRITE #1 "        <register address='0xb2a0184' value='0x" DATA.LONG(A:0x2a0184) "' name='RPMH_PDC_MODEM_IRQ_29_CFG_DRV1'/>"
WRITE #1 "        <register address='0xb2a0188' value='0x" DATA.LONG(A:0x2a0188) "' name='RPMH_PDC_MODEM_IRQ_30_CFG_DRV1'/>"
WRITE #1 "        <register address='0xb2a018c' value='0x" DATA.LONG(A:0x2a018c) "' name='RPMH_PDC_MODEM_IRQ_31_CFG_DRV1'/>"
WRITE #1 "        <register address='0xb2a0190' value='0x" DATA.LONG(A:0x2a0190) "' name='RPMH_PDC_MODEM_IRQ_32_CFG_DRV1'/>"
WRITE #1 "        <register address='0xb2a0194' value='0x" DATA.LONG(A:0x2a0194) "' name='RPMH_PDC_MODEM_IRQ_33_CFG_DRV1'/>"
WRITE #1 "        <register address='0xb2a0198' value='0x" DATA.LONG(A:0x2a0198) "' name='RPMH_PDC_MODEM_IRQ_34_CFG_DRV1'/>"
WRITE #1 "        <register address='0xb2a019c' value='0x" DATA.LONG(A:0x2a019c) "' name='RPMH_PDC_MODEM_IRQ_35_CFG_DRV1'/>"
WRITE #1 "        <register address='0xb2a01a0' value='0x" DATA.LONG(A:0x2a01a0) "' name='RPMH_PDC_MODEM_IRQ_36_CFG_DRV1'/>"
WRITE #1 "        <register address='0xb2a01a4' value='0x" DATA.LONG(A:0x2a01a4) "' name='RPMH_PDC_MODEM_IRQ_37_CFG_DRV1'/>"
WRITE #1 "        <register address='0xb2a01a8' value='0x" DATA.LONG(A:0x2a01a8) "' name='RPMH_PDC_MODEM_IRQ_38_CFG_DRV1'/>"
WRITE #1 "        <register address='0xb2a01ac' value='0x" DATA.LONG(A:0x2a01ac) "' name='RPMH_PDC_MODEM_IRQ_39_CFG_DRV1'/>"
WRITE #1 "        <register address='0xb2a01b0' value='0x" DATA.LONG(A:0x2a01b0) "' name='RPMH_PDC_MODEM_IRQ_40_CFG_DRV1'/>"
WRITE #1 "        <register address='0xb2a01b4' value='0x" DATA.LONG(A:0x2a01b4) "' name='RPMH_PDC_MODEM_IRQ_41_CFG_DRV1'/>"
WRITE #1 "        <register address='0xb2a01b8' value='0x" DATA.LONG(A:0x2a01b8) "' name='RPMH_PDC_MODEM_IRQ_42_CFG_DRV1'/>"
WRITE #1 "        <register address='0xb2a01bc' value='0x" DATA.LONG(A:0x2a01bc) "' name='RPMH_PDC_MODEM_IRQ_43_CFG_DRV1'/>"
WRITE #1 "        <register address='0xb2a01c0' value='0x" DATA.LONG(A:0x2a01c0) "' name='RPMH_PDC_MODEM_IRQ_44_CFG_DRV1'/>"
WRITE #1 "        <register address='0xb290900' value='0x" DATA.LONG(A:0x290900) "' name='RPMH_PDC_MODEM_IRQ_STATUS_BANK0_DRV0'/>"
WRITE #1 "        <register address='0xb290904' value='0x" DATA.LONG(A:0x290904) "' name='RPMH_PDC_MODEM_IRQ_STATUS_BANK1_DRV0'/>"
WRITE #1 "        <register address='0xb2a0900' value='0x" DATA.LONG(A:0x2a0900) "' name='RPMH_PDC_MODEM_IRQ_STATUS_BANK0_DRV1'/>"
WRITE #1 "        <register address='0xb2a0904' value='0x" DATA.LONG(A:0x2a0904) "' name='RPMH_PDC_MODEM_IRQ_STATUS_BANK1_DRV1'/>"
WRITE #1 "        <register address='0xb291000' value='0x" DATA.LONG(A:0x291000) "' name='RPMH_PDC_MODEM_PDC_VERSION_DRV0'/>"
WRITE #1 "        <register address='0xb2a1000' value='0x" DATA.LONG(A:0x2a1000) "' name='RPMH_PDC_MODEM_PDC_VERSION_DRV1'/>"
WRITE #1 "        <register address='0xb291004' value='0x" DATA.LONG(A:0x291004) "' name='RPMH_PDC_MODEM_PDC_PARAM_RESOURCE_DRV0'/>"
WRITE #1 "        <register address='0xb2a1004' value='0x" DATA.LONG(A:0x2a1004) "' name='RPMH_PDC_MODEM_PDC_PARAM_RESOURCE_DRV1'/>"
WRITE #1 "        <register address='0xb291008' value='0x" DATA.LONG(A:0x291008) "' name='RPMH_PDC_MODEM_PDC_PARAM_SEQ_CONFIG_DRV0'/>"
WRITE #1 "        <register address='0xb2a1008' value='0x" DATA.LONG(A:0x2a1008) "' name='RPMH_PDC_MODEM_PDC_PARAM_SEQ_CONFIG_DRV1'/>"
WRITE #1 "        <register address='0xb29100c' value='0x" DATA.LONG(A:0x29100c) "' name='RPMH_PDC_MODEM_PDC_PARAM_IRQ_CONFIG_DRV0'/>"
WRITE #1 "        <register address='0xb2a100c' value='0x" DATA.LONG(A:0x2a100c) "' name='RPMH_PDC_MODEM_PDC_PARAM_IRQ_CONFIG_DRV1'/>"
WRITE #1 "        <register address='0xb291020' value='0x" DATA.LONG(A:0x291020) "' name='RPMH_PDC_MODEM_SEQ_BUSY_DRV0'/>"
WRITE #1 "        <register address='0xb2a1020' value='0x" DATA.LONG(A:0x2a1020) "' name='RPMH_PDC_MODEM_SEQ_BUSY_DRV1'/>"
WRITE #1 "        <register address='0xb291024' value='0x" DATA.LONG(A:0x291024) "' name='RPMH_PDC_MODEM_SEQ_DBG_PROGRAM_COUNTER_DRV0'/>"
WRITE #1 "        <register address='0xb2a1024' value='0x" DATA.LONG(A:0x2a1024) "' name='RPMH_PDC_MODEM_SEQ_DBG_PROGRAM_COUNTER_DRV1'/>"
WRITE #1 "        <register address='0xb291028' value='0x" DATA.LONG(A:0x291028) "' name='RPMH_PDC_MODEM_SEQ_DBG_STAT_DRV0'/>"
WRITE #1 "        <register address='0xb2a1028' value='0x" DATA.LONG(A:0x2a1028) "' name='RPMH_PDC_MODEM_SEQ_DBG_STAT_DRV1'/>"
WRITE #1 "        <register address='0xb29102c' value='0x" DATA.LONG(A:0x29102c) "' name='RPMH_PDC_MODEM_SEQ_DBG_WAIT_EVNT_DRV0'/>"
WRITE #1 "        <register address='0xb2a102c' value='0x" DATA.LONG(A:0x2a102c) "' name='RPMH_PDC_MODEM_SEQ_DBG_WAIT_EVNT_DRV1'/>"
WRITE #1 "        <register address='0xb291030' value='0x" DATA.LONG(A:0x291030) "' name='RPMH_PDC_MODEM_PDC_MODE_STATUS_DRV0'/>"
WRITE #1 "        <register address='0xb2a1030' value='0x" DATA.LONG(A:0x2a1030) "' name='RPMH_PDC_MODEM_PDC_MODE_STATUS_DRV1'/>"
WRITE #1 "        <register address='0xb291034' value='0x" DATA.LONG(A:0x291034) "' name='RPMH_PDC_MODEM_DBG_EPCB_RX_ADDR0'/>"
WRITE #1 "        <register address='0xb2a1034' value='0x" DATA.LONG(A:0x2a1034) "' name='RPMH_PDC_MODEM_DBG_EPCB_RX_ADDR1'/>"
WRITE #1 "        <register address='0xb291038' value='0x" DATA.LONG(A:0x291038) "' name='RPMH_PDC_MODEM_DBG_EPCB_RX_DATA0'/>"
WRITE #1 "        <register address='0xb2a1038' value='0x" DATA.LONG(A:0x2a1038) "' name='RPMH_PDC_MODEM_DBG_EPCB_RX_DATA1'/>"
WRITE #1 "        <register address='0xb291200' value='0x" DATA.LONG(A:0x291200) "' name='RPMH_PDC_MODEM_PROFILING_UNIT0_DRV0_OUTPUT'/>"
WRITE #1 "        <register address='0xb291214' value='0x" DATA.LONG(A:0x291214) "' name='RPMH_PDC_MODEM_PROFILING_UNIT1_DRV0_OUTPUT'/>"
WRITE #1 "        <register address='0xb291228' value='0x" DATA.LONG(A:0x291228) "' name='RPMH_PDC_MODEM_PROFILING_UNIT2_DRV0_OUTPUT'/>"
WRITE #1 "        <register address='0xb29123c' value='0x" DATA.LONG(A:0x29123c) "' name='RPMH_PDC_MODEM_PROFILING_UNIT3_DRV0_OUTPUT'/>"
WRITE #1 "        <register address='0xb291250' value='0x" DATA.LONG(A:0x291250) "' name='RPMH_PDC_MODEM_PROFILING_UNIT4_DRV0_OUTPUT'/>"
WRITE #1 "        <register address='0xb2a1200' value='0x" DATA.LONG(A:0x2a1200) "' name='RPMH_PDC_MODEM_PROFILING_UNIT0_DRV1_OUTPUT'/>"
WRITE #1 "        <register address='0xb2a1214' value='0x" DATA.LONG(A:0x2a1214) "' name='RPMH_PDC_MODEM_PROFILING_UNIT1_DRV1_OUTPUT'/>"
WRITE #1 "        <register address='0xb2a1228' value='0x" DATA.LONG(A:0x2a1228) "' name='RPMH_PDC_MODEM_PROFILING_UNIT2_DRV1_OUTPUT'/>"
WRITE #1 "        <register address='0xb2a123c' value='0x" DATA.LONG(A:0x2a123c) "' name='RPMH_PDC_MODEM_PROFILING_UNIT3_DRV1_OUTPUT'/>"
WRITE #1 "        <register address='0xb2a1250' value='0x" DATA.LONG(A:0x2a1250) "' name='RPMH_PDC_MODEM_PROFILING_UNIT4_DRV1_OUTPUT'/>"
WRITE #1 "        <register address='0xb291204' value='0x" DATA.LONG(A:0x291204) "' name='RPMH_PDC_MODEM_PROFILING_UNIT0_DRV0_TIMESTAMP_LO'/>"
WRITE #1 "        <register address='0xb291218' value='0x" DATA.LONG(A:0x291218) "' name='RPMH_PDC_MODEM_PROFILING_UNIT1_DRV0_TIMESTAMP_LO'/>"
WRITE #1 "        <register address='0xb29122c' value='0x" DATA.LONG(A:0x29122c) "' name='RPMH_PDC_MODEM_PROFILING_UNIT2_DRV0_TIMESTAMP_LO'/>"
WRITE #1 "        <register address='0xb291240' value='0x" DATA.LONG(A:0x291240) "' name='RPMH_PDC_MODEM_PROFILING_UNIT3_DRV0_TIMESTAMP_LO'/>"
WRITE #1 "        <register address='0xb291254' value='0x" DATA.LONG(A:0x291254) "' name='RPMH_PDC_MODEM_PROFILING_UNIT4_DRV0_TIMESTAMP_LO'/>"
WRITE #1 "        <register address='0xb2a1204' value='0x" DATA.LONG(A:0x2a1204) "' name='RPMH_PDC_MODEM_PROFILING_UNIT0_DRV1_TIMESTAMP_LO'/>"
WRITE #1 "        <register address='0xb2a1218' value='0x" DATA.LONG(A:0x2a1218) "' name='RPMH_PDC_MODEM_PROFILING_UNIT1_DRV1_TIMESTAMP_LO'/>"
WRITE #1 "        <register address='0xb2a122c' value='0x" DATA.LONG(A:0x2a122c) "' name='RPMH_PDC_MODEM_PROFILING_UNIT2_DRV1_TIMESTAMP_LO'/>"
WRITE #1 "        <register address='0xb2a1240' value='0x" DATA.LONG(A:0x2a1240) "' name='RPMH_PDC_MODEM_PROFILING_UNIT3_DRV1_TIMESTAMP_LO'/>"
WRITE #1 "        <register address='0xb2a1254' value='0x" DATA.LONG(A:0x2a1254) "' name='RPMH_PDC_MODEM_PROFILING_UNIT4_DRV1_TIMESTAMP_LO'/>"
WRITE #1 "        <register address='0xb291208' value='0x" DATA.LONG(A:0x291208) "' name='RPMH_PDC_MODEM_PROFILING_UNIT0_DRV0_TIMESTAMP_HI'/>"
WRITE #1 "        <register address='0xb29121c' value='0x" DATA.LONG(A:0x29121c) "' name='RPMH_PDC_MODEM_PROFILING_UNIT1_DRV0_TIMESTAMP_HI'/>"
WRITE #1 "        <register address='0xb291230' value='0x" DATA.LONG(A:0x291230) "' name='RPMH_PDC_MODEM_PROFILING_UNIT2_DRV0_TIMESTAMP_HI'/>"
WRITE #1 "        <register address='0xb291244' value='0x" DATA.LONG(A:0x291244) "' name='RPMH_PDC_MODEM_PROFILING_UNIT3_DRV0_TIMESTAMP_HI'/>"
WRITE #1 "        <register address='0xb291258' value='0x" DATA.LONG(A:0x291258) "' name='RPMH_PDC_MODEM_PROFILING_UNIT4_DRV0_TIMESTAMP_HI'/>"
WRITE #1 "        <register address='0xb2a1208' value='0x" DATA.LONG(A:0x2a1208) "' name='RPMH_PDC_MODEM_PROFILING_UNIT0_DRV1_TIMESTAMP_HI'/>"
WRITE #1 "        <register address='0xb2a121c' value='0x" DATA.LONG(A:0x2a121c) "' name='RPMH_PDC_MODEM_PROFILING_UNIT1_DRV1_TIMESTAMP_HI'/>"
WRITE #1 "        <register address='0xb2a1230' value='0x" DATA.LONG(A:0x2a1230) "' name='RPMH_PDC_MODEM_PROFILING_UNIT2_DRV1_TIMESTAMP_HI'/>"
WRITE #1 "        <register address='0xb2a1244' value='0x" DATA.LONG(A:0x2a1244) "' name='RPMH_PDC_MODEM_PROFILING_UNIT3_DRV1_TIMESTAMP_HI'/>"
WRITE #1 "        <register address='0xb2a1258' value='0x" DATA.LONG(A:0x2a1258) "' name='RPMH_PDC_MODEM_PROFILING_UNIT4_DRV1_TIMESTAMP_HI'/>"
WRITE #1 "        <register address='0xb291300' value='0x" DATA.LONG(A:0x291300) "' name='RPMH_PDC_MODEM_TCS0_DRV0_STATUS'/>"
WRITE #1 "        <register address='0xb2913c8' value='0x" DATA.LONG(A:0x2913c8) "' name='RPMH_PDC_MODEM_TCS1_DRV0_STATUS'/>"
WRITE #1 "        <register address='0xb291490' value='0x" DATA.LONG(A:0x291490) "' name='RPMH_PDC_MODEM_TCS2_DRV0_STATUS'/>"
WRITE #1 "        <register address='0xb291558' value='0x" DATA.LONG(A:0x291558) "' name='RPMH_PDC_MODEM_TCS3_DRV0_STATUS'/>"
WRITE #1 "        <register address='0xb2a1300' value='0x" DATA.LONG(A:0x2a1300) "' name='RPMH_PDC_MODEM_TCS0_DRV1_STATUS'/>"
WRITE #1 "        <register address='0xb2a13c8' value='0x" DATA.LONG(A:0x2a13c8) "' name='RPMH_PDC_MODEM_TCS1_DRV1_STATUS'/>"
WRITE #1 "        <register address='0xb2a1490' value='0x" DATA.LONG(A:0x2a1490) "' name='RPMH_PDC_MODEM_TCS2_DRV1_STATUS'/>"
WRITE #1 "        <register address='0xb2a1558' value='0x" DATA.LONG(A:0x2a1558) "' name='RPMH_PDC_MODEM_TCS3_DRV1_STATUS'/>"
WRITE #1 "        <register address='0xb291304' value='0x" DATA.LONG(A:0x291304) "' name='RPMH_PDC_MODEM_TCS0_CMD0_DRV0_STATUS'/>"
WRITE #1 "        <register address='0xb29130c' value='0x" DATA.LONG(A:0x29130c) "' name='RPMH_PDC_MODEM_TCS0_CMD1_DRV0_STATUS'/>"
WRITE #1 "        <register address='0xb291314' value='0x" DATA.LONG(A:0x291314) "' name='RPMH_PDC_MODEM_TCS0_CMD2_DRV0_STATUS'/>"
WRITE #1 "        <register address='0xb29131c' value='0x" DATA.LONG(A:0x29131c) "' name='RPMH_PDC_MODEM_TCS0_CMD3_DRV0_STATUS'/>"
WRITE #1 "        <register address='0xb2913cc' value='0x" DATA.LONG(A:0x2913cc) "' name='RPMH_PDC_MODEM_TCS1_CMD0_DRV0_STATUS'/>"
WRITE #1 "        <register address='0xb2913d4' value='0x" DATA.LONG(A:0x2913d4) "' name='RPMH_PDC_MODEM_TCS1_CMD1_DRV0_STATUS'/>"
WRITE #1 "        <register address='0xb2913dc' value='0x" DATA.LONG(A:0x2913dc) "' name='RPMH_PDC_MODEM_TCS1_CMD2_DRV0_STATUS'/>"
WRITE #1 "        <register address='0xb2913e4' value='0x" DATA.LONG(A:0x2913e4) "' name='RPMH_PDC_MODEM_TCS1_CMD3_DRV0_STATUS'/>"
WRITE #1 "        <register address='0xb291494' value='0x" DATA.LONG(A:0x291494) "' name='RPMH_PDC_MODEM_TCS2_CMD0_DRV0_STATUS'/>"
WRITE #1 "        <register address='0xb29149c' value='0x" DATA.LONG(A:0x29149c) "' name='RPMH_PDC_MODEM_TCS2_CMD1_DRV0_STATUS'/>"
WRITE #1 "        <register address='0xb2914a4' value='0x" DATA.LONG(A:0x2914a4) "' name='RPMH_PDC_MODEM_TCS2_CMD2_DRV0_STATUS'/>"
WRITE #1 "        <register address='0xb2914ac' value='0x" DATA.LONG(A:0x2914ac) "' name='RPMH_PDC_MODEM_TCS2_CMD3_DRV0_STATUS'/>"
WRITE #1 "        <register address='0xb29155c' value='0x" DATA.LONG(A:0x29155c) "' name='RPMH_PDC_MODEM_TCS3_CMD0_DRV0_STATUS'/>"
WRITE #1 "        <register address='0xb291564' value='0x" DATA.LONG(A:0x291564) "' name='RPMH_PDC_MODEM_TCS3_CMD1_DRV0_STATUS'/>"
WRITE #1 "        <register address='0xb29156c' value='0x" DATA.LONG(A:0x29156c) "' name='RPMH_PDC_MODEM_TCS3_CMD2_DRV0_STATUS'/>"
WRITE #1 "        <register address='0xb291574' value='0x" DATA.LONG(A:0x291574) "' name='RPMH_PDC_MODEM_TCS3_CMD3_DRV0_STATUS'/>"
WRITE #1 "        <register address='0xb2a1304' value='0x" DATA.LONG(A:0x2a1304) "' name='RPMH_PDC_MODEM_TCS0_CMD0_DRV1_STATUS'/>"
WRITE #1 "        <register address='0xb2a130c' value='0x" DATA.LONG(A:0x2a130c) "' name='RPMH_PDC_MODEM_TCS0_CMD1_DRV1_STATUS'/>"
WRITE #1 "        <register address='0xb2a1314' value='0x" DATA.LONG(A:0x2a1314) "' name='RPMH_PDC_MODEM_TCS0_CMD2_DRV1_STATUS'/>"
WRITE #1 "        <register address='0xb2a131c' value='0x" DATA.LONG(A:0x2a131c) "' name='RPMH_PDC_MODEM_TCS0_CMD3_DRV1_STATUS'/>"
WRITE #1 "        <register address='0xb2a13cc' value='0x" DATA.LONG(A:0x2a13cc) "' name='RPMH_PDC_MODEM_TCS1_CMD0_DRV1_STATUS'/>"
WRITE #1 "        <register address='0xb2a13d4' value='0x" DATA.LONG(A:0x2a13d4) "' name='RPMH_PDC_MODEM_TCS1_CMD1_DRV1_STATUS'/>"
WRITE #1 "        <register address='0xb2a13dc' value='0x" DATA.LONG(A:0x2a13dc) "' name='RPMH_PDC_MODEM_TCS1_CMD2_DRV1_STATUS'/>"
WRITE #1 "        <register address='0xb2a13e4' value='0x" DATA.LONG(A:0x2a13e4) "' name='RPMH_PDC_MODEM_TCS1_CMD3_DRV1_STATUS'/>"
WRITE #1 "        <register address='0xb2a1494' value='0x" DATA.LONG(A:0x2a1494) "' name='RPMH_PDC_MODEM_TCS2_CMD0_DRV1_STATUS'/>"
WRITE #1 "        <register address='0xb2a149c' value='0x" DATA.LONG(A:0x2a149c) "' name='RPMH_PDC_MODEM_TCS2_CMD1_DRV1_STATUS'/>"
WRITE #1 "        <register address='0xb2a14a4' value='0x" DATA.LONG(A:0x2a14a4) "' name='RPMH_PDC_MODEM_TCS2_CMD2_DRV1_STATUS'/>"
WRITE #1 "        <register address='0xb2a14ac' value='0x" DATA.LONG(A:0x2a14ac) "' name='RPMH_PDC_MODEM_TCS2_CMD3_DRV1_STATUS'/>"
WRITE #1 "        <register address='0xb2a155c' value='0x" DATA.LONG(A:0x2a155c) "' name='RPMH_PDC_MODEM_TCS3_CMD0_DRV1_STATUS'/>"
WRITE #1 "        <register address='0xb2a1564' value='0x" DATA.LONG(A:0x2a1564) "' name='RPMH_PDC_MODEM_TCS3_CMD1_DRV1_STATUS'/>"
WRITE #1 "        <register address='0xb2a156c' value='0x" DATA.LONG(A:0x2a156c) "' name='RPMH_PDC_MODEM_TCS3_CMD2_DRV1_STATUS'/>"
WRITE #1 "        <register address='0xb2a1574' value='0x" DATA.LONG(A:0x2a1574) "' name='RPMH_PDC_MODEM_TCS3_CMD3_DRV1_STATUS'/>"
WRITE #1 "        <register address='0xb294500' value='0x" DATA.LONG(A:0x294500) "' name='RPMH_PDC_MODEM_ENABLE_PDC'/>"
WRITE #1 "        <register address='0xb294510' value='0x" DATA.LONG(A:0x294510) "' name='RPMH_PDC_MODEM_TIMER_MATCH_VALUE_LO'/>"
WRITE #1 "        <register address='0xb294514' value='0x" DATA.LONG(A:0x294514) "' name='RPMH_PDC_MODEM_TIMER_MATCH_VALUE_HI'/>"
WRITE #1 "        <register address='0xb294518' value='0x" DATA.LONG(A:0x294518) "' name='RPMH_PDC_MODEM_TIMER_DISABLED_FOR_ARC'/>"
WRITE #1 "        <register address='0xb294520' value='0x" DATA.LONG(A:0x294520) "' name='RPMH_PDC_MODEM_SEQ_START_ADDR'/>"
WRITE #1 "        <register address='0xb294524' value='0x" DATA.LONG(A:0x294524) "' name='RPMH_PDC_MODEM_SEQ_OVERRIDE_START_ADDR'/>"
WRITE #1 "        <register address='0xb29452c' value='0x" DATA.LONG(A:0x29452c) "' name='RPMH_PDC_MODEM_SEQ_OVERRIDE_TRIGGER'/>"
WRITE #1 "        <register address='0xb294530' value='0x" DATA.LONG(A:0x294530) "' name='RPMH_PDC_MODEM_SEQ_PWR_CTRL_OVERRIDE_MASK'/>"
WRITE #1 "        <register address='0xb294534' value='0x" DATA.LONG(A:0x294534) "' name='RPMH_PDC_MODEM_SEQ_PWR_CTRL_OVERRIDE_VAL'/>"
WRITE #1 "        <register address='0xb294540' value='0x" DATA.LONG(A:0x294540) "' name='RPMH_PDC_MODEM_SEQ_WAIT_EVENT_OVERRIDE_MASK'/>"
WRITE #1 "        <register address='0xb294544' value='0x" DATA.LONG(A:0x294544) "' name='RPMH_PDC_MODEM_SEQ_WAIT_EVENT_OVERRIDE_VAL'/>"
WRITE #1 "        <register address='0xb294550' value='0x" DATA.LONG(A:0x294550) "' name='RPMH_PDC_MODEM_SEQ_BR_EVENT_OVERRIDE_MASK'/>"
WRITE #1 "        <register address='0xb294554' value='0x" DATA.LONG(A:0x294554) "' name='RPMH_PDC_MODEM_SEQ_BR_EVENT_OVERRIDE_VAL'/>"
WRITE #1 "        <register address='0xb294590' value='0x" DATA.LONG(A:0x294590) "' name='RPMH_PDC_MODEM_SEQ_CFG_BR_ADDR_0'/>"
WRITE #1 "        <register address='0xb294594' value='0x" DATA.LONG(A:0x294594) "' name='RPMH_PDC_MODEM_SEQ_CFG_BR_ADDR_1'/>"
WRITE #1 "        <register address='0xb294598' value='0x" DATA.LONG(A:0x294598) "' name='RPMH_PDC_MODEM_SEQ_CFG_BR_ADDR_2'/>"
WRITE #1 "        <register address='0xb29459c' value='0x" DATA.LONG(A:0x29459c) "' name='RPMH_PDC_MODEM_SEQ_CFG_BR_ADDR_3'/>"
WRITE #1 "        <register address='0xb2945a0' value='0x" DATA.LONG(A:0x2945a0) "' name='RPMH_PDC_MODEM_SEQ_CFG_DELAY_VAL_0'/>"
WRITE #1 "        <register address='0xb2945a4' value='0x" DATA.LONG(A:0x2945a4) "' name='RPMH_PDC_MODEM_SEQ_CFG_DELAY_VAL_1'/>"
WRITE #1 "        <register address='0xb2945a8' value='0x" DATA.LONG(A:0x2945a8) "' name='RPMH_PDC_MODEM_SEQ_CFG_DELAY_VAL_2'/>"
WRITE #1 "        <register address='0xb2945ac' value='0x" DATA.LONG(A:0x2945ac) "' name='RPMH_PDC_MODEM_SEQ_CFG_DELAY_VAL_3'/>"
WRITE #1 "        <register address='0xb2945b0' value='0x" DATA.LONG(A:0x2945b0) "' name='RPMH_PDC_MODEM_SEQ_CFG_DELAY_VAL_4'/>"
WRITE #1 "        <register address='0xb2945b4' value='0x" DATA.LONG(A:0x2945b4) "' name='RPMH_PDC_MODEM_SEQ_CFG_DELAY_VAL_5'/>"
WRITE #1 "        <register address='0xb2945b8' value='0x" DATA.LONG(A:0x2945b8) "' name='RPMH_PDC_MODEM_SEQ_CFG_DELAY_VAL_6'/>"
WRITE #1 "        <register address='0xb2945bc' value='0x" DATA.LONG(A:0x2945bc) "' name='RPMH_PDC_MODEM_SEQ_CFG_DELAY_VAL_7'/>"
WRITE #1 "        <register address='0xb2945c0' value='0x" DATA.LONG(A:0x2945c0) "' name='RPMH_PDC_MODEM_SEQ_CFG_DELAY_VAL_8'/>"
WRITE #1 "        <register address='0xb2945c4' value='0x" DATA.LONG(A:0x2945c4) "' name='RPMH_PDC_MODEM_SEQ_CFG_DELAY_VAL_9'/>"
WRITE #1 "        <register address='0xb2945c8' value='0x" DATA.LONG(A:0x2945c8) "' name='RPMH_PDC_MODEM_SEQ_CFG_DELAY_VAL_10'/>"
WRITE #1 "        <register address='0xb2945cc' value='0x" DATA.LONG(A:0x2945cc) "' name='RPMH_PDC_MODEM_SEQ_CFG_DELAY_VAL_11'/>"
WRITE #1 "        <register address='0xb2945d0' value='0x" DATA.LONG(A:0x2945d0) "' name='RPMH_PDC_MODEM_SEQ_CFG_DELAY_VAL_12'/>"
WRITE #1 "        <register address='0xb2945d4' value='0x" DATA.LONG(A:0x2945d4) "' name='RPMH_PDC_MODEM_SEQ_CFG_DELAY_VAL_13'/>"
WRITE #1 "        <register address='0xb2945d8' value='0x" DATA.LONG(A:0x2945d8) "' name='RPMH_PDC_MODEM_SEQ_CFG_DELAY_VAL_14'/>"
WRITE #1 "        <register address='0xb2945dc' value='0x" DATA.LONG(A:0x2945dc) "' name='RPMH_PDC_MODEM_SEQ_CFG_DELAY_VAL_15'/>"
WRITE #1 "        <register address='0xb2945e0' value='0x" DATA.LONG(A:0x2945e0) "' name='RPMH_PDC_MODEM_SEQ_DBG_BREAKPOINT_ADDR'/>"
WRITE #1 "        <register address='0xb2945e4' value='0x" DATA.LONG(A:0x2945e4) "' name='RPMH_PDC_MODEM_SEQ_DBG_STEP'/>"
WRITE #1 "        <register address='0xb294600' value='0x" DATA.LONG(A:0x294600) "' name='RPMH_PDC_MODEM_IRQ_0_OWNER'/>"
WRITE #1 "        <register address='0xb294604' value='0x" DATA.LONG(A:0x294604) "' name='RPMH_PDC_MODEM_IRQ_1_OWNER'/>"
WRITE #1 "        <register address='0xb294608' value='0x" DATA.LONG(A:0x294608) "' name='RPMH_PDC_MODEM_IRQ_2_OWNER'/>"
WRITE #1 "        <register address='0xb29460c' value='0x" DATA.LONG(A:0x29460c) "' name='RPMH_PDC_MODEM_IRQ_3_OWNER'/>"
WRITE #1 "        <register address='0xb294610' value='0x" DATA.LONG(A:0x294610) "' name='RPMH_PDC_MODEM_IRQ_4_OWNER'/>"
WRITE #1 "        <register address='0xb294614' value='0x" DATA.LONG(A:0x294614) "' name='RPMH_PDC_MODEM_IRQ_5_OWNER'/>"
WRITE #1 "        <register address='0xb294618' value='0x" DATA.LONG(A:0x294618) "' name='RPMH_PDC_MODEM_IRQ_6_OWNER'/>"
WRITE #1 "        <register address='0xb29461c' value='0x" DATA.LONG(A:0x29461c) "' name='RPMH_PDC_MODEM_IRQ_7_OWNER'/>"
WRITE #1 "        <register address='0xb294620' value='0x" DATA.LONG(A:0x294620) "' name='RPMH_PDC_MODEM_IRQ_8_OWNER'/>"
WRITE #1 "        <register address='0xb294624' value='0x" DATA.LONG(A:0x294624) "' name='RPMH_PDC_MODEM_IRQ_9_OWNER'/>"
WRITE #1 "        <register address='0xb294628' value='0x" DATA.LONG(A:0x294628) "' name='RPMH_PDC_MODEM_IRQ_10_OWNER'/>"
WRITE #1 "        <register address='0xb29462c' value='0x" DATA.LONG(A:0x29462c) "' name='RPMH_PDC_MODEM_IRQ_11_OWNER'/>"
WRITE #1 "        <register address='0xb294630' value='0x" DATA.LONG(A:0x294630) "' name='RPMH_PDC_MODEM_IRQ_12_OWNER'/>"
WRITE #1 "        <register address='0xb294634' value='0x" DATA.LONG(A:0x294634) "' name='RPMH_PDC_MODEM_IRQ_13_OWNER'/>"
WRITE #1 "        <register address='0xb294638' value='0x" DATA.LONG(A:0x294638) "' name='RPMH_PDC_MODEM_IRQ_14_OWNER'/>"
WRITE #1 "        <register address='0xb29463c' value='0x" DATA.LONG(A:0x29463c) "' name='RPMH_PDC_MODEM_IRQ_15_OWNER'/>"
WRITE #1 "        <register address='0xb294640' value='0x" DATA.LONG(A:0x294640) "' name='RPMH_PDC_MODEM_IRQ_16_OWNER'/>"
WRITE #1 "        <register address='0xb294644' value='0x" DATA.LONG(A:0x294644) "' name='RPMH_PDC_MODEM_IRQ_17_OWNER'/>"
WRITE #1 "        <register address='0xb294648' value='0x" DATA.LONG(A:0x294648) "' name='RPMH_PDC_MODEM_IRQ_18_OWNER'/>"
WRITE #1 "        <register address='0xb29464c' value='0x" DATA.LONG(A:0x29464c) "' name='RPMH_PDC_MODEM_IRQ_19_OWNER'/>"
WRITE #1 "        <register address='0xb294650' value='0x" DATA.LONG(A:0x294650) "' name='RPMH_PDC_MODEM_IRQ_20_OWNER'/>"
WRITE #1 "        <register address='0xb294654' value='0x" DATA.LONG(A:0x294654) "' name='RPMH_PDC_MODEM_IRQ_21_OWNER'/>"
WRITE #1 "        <register address='0xb294658' value='0x" DATA.LONG(A:0x294658) "' name='RPMH_PDC_MODEM_IRQ_22_OWNER'/>"
WRITE #1 "        <register address='0xb29465c' value='0x" DATA.LONG(A:0x29465c) "' name='RPMH_PDC_MODEM_IRQ_23_OWNER'/>"
WRITE #1 "        <register address='0xb294660' value='0x" DATA.LONG(A:0x294660) "' name='RPMH_PDC_MODEM_IRQ_24_OWNER'/>"
WRITE #1 "        <register address='0xb294664' value='0x" DATA.LONG(A:0x294664) "' name='RPMH_PDC_MODEM_IRQ_25_OWNER'/>"
WRITE #1 "        <register address='0xb294668' value='0x" DATA.LONG(A:0x294668) "' name='RPMH_PDC_MODEM_IRQ_26_OWNER'/>"
WRITE #1 "        <register address='0xb29466c' value='0x" DATA.LONG(A:0x29466c) "' name='RPMH_PDC_MODEM_IRQ_27_OWNER'/>"
WRITE #1 "        <register address='0xb294670' value='0x" DATA.LONG(A:0x294670) "' name='RPMH_PDC_MODEM_IRQ_28_OWNER'/>"
WRITE #1 "        <register address='0xb294674' value='0x" DATA.LONG(A:0x294674) "' name='RPMH_PDC_MODEM_IRQ_29_OWNER'/>"
WRITE #1 "        <register address='0xb294678' value='0x" DATA.LONG(A:0x294678) "' name='RPMH_PDC_MODEM_IRQ_30_OWNER'/>"
WRITE #1 "        <register address='0xb29467c' value='0x" DATA.LONG(A:0x29467c) "' name='RPMH_PDC_MODEM_IRQ_31_OWNER'/>"
WRITE #1 "        <register address='0xb294680' value='0x" DATA.LONG(A:0x294680) "' name='RPMH_PDC_MODEM_IRQ_32_OWNER'/>"
WRITE #1 "        <register address='0xb294684' value='0x" DATA.LONG(A:0x294684) "' name='RPMH_PDC_MODEM_IRQ_33_OWNER'/>"
WRITE #1 "        <register address='0xb294688' value='0x" DATA.LONG(A:0x294688) "' name='RPMH_PDC_MODEM_IRQ_34_OWNER'/>"
WRITE #1 "        <register address='0xb29468c' value='0x" DATA.LONG(A:0x29468c) "' name='RPMH_PDC_MODEM_IRQ_35_OWNER'/>"
WRITE #1 "        <register address='0xb294690' value='0x" DATA.LONG(A:0x294690) "' name='RPMH_PDC_MODEM_IRQ_36_OWNER'/>"
WRITE #1 "        <register address='0xb294694' value='0x" DATA.LONG(A:0x294694) "' name='RPMH_PDC_MODEM_IRQ_37_OWNER'/>"
WRITE #1 "        <register address='0xb294698' value='0x" DATA.LONG(A:0x294698) "' name='RPMH_PDC_MODEM_IRQ_38_OWNER'/>"
WRITE #1 "        <register address='0xb29469c' value='0x" DATA.LONG(A:0x29469c) "' name='RPMH_PDC_MODEM_IRQ_39_OWNER'/>"
WRITE #1 "        <register address='0xb2946a0' value='0x" DATA.LONG(A:0x2946a0) "' name='RPMH_PDC_MODEM_IRQ_40_OWNER'/>"
WRITE #1 "        <register address='0xb2946a4' value='0x" DATA.LONG(A:0x2946a4) "' name='RPMH_PDC_MODEM_IRQ_41_OWNER'/>"
WRITE #1 "        <register address='0xb2946a8' value='0x" DATA.LONG(A:0x2946a8) "' name='RPMH_PDC_MODEM_IRQ_42_OWNER'/>"
WRITE #1 "        <register address='0xb2946ac' value='0x" DATA.LONG(A:0x2946ac) "' name='RPMH_PDC_MODEM_IRQ_43_OWNER'/>"
WRITE #1 "        <register address='0xb2946b0' value='0x" DATA.LONG(A:0x2946b0) "' name='RPMH_PDC_MODEM_IRQ_44_OWNER'/>"
WRITE #1 "        <register address='0xb294900' value='0x" DATA.LONG(A:0x294900) "' name='RPMH_PDC_MODEM_GP_IRQ_SELECT0'/>"
WRITE #1 "        <register address='0xb294914' value='0x" DATA.LONG(A:0x294914) "' name='RPMH_PDC_MODEM_GP_IRQ_SELECT1'/>"
WRITE #1 "        <register address='0xb294928' value='0x" DATA.LONG(A:0x294928) "' name='RPMH_PDC_MODEM_GP_IRQ_SELECT2'/>"
WRITE #1 "        <register address='0xb29493c' value='0x" DATA.LONG(A:0x29493c) "' name='RPMH_PDC_MODEM_GP_IRQ_SELECT3'/>"
WRITE #1 "        <register address='0xb294950' value='0x" DATA.LONG(A:0x294950) "' name='RPMH_PDC_MODEM_GP_IRQ_SELECT4'/>"
WRITE #1 "        <register address='0xb294964' value='0x" DATA.LONG(A:0x294964) "' name='RPMH_PDC_MODEM_GP_IRQ_SELECT5'/>"
WRITE #1 "        <register address='0xb294978' value='0x" DATA.LONG(A:0x294978) "' name='RPMH_PDC_MODEM_GP_IRQ_SELECT6'/>"
WRITE #1 "        <register address='0xb29498c' value='0x" DATA.LONG(A:0x29498c) "' name='RPMH_PDC_MODEM_GP_IRQ_SELECT7'/>"
WRITE #1 "        <register address='0xb2949a0' value='0x" DATA.LONG(A:0x2949a0) "' name='RPMH_PDC_MODEM_GP_IRQ_SELECT8'/>"
WRITE #1 "        <register address='0xb2949b4' value='0x" DATA.LONG(A:0x2949b4) "' name='RPMH_PDC_MODEM_GP_IRQ_SELECT9'/>"
WRITE #1 "        <register address='0xb2949c8' value='0x" DATA.LONG(A:0x2949c8) "' name='RPMH_PDC_MODEM_GP_IRQ_SELECT10'/>"
WRITE #1 "        <register address='0xb2949dc' value='0x" DATA.LONG(A:0x2949dc) "' name='RPMH_PDC_MODEM_GP_IRQ_SELECT11'/>"
WRITE #1 "        <register address='0xb2949f0' value='0x" DATA.LONG(A:0x2949f0) "' name='RPMH_PDC_MODEM_GP_IRQ_SELECT12'/>"
WRITE #1 "        <register address='0xb294a04' value='0x" DATA.LONG(A:0x294a04) "' name='RPMH_PDC_MODEM_GP_IRQ_SELECT13'/>"
WRITE #1 "        <register address='0xb294a18' value='0x" DATA.LONG(A:0x294a18) "' name='RPMH_PDC_MODEM_GP_IRQ_SELECT14'/>"
WRITE #1 "        <register address='0xb294a2c' value='0x" DATA.LONG(A:0x294a2c) "' name='RPMH_PDC_MODEM_GP_IRQ_SELECT15'/>"
WRITE #1 "        <register address='0xb294a40' value='0x" DATA.LONG(A:0x294a40) "' name='RPMH_PDC_MODEM_GP_IRQ_SELECT16'/>"
WRITE #1 "        <register address='0xb294a54' value='0x" DATA.LONG(A:0x294a54) "' name='RPMH_PDC_MODEM_GP_IRQ_SELECT17'/>"
WRITE #1 "        <register address='0xb294a68' value='0x" DATA.LONG(A:0x294a68) "' name='RPMH_PDC_MODEM_GP_IRQ_SELECT18'/>"
WRITE #1 "        <register address='0xb294a7c' value='0x" DATA.LONG(A:0x294a7c) "' name='RPMH_PDC_MODEM_GP_IRQ_SELECT19'/>"
WRITE #1 "        <register address='0xb294a90' value='0x" DATA.LONG(A:0x294a90) "' name='RPMH_PDC_MODEM_GP_IRQ_SELECT20'/>"
WRITE #1 "        <register address='0xb294aa4' value='0x" DATA.LONG(A:0x294aa4) "' name='RPMH_PDC_MODEM_GP_IRQ_SELECT21'/>"
WRITE #1 "        <register address='0xb294ab8' value='0x" DATA.LONG(A:0x294ab8) "' name='RPMH_PDC_MODEM_GP_IRQ_SELECT22'/>"
WRITE #1 "        <register address='0xb294acc' value='0x" DATA.LONG(A:0x294acc) "' name='RPMH_PDC_MODEM_GP_IRQ_SELECT23'/>"
WRITE #1 "        <register address='0xb294ae0' value='0x" DATA.LONG(A:0x294ae0) "' name='RPMH_PDC_MODEM_GP_IRQ_SELECT24'/>"
WRITE #1 "        <register address='0xb294af4' value='0x" DATA.LONG(A:0x294af4) "' name='RPMH_PDC_MODEM_GP_IRQ_SELECT25'/>"
WRITE #1 "        <register address='0xb294b08' value='0x" DATA.LONG(A:0x294b08) "' name='RPMH_PDC_MODEM_GP_IRQ_SELECT26'/>"
WRITE #1 "        <register address='0xb294b1c' value='0x" DATA.LONG(A:0x294b1c) "' name='RPMH_PDC_MODEM_GP_IRQ_SELECT27'/>"
WRITE #1 "        <register address='0xb294b30' value='0x" DATA.LONG(A:0x294b30) "' name='RPMH_PDC_MODEM_GP_IRQ_SELECT28'/>"
WRITE #1 "        <register address='0xb294b44' value='0x" DATA.LONG(A:0x294b44) "' name='RPMH_PDC_MODEM_GP_IRQ_SELECT29'/>"
WRITE #1 "        <register address='0xb295000' value='0x" DATA.LONG(A:0x295000) "' name='RPMH_PDC_MODEM_PROFILING_UNIT0_EN'/>"
WRITE #1 "        <register address='0xb295014' value='0x" DATA.LONG(A:0x295014) "' name='RPMH_PDC_MODEM_PROFILING_UNIT1_EN'/>"
WRITE #1 "        <register address='0xb295028' value='0x" DATA.LONG(A:0x295028) "' name='RPMH_PDC_MODEM_PROFILING_UNIT2_EN'/>"
WRITE #1 "        <register address='0xb29503c' value='0x" DATA.LONG(A:0x29503c) "' name='RPMH_PDC_MODEM_PROFILING_UNIT3_EN'/>"
WRITE #1 "        <register address='0xb295050' value='0x" DATA.LONG(A:0x295050) "' name='RPMH_PDC_MODEM_PROFILING_UNIT4_EN'/>"
WRITE #1 "        <register address='0xb295500' value='0x" DATA.LONG(A:0x295500) "' name='RPMH_PDC_MODEM_TCS0_CONTROL'/>"
WRITE #1 "        <register address='0xb2955c8' value='0x" DATA.LONG(A:0x2955c8) "' name='RPMH_PDC_MODEM_TCS1_CONTROL'/>"
WRITE #1 "        <register address='0xb295690' value='0x" DATA.LONG(A:0x295690) "' name='RPMH_PDC_MODEM_TCS2_CONTROL'/>"
WRITE #1 "        <register address='0xb295758' value='0x" DATA.LONG(A:0x295758) "' name='RPMH_PDC_MODEM_TCS3_CONTROL'/>"
WRITE #1 "        <register address='0xb295504' value='0x" DATA.LONG(A:0x295504) "' name='RPMH_PDC_MODEM_TCS0_CMD_ENABLE_BANK'/>"
WRITE #1 "        <register address='0xb2955cc' value='0x" DATA.LONG(A:0x2955cc) "' name='RPMH_PDC_MODEM_TCS1_CMD_ENABLE_BANK'/>"
WRITE #1 "        <register address='0xb295694' value='0x" DATA.LONG(A:0x295694) "' name='RPMH_PDC_MODEM_TCS2_CMD_ENABLE_BANK'/>"
WRITE #1 "        <register address='0xb29575c' value='0x" DATA.LONG(A:0x29575c) "' name='RPMH_PDC_MODEM_TCS3_CMD_ENABLE_BANK'/>"
WRITE #1 "        <register address='0xb295508' value='0x" DATA.LONG(A:0x295508) "' name='RPMH_PDC_MODEM_TCS0_CMD_WAIT_FOR_CMPL_BANK'/>"
WRITE #1 "        <register address='0xb2955d0' value='0x" DATA.LONG(A:0x2955d0) "' name='RPMH_PDC_MODEM_TCS1_CMD_WAIT_FOR_CMPL_BANK'/>"
WRITE #1 "        <register address='0xb295698' value='0x" DATA.LONG(A:0x295698) "' name='RPMH_PDC_MODEM_TCS2_CMD_WAIT_FOR_CMPL_BANK'/>"
WRITE #1 "        <register address='0xb295760' value='0x" DATA.LONG(A:0x295760) "' name='RPMH_PDC_MODEM_TCS3_CMD_WAIT_FOR_CMPL_BANK'/>"
WRITE #1 "        <register address='0xb29550c' value='0x" DATA.LONG(A:0x29550c) "' name='RPMH_PDC_MODEM_TCS0_CMD0_MSGID'/>"
WRITE #1 "        <register address='0xb29551c' value='0x" DATA.LONG(A:0x29551c) "' name='RPMH_PDC_MODEM_TCS0_CMD1_MSGID'/>"
WRITE #1 "        <register address='0xb29552c' value='0x" DATA.LONG(A:0x29552c) "' name='RPMH_PDC_MODEM_TCS0_CMD2_MSGID'/>"
WRITE #1 "        <register address='0xb29553c' value='0x" DATA.LONG(A:0x29553c) "' name='RPMH_PDC_MODEM_TCS0_CMD3_MSGID'/>"
WRITE #1 "        <register address='0xb2955d4' value='0x" DATA.LONG(A:0x2955d4) "' name='RPMH_PDC_MODEM_TCS1_CMD0_MSGID'/>"
WRITE #1 "        <register address='0xb2955e4' value='0x" DATA.LONG(A:0x2955e4) "' name='RPMH_PDC_MODEM_TCS1_CMD1_MSGID'/>"
WRITE #1 "        <register address='0xb2955f4' value='0x" DATA.LONG(A:0x2955f4) "' name='RPMH_PDC_MODEM_TCS1_CMD2_MSGID'/>"
WRITE #1 "        <register address='0xb295604' value='0x" DATA.LONG(A:0x295604) "' name='RPMH_PDC_MODEM_TCS1_CMD3_MSGID'/>"
WRITE #1 "        <register address='0xb29569c' value='0x" DATA.LONG(A:0x29569c) "' name='RPMH_PDC_MODEM_TCS2_CMD0_MSGID'/>"
WRITE #1 "        <register address='0xb2956ac' value='0x" DATA.LONG(A:0x2956ac) "' name='RPMH_PDC_MODEM_TCS2_CMD1_MSGID'/>"
WRITE #1 "        <register address='0xb2956bc' value='0x" DATA.LONG(A:0x2956bc) "' name='RPMH_PDC_MODEM_TCS2_CMD2_MSGID'/>"
WRITE #1 "        <register address='0xb2956cc' value='0x" DATA.LONG(A:0x2956cc) "' name='RPMH_PDC_MODEM_TCS2_CMD3_MSGID'/>"
WRITE #1 "        <register address='0xb295764' value='0x" DATA.LONG(A:0x295764) "' name='RPMH_PDC_MODEM_TCS3_CMD0_MSGID'/>"
WRITE #1 "        <register address='0xb295774' value='0x" DATA.LONG(A:0x295774) "' name='RPMH_PDC_MODEM_TCS3_CMD1_MSGID'/>"
WRITE #1 "        <register address='0xb295784' value='0x" DATA.LONG(A:0x295784) "' name='RPMH_PDC_MODEM_TCS3_CMD2_MSGID'/>"
WRITE #1 "        <register address='0xb295794' value='0x" DATA.LONG(A:0x295794) "' name='RPMH_PDC_MODEM_TCS3_CMD3_MSGID'/>"
WRITE #1 "        <register address='0xb295510' value='0x" DATA.LONG(A:0x295510) "' name='RPMH_PDC_MODEM_TCS0_CMD0_ADDR'/>"
WRITE #1 "        <register address='0xb295520' value='0x" DATA.LONG(A:0x295520) "' name='RPMH_PDC_MODEM_TCS0_CMD1_ADDR'/>"
WRITE #1 "        <register address='0xb295530' value='0x" DATA.LONG(A:0x295530) "' name='RPMH_PDC_MODEM_TCS0_CMD2_ADDR'/>"
WRITE #1 "        <register address='0xb295540' value='0x" DATA.LONG(A:0x295540) "' name='RPMH_PDC_MODEM_TCS0_CMD3_ADDR'/>"
WRITE #1 "        <register address='0xb2955d8' value='0x" DATA.LONG(A:0x2955d8) "' name='RPMH_PDC_MODEM_TCS1_CMD0_ADDR'/>"
WRITE #1 "        <register address='0xb2955e8' value='0x" DATA.LONG(A:0x2955e8) "' name='RPMH_PDC_MODEM_TCS1_CMD1_ADDR'/>"
WRITE #1 "        <register address='0xb2955f8' value='0x" DATA.LONG(A:0x2955f8) "' name='RPMH_PDC_MODEM_TCS1_CMD2_ADDR'/>"
WRITE #1 "        <register address='0xb295608' value='0x" DATA.LONG(A:0x295608) "' name='RPMH_PDC_MODEM_TCS1_CMD3_ADDR'/>"
WRITE #1 "        <register address='0xb2956a0' value='0x" DATA.LONG(A:0x2956a0) "' name='RPMH_PDC_MODEM_TCS2_CMD0_ADDR'/>"
WRITE #1 "        <register address='0xb2956b0' value='0x" DATA.LONG(A:0x2956b0) "' name='RPMH_PDC_MODEM_TCS2_CMD1_ADDR'/>"
WRITE #1 "        <register address='0xb2956c0' value='0x" DATA.LONG(A:0x2956c0) "' name='RPMH_PDC_MODEM_TCS2_CMD2_ADDR'/>"
WRITE #1 "        <register address='0xb2956d0' value='0x" DATA.LONG(A:0x2956d0) "' name='RPMH_PDC_MODEM_TCS2_CMD3_ADDR'/>"
WRITE #1 "        <register address='0xb295768' value='0x" DATA.LONG(A:0x295768) "' name='RPMH_PDC_MODEM_TCS3_CMD0_ADDR'/>"
WRITE #1 "        <register address='0xb295778' value='0x" DATA.LONG(A:0x295778) "' name='RPMH_PDC_MODEM_TCS3_CMD1_ADDR'/>"
WRITE #1 "        <register address='0xb295788' value='0x" DATA.LONG(A:0x295788) "' name='RPMH_PDC_MODEM_TCS3_CMD2_ADDR'/>"
WRITE #1 "        <register address='0xb295798' value='0x" DATA.LONG(A:0x295798) "' name='RPMH_PDC_MODEM_TCS3_CMD3_ADDR'/>"
WRITE #1 "        <register address='0xb295514' value='0x" DATA.LONG(A:0x295514) "' name='RPMH_PDC_MODEM_TCS0_CMD0_DATA'/>"
WRITE #1 "        <register address='0xb295524' value='0x" DATA.LONG(A:0x295524) "' name='RPMH_PDC_MODEM_TCS0_CMD1_DATA'/>"
WRITE #1 "        <register address='0xb295534' value='0x" DATA.LONG(A:0x295534) "' name='RPMH_PDC_MODEM_TCS0_CMD2_DATA'/>"
WRITE #1 "        <register address='0xb295544' value='0x" DATA.LONG(A:0x295544) "' name='RPMH_PDC_MODEM_TCS0_CMD3_DATA'/>"
WRITE #1 "        <register address='0xb2955dc' value='0x" DATA.LONG(A:0x2955dc) "' name='RPMH_PDC_MODEM_TCS1_CMD0_DATA'/>"
WRITE #1 "        <register address='0xb2955ec' value='0x" DATA.LONG(A:0x2955ec) "' name='RPMH_PDC_MODEM_TCS1_CMD1_DATA'/>"
WRITE #1 "        <register address='0xb2955fc' value='0x" DATA.LONG(A:0x2955fc) "' name='RPMH_PDC_MODEM_TCS1_CMD2_DATA'/>"
WRITE #1 "        <register address='0xb29560c' value='0x" DATA.LONG(A:0x29560c) "' name='RPMH_PDC_MODEM_TCS1_CMD3_DATA'/>"
WRITE #1 "        <register address='0xb2956a4' value='0x" DATA.LONG(A:0x2956a4) "' name='RPMH_PDC_MODEM_TCS2_CMD0_DATA'/>"
WRITE #1 "        <register address='0xb2956b4' value='0x" DATA.LONG(A:0x2956b4) "' name='RPMH_PDC_MODEM_TCS2_CMD1_DATA'/>"
WRITE #1 "        <register address='0xb2956c4' value='0x" DATA.LONG(A:0x2956c4) "' name='RPMH_PDC_MODEM_TCS2_CMD2_DATA'/>"
WRITE #1 "        <register address='0xb2956d4' value='0x" DATA.LONG(A:0x2956d4) "' name='RPMH_PDC_MODEM_TCS2_CMD3_DATA'/>"
WRITE #1 "        <register address='0xb29576c' value='0x" DATA.LONG(A:0x29576c) "' name='RPMH_PDC_MODEM_TCS3_CMD0_DATA'/>"
WRITE #1 "        <register address='0xb29577c' value='0x" DATA.LONG(A:0x29577c) "' name='RPMH_PDC_MODEM_TCS3_CMD1_DATA'/>"
WRITE #1 "        <register address='0xb29578c' value='0x" DATA.LONG(A:0x29578c) "' name='RPMH_PDC_MODEM_TCS3_CMD2_DATA'/>"
WRITE #1 "        <register address='0xb29579c' value='0x" DATA.LONG(A:0x29579c) "' name='RPMH_PDC_MODEM_TCS3_CMD3_DATA'/>"
WRITE #1 "        <register address='0xb2e0020' value='0x" DATA.LONG(A:0x2e0020) "' name='RPMH_PDC_APPS_PDC_RSC_DRV_ID0'/>"
WRITE #1 "        <register address='0xb2e0024' value='0x" DATA.LONG(A:0x2e0024) "' name='RPMH_PDC_APPS_PDC_RSC_DRV_ID1'/>"
WRITE #1 "        <register address='0xb2e0028' value='0x" DATA.LONG(A:0x2e0028) "' name='RPMH_PDC_APPS_PDC_RSC_DRV_ID2'/>"
WRITE #1 "        <register address='0xb2e0050' value='0x" DATA.LONG(A:0x2e0050) "' name='RPMH_PDC_AUDIO_SENSORS_PDC_RSC_DRV_ID0'/>"
WRITE #1 "        <register address='0xb2e0060' value='0x" DATA.LONG(A:0x2e0060) "' name='RPMH_PDC_AOP_PDC_RSC_DRV_ID0'/>"
WRITE #1 "        <register address='0xb2e0070' value='0x" DATA.LONG(A:0x2e0070) "' name='RPMH_PDC_DEBUG_PDC_RSC_DRV_ID0'/>"
WRITE #1 "        <register address='0xb2e0080' value='0x" DATA.LONG(A:0x2e0080) "' name='RPMH_PDC_GPU_PDC_RSC_DRV_ID0'/>"
WRITE #1 "        <register address='0xb2e0090' value='0x" DATA.LONG(A:0x2e0090) "' name='RPMH_PDC_DISPLAY_PDC_RSC_DRV_ID0'/>"
WRITE #1 "        <register address='0xb2e00a0' value='0x" DATA.LONG(A:0x2e00a0) "' name='RPMH_PDC_COMPUTE_PDC_RSC_DRV_ID0'/>"
WRITE #1 "        <register address='0xb2e00b0' value='0x" DATA.LONG(A:0x2e00b0) "' name='RPMH_PDC_MODEM_PDC_RSC_DRV_ID0'/>"
WRITE #1 "        <register address='0xb2e00b4' value='0x" DATA.LONG(A:0x2e00b4) "' name='RPMH_PDC_MODEM_PDC_RSC_DRV_ID1'/>"
WRITE #1 "        <register address='0xb2e0100' value='0x" DATA.LONG(A:0x2e0100) "' name='RPMH_PDC_SYNC_RESET'/>"
WRITE #1 "        <register address='0xb2e0140' value='0x" DATA.LONG(A:0x2e0140) "' name='RPMH_PDC_EPCB_TIMEOUT_THRESHOLD'/>"
WRITE #1 "        <register address='0xb2e0150' value='0x" DATA.LONG(A:0x2e0150) "' name='RPMH_PDC_EPCB_TIMEOUT_IRQ_EN_BANK0'/>"
WRITE #1 "        <register address='0xb2e0160' value='0x" DATA.LONG(A:0x2e0160) "' name='RPMH_PDC_EPCB_TIMEOUT_IRQ_STATUS_BANK0'/>"
WRITE #1 "        <register address='0xb2e0170' value='0x" DATA.LONG(A:0x2e0170) "' name='RPMH_PDC_EPCB_TIMEOUT_IRQ_CLEAR_BANK0'/>"
WRITE #1 "        <register address='0xb2e0200' value='0x" DATA.LONG(A:0x2e0200) "' name='RPMH_PDC_AOP_IRQ_EN_BANK0'/>"
WRITE #1 "        <register address='0xb2e0210' value='0x" DATA.LONG(A:0x2e0210) "' name='RPMH_PDC_AOP_IRQ_STATUS_BANK0'/>"
WRITE #1 "        <register address='0xb2e0214' value='0x" DATA.LONG(A:0x2e0214) "' name='RPMH_PDC_AOP_IRQ_RAW_STATUS_BANK0'/>"
WRITE #1 "        <register address='0xb2e0218' value='0x" DATA.LONG(A:0x2e0218) "' name='RPMH_PDC_AOP_IRQ_CLEAR_BANK0'/>"
WRITE #1 "        <register address='0xb2e0220' value='0x" DATA.LONG(A:0x2e0220) "' name='RPMH_PDC_AOP_SEQ_RESUME_BANK0'/>"
WRITE #1 "        <register address='0xb2e0230' value='0x" DATA.LONG(A:0x2e0230) "' name='RPMH_PDC_AOP_SEQ_RESUME_ONCE_BANK0'/>"
WRITE #1 "        <register address='0xb2e0300' value='0x" DATA.LONG(A:0x2e0300) "' name='RPMH_PDC_SOC_SLEEP_LOCK_MASK_BANK0'/>"
WRITE #1 "        <register address='0xb2e0310' value='0x" DATA.LONG(A:0x2e0310) "' name='RPMH_PDC_SOC_SLEEP_LOCK_STATUS_BANK0'/>"
WRITE #1 "        <register address='0xb2e0320' value='0x" DATA.LONG(A:0x2e0320) "' name='RPMH_PDC_CX_COLLAPSE_LOCK_MASK_BANK0'/>"
WRITE #1 "        <register address='0xb2e0330' value='0x" DATA.LONG(A:0x2e0330) "' name='RPMH_PDC_CX_COLLAPSE_LOCK_STATUS_BANK0'/>"
WRITE #1 "        <register address='0xb2e0340' value='0x" DATA.LONG(A:0x2e0340) "' name='RPMH_PDC_DBG_RSRC_REL_LOCK_MASK_BANK0'/>"
WRITE #1 "        <register address='0xb2e0350' value='0x" DATA.LONG(A:0x2e0350) "' name='RPMH_PDC_DBG_RSRC_REL_LOCK_STATUS_BANK0'/>"
WRITE #1 "        <register address='0xb2e0400' value='0x" DATA.LONG(A:0x2e0400) "' name='RPMH_PDC_DBG_BUS_CONTROL'/>"
WRITE #1 "        <register address='0xb400000' value='0x" DATA.LONG(A:0x400000) "' name='RPMH_PDC_APPS_SEQ_MEM_0'/>"
WRITE #1 "        <register address='0xb400004' value='0x" DATA.LONG(A:0x400004) "' name='RPMH_PDC_APPS_SEQ_MEM_1'/>"
WRITE #1 "        <register address='0xb400008' value='0x" DATA.LONG(A:0x400008) "' name='RPMH_PDC_APPS_SEQ_MEM_2'/>"
WRITE #1 "        <register address='0xb40000c' value='0x" DATA.LONG(A:0x40000c) "' name='RPMH_PDC_APPS_SEQ_MEM_3'/>"
WRITE #1 "        <register address='0xb400010' value='0x" DATA.LONG(A:0x400010) "' name='RPMH_PDC_APPS_SEQ_MEM_4'/>"
WRITE #1 "        <register address='0xb400014' value='0x" DATA.LONG(A:0x400014) "' name='RPMH_PDC_APPS_SEQ_MEM_5'/>"
WRITE #1 "        <register address='0xb400018' value='0x" DATA.LONG(A:0x400018) "' name='RPMH_PDC_APPS_SEQ_MEM_6'/>"
WRITE #1 "        <register address='0xb40001c' value='0x" DATA.LONG(A:0x40001c) "' name='RPMH_PDC_APPS_SEQ_MEM_7'/>"
WRITE #1 "        <register address='0xb400020' value='0x" DATA.LONG(A:0x400020) "' name='RPMH_PDC_APPS_SEQ_MEM_8'/>"
WRITE #1 "        <register address='0xb400024' value='0x" DATA.LONG(A:0x400024) "' name='RPMH_PDC_APPS_SEQ_MEM_9'/>"
WRITE #1 "        <register address='0xb400028' value='0x" DATA.LONG(A:0x400028) "' name='RPMH_PDC_APPS_SEQ_MEM_10'/>"
WRITE #1 "        <register address='0xb40002c' value='0x" DATA.LONG(A:0x40002c) "' name='RPMH_PDC_APPS_SEQ_MEM_11'/>"
WRITE #1 "        <register address='0xb400030' value='0x" DATA.LONG(A:0x400030) "' name='RPMH_PDC_APPS_SEQ_MEM_12'/>"
WRITE #1 "        <register address='0xb400034' value='0x" DATA.LONG(A:0x400034) "' name='RPMH_PDC_APPS_SEQ_MEM_13'/>"
WRITE #1 "        <register address='0xb400038' value='0x" DATA.LONG(A:0x400038) "' name='RPMH_PDC_APPS_SEQ_MEM_14'/>"
WRITE #1 "        <register address='0xb40003c' value='0x" DATA.LONG(A:0x40003c) "' name='RPMH_PDC_APPS_SEQ_MEM_15'/>"
WRITE #1 "        <register address='0xb400040' value='0x" DATA.LONG(A:0x400040) "' name='RPMH_PDC_APPS_SEQ_MEM_16'/>"
WRITE #1 "        <register address='0xb400044' value='0x" DATA.LONG(A:0x400044) "' name='RPMH_PDC_APPS_SEQ_MEM_17'/>"
WRITE #1 "        <register address='0xb400048' value='0x" DATA.LONG(A:0x400048) "' name='RPMH_PDC_APPS_SEQ_MEM_18'/>"
WRITE #1 "        <register address='0xb40004c' value='0x" DATA.LONG(A:0x40004c) "' name='RPMH_PDC_APPS_SEQ_MEM_19'/>"
WRITE #1 "        <register address='0xb430000' value='0x" DATA.LONG(A:0x430000) "' name='RPMH_PDC_AUDIO_SENSORS_SEQ_MEM_0'/>"
WRITE #1 "        <register address='0xb430004' value='0x" DATA.LONG(A:0x430004) "' name='RPMH_PDC_AUDIO_SENSORS_SEQ_MEM_1'/>"
WRITE #1 "        <register address='0xb430008' value='0x" DATA.LONG(A:0x430008) "' name='RPMH_PDC_AUDIO_SENSORS_SEQ_MEM_2'/>"
WRITE #1 "        <register address='0xb43000c' value='0x" DATA.LONG(A:0x43000c) "' name='RPMH_PDC_AUDIO_SENSORS_SEQ_MEM_3'/>"
WRITE #1 "        <register address='0xb430010' value='0x" DATA.LONG(A:0x430010) "' name='RPMH_PDC_AUDIO_SENSORS_SEQ_MEM_4'/>"
WRITE #1 "        <register address='0xb430014' value='0x" DATA.LONG(A:0x430014) "' name='RPMH_PDC_AUDIO_SENSORS_SEQ_MEM_5'/>"
WRITE #1 "        <register address='0xb430018' value='0x" DATA.LONG(A:0x430018) "' name='RPMH_PDC_AUDIO_SENSORS_SEQ_MEM_6'/>"
WRITE #1 "        <register address='0xb43001c' value='0x" DATA.LONG(A:0x43001c) "' name='RPMH_PDC_AUDIO_SENSORS_SEQ_MEM_7'/>"
WRITE #1 "        <register address='0xb430020' value='0x" DATA.LONG(A:0x430020) "' name='RPMH_PDC_AUDIO_SENSORS_SEQ_MEM_8'/>"
WRITE #1 "        <register address='0xb430024' value='0x" DATA.LONG(A:0x430024) "' name='RPMH_PDC_AUDIO_SENSORS_SEQ_MEM_9'/>"
WRITE #1 "        <register address='0xb430028' value='0x" DATA.LONG(A:0x430028) "' name='RPMH_PDC_AUDIO_SENSORS_SEQ_MEM_10'/>"
WRITE #1 "        <register address='0xb43002c' value='0x" DATA.LONG(A:0x43002c) "' name='RPMH_PDC_AUDIO_SENSORS_SEQ_MEM_11'/>"
WRITE #1 "        <register address='0xb430030' value='0x" DATA.LONG(A:0x430030) "' name='RPMH_PDC_AUDIO_SENSORS_SEQ_MEM_12'/>"
WRITE #1 "        <register address='0xb430034' value='0x" DATA.LONG(A:0x430034) "' name='RPMH_PDC_AUDIO_SENSORS_SEQ_MEM_13'/>"
WRITE #1 "        <register address='0xb430038' value='0x" DATA.LONG(A:0x430038) "' name='RPMH_PDC_AUDIO_SENSORS_SEQ_MEM_14'/>"
WRITE #1 "        <register address='0xb43003c' value='0x" DATA.LONG(A:0x43003c) "' name='RPMH_PDC_AUDIO_SENSORS_SEQ_MEM_15'/>"
WRITE #1 "        <register address='0xb430040' value='0x" DATA.LONG(A:0x430040) "' name='RPMH_PDC_AUDIO_SENSORS_SEQ_MEM_16'/>"
WRITE #1 "        <register address='0xb430044' value='0x" DATA.LONG(A:0x430044) "' name='RPMH_PDC_AUDIO_SENSORS_SEQ_MEM_17'/>"
WRITE #1 "        <register address='0xb430048' value='0x" DATA.LONG(A:0x430048) "' name='RPMH_PDC_AUDIO_SENSORS_SEQ_MEM_18'/>"
WRITE #1 "        <register address='0xb43004c' value='0x" DATA.LONG(A:0x43004c) "' name='RPMH_PDC_AUDIO_SENSORS_SEQ_MEM_19'/>"
WRITE #1 "        <register address='0xb440000' value='0x" DATA.LONG(A:0x440000) "' name='RPMH_PDC_AOP_SEQ_MEM_0'/>"
WRITE #1 "        <register address='0xb440004' value='0x" DATA.LONG(A:0x440004) "' name='RPMH_PDC_AOP_SEQ_MEM_1'/>"
WRITE #1 "        <register address='0xb440008' value='0x" DATA.LONG(A:0x440008) "' name='RPMH_PDC_AOP_SEQ_MEM_2'/>"
WRITE #1 "        <register address='0xb44000c' value='0x" DATA.LONG(A:0x44000c) "' name='RPMH_PDC_AOP_SEQ_MEM_3'/>"
WRITE #1 "        <register address='0xb440010' value='0x" DATA.LONG(A:0x440010) "' name='RPMH_PDC_AOP_SEQ_MEM_4'/>"
WRITE #1 "        <register address='0xb440014' value='0x" DATA.LONG(A:0x440014) "' name='RPMH_PDC_AOP_SEQ_MEM_5'/>"
WRITE #1 "        <register address='0xb440018' value='0x" DATA.LONG(A:0x440018) "' name='RPMH_PDC_AOP_SEQ_MEM_6'/>"
WRITE #1 "        <register address='0xb44001c' value='0x" DATA.LONG(A:0x44001c) "' name='RPMH_PDC_AOP_SEQ_MEM_7'/>"
WRITE #1 "        <register address='0xb440020' value='0x" DATA.LONG(A:0x440020) "' name='RPMH_PDC_AOP_SEQ_MEM_8'/>"
WRITE #1 "        <register address='0xb440024' value='0x" DATA.LONG(A:0x440024) "' name='RPMH_PDC_AOP_SEQ_MEM_9'/>"
WRITE #1 "        <register address='0xb440028' value='0x" DATA.LONG(A:0x440028) "' name='RPMH_PDC_AOP_SEQ_MEM_10'/>"
WRITE #1 "        <register address='0xb44002c' value='0x" DATA.LONG(A:0x44002c) "' name='RPMH_PDC_AOP_SEQ_MEM_11'/>"
WRITE #1 "        <register address='0xb440030' value='0x" DATA.LONG(A:0x440030) "' name='RPMH_PDC_AOP_SEQ_MEM_12'/>"
WRITE #1 "        <register address='0xb440034' value='0x" DATA.LONG(A:0x440034) "' name='RPMH_PDC_AOP_SEQ_MEM_13'/>"
WRITE #1 "        <register address='0xb450000' value='0x" DATA.LONG(A:0x450000) "' name='RPMH_PDC_DEBUG_SEQ_MEM_0'/>"
WRITE #1 "        <register address='0xb450004' value='0x" DATA.LONG(A:0x450004) "' name='RPMH_PDC_DEBUG_SEQ_MEM_1'/>"
WRITE #1 "        <register address='0xb450008' value='0x" DATA.LONG(A:0x450008) "' name='RPMH_PDC_DEBUG_SEQ_MEM_2'/>"
WRITE #1 "        <register address='0xb45000c' value='0x" DATA.LONG(A:0x45000c) "' name='RPMH_PDC_DEBUG_SEQ_MEM_3'/>"
WRITE #1 "        <register address='0xb450010' value='0x" DATA.LONG(A:0x450010) "' name='RPMH_PDC_DEBUG_SEQ_MEM_4'/>"
WRITE #1 "        <register address='0xb450014' value='0x" DATA.LONG(A:0x450014) "' name='RPMH_PDC_DEBUG_SEQ_MEM_5'/>"
WRITE #1 "        <register address='0xb450018' value='0x" DATA.LONG(A:0x450018) "' name='RPMH_PDC_DEBUG_SEQ_MEM_6'/>"
WRITE #1 "        <register address='0xb45001c' value='0x" DATA.LONG(A:0x45001c) "' name='RPMH_PDC_DEBUG_SEQ_MEM_7'/>"
WRITE #1 "        <register address='0xb450020' value='0x" DATA.LONG(A:0x450020) "' name='RPMH_PDC_DEBUG_SEQ_MEM_8'/>"
WRITE #1 "        <register address='0xb450024' value='0x" DATA.LONG(A:0x450024) "' name='RPMH_PDC_DEBUG_SEQ_MEM_9'/>"
WRITE #1 "        <register address='0xb450028' value='0x" DATA.LONG(A:0x450028) "' name='RPMH_PDC_DEBUG_SEQ_MEM_10'/>"
WRITE #1 "        <register address='0xb45002c' value='0x" DATA.LONG(A:0x45002c) "' name='RPMH_PDC_DEBUG_SEQ_MEM_11'/>"
WRITE #1 "        <register address='0xb450030' value='0x" DATA.LONG(A:0x450030) "' name='RPMH_PDC_DEBUG_SEQ_MEM_12'/>"
WRITE #1 "        <register address='0xb450034' value='0x" DATA.LONG(A:0x450034) "' name='RPMH_PDC_DEBUG_SEQ_MEM_13'/>"
WRITE #1 "        <register address='0xb450038' value='0x" DATA.LONG(A:0x450038) "' name='RPMH_PDC_DEBUG_SEQ_MEM_14'/>"
WRITE #1 "        <register address='0xb45003c' value='0x" DATA.LONG(A:0x45003c) "' name='RPMH_PDC_DEBUG_SEQ_MEM_15'/>"
WRITE #1 "        <register address='0xb450040' value='0x" DATA.LONG(A:0x450040) "' name='RPMH_PDC_DEBUG_SEQ_MEM_16'/>"
WRITE #1 "        <register address='0xb450044' value='0x" DATA.LONG(A:0x450044) "' name='RPMH_PDC_DEBUG_SEQ_MEM_17'/>"
WRITE #1 "        <register address='0xb450048' value='0x" DATA.LONG(A:0x450048) "' name='RPMH_PDC_DEBUG_SEQ_MEM_18'/>"
WRITE #1 "        <register address='0xb45004c' value='0x" DATA.LONG(A:0x45004c) "' name='RPMH_PDC_DEBUG_SEQ_MEM_19'/>"
WRITE #1 "        <register address='0xb460000' value='0x" DATA.LONG(A:0x460000) "' name='RPMH_PDC_GPU_SEQ_MEM_0'/>"
WRITE #1 "        <register address='0xb460004' value='0x" DATA.LONG(A:0x460004) "' name='RPMH_PDC_GPU_SEQ_MEM_1'/>"
WRITE #1 "        <register address='0xb460008' value='0x" DATA.LONG(A:0x460008) "' name='RPMH_PDC_GPU_SEQ_MEM_2'/>"
WRITE #1 "        <register address='0xb46000c' value='0x" DATA.LONG(A:0x46000c) "' name='RPMH_PDC_GPU_SEQ_MEM_3'/>"
WRITE #1 "        <register address='0xb460010' value='0x" DATA.LONG(A:0x460010) "' name='RPMH_PDC_GPU_SEQ_MEM_4'/>"
WRITE #1 "        <register address='0xb460014' value='0x" DATA.LONG(A:0x460014) "' name='RPMH_PDC_GPU_SEQ_MEM_5'/>"
WRITE #1 "        <register address='0xb460018' value='0x" DATA.LONG(A:0x460018) "' name='RPMH_PDC_GPU_SEQ_MEM_6'/>"
WRITE #1 "        <register address='0xb46001c' value='0x" DATA.LONG(A:0x46001c) "' name='RPMH_PDC_GPU_SEQ_MEM_7'/>"
WRITE #1 "        <register address='0xb460020' value='0x" DATA.LONG(A:0x460020) "' name='RPMH_PDC_GPU_SEQ_MEM_8'/>"
WRITE #1 "        <register address='0xb460024' value='0x" DATA.LONG(A:0x460024) "' name='RPMH_PDC_GPU_SEQ_MEM_9'/>"
WRITE #1 "        <register address='0xb460028' value='0x" DATA.LONG(A:0x460028) "' name='RPMH_PDC_GPU_SEQ_MEM_10'/>"
WRITE #1 "        <register address='0xb46002c' value='0x" DATA.LONG(A:0x46002c) "' name='RPMH_PDC_GPU_SEQ_MEM_11'/>"
WRITE #1 "        <register address='0xb460030' value='0x" DATA.LONG(A:0x460030) "' name='RPMH_PDC_GPU_SEQ_MEM_12'/>"
WRITE #1 "        <register address='0xb460034' value='0x" DATA.LONG(A:0x460034) "' name='RPMH_PDC_GPU_SEQ_MEM_13'/>"
WRITE #1 "        <register address='0xb460038' value='0x" DATA.LONG(A:0x460038) "' name='RPMH_PDC_GPU_SEQ_MEM_14'/>"
WRITE #1 "        <register address='0xb46003c' value='0x" DATA.LONG(A:0x46003c) "' name='RPMH_PDC_GPU_SEQ_MEM_15'/>"
WRITE #1 "        <register address='0xb470000' value='0x" DATA.LONG(A:0x470000) "' name='RPMH_PDC_DISPLAY_SEQ_MEM_0'/>"
WRITE #1 "        <register address='0xb470004' value='0x" DATA.LONG(A:0x470004) "' name='RPMH_PDC_DISPLAY_SEQ_MEM_1'/>"
WRITE #1 "        <register address='0xb470008' value='0x" DATA.LONG(A:0x470008) "' name='RPMH_PDC_DISPLAY_SEQ_MEM_2'/>"
WRITE #1 "        <register address='0xb47000c' value='0x" DATA.LONG(A:0x47000c) "' name='RPMH_PDC_DISPLAY_SEQ_MEM_3'/>"
WRITE #1 "        <register address='0xb470010' value='0x" DATA.LONG(A:0x470010) "' name='RPMH_PDC_DISPLAY_SEQ_MEM_4'/>"
WRITE #1 "        <register address='0xb470014' value='0x" DATA.LONG(A:0x470014) "' name='RPMH_PDC_DISPLAY_SEQ_MEM_5'/>"
WRITE #1 "        <register address='0xb470018' value='0x" DATA.LONG(A:0x470018) "' name='RPMH_PDC_DISPLAY_SEQ_MEM_6'/>"
WRITE #1 "        <register address='0xb47001c' value='0x" DATA.LONG(A:0x47001c) "' name='RPMH_PDC_DISPLAY_SEQ_MEM_7'/>"
WRITE #1 "        <register address='0xb470020' value='0x" DATA.LONG(A:0x470020) "' name='RPMH_PDC_DISPLAY_SEQ_MEM_8'/>"
WRITE #1 "        <register address='0xb470024' value='0x" DATA.LONG(A:0x470024) "' name='RPMH_PDC_DISPLAY_SEQ_MEM_9'/>"
WRITE #1 "        <register address='0xb470028' value='0x" DATA.LONG(A:0x470028) "' name='RPMH_PDC_DISPLAY_SEQ_MEM_10'/>"
WRITE #1 "        <register address='0xb47002c' value='0x" DATA.LONG(A:0x47002c) "' name='RPMH_PDC_DISPLAY_SEQ_MEM_11'/>"
WRITE #1 "        <register address='0xb470030' value='0x" DATA.LONG(A:0x470030) "' name='RPMH_PDC_DISPLAY_SEQ_MEM_12'/>"
WRITE #1 "        <register address='0xb470034' value='0x" DATA.LONG(A:0x470034) "' name='RPMH_PDC_DISPLAY_SEQ_MEM_13'/>"
WRITE #1 "        <register address='0xb470038' value='0x" DATA.LONG(A:0x470038) "' name='RPMH_PDC_DISPLAY_SEQ_MEM_14'/>"
WRITE #1 "        <register address='0xb47003c' value='0x" DATA.LONG(A:0x47003c) "' name='RPMH_PDC_DISPLAY_SEQ_MEM_15'/>"
WRITE #1 "        <register address='0xb480000' value='0x" DATA.LONG(A:0x480000) "' name='RPMH_PDC_COMPUTE_SEQ_MEM_0'/>"
WRITE #1 "        <register address='0xb480004' value='0x" DATA.LONG(A:0x480004) "' name='RPMH_PDC_COMPUTE_SEQ_MEM_1'/>"
WRITE #1 "        <register address='0xb480008' value='0x" DATA.LONG(A:0x480008) "' name='RPMH_PDC_COMPUTE_SEQ_MEM_2'/>"
WRITE #1 "        <register address='0xb48000c' value='0x" DATA.LONG(A:0x48000c) "' name='RPMH_PDC_COMPUTE_SEQ_MEM_3'/>"
WRITE #1 "        <register address='0xb480010' value='0x" DATA.LONG(A:0x480010) "' name='RPMH_PDC_COMPUTE_SEQ_MEM_4'/>"
WRITE #1 "        <register address='0xb480014' value='0x" DATA.LONG(A:0x480014) "' name='RPMH_PDC_COMPUTE_SEQ_MEM_5'/>"
WRITE #1 "        <register address='0xb480018' value='0x" DATA.LONG(A:0x480018) "' name='RPMH_PDC_COMPUTE_SEQ_MEM_6'/>"
WRITE #1 "        <register address='0xb48001c' value='0x" DATA.LONG(A:0x48001c) "' name='RPMH_PDC_COMPUTE_SEQ_MEM_7'/>"
WRITE #1 "        <register address='0xb480020' value='0x" DATA.LONG(A:0x480020) "' name='RPMH_PDC_COMPUTE_SEQ_MEM_8'/>"
WRITE #1 "        <register address='0xb480024' value='0x" DATA.LONG(A:0x480024) "' name='RPMH_PDC_COMPUTE_SEQ_MEM_9'/>"
WRITE #1 "        <register address='0xb480028' value='0x" DATA.LONG(A:0x480028) "' name='RPMH_PDC_COMPUTE_SEQ_MEM_10'/>"
WRITE #1 "        <register address='0xb48002c' value='0x" DATA.LONG(A:0x48002c) "' name='RPMH_PDC_COMPUTE_SEQ_MEM_11'/>"
WRITE #1 "        <register address='0xb480030' value='0x" DATA.LONG(A:0x480030) "' name='RPMH_PDC_COMPUTE_SEQ_MEM_12'/>"
WRITE #1 "        <register address='0xb480034' value='0x" DATA.LONG(A:0x480034) "' name='RPMH_PDC_COMPUTE_SEQ_MEM_13'/>"
WRITE #1 "        <register address='0xb480038' value='0x" DATA.LONG(A:0x480038) "' name='RPMH_PDC_COMPUTE_SEQ_MEM_14'/>"
WRITE #1 "        <register address='0xb48003c' value='0x" DATA.LONG(A:0x48003c) "' name='RPMH_PDC_COMPUTE_SEQ_MEM_15'/>"
WRITE #1 "        <register address='0xb490000' value='0x" DATA.LONG(A:0x490000) "' name='RPMH_PDC_MODEM_SEQ_MEM_0'/>"
WRITE #1 "        <register address='0xb490004' value='0x" DATA.LONG(A:0x490004) "' name='RPMH_PDC_MODEM_SEQ_MEM_1'/>"
WRITE #1 "        <register address='0xb490008' value='0x" DATA.LONG(A:0x490008) "' name='RPMH_PDC_MODEM_SEQ_MEM_2'/>"
WRITE #1 "        <register address='0xb49000c' value='0x" DATA.LONG(A:0x49000c) "' name='RPMH_PDC_MODEM_SEQ_MEM_3'/>"
WRITE #1 "        <register address='0xb490010' value='0x" DATA.LONG(A:0x490010) "' name='RPMH_PDC_MODEM_SEQ_MEM_4'/>"
WRITE #1 "        <register address='0xb490014' value='0x" DATA.LONG(A:0x490014) "' name='RPMH_PDC_MODEM_SEQ_MEM_5'/>"
WRITE #1 "        <register address='0xb490018' value='0x" DATA.LONG(A:0x490018) "' name='RPMH_PDC_MODEM_SEQ_MEM_6'/>"
WRITE #1 "        <register address='0xb49001c' value='0x" DATA.LONG(A:0x49001c) "' name='RPMH_PDC_MODEM_SEQ_MEM_7'/>"
WRITE #1 "        <register address='0xb490020' value='0x" DATA.LONG(A:0x490020) "' name='RPMH_PDC_MODEM_SEQ_MEM_8'/>"
WRITE #1 "        <register address='0xb490024' value='0x" DATA.LONG(A:0x490024) "' name='RPMH_PDC_MODEM_SEQ_MEM_9'/>"
WRITE #1 "        <register address='0xb490028' value='0x" DATA.LONG(A:0x490028) "' name='RPMH_PDC_MODEM_SEQ_MEM_10'/>"
WRITE #1 "        <register address='0xb49002c' value='0x" DATA.LONG(A:0x49002c) "' name='RPMH_PDC_MODEM_SEQ_MEM_11'/>"
WRITE #1 "        <register address='0xb490030' value='0x" DATA.LONG(A:0x490030) "' name='RPMH_PDC_MODEM_SEQ_MEM_12'/>"
WRITE #1 "        <register address='0xb490034' value='0x" DATA.LONG(A:0x490034) "' name='RPMH_PDC_MODEM_SEQ_MEM_13'/>"
WRITE #1 "        <register address='0xb490038' value='0x" DATA.LONG(A:0x490038) "' name='RPMH_PDC_MODEM_SEQ_MEM_14'/>"
WRITE #1 "        <register address='0xb49003c' value='0x" DATA.LONG(A:0x49003c) "' name='RPMH_PDC_MODEM_SEQ_MEM_15'/>"
WRITE #1 "        <register address='0xb490040' value='0x" DATA.LONG(A:0x490040) "' name='RPMH_PDC_MODEM_SEQ_MEM_16'/>"
WRITE #1 "        <register address='0xb490044' value='0x" DATA.LONG(A:0x490044) "' name='RPMH_PDC_MODEM_SEQ_MEM_17'/>"
WRITE #1 "        <register address='0xb490048' value='0x" DATA.LONG(A:0x490048) "' name='RPMH_PDC_MODEM_SEQ_MEM_18'/>"
WRITE #1 "        <register address='0xb49004c' value='0x" DATA.LONG(A:0x49004c) "' name='RPMH_PDC_MODEM_SEQ_MEM_19'/>"
WRITE #1 "        <register address='0xb800000' value='0x" DATA.LONG(A:0x800000) "' name='RPMH_VRM_VOLTAGE_VOTE_DRV0_REG0'/>"
WRITE #1 "        <register address='0xb800100' value='0x" DATA.LONG(A:0x800100) "' name='RPMH_VRM_VOLTAGE_VOTE_DRV0_REG1'/>"
WRITE #1 "        <register address='0xb800200' value='0x" DATA.LONG(A:0x800200) "' name='RPMH_VRM_VOLTAGE_VOTE_DRV0_REG2'/>"
WRITE #1 "        <register address='0xb800300' value='0x" DATA.LONG(A:0x800300) "' name='RPMH_VRM_VOLTAGE_VOTE_DRV0_REG3'/>"
WRITE #1 "        <register address='0xb800400' value='0x" DATA.LONG(A:0x800400) "' name='RPMH_VRM_VOLTAGE_VOTE_DRV0_REG4'/>"
WRITE #1 "        <register address='0xb800500' value='0x" DATA.LONG(A:0x800500) "' name='RPMH_VRM_VOLTAGE_VOTE_DRV0_REG5'/>"
WRITE #1 "        <register address='0xb800600' value='0x" DATA.LONG(A:0x800600) "' name='RPMH_VRM_VOLTAGE_VOTE_DRV0_REG6'/>"
WRITE #1 "        <register address='0xb800700' value='0x" DATA.LONG(A:0x800700) "' name='RPMH_VRM_VOLTAGE_VOTE_DRV0_REG7'/>"
WRITE #1 "        <register address='0xb800800' value='0x" DATA.LONG(A:0x800800) "' name='RPMH_VRM_VOLTAGE_VOTE_DRV0_REG8'/>"
WRITE #1 "        <register address='0xb800900' value='0x" DATA.LONG(A:0x800900) "' name='RPMH_VRM_VOLTAGE_VOTE_DRV0_REG9'/>"
WRITE #1 "        <register address='0xb800a00' value='0x" DATA.LONG(A:0x800a00) "' name='RPMH_VRM_VOLTAGE_VOTE_DRV0_REG10'/>"
WRITE #1 "        <register address='0xb800b00' value='0x" DATA.LONG(A:0x800b00) "' name='RPMH_VRM_VOLTAGE_VOTE_DRV0_REG11'/>"
WRITE #1 "        <register address='0xb800c00' value='0x" DATA.LONG(A:0x800c00) "' name='RPMH_VRM_VOLTAGE_VOTE_DRV0_REG12'/>"
WRITE #1 "        <register address='0xb800d00' value='0x" DATA.LONG(A:0x800d00) "' name='RPMH_VRM_VOLTAGE_VOTE_DRV0_REG13'/>"
WRITE #1 "        <register address='0xb800e00' value='0x" DATA.LONG(A:0x800e00) "' name='RPMH_VRM_VOLTAGE_VOTE_DRV0_REG14'/>"
WRITE #1 "        <register address='0xb800f00' value='0x" DATA.LONG(A:0x800f00) "' name='RPMH_VRM_VOLTAGE_VOTE_DRV0_REG15'/>"
WRITE #1 "        <register address='0xb801000' value='0x" DATA.LONG(A:0x801000) "' name='RPMH_VRM_VOLTAGE_VOTE_DRV0_REG16'/>"
WRITE #1 "        <register address='0xb801100' value='0x" DATA.LONG(A:0x801100) "' name='RPMH_VRM_VOLTAGE_VOTE_DRV0_REG17'/>"
WRITE #1 "        <register address='0xb801200' value='0x" DATA.LONG(A:0x801200) "' name='RPMH_VRM_VOLTAGE_VOTE_DRV0_REG18'/>"
WRITE #1 "        <register address='0xb801300' value='0x" DATA.LONG(A:0x801300) "' name='RPMH_VRM_VOLTAGE_VOTE_DRV0_REG19'/>"
WRITE #1 "        <register address='0xb801400' value='0x" DATA.LONG(A:0x801400) "' name='RPMH_VRM_VOLTAGE_VOTE_DRV0_REG20'/>"
WRITE #1 "        <register address='0xb801500' value='0x" DATA.LONG(A:0x801500) "' name='RPMH_VRM_VOLTAGE_VOTE_DRV0_REG21'/>"
WRITE #1 "        <register address='0xb801600' value='0x" DATA.LONG(A:0x801600) "' name='RPMH_VRM_VOLTAGE_VOTE_DRV0_REG22'/>"
WRITE #1 "        <register address='0xb801700' value='0x" DATA.LONG(A:0x801700) "' name='RPMH_VRM_VOLTAGE_VOTE_DRV0_REG23'/>"
WRITE #1 "        <register address='0xb801800' value='0x" DATA.LONG(A:0x801800) "' name='RPMH_VRM_VOLTAGE_VOTE_DRV0_REG24'/>"
WRITE #1 "        <register address='0xb801900' value='0x" DATA.LONG(A:0x801900) "' name='RPMH_VRM_VOLTAGE_VOTE_DRV0_REG25'/>"
WRITE #1 "        <register address='0xb801a00' value='0x" DATA.LONG(A:0x801a00) "' name='RPMH_VRM_VOLTAGE_VOTE_DRV0_REG26'/>"
WRITE #1 "        <register address='0xb801b00' value='0x" DATA.LONG(A:0x801b00) "' name='RPMH_VRM_VOLTAGE_VOTE_DRV0_REG27'/>"
WRITE #1 "        <register address='0xb801c00' value='0x" DATA.LONG(A:0x801c00) "' name='RPMH_VRM_VOLTAGE_VOTE_DRV0_REG28'/>"
WRITE #1 "        <register address='0xb801d00' value='0x" DATA.LONG(A:0x801d00) "' name='RPMH_VRM_VOLTAGE_VOTE_DRV0_REG29'/>"
WRITE #1 "        <register address='0xb801e00' value='0x" DATA.LONG(A:0x801e00) "' name='RPMH_VRM_VOLTAGE_VOTE_DRV0_REG30'/>"
WRITE #1 "        <register address='0xb801f00' value='0x" DATA.LONG(A:0x801f00) "' name='RPMH_VRM_VOLTAGE_VOTE_DRV0_REG31'/>"
WRITE #1 "        <register address='0xb802000' value='0x" DATA.LONG(A:0x802000) "' name='RPMH_VRM_VOLTAGE_VOTE_DRV0_REG32'/>"
WRITE #1 "        <register address='0xb802100' value='0x" DATA.LONG(A:0x802100) "' name='RPMH_VRM_VOLTAGE_VOTE_DRV0_REG33'/>"
WRITE #1 "        <register address='0xb802200' value='0x" DATA.LONG(A:0x802200) "' name='RPMH_VRM_VOLTAGE_VOTE_DRV0_REG34'/>"
WRITE #1 "        <register address='0xb802300' value='0x" DATA.LONG(A:0x802300) "' name='RPMH_VRM_VOLTAGE_VOTE_DRV0_REG35'/>"
WRITE #1 "        <register address='0xb802400' value='0x" DATA.LONG(A:0x802400) "' name='RPMH_VRM_VOLTAGE_VOTE_DRV0_REG36'/>"
WRITE #1 "        <register address='0xb802500' value='0x" DATA.LONG(A:0x802500) "' name='RPMH_VRM_VOLTAGE_VOTE_DRV0_REG37'/>"
WRITE #1 "        <register address='0xb802600' value='0x" DATA.LONG(A:0x802600) "' name='RPMH_VRM_VOLTAGE_VOTE_DRV0_REG38'/>"
WRITE #1 "        <register address='0xb802700' value='0x" DATA.LONG(A:0x802700) "' name='RPMH_VRM_VOLTAGE_VOTE_DRV0_REG39'/>"
WRITE #1 "        <register address='0xb802800' value='0x" DATA.LONG(A:0x802800) "' name='RPMH_VRM_VOLTAGE_VOTE_DRV0_REG40'/>"
WRITE #1 "        <register address='0xb802900' value='0x" DATA.LONG(A:0x802900) "' name='RPMH_VRM_VOLTAGE_VOTE_DRV0_REG41'/>"
WRITE #1 "        <register address='0xb802a00' value='0x" DATA.LONG(A:0x802a00) "' name='RPMH_VRM_VOLTAGE_VOTE_DRV0_REG42'/>"
WRITE #1 "        <register address='0xb802b00' value='0x" DATA.LONG(A:0x802b00) "' name='RPMH_VRM_VOLTAGE_VOTE_DRV0_REG43'/>"
WRITE #1 "        <register address='0xb802c00' value='0x" DATA.LONG(A:0x802c00) "' name='RPMH_VRM_VOLTAGE_VOTE_DRV0_REG44'/>"
WRITE #1 "        <register address='0xb802d00' value='0x" DATA.LONG(A:0x802d00) "' name='RPMH_VRM_VOLTAGE_VOTE_DRV0_REG45'/>"
WRITE #1 "        <register address='0xb810000' value='0x" DATA.LONG(A:0x810000) "' name='RPMH_VRM_VOLTAGE_VOTE_DRV1_REG0'/>"
WRITE #1 "        <register address='0xb810100' value='0x" DATA.LONG(A:0x810100) "' name='RPMH_VRM_VOLTAGE_VOTE_DRV1_REG1'/>"
WRITE #1 "        <register address='0xb810200' value='0x" DATA.LONG(A:0x810200) "' name='RPMH_VRM_VOLTAGE_VOTE_DRV1_REG2'/>"
WRITE #1 "        <register address='0xb810300' value='0x" DATA.LONG(A:0x810300) "' name='RPMH_VRM_VOLTAGE_VOTE_DRV1_REG3'/>"
WRITE #1 "        <register address='0xb810400' value='0x" DATA.LONG(A:0x810400) "' name='RPMH_VRM_VOLTAGE_VOTE_DRV1_REG4'/>"
WRITE #1 "        <register address='0xb810500' value='0x" DATA.LONG(A:0x810500) "' name='RPMH_VRM_VOLTAGE_VOTE_DRV1_REG5'/>"
WRITE #1 "        <register address='0xb810600' value='0x" DATA.LONG(A:0x810600) "' name='RPMH_VRM_VOLTAGE_VOTE_DRV1_REG6'/>"
WRITE #1 "        <register address='0xb810700' value='0x" DATA.LONG(A:0x810700) "' name='RPMH_VRM_VOLTAGE_VOTE_DRV1_REG7'/>"
WRITE #1 "        <register address='0xb810800' value='0x" DATA.LONG(A:0x810800) "' name='RPMH_VRM_VOLTAGE_VOTE_DRV1_REG8'/>"
WRITE #1 "        <register address='0xb810900' value='0x" DATA.LONG(A:0x810900) "' name='RPMH_VRM_VOLTAGE_VOTE_DRV1_REG9'/>"
WRITE #1 "        <register address='0xb810a00' value='0x" DATA.LONG(A:0x810a00) "' name='RPMH_VRM_VOLTAGE_VOTE_DRV1_REG10'/>"
WRITE #1 "        <register address='0xb810b00' value='0x" DATA.LONG(A:0x810b00) "' name='RPMH_VRM_VOLTAGE_VOTE_DRV1_REG11'/>"
WRITE #1 "        <register address='0xb810c00' value='0x" DATA.LONG(A:0x810c00) "' name='RPMH_VRM_VOLTAGE_VOTE_DRV1_REG12'/>"
WRITE #1 "        <register address='0xb810d00' value='0x" DATA.LONG(A:0x810d00) "' name='RPMH_VRM_VOLTAGE_VOTE_DRV1_REG13'/>"
WRITE #1 "        <register address='0xb810e00' value='0x" DATA.LONG(A:0x810e00) "' name='RPMH_VRM_VOLTAGE_VOTE_DRV1_REG14'/>"
WRITE #1 "        <register address='0xb810f00' value='0x" DATA.LONG(A:0x810f00) "' name='RPMH_VRM_VOLTAGE_VOTE_DRV1_REG15'/>"
WRITE #1 "        <register address='0xb811000' value='0x" DATA.LONG(A:0x811000) "' name='RPMH_VRM_VOLTAGE_VOTE_DRV1_REG16'/>"
WRITE #1 "        <register address='0xb811100' value='0x" DATA.LONG(A:0x811100) "' name='RPMH_VRM_VOLTAGE_VOTE_DRV1_REG17'/>"
WRITE #1 "        <register address='0xb811200' value='0x" DATA.LONG(A:0x811200) "' name='RPMH_VRM_VOLTAGE_VOTE_DRV1_REG18'/>"
WRITE #1 "        <register address='0xb811300' value='0x" DATA.LONG(A:0x811300) "' name='RPMH_VRM_VOLTAGE_VOTE_DRV1_REG19'/>"
WRITE #1 "        <register address='0xb811400' value='0x" DATA.LONG(A:0x811400) "' name='RPMH_VRM_VOLTAGE_VOTE_DRV1_REG20'/>"
WRITE #1 "        <register address='0xb811500' value='0x" DATA.LONG(A:0x811500) "' name='RPMH_VRM_VOLTAGE_VOTE_DRV1_REG21'/>"
WRITE #1 "        <register address='0xb811600' value='0x" DATA.LONG(A:0x811600) "' name='RPMH_VRM_VOLTAGE_VOTE_DRV1_REG22'/>"
WRITE #1 "        <register address='0xb811700' value='0x" DATA.LONG(A:0x811700) "' name='RPMH_VRM_VOLTAGE_VOTE_DRV1_REG23'/>"
WRITE #1 "        <register address='0xb811800' value='0x" DATA.LONG(A:0x811800) "' name='RPMH_VRM_VOLTAGE_VOTE_DRV1_REG24'/>"
WRITE #1 "        <register address='0xb811900' value='0x" DATA.LONG(A:0x811900) "' name='RPMH_VRM_VOLTAGE_VOTE_DRV1_REG25'/>"
WRITE #1 "        <register address='0xb811a00' value='0x" DATA.LONG(A:0x811a00) "' name='RPMH_VRM_VOLTAGE_VOTE_DRV1_REG26'/>"
WRITE #1 "        <register address='0xb811b00' value='0x" DATA.LONG(A:0x811b00) "' name='RPMH_VRM_VOLTAGE_VOTE_DRV1_REG27'/>"
WRITE #1 "        <register address='0xb811c00' value='0x" DATA.LONG(A:0x811c00) "' name='RPMH_VRM_VOLTAGE_VOTE_DRV1_REG28'/>"
WRITE #1 "        <register address='0xb811d00' value='0x" DATA.LONG(A:0x811d00) "' name='RPMH_VRM_VOLTAGE_VOTE_DRV1_REG29'/>"
WRITE #1 "        <register address='0xb811e00' value='0x" DATA.LONG(A:0x811e00) "' name='RPMH_VRM_VOLTAGE_VOTE_DRV1_REG30'/>"
WRITE #1 "        <register address='0xb811f00' value='0x" DATA.LONG(A:0x811f00) "' name='RPMH_VRM_VOLTAGE_VOTE_DRV1_REG31'/>"
WRITE #1 "        <register address='0xb812000' value='0x" DATA.LONG(A:0x812000) "' name='RPMH_VRM_VOLTAGE_VOTE_DRV1_REG32'/>"
WRITE #1 "        <register address='0xb812100' value='0x" DATA.LONG(A:0x812100) "' name='RPMH_VRM_VOLTAGE_VOTE_DRV1_REG33'/>"
WRITE #1 "        <register address='0xb812200' value='0x" DATA.LONG(A:0x812200) "' name='RPMH_VRM_VOLTAGE_VOTE_DRV1_REG34'/>"
WRITE #1 "        <register address='0xb812300' value='0x" DATA.LONG(A:0x812300) "' name='RPMH_VRM_VOLTAGE_VOTE_DRV1_REG35'/>"
WRITE #1 "        <register address='0xb812400' value='0x" DATA.LONG(A:0x812400) "' name='RPMH_VRM_VOLTAGE_VOTE_DRV1_REG36'/>"
WRITE #1 "        <register address='0xb812500' value='0x" DATA.LONG(A:0x812500) "' name='RPMH_VRM_VOLTAGE_VOTE_DRV1_REG37'/>"
WRITE #1 "        <register address='0xb812600' value='0x" DATA.LONG(A:0x812600) "' name='RPMH_VRM_VOLTAGE_VOTE_DRV1_REG38'/>"
WRITE #1 "        <register address='0xb812700' value='0x" DATA.LONG(A:0x812700) "' name='RPMH_VRM_VOLTAGE_VOTE_DRV1_REG39'/>"
WRITE #1 "        <register address='0xb812800' value='0x" DATA.LONG(A:0x812800) "' name='RPMH_VRM_VOLTAGE_VOTE_DRV1_REG40'/>"
WRITE #1 "        <register address='0xb812900' value='0x" DATA.LONG(A:0x812900) "' name='RPMH_VRM_VOLTAGE_VOTE_DRV1_REG41'/>"
WRITE #1 "        <register address='0xb812a00' value='0x" DATA.LONG(A:0x812a00) "' name='RPMH_VRM_VOLTAGE_VOTE_DRV1_REG42'/>"
WRITE #1 "        <register address='0xb812b00' value='0x" DATA.LONG(A:0x812b00) "' name='RPMH_VRM_VOLTAGE_VOTE_DRV1_REG43'/>"
WRITE #1 "        <register address='0xb812c00' value='0x" DATA.LONG(A:0x812c00) "' name='RPMH_VRM_VOLTAGE_VOTE_DRV1_REG44'/>"
WRITE #1 "        <register address='0xb812d00' value='0x" DATA.LONG(A:0x812d00) "' name='RPMH_VRM_VOLTAGE_VOTE_DRV1_REG45'/>"
WRITE #1 "        <register address='0xb820000' value='0x" DATA.LONG(A:0x820000) "' name='RPMH_VRM_VOLTAGE_VOTE_DRV2_REG0'/>"
WRITE #1 "        <register address='0xb820100' value='0x" DATA.LONG(A:0x820100) "' name='RPMH_VRM_VOLTAGE_VOTE_DRV2_REG1'/>"
WRITE #1 "        <register address='0xb820200' value='0x" DATA.LONG(A:0x820200) "' name='RPMH_VRM_VOLTAGE_VOTE_DRV2_REG2'/>"
WRITE #1 "        <register address='0xb820300' value='0x" DATA.LONG(A:0x820300) "' name='RPMH_VRM_VOLTAGE_VOTE_DRV2_REG3'/>"
WRITE #1 "        <register address='0xb820400' value='0x" DATA.LONG(A:0x820400) "' name='RPMH_VRM_VOLTAGE_VOTE_DRV2_REG4'/>"
WRITE #1 "        <register address='0xb820500' value='0x" DATA.LONG(A:0x820500) "' name='RPMH_VRM_VOLTAGE_VOTE_DRV2_REG5'/>"
WRITE #1 "        <register address='0xb820600' value='0x" DATA.LONG(A:0x820600) "' name='RPMH_VRM_VOLTAGE_VOTE_DRV2_REG6'/>"
WRITE #1 "        <register address='0xb820700' value='0x" DATA.LONG(A:0x820700) "' name='RPMH_VRM_VOLTAGE_VOTE_DRV2_REG7'/>"
WRITE #1 "        <register address='0xb820800' value='0x" DATA.LONG(A:0x820800) "' name='RPMH_VRM_VOLTAGE_VOTE_DRV2_REG8'/>"
WRITE #1 "        <register address='0xb820900' value='0x" DATA.LONG(A:0x820900) "' name='RPMH_VRM_VOLTAGE_VOTE_DRV2_REG9'/>"
WRITE #1 "        <register address='0xb820a00' value='0x" DATA.LONG(A:0x820a00) "' name='RPMH_VRM_VOLTAGE_VOTE_DRV2_REG10'/>"
WRITE #1 "        <register address='0xb820b00' value='0x" DATA.LONG(A:0x820b00) "' name='RPMH_VRM_VOLTAGE_VOTE_DRV2_REG11'/>"
WRITE #1 "        <register address='0xb820c00' value='0x" DATA.LONG(A:0x820c00) "' name='RPMH_VRM_VOLTAGE_VOTE_DRV2_REG12'/>"
WRITE #1 "        <register address='0xb820d00' value='0x" DATA.LONG(A:0x820d00) "' name='RPMH_VRM_VOLTAGE_VOTE_DRV2_REG13'/>"
WRITE #1 "        <register address='0xb820e00' value='0x" DATA.LONG(A:0x820e00) "' name='RPMH_VRM_VOLTAGE_VOTE_DRV2_REG14'/>"
WRITE #1 "        <register address='0xb820f00' value='0x" DATA.LONG(A:0x820f00) "' name='RPMH_VRM_VOLTAGE_VOTE_DRV2_REG15'/>"
WRITE #1 "        <register address='0xb821000' value='0x" DATA.LONG(A:0x821000) "' name='RPMH_VRM_VOLTAGE_VOTE_DRV2_REG16'/>"
WRITE #1 "        <register address='0xb821100' value='0x" DATA.LONG(A:0x821100) "' name='RPMH_VRM_VOLTAGE_VOTE_DRV2_REG17'/>"
WRITE #1 "        <register address='0xb821200' value='0x" DATA.LONG(A:0x821200) "' name='RPMH_VRM_VOLTAGE_VOTE_DRV2_REG18'/>"
WRITE #1 "        <register address='0xb821300' value='0x" DATA.LONG(A:0x821300) "' name='RPMH_VRM_VOLTAGE_VOTE_DRV2_REG19'/>"
WRITE #1 "        <register address='0xb821400' value='0x" DATA.LONG(A:0x821400) "' name='RPMH_VRM_VOLTAGE_VOTE_DRV2_REG20'/>"
WRITE #1 "        <register address='0xb821500' value='0x" DATA.LONG(A:0x821500) "' name='RPMH_VRM_VOLTAGE_VOTE_DRV2_REG21'/>"
WRITE #1 "        <register address='0xb821600' value='0x" DATA.LONG(A:0x821600) "' name='RPMH_VRM_VOLTAGE_VOTE_DRV2_REG22'/>"
WRITE #1 "        <register address='0xb821700' value='0x" DATA.LONG(A:0x821700) "' name='RPMH_VRM_VOLTAGE_VOTE_DRV2_REG23'/>"
WRITE #1 "        <register address='0xb821800' value='0x" DATA.LONG(A:0x821800) "' name='RPMH_VRM_VOLTAGE_VOTE_DRV2_REG24'/>"
WRITE #1 "        <register address='0xb821900' value='0x" DATA.LONG(A:0x821900) "' name='RPMH_VRM_VOLTAGE_VOTE_DRV2_REG25'/>"
WRITE #1 "        <register address='0xb821a00' value='0x" DATA.LONG(A:0x821a00) "' name='RPMH_VRM_VOLTAGE_VOTE_DRV2_REG26'/>"
WRITE #1 "        <register address='0xb821b00' value='0x" DATA.LONG(A:0x821b00) "' name='RPMH_VRM_VOLTAGE_VOTE_DRV2_REG27'/>"
WRITE #1 "        <register address='0xb821c00' value='0x" DATA.LONG(A:0x821c00) "' name='RPMH_VRM_VOLTAGE_VOTE_DRV2_REG28'/>"
WRITE #1 "        <register address='0xb821d00' value='0x" DATA.LONG(A:0x821d00) "' name='RPMH_VRM_VOLTAGE_VOTE_DRV2_REG29'/>"
WRITE #1 "        <register address='0xb821e00' value='0x" DATA.LONG(A:0x821e00) "' name='RPMH_VRM_VOLTAGE_VOTE_DRV2_REG30'/>"
WRITE #1 "        <register address='0xb821f00' value='0x" DATA.LONG(A:0x821f00) "' name='RPMH_VRM_VOLTAGE_VOTE_DRV2_REG31'/>"
WRITE #1 "        <register address='0xb822000' value='0x" DATA.LONG(A:0x822000) "' name='RPMH_VRM_VOLTAGE_VOTE_DRV2_REG32'/>"
WRITE #1 "        <register address='0xb822100' value='0x" DATA.LONG(A:0x822100) "' name='RPMH_VRM_VOLTAGE_VOTE_DRV2_REG33'/>"
WRITE #1 "        <register address='0xb822200' value='0x" DATA.LONG(A:0x822200) "' name='RPMH_VRM_VOLTAGE_VOTE_DRV2_REG34'/>"
WRITE #1 "        <register address='0xb822300' value='0x" DATA.LONG(A:0x822300) "' name='RPMH_VRM_VOLTAGE_VOTE_DRV2_REG35'/>"
WRITE #1 "        <register address='0xb822400' value='0x" DATA.LONG(A:0x822400) "' name='RPMH_VRM_VOLTAGE_VOTE_DRV2_REG36'/>"
WRITE #1 "        <register address='0xb822500' value='0x" DATA.LONG(A:0x822500) "' name='RPMH_VRM_VOLTAGE_VOTE_DRV2_REG37'/>"
WRITE #1 "        <register address='0xb822600' value='0x" DATA.LONG(A:0x822600) "' name='RPMH_VRM_VOLTAGE_VOTE_DRV2_REG38'/>"
WRITE #1 "        <register address='0xb822700' value='0x" DATA.LONG(A:0x822700) "' name='RPMH_VRM_VOLTAGE_VOTE_DRV2_REG39'/>"
WRITE #1 "        <register address='0xb822800' value='0x" DATA.LONG(A:0x822800) "' name='RPMH_VRM_VOLTAGE_VOTE_DRV2_REG40'/>"
WRITE #1 "        <register address='0xb822900' value='0x" DATA.LONG(A:0x822900) "' name='RPMH_VRM_VOLTAGE_VOTE_DRV2_REG41'/>"
WRITE #1 "        <register address='0xb822a00' value='0x" DATA.LONG(A:0x822a00) "' name='RPMH_VRM_VOLTAGE_VOTE_DRV2_REG42'/>"
WRITE #1 "        <register address='0xb822b00' value='0x" DATA.LONG(A:0x822b00) "' name='RPMH_VRM_VOLTAGE_VOTE_DRV2_REG43'/>"
WRITE #1 "        <register address='0xb822c00' value='0x" DATA.LONG(A:0x822c00) "' name='RPMH_VRM_VOLTAGE_VOTE_DRV2_REG44'/>"
WRITE #1 "        <register address='0xb822d00' value='0x" DATA.LONG(A:0x822d00) "' name='RPMH_VRM_VOLTAGE_VOTE_DRV2_REG45'/>"
WRITE #1 "        <register address='0xb830000' value='0x" DATA.LONG(A:0x830000) "' name='RPMH_VRM_VOLTAGE_VOTE_DRV3_REG0'/>"
WRITE #1 "        <register address='0xb830100' value='0x" DATA.LONG(A:0x830100) "' name='RPMH_VRM_VOLTAGE_VOTE_DRV3_REG1'/>"
WRITE #1 "        <register address='0xb830200' value='0x" DATA.LONG(A:0x830200) "' name='RPMH_VRM_VOLTAGE_VOTE_DRV3_REG2'/>"
WRITE #1 "        <register address='0xb830300' value='0x" DATA.LONG(A:0x830300) "' name='RPMH_VRM_VOLTAGE_VOTE_DRV3_REG3'/>"
WRITE #1 "        <register address='0xb830400' value='0x" DATA.LONG(A:0x830400) "' name='RPMH_VRM_VOLTAGE_VOTE_DRV3_REG4'/>"
WRITE #1 "        <register address='0xb830500' value='0x" DATA.LONG(A:0x830500) "' name='RPMH_VRM_VOLTAGE_VOTE_DRV3_REG5'/>"
WRITE #1 "        <register address='0xb830600' value='0x" DATA.LONG(A:0x830600) "' name='RPMH_VRM_VOLTAGE_VOTE_DRV3_REG6'/>"
WRITE #1 "        <register address='0xb830700' value='0x" DATA.LONG(A:0x830700) "' name='RPMH_VRM_VOLTAGE_VOTE_DRV3_REG7'/>"
WRITE #1 "        <register address='0xb830800' value='0x" DATA.LONG(A:0x830800) "' name='RPMH_VRM_VOLTAGE_VOTE_DRV3_REG8'/>"
WRITE #1 "        <register address='0xb830900' value='0x" DATA.LONG(A:0x830900) "' name='RPMH_VRM_VOLTAGE_VOTE_DRV3_REG9'/>"
WRITE #1 "        <register address='0xb830a00' value='0x" DATA.LONG(A:0x830a00) "' name='RPMH_VRM_VOLTAGE_VOTE_DRV3_REG10'/>"
WRITE #1 "        <register address='0xb830b00' value='0x" DATA.LONG(A:0x830b00) "' name='RPMH_VRM_VOLTAGE_VOTE_DRV3_REG11'/>"
WRITE #1 "        <register address='0xb830c00' value='0x" DATA.LONG(A:0x830c00) "' name='RPMH_VRM_VOLTAGE_VOTE_DRV3_REG12'/>"
WRITE #1 "        <register address='0xb830d00' value='0x" DATA.LONG(A:0x830d00) "' name='RPMH_VRM_VOLTAGE_VOTE_DRV3_REG13'/>"
WRITE #1 "        <register address='0xb830e00' value='0x" DATA.LONG(A:0x830e00) "' name='RPMH_VRM_VOLTAGE_VOTE_DRV3_REG14'/>"
WRITE #1 "        <register address='0xb830f00' value='0x" DATA.LONG(A:0x830f00) "' name='RPMH_VRM_VOLTAGE_VOTE_DRV3_REG15'/>"
WRITE #1 "        <register address='0xb831000' value='0x" DATA.LONG(A:0x831000) "' name='RPMH_VRM_VOLTAGE_VOTE_DRV3_REG16'/>"
WRITE #1 "        <register address='0xb831100' value='0x" DATA.LONG(A:0x831100) "' name='RPMH_VRM_VOLTAGE_VOTE_DRV3_REG17'/>"
WRITE #1 "        <register address='0xb831200' value='0x" DATA.LONG(A:0x831200) "' name='RPMH_VRM_VOLTAGE_VOTE_DRV3_REG18'/>"
WRITE #1 "        <register address='0xb831300' value='0x" DATA.LONG(A:0x831300) "' name='RPMH_VRM_VOLTAGE_VOTE_DRV3_REG19'/>"
WRITE #1 "        <register address='0xb831400' value='0x" DATA.LONG(A:0x831400) "' name='RPMH_VRM_VOLTAGE_VOTE_DRV3_REG20'/>"
WRITE #1 "        <register address='0xb831500' value='0x" DATA.LONG(A:0x831500) "' name='RPMH_VRM_VOLTAGE_VOTE_DRV3_REG21'/>"
WRITE #1 "        <register address='0xb831600' value='0x" DATA.LONG(A:0x831600) "' name='RPMH_VRM_VOLTAGE_VOTE_DRV3_REG22'/>"
WRITE #1 "        <register address='0xb831700' value='0x" DATA.LONG(A:0x831700) "' name='RPMH_VRM_VOLTAGE_VOTE_DRV3_REG23'/>"
WRITE #1 "        <register address='0xb831800' value='0x" DATA.LONG(A:0x831800) "' name='RPMH_VRM_VOLTAGE_VOTE_DRV3_REG24'/>"
WRITE #1 "        <register address='0xb831900' value='0x" DATA.LONG(A:0x831900) "' name='RPMH_VRM_VOLTAGE_VOTE_DRV3_REG25'/>"
WRITE #1 "        <register address='0xb831a00' value='0x" DATA.LONG(A:0x831a00) "' name='RPMH_VRM_VOLTAGE_VOTE_DRV3_REG26'/>"
WRITE #1 "        <register address='0xb831b00' value='0x" DATA.LONG(A:0x831b00) "' name='RPMH_VRM_VOLTAGE_VOTE_DRV3_REG27'/>"
WRITE #1 "        <register address='0xb831c00' value='0x" DATA.LONG(A:0x831c00) "' name='RPMH_VRM_VOLTAGE_VOTE_DRV3_REG28'/>"
WRITE #1 "        <register address='0xb831d00' value='0x" DATA.LONG(A:0x831d00) "' name='RPMH_VRM_VOLTAGE_VOTE_DRV3_REG29'/>"
WRITE #1 "        <register address='0xb831e00' value='0x" DATA.LONG(A:0x831e00) "' name='RPMH_VRM_VOLTAGE_VOTE_DRV3_REG30'/>"
WRITE #1 "        <register address='0xb831f00' value='0x" DATA.LONG(A:0x831f00) "' name='RPMH_VRM_VOLTAGE_VOTE_DRV3_REG31'/>"
WRITE #1 "        <register address='0xb832000' value='0x" DATA.LONG(A:0x832000) "' name='RPMH_VRM_VOLTAGE_VOTE_DRV3_REG32'/>"
WRITE #1 "        <register address='0xb832100' value='0x" DATA.LONG(A:0x832100) "' name='RPMH_VRM_VOLTAGE_VOTE_DRV3_REG33'/>"
WRITE #1 "        <register address='0xb832200' value='0x" DATA.LONG(A:0x832200) "' name='RPMH_VRM_VOLTAGE_VOTE_DRV3_REG34'/>"
WRITE #1 "        <register address='0xb832300' value='0x" DATA.LONG(A:0x832300) "' name='RPMH_VRM_VOLTAGE_VOTE_DRV3_REG35'/>"
WRITE #1 "        <register address='0xb832400' value='0x" DATA.LONG(A:0x832400) "' name='RPMH_VRM_VOLTAGE_VOTE_DRV3_REG36'/>"
WRITE #1 "        <register address='0xb832500' value='0x" DATA.LONG(A:0x832500) "' name='RPMH_VRM_VOLTAGE_VOTE_DRV3_REG37'/>"
WRITE #1 "        <register address='0xb832600' value='0x" DATA.LONG(A:0x832600) "' name='RPMH_VRM_VOLTAGE_VOTE_DRV3_REG38'/>"
WRITE #1 "        <register address='0xb832700' value='0x" DATA.LONG(A:0x832700) "' name='RPMH_VRM_VOLTAGE_VOTE_DRV3_REG39'/>"
WRITE #1 "        <register address='0xb832800' value='0x" DATA.LONG(A:0x832800) "' name='RPMH_VRM_VOLTAGE_VOTE_DRV3_REG40'/>"
WRITE #1 "        <register address='0xb832900' value='0x" DATA.LONG(A:0x832900) "' name='RPMH_VRM_VOLTAGE_VOTE_DRV3_REG41'/>"
WRITE #1 "        <register address='0xb832a00' value='0x" DATA.LONG(A:0x832a00) "' name='RPMH_VRM_VOLTAGE_VOTE_DRV3_REG42'/>"
WRITE #1 "        <register address='0xb832b00' value='0x" DATA.LONG(A:0x832b00) "' name='RPMH_VRM_VOLTAGE_VOTE_DRV3_REG43'/>"
WRITE #1 "        <register address='0xb832c00' value='0x" DATA.LONG(A:0x832c00) "' name='RPMH_VRM_VOLTAGE_VOTE_DRV3_REG44'/>"
WRITE #1 "        <register address='0xb832d00' value='0x" DATA.LONG(A:0x832d00) "' name='RPMH_VRM_VOLTAGE_VOTE_DRV3_REG45'/>"
WRITE #1 "        <register address='0xb840000' value='0x" DATA.LONG(A:0x840000) "' name='RPMH_VRM_VOLTAGE_VOTE_DRV4_REG0'/>"
WRITE #1 "        <register address='0xb840100' value='0x" DATA.LONG(A:0x840100) "' name='RPMH_VRM_VOLTAGE_VOTE_DRV4_REG1'/>"
WRITE #1 "        <register address='0xb840200' value='0x" DATA.LONG(A:0x840200) "' name='RPMH_VRM_VOLTAGE_VOTE_DRV4_REG2'/>"
WRITE #1 "        <register address='0xb840300' value='0x" DATA.LONG(A:0x840300) "' name='RPMH_VRM_VOLTAGE_VOTE_DRV4_REG3'/>"
WRITE #1 "        <register address='0xb840400' value='0x" DATA.LONG(A:0x840400) "' name='RPMH_VRM_VOLTAGE_VOTE_DRV4_REG4'/>"
WRITE #1 "        <register address='0xb840500' value='0x" DATA.LONG(A:0x840500) "' name='RPMH_VRM_VOLTAGE_VOTE_DRV4_REG5'/>"
WRITE #1 "        <register address='0xb840600' value='0x" DATA.LONG(A:0x840600) "' name='RPMH_VRM_VOLTAGE_VOTE_DRV4_REG6'/>"
WRITE #1 "        <register address='0xb840700' value='0x" DATA.LONG(A:0x840700) "' name='RPMH_VRM_VOLTAGE_VOTE_DRV4_REG7'/>"
WRITE #1 "        <register address='0xb840800' value='0x" DATA.LONG(A:0x840800) "' name='RPMH_VRM_VOLTAGE_VOTE_DRV4_REG8'/>"
WRITE #1 "        <register address='0xb840900' value='0x" DATA.LONG(A:0x840900) "' name='RPMH_VRM_VOLTAGE_VOTE_DRV4_REG9'/>"
WRITE #1 "        <register address='0xb840a00' value='0x" DATA.LONG(A:0x840a00) "' name='RPMH_VRM_VOLTAGE_VOTE_DRV4_REG10'/>"
WRITE #1 "        <register address='0xb840b00' value='0x" DATA.LONG(A:0x840b00) "' name='RPMH_VRM_VOLTAGE_VOTE_DRV4_REG11'/>"
WRITE #1 "        <register address='0xb840c00' value='0x" DATA.LONG(A:0x840c00) "' name='RPMH_VRM_VOLTAGE_VOTE_DRV4_REG12'/>"
WRITE #1 "        <register address='0xb840d00' value='0x" DATA.LONG(A:0x840d00) "' name='RPMH_VRM_VOLTAGE_VOTE_DRV4_REG13'/>"
WRITE #1 "        <register address='0xb840e00' value='0x" DATA.LONG(A:0x840e00) "' name='RPMH_VRM_VOLTAGE_VOTE_DRV4_REG14'/>"
WRITE #1 "        <register address='0xb840f00' value='0x" DATA.LONG(A:0x840f00) "' name='RPMH_VRM_VOLTAGE_VOTE_DRV4_REG15'/>"
WRITE #1 "        <register address='0xb841000' value='0x" DATA.LONG(A:0x841000) "' name='RPMH_VRM_VOLTAGE_VOTE_DRV4_REG16'/>"
WRITE #1 "        <register address='0xb841100' value='0x" DATA.LONG(A:0x841100) "' name='RPMH_VRM_VOLTAGE_VOTE_DRV4_REG17'/>"
WRITE #1 "        <register address='0xb841200' value='0x" DATA.LONG(A:0x841200) "' name='RPMH_VRM_VOLTAGE_VOTE_DRV4_REG18'/>"
WRITE #1 "        <register address='0xb841300' value='0x" DATA.LONG(A:0x841300) "' name='RPMH_VRM_VOLTAGE_VOTE_DRV4_REG19'/>"
WRITE #1 "        <register address='0xb841400' value='0x" DATA.LONG(A:0x841400) "' name='RPMH_VRM_VOLTAGE_VOTE_DRV4_REG20'/>"
WRITE #1 "        <register address='0xb841500' value='0x" DATA.LONG(A:0x841500) "' name='RPMH_VRM_VOLTAGE_VOTE_DRV4_REG21'/>"
WRITE #1 "        <register address='0xb841600' value='0x" DATA.LONG(A:0x841600) "' name='RPMH_VRM_VOLTAGE_VOTE_DRV4_REG22'/>"
WRITE #1 "        <register address='0xb841700' value='0x" DATA.LONG(A:0x841700) "' name='RPMH_VRM_VOLTAGE_VOTE_DRV4_REG23'/>"
WRITE #1 "        <register address='0xb841800' value='0x" DATA.LONG(A:0x841800) "' name='RPMH_VRM_VOLTAGE_VOTE_DRV4_REG24'/>"
WRITE #1 "        <register address='0xb841900' value='0x" DATA.LONG(A:0x841900) "' name='RPMH_VRM_VOLTAGE_VOTE_DRV4_REG25'/>"
WRITE #1 "        <register address='0xb841a00' value='0x" DATA.LONG(A:0x841a00) "' name='RPMH_VRM_VOLTAGE_VOTE_DRV4_REG26'/>"
WRITE #1 "        <register address='0xb841b00' value='0x" DATA.LONG(A:0x841b00) "' name='RPMH_VRM_VOLTAGE_VOTE_DRV4_REG27'/>"
WRITE #1 "        <register address='0xb841c00' value='0x" DATA.LONG(A:0x841c00) "' name='RPMH_VRM_VOLTAGE_VOTE_DRV4_REG28'/>"
WRITE #1 "        <register address='0xb841d00' value='0x" DATA.LONG(A:0x841d00) "' name='RPMH_VRM_VOLTAGE_VOTE_DRV4_REG29'/>"
WRITE #1 "        <register address='0xb841e00' value='0x" DATA.LONG(A:0x841e00) "' name='RPMH_VRM_VOLTAGE_VOTE_DRV4_REG30'/>"
WRITE #1 "        <register address='0xb841f00' value='0x" DATA.LONG(A:0x841f00) "' name='RPMH_VRM_VOLTAGE_VOTE_DRV4_REG31'/>"
WRITE #1 "        <register address='0xb842000' value='0x" DATA.LONG(A:0x842000) "' name='RPMH_VRM_VOLTAGE_VOTE_DRV4_REG32'/>"
WRITE #1 "        <register address='0xb842100' value='0x" DATA.LONG(A:0x842100) "' name='RPMH_VRM_VOLTAGE_VOTE_DRV4_REG33'/>"
WRITE #1 "        <register address='0xb842200' value='0x" DATA.LONG(A:0x842200) "' name='RPMH_VRM_VOLTAGE_VOTE_DRV4_REG34'/>"
WRITE #1 "        <register address='0xb842300' value='0x" DATA.LONG(A:0x842300) "' name='RPMH_VRM_VOLTAGE_VOTE_DRV4_REG35'/>"
WRITE #1 "        <register address='0xb842400' value='0x" DATA.LONG(A:0x842400) "' name='RPMH_VRM_VOLTAGE_VOTE_DRV4_REG36'/>"
WRITE #1 "        <register address='0xb842500' value='0x" DATA.LONG(A:0x842500) "' name='RPMH_VRM_VOLTAGE_VOTE_DRV4_REG37'/>"
WRITE #1 "        <register address='0xb842600' value='0x" DATA.LONG(A:0x842600) "' name='RPMH_VRM_VOLTAGE_VOTE_DRV4_REG38'/>"
WRITE #1 "        <register address='0xb842700' value='0x" DATA.LONG(A:0x842700) "' name='RPMH_VRM_VOLTAGE_VOTE_DRV4_REG39'/>"
WRITE #1 "        <register address='0xb842800' value='0x" DATA.LONG(A:0x842800) "' name='RPMH_VRM_VOLTAGE_VOTE_DRV4_REG40'/>"
WRITE #1 "        <register address='0xb842900' value='0x" DATA.LONG(A:0x842900) "' name='RPMH_VRM_VOLTAGE_VOTE_DRV4_REG41'/>"
WRITE #1 "        <register address='0xb842a00' value='0x" DATA.LONG(A:0x842a00) "' name='RPMH_VRM_VOLTAGE_VOTE_DRV4_REG42'/>"
WRITE #1 "        <register address='0xb842b00' value='0x" DATA.LONG(A:0x842b00) "' name='RPMH_VRM_VOLTAGE_VOTE_DRV4_REG43'/>"
WRITE #1 "        <register address='0xb842c00' value='0x" DATA.LONG(A:0x842c00) "' name='RPMH_VRM_VOLTAGE_VOTE_DRV4_REG44'/>"
WRITE #1 "        <register address='0xb842d00' value='0x" DATA.LONG(A:0x842d00) "' name='RPMH_VRM_VOLTAGE_VOTE_DRV4_REG45'/>"
WRITE #1 "        <register address='0xb850000' value='0x" DATA.LONG(A:0x850000) "' name='RPMH_VRM_VOLTAGE_VOTE_DRV5_REG0'/>"
WRITE #1 "        <register address='0xb850100' value='0x" DATA.LONG(A:0x850100) "' name='RPMH_VRM_VOLTAGE_VOTE_DRV5_REG1'/>"
WRITE #1 "        <register address='0xb850200' value='0x" DATA.LONG(A:0x850200) "' name='RPMH_VRM_VOLTAGE_VOTE_DRV5_REG2'/>"
WRITE #1 "        <register address='0xb850300' value='0x" DATA.LONG(A:0x850300) "' name='RPMH_VRM_VOLTAGE_VOTE_DRV5_REG3'/>"
WRITE #1 "        <register address='0xb850400' value='0x" DATA.LONG(A:0x850400) "' name='RPMH_VRM_VOLTAGE_VOTE_DRV5_REG4'/>"
WRITE #1 "        <register address='0xb850500' value='0x" DATA.LONG(A:0x850500) "' name='RPMH_VRM_VOLTAGE_VOTE_DRV5_REG5'/>"
WRITE #1 "        <register address='0xb850600' value='0x" DATA.LONG(A:0x850600) "' name='RPMH_VRM_VOLTAGE_VOTE_DRV5_REG6'/>"
WRITE #1 "        <register address='0xb850700' value='0x" DATA.LONG(A:0x850700) "' name='RPMH_VRM_VOLTAGE_VOTE_DRV5_REG7'/>"
WRITE #1 "        <register address='0xb850800' value='0x" DATA.LONG(A:0x850800) "' name='RPMH_VRM_VOLTAGE_VOTE_DRV5_REG8'/>"
WRITE #1 "        <register address='0xb850900' value='0x" DATA.LONG(A:0x850900) "' name='RPMH_VRM_VOLTAGE_VOTE_DRV5_REG9'/>"
WRITE #1 "        <register address='0xb850a00' value='0x" DATA.LONG(A:0x850a00) "' name='RPMH_VRM_VOLTAGE_VOTE_DRV5_REG10'/>"
WRITE #1 "        <register address='0xb850b00' value='0x" DATA.LONG(A:0x850b00) "' name='RPMH_VRM_VOLTAGE_VOTE_DRV5_REG11'/>"
WRITE #1 "        <register address='0xb850c00' value='0x" DATA.LONG(A:0x850c00) "' name='RPMH_VRM_VOLTAGE_VOTE_DRV5_REG12'/>"
WRITE #1 "        <register address='0xb850d00' value='0x" DATA.LONG(A:0x850d00) "' name='RPMH_VRM_VOLTAGE_VOTE_DRV5_REG13'/>"
WRITE #1 "        <register address='0xb850e00' value='0x" DATA.LONG(A:0x850e00) "' name='RPMH_VRM_VOLTAGE_VOTE_DRV5_REG14'/>"
WRITE #1 "        <register address='0xb850f00' value='0x" DATA.LONG(A:0x850f00) "' name='RPMH_VRM_VOLTAGE_VOTE_DRV5_REG15'/>"
WRITE #1 "        <register address='0xb851000' value='0x" DATA.LONG(A:0x851000) "' name='RPMH_VRM_VOLTAGE_VOTE_DRV5_REG16'/>"
WRITE #1 "        <register address='0xb851100' value='0x" DATA.LONG(A:0x851100) "' name='RPMH_VRM_VOLTAGE_VOTE_DRV5_REG17'/>"
WRITE #1 "        <register address='0xb851200' value='0x" DATA.LONG(A:0x851200) "' name='RPMH_VRM_VOLTAGE_VOTE_DRV5_REG18'/>"
WRITE #1 "        <register address='0xb851300' value='0x" DATA.LONG(A:0x851300) "' name='RPMH_VRM_VOLTAGE_VOTE_DRV5_REG19'/>"
WRITE #1 "        <register address='0xb851400' value='0x" DATA.LONG(A:0x851400) "' name='RPMH_VRM_VOLTAGE_VOTE_DRV5_REG20'/>"
WRITE #1 "        <register address='0xb851500' value='0x" DATA.LONG(A:0x851500) "' name='RPMH_VRM_VOLTAGE_VOTE_DRV5_REG21'/>"
WRITE #1 "        <register address='0xb851600' value='0x" DATA.LONG(A:0x851600) "' name='RPMH_VRM_VOLTAGE_VOTE_DRV5_REG22'/>"
WRITE #1 "        <register address='0xb851700' value='0x" DATA.LONG(A:0x851700) "' name='RPMH_VRM_VOLTAGE_VOTE_DRV5_REG23'/>"
WRITE #1 "        <register address='0xb851800' value='0x" DATA.LONG(A:0x851800) "' name='RPMH_VRM_VOLTAGE_VOTE_DRV5_REG24'/>"
WRITE #1 "        <register address='0xb851900' value='0x" DATA.LONG(A:0x851900) "' name='RPMH_VRM_VOLTAGE_VOTE_DRV5_REG25'/>"
WRITE #1 "        <register address='0xb851a00' value='0x" DATA.LONG(A:0x851a00) "' name='RPMH_VRM_VOLTAGE_VOTE_DRV5_REG26'/>"
WRITE #1 "        <register address='0xb851b00' value='0x" DATA.LONG(A:0x851b00) "' name='RPMH_VRM_VOLTAGE_VOTE_DRV5_REG27'/>"
WRITE #1 "        <register address='0xb851c00' value='0x" DATA.LONG(A:0x851c00) "' name='RPMH_VRM_VOLTAGE_VOTE_DRV5_REG28'/>"
WRITE #1 "        <register address='0xb851d00' value='0x" DATA.LONG(A:0x851d00) "' name='RPMH_VRM_VOLTAGE_VOTE_DRV5_REG29'/>"
WRITE #1 "        <register address='0xb851e00' value='0x" DATA.LONG(A:0x851e00) "' name='RPMH_VRM_VOLTAGE_VOTE_DRV5_REG30'/>"
WRITE #1 "        <register address='0xb851f00' value='0x" DATA.LONG(A:0x851f00) "' name='RPMH_VRM_VOLTAGE_VOTE_DRV5_REG31'/>"
WRITE #1 "        <register address='0xb852000' value='0x" DATA.LONG(A:0x852000) "' name='RPMH_VRM_VOLTAGE_VOTE_DRV5_REG32'/>"
WRITE #1 "        <register address='0xb852100' value='0x" DATA.LONG(A:0x852100) "' name='RPMH_VRM_VOLTAGE_VOTE_DRV5_REG33'/>"
WRITE #1 "        <register address='0xb852200' value='0x" DATA.LONG(A:0x852200) "' name='RPMH_VRM_VOLTAGE_VOTE_DRV5_REG34'/>"
WRITE #1 "        <register address='0xb852300' value='0x" DATA.LONG(A:0x852300) "' name='RPMH_VRM_VOLTAGE_VOTE_DRV5_REG35'/>"
WRITE #1 "        <register address='0xb852400' value='0x" DATA.LONG(A:0x852400) "' name='RPMH_VRM_VOLTAGE_VOTE_DRV5_REG36'/>"
WRITE #1 "        <register address='0xb852500' value='0x" DATA.LONG(A:0x852500) "' name='RPMH_VRM_VOLTAGE_VOTE_DRV5_REG37'/>"
WRITE #1 "        <register address='0xb852600' value='0x" DATA.LONG(A:0x852600) "' name='RPMH_VRM_VOLTAGE_VOTE_DRV5_REG38'/>"
WRITE #1 "        <register address='0xb852700' value='0x" DATA.LONG(A:0x852700) "' name='RPMH_VRM_VOLTAGE_VOTE_DRV5_REG39'/>"
WRITE #1 "        <register address='0xb852800' value='0x" DATA.LONG(A:0x852800) "' name='RPMH_VRM_VOLTAGE_VOTE_DRV5_REG40'/>"
WRITE #1 "        <register address='0xb852900' value='0x" DATA.LONG(A:0x852900) "' name='RPMH_VRM_VOLTAGE_VOTE_DRV5_REG41'/>"
WRITE #1 "        <register address='0xb852a00' value='0x" DATA.LONG(A:0x852a00) "' name='RPMH_VRM_VOLTAGE_VOTE_DRV5_REG42'/>"
WRITE #1 "        <register address='0xb852b00' value='0x" DATA.LONG(A:0x852b00) "' name='RPMH_VRM_VOLTAGE_VOTE_DRV5_REG43'/>"
WRITE #1 "        <register address='0xb852c00' value='0x" DATA.LONG(A:0x852c00) "' name='RPMH_VRM_VOLTAGE_VOTE_DRV5_REG44'/>"
WRITE #1 "        <register address='0xb852d00' value='0x" DATA.LONG(A:0x852d00) "' name='RPMH_VRM_VOLTAGE_VOTE_DRV5_REG45'/>"
WRITE #1 "        <register address='0xb860000' value='0x" DATA.LONG(A:0x860000) "' name='RPMH_VRM_VOLTAGE_VOTE_DRV6_REG0'/>"
WRITE #1 "        <register address='0xb860100' value='0x" DATA.LONG(A:0x860100) "' name='RPMH_VRM_VOLTAGE_VOTE_DRV6_REG1'/>"
WRITE #1 "        <register address='0xb860200' value='0x" DATA.LONG(A:0x860200) "' name='RPMH_VRM_VOLTAGE_VOTE_DRV6_REG2'/>"
WRITE #1 "        <register address='0xb860300' value='0x" DATA.LONG(A:0x860300) "' name='RPMH_VRM_VOLTAGE_VOTE_DRV6_REG3'/>"
WRITE #1 "        <register address='0xb860400' value='0x" DATA.LONG(A:0x860400) "' name='RPMH_VRM_VOLTAGE_VOTE_DRV6_REG4'/>"
WRITE #1 "        <register address='0xb860500' value='0x" DATA.LONG(A:0x860500) "' name='RPMH_VRM_VOLTAGE_VOTE_DRV6_REG5'/>"
WRITE #1 "        <register address='0xb860600' value='0x" DATA.LONG(A:0x860600) "' name='RPMH_VRM_VOLTAGE_VOTE_DRV6_REG6'/>"
WRITE #1 "        <register address='0xb860700' value='0x" DATA.LONG(A:0x860700) "' name='RPMH_VRM_VOLTAGE_VOTE_DRV6_REG7'/>"
WRITE #1 "        <register address='0xb860800' value='0x" DATA.LONG(A:0x860800) "' name='RPMH_VRM_VOLTAGE_VOTE_DRV6_REG8'/>"
WRITE #1 "        <register address='0xb860900' value='0x" DATA.LONG(A:0x860900) "' name='RPMH_VRM_VOLTAGE_VOTE_DRV6_REG9'/>"
WRITE #1 "        <register address='0xb860a00' value='0x" DATA.LONG(A:0x860a00) "' name='RPMH_VRM_VOLTAGE_VOTE_DRV6_REG10'/>"
WRITE #1 "        <register address='0xb860b00' value='0x" DATA.LONG(A:0x860b00) "' name='RPMH_VRM_VOLTAGE_VOTE_DRV6_REG11'/>"
WRITE #1 "        <register address='0xb860c00' value='0x" DATA.LONG(A:0x860c00) "' name='RPMH_VRM_VOLTAGE_VOTE_DRV6_REG12'/>"
WRITE #1 "        <register address='0xb860d00' value='0x" DATA.LONG(A:0x860d00) "' name='RPMH_VRM_VOLTAGE_VOTE_DRV6_REG13'/>"
WRITE #1 "        <register address='0xb860e00' value='0x" DATA.LONG(A:0x860e00) "' name='RPMH_VRM_VOLTAGE_VOTE_DRV6_REG14'/>"
WRITE #1 "        <register address='0xb860f00' value='0x" DATA.LONG(A:0x860f00) "' name='RPMH_VRM_VOLTAGE_VOTE_DRV6_REG15'/>"
WRITE #1 "        <register address='0xb861000' value='0x" DATA.LONG(A:0x861000) "' name='RPMH_VRM_VOLTAGE_VOTE_DRV6_REG16'/>"
WRITE #1 "        <register address='0xb861100' value='0x" DATA.LONG(A:0x861100) "' name='RPMH_VRM_VOLTAGE_VOTE_DRV6_REG17'/>"
WRITE #1 "        <register address='0xb861200' value='0x" DATA.LONG(A:0x861200) "' name='RPMH_VRM_VOLTAGE_VOTE_DRV6_REG18'/>"
WRITE #1 "        <register address='0xb861300' value='0x" DATA.LONG(A:0x861300) "' name='RPMH_VRM_VOLTAGE_VOTE_DRV6_REG19'/>"
WRITE #1 "        <register address='0xb861400' value='0x" DATA.LONG(A:0x861400) "' name='RPMH_VRM_VOLTAGE_VOTE_DRV6_REG20'/>"
WRITE #1 "        <register address='0xb861500' value='0x" DATA.LONG(A:0x861500) "' name='RPMH_VRM_VOLTAGE_VOTE_DRV6_REG21'/>"
WRITE #1 "        <register address='0xb861600' value='0x" DATA.LONG(A:0x861600) "' name='RPMH_VRM_VOLTAGE_VOTE_DRV6_REG22'/>"
WRITE #1 "        <register address='0xb861700' value='0x" DATA.LONG(A:0x861700) "' name='RPMH_VRM_VOLTAGE_VOTE_DRV6_REG23'/>"
WRITE #1 "        <register address='0xb861800' value='0x" DATA.LONG(A:0x861800) "' name='RPMH_VRM_VOLTAGE_VOTE_DRV6_REG24'/>"
WRITE #1 "        <register address='0xb861900' value='0x" DATA.LONG(A:0x861900) "' name='RPMH_VRM_VOLTAGE_VOTE_DRV6_REG25'/>"
WRITE #1 "        <register address='0xb861a00' value='0x" DATA.LONG(A:0x861a00) "' name='RPMH_VRM_VOLTAGE_VOTE_DRV6_REG26'/>"
WRITE #1 "        <register address='0xb861b00' value='0x" DATA.LONG(A:0x861b00) "' name='RPMH_VRM_VOLTAGE_VOTE_DRV6_REG27'/>"
WRITE #1 "        <register address='0xb861c00' value='0x" DATA.LONG(A:0x861c00) "' name='RPMH_VRM_VOLTAGE_VOTE_DRV6_REG28'/>"
WRITE #1 "        <register address='0xb861d00' value='0x" DATA.LONG(A:0x861d00) "' name='RPMH_VRM_VOLTAGE_VOTE_DRV6_REG29'/>"
WRITE #1 "        <register address='0xb861e00' value='0x" DATA.LONG(A:0x861e00) "' name='RPMH_VRM_VOLTAGE_VOTE_DRV6_REG30'/>"
WRITE #1 "        <register address='0xb861f00' value='0x" DATA.LONG(A:0x861f00) "' name='RPMH_VRM_VOLTAGE_VOTE_DRV6_REG31'/>"
WRITE #1 "        <register address='0xb862000' value='0x" DATA.LONG(A:0x862000) "' name='RPMH_VRM_VOLTAGE_VOTE_DRV6_REG32'/>"
WRITE #1 "        <register address='0xb862100' value='0x" DATA.LONG(A:0x862100) "' name='RPMH_VRM_VOLTAGE_VOTE_DRV6_REG33'/>"
WRITE #1 "        <register address='0xb862200' value='0x" DATA.LONG(A:0x862200) "' name='RPMH_VRM_VOLTAGE_VOTE_DRV6_REG34'/>"
WRITE #1 "        <register address='0xb862300' value='0x" DATA.LONG(A:0x862300) "' name='RPMH_VRM_VOLTAGE_VOTE_DRV6_REG35'/>"
WRITE #1 "        <register address='0xb862400' value='0x" DATA.LONG(A:0x862400) "' name='RPMH_VRM_VOLTAGE_VOTE_DRV6_REG36'/>"
WRITE #1 "        <register address='0xb862500' value='0x" DATA.LONG(A:0x862500) "' name='RPMH_VRM_VOLTAGE_VOTE_DRV6_REG37'/>"
WRITE #1 "        <register address='0xb862600' value='0x" DATA.LONG(A:0x862600) "' name='RPMH_VRM_VOLTAGE_VOTE_DRV6_REG38'/>"
WRITE #1 "        <register address='0xb862700' value='0x" DATA.LONG(A:0x862700) "' name='RPMH_VRM_VOLTAGE_VOTE_DRV6_REG39'/>"
WRITE #1 "        <register address='0xb862800' value='0x" DATA.LONG(A:0x862800) "' name='RPMH_VRM_VOLTAGE_VOTE_DRV6_REG40'/>"
WRITE #1 "        <register address='0xb862900' value='0x" DATA.LONG(A:0x862900) "' name='RPMH_VRM_VOLTAGE_VOTE_DRV6_REG41'/>"
WRITE #1 "        <register address='0xb862a00' value='0x" DATA.LONG(A:0x862a00) "' name='RPMH_VRM_VOLTAGE_VOTE_DRV6_REG42'/>"
WRITE #1 "        <register address='0xb862b00' value='0x" DATA.LONG(A:0x862b00) "' name='RPMH_VRM_VOLTAGE_VOTE_DRV6_REG43'/>"
WRITE #1 "        <register address='0xb862c00' value='0x" DATA.LONG(A:0x862c00) "' name='RPMH_VRM_VOLTAGE_VOTE_DRV6_REG44'/>"
WRITE #1 "        <register address='0xb862d00' value='0x" DATA.LONG(A:0x862d00) "' name='RPMH_VRM_VOLTAGE_VOTE_DRV6_REG45'/>"
WRITE #1 "        <register address='0xb870000' value='0x" DATA.LONG(A:0x870000) "' name='RPMH_VRM_VOLTAGE_VOTE_DRV7_REG0'/>"
WRITE #1 "        <register address='0xb870100' value='0x" DATA.LONG(A:0x870100) "' name='RPMH_VRM_VOLTAGE_VOTE_DRV7_REG1'/>"
WRITE #1 "        <register address='0xb870200' value='0x" DATA.LONG(A:0x870200) "' name='RPMH_VRM_VOLTAGE_VOTE_DRV7_REG2'/>"
WRITE #1 "        <register address='0xb870300' value='0x" DATA.LONG(A:0x870300) "' name='RPMH_VRM_VOLTAGE_VOTE_DRV7_REG3'/>"
WRITE #1 "        <register address='0xb870400' value='0x" DATA.LONG(A:0x870400) "' name='RPMH_VRM_VOLTAGE_VOTE_DRV7_REG4'/>"
WRITE #1 "        <register address='0xb870500' value='0x" DATA.LONG(A:0x870500) "' name='RPMH_VRM_VOLTAGE_VOTE_DRV7_REG5'/>"
WRITE #1 "        <register address='0xb870600' value='0x" DATA.LONG(A:0x870600) "' name='RPMH_VRM_VOLTAGE_VOTE_DRV7_REG6'/>"
WRITE #1 "        <register address='0xb870700' value='0x" DATA.LONG(A:0x870700) "' name='RPMH_VRM_VOLTAGE_VOTE_DRV7_REG7'/>"
WRITE #1 "        <register address='0xb870800' value='0x" DATA.LONG(A:0x870800) "' name='RPMH_VRM_VOLTAGE_VOTE_DRV7_REG8'/>"
WRITE #1 "        <register address='0xb870900' value='0x" DATA.LONG(A:0x870900) "' name='RPMH_VRM_VOLTAGE_VOTE_DRV7_REG9'/>"
WRITE #1 "        <register address='0xb870a00' value='0x" DATA.LONG(A:0x870a00) "' name='RPMH_VRM_VOLTAGE_VOTE_DRV7_REG10'/>"
WRITE #1 "        <register address='0xb870b00' value='0x" DATA.LONG(A:0x870b00) "' name='RPMH_VRM_VOLTAGE_VOTE_DRV7_REG11'/>"
WRITE #1 "        <register address='0xb870c00' value='0x" DATA.LONG(A:0x870c00) "' name='RPMH_VRM_VOLTAGE_VOTE_DRV7_REG12'/>"
WRITE #1 "        <register address='0xb870d00' value='0x" DATA.LONG(A:0x870d00) "' name='RPMH_VRM_VOLTAGE_VOTE_DRV7_REG13'/>"
WRITE #1 "        <register address='0xb870e00' value='0x" DATA.LONG(A:0x870e00) "' name='RPMH_VRM_VOLTAGE_VOTE_DRV7_REG14'/>"
WRITE #1 "        <register address='0xb870f00' value='0x" DATA.LONG(A:0x870f00) "' name='RPMH_VRM_VOLTAGE_VOTE_DRV7_REG15'/>"
WRITE #1 "        <register address='0xb871000' value='0x" DATA.LONG(A:0x871000) "' name='RPMH_VRM_VOLTAGE_VOTE_DRV7_REG16'/>"
WRITE #1 "        <register address='0xb871100' value='0x" DATA.LONG(A:0x871100) "' name='RPMH_VRM_VOLTAGE_VOTE_DRV7_REG17'/>"
WRITE #1 "        <register address='0xb871200' value='0x" DATA.LONG(A:0x871200) "' name='RPMH_VRM_VOLTAGE_VOTE_DRV7_REG18'/>"
WRITE #1 "        <register address='0xb871300' value='0x" DATA.LONG(A:0x871300) "' name='RPMH_VRM_VOLTAGE_VOTE_DRV7_REG19'/>"
WRITE #1 "        <register address='0xb871400' value='0x" DATA.LONG(A:0x871400) "' name='RPMH_VRM_VOLTAGE_VOTE_DRV7_REG20'/>"
WRITE #1 "        <register address='0xb871500' value='0x" DATA.LONG(A:0x871500) "' name='RPMH_VRM_VOLTAGE_VOTE_DRV7_REG21'/>"
WRITE #1 "        <register address='0xb871600' value='0x" DATA.LONG(A:0x871600) "' name='RPMH_VRM_VOLTAGE_VOTE_DRV7_REG22'/>"
WRITE #1 "        <register address='0xb871700' value='0x" DATA.LONG(A:0x871700) "' name='RPMH_VRM_VOLTAGE_VOTE_DRV7_REG23'/>"
WRITE #1 "        <register address='0xb871800' value='0x" DATA.LONG(A:0x871800) "' name='RPMH_VRM_VOLTAGE_VOTE_DRV7_REG24'/>"
WRITE #1 "        <register address='0xb871900' value='0x" DATA.LONG(A:0x871900) "' name='RPMH_VRM_VOLTAGE_VOTE_DRV7_REG25'/>"
WRITE #1 "        <register address='0xb871a00' value='0x" DATA.LONG(A:0x871a00) "' name='RPMH_VRM_VOLTAGE_VOTE_DRV7_REG26'/>"
WRITE #1 "        <register address='0xb871b00' value='0x" DATA.LONG(A:0x871b00) "' name='RPMH_VRM_VOLTAGE_VOTE_DRV7_REG27'/>"
WRITE #1 "        <register address='0xb871c00' value='0x" DATA.LONG(A:0x871c00) "' name='RPMH_VRM_VOLTAGE_VOTE_DRV7_REG28'/>"
WRITE #1 "        <register address='0xb871d00' value='0x" DATA.LONG(A:0x871d00) "' name='RPMH_VRM_VOLTAGE_VOTE_DRV7_REG29'/>"
WRITE #1 "        <register address='0xb871e00' value='0x" DATA.LONG(A:0x871e00) "' name='RPMH_VRM_VOLTAGE_VOTE_DRV7_REG30'/>"
WRITE #1 "        <register address='0xb871f00' value='0x" DATA.LONG(A:0x871f00) "' name='RPMH_VRM_VOLTAGE_VOTE_DRV7_REG31'/>"
WRITE #1 "        <register address='0xb872000' value='0x" DATA.LONG(A:0x872000) "' name='RPMH_VRM_VOLTAGE_VOTE_DRV7_REG32'/>"
WRITE #1 "        <register address='0xb872100' value='0x" DATA.LONG(A:0x872100) "' name='RPMH_VRM_VOLTAGE_VOTE_DRV7_REG33'/>"
WRITE #1 "        <register address='0xb872200' value='0x" DATA.LONG(A:0x872200) "' name='RPMH_VRM_VOLTAGE_VOTE_DRV7_REG34'/>"
WRITE #1 "        <register address='0xb872300' value='0x" DATA.LONG(A:0x872300) "' name='RPMH_VRM_VOLTAGE_VOTE_DRV7_REG35'/>"
WRITE #1 "        <register address='0xb872400' value='0x" DATA.LONG(A:0x872400) "' name='RPMH_VRM_VOLTAGE_VOTE_DRV7_REG36'/>"
WRITE #1 "        <register address='0xb872500' value='0x" DATA.LONG(A:0x872500) "' name='RPMH_VRM_VOLTAGE_VOTE_DRV7_REG37'/>"
WRITE #1 "        <register address='0xb872600' value='0x" DATA.LONG(A:0x872600) "' name='RPMH_VRM_VOLTAGE_VOTE_DRV7_REG38'/>"
WRITE #1 "        <register address='0xb872700' value='0x" DATA.LONG(A:0x872700) "' name='RPMH_VRM_VOLTAGE_VOTE_DRV7_REG39'/>"
WRITE #1 "        <register address='0xb872800' value='0x" DATA.LONG(A:0x872800) "' name='RPMH_VRM_VOLTAGE_VOTE_DRV7_REG40'/>"
WRITE #1 "        <register address='0xb872900' value='0x" DATA.LONG(A:0x872900) "' name='RPMH_VRM_VOLTAGE_VOTE_DRV7_REG41'/>"
WRITE #1 "        <register address='0xb872a00' value='0x" DATA.LONG(A:0x872a00) "' name='RPMH_VRM_VOLTAGE_VOTE_DRV7_REG42'/>"
WRITE #1 "        <register address='0xb872b00' value='0x" DATA.LONG(A:0x872b00) "' name='RPMH_VRM_VOLTAGE_VOTE_DRV7_REG43'/>"
WRITE #1 "        <register address='0xb872c00' value='0x" DATA.LONG(A:0x872c00) "' name='RPMH_VRM_VOLTAGE_VOTE_DRV7_REG44'/>"
WRITE #1 "        <register address='0xb872d00' value='0x" DATA.LONG(A:0x872d00) "' name='RPMH_VRM_VOLTAGE_VOTE_DRV7_REG45'/>"
WRITE #1 "        <register address='0xb880000' value='0x" DATA.LONG(A:0x880000) "' name='RPMH_VRM_VOLTAGE_VOTE_DRV8_REG0'/>"
WRITE #1 "        <register address='0xb880100' value='0x" DATA.LONG(A:0x880100) "' name='RPMH_VRM_VOLTAGE_VOTE_DRV8_REG1'/>"
WRITE #1 "        <register address='0xb880200' value='0x" DATA.LONG(A:0x880200) "' name='RPMH_VRM_VOLTAGE_VOTE_DRV8_REG2'/>"
WRITE #1 "        <register address='0xb880300' value='0x" DATA.LONG(A:0x880300) "' name='RPMH_VRM_VOLTAGE_VOTE_DRV8_REG3'/>"
WRITE #1 "        <register address='0xb880400' value='0x" DATA.LONG(A:0x880400) "' name='RPMH_VRM_VOLTAGE_VOTE_DRV8_REG4'/>"
WRITE #1 "        <register address='0xb880500' value='0x" DATA.LONG(A:0x880500) "' name='RPMH_VRM_VOLTAGE_VOTE_DRV8_REG5'/>"
WRITE #1 "        <register address='0xb880600' value='0x" DATA.LONG(A:0x880600) "' name='RPMH_VRM_VOLTAGE_VOTE_DRV8_REG6'/>"
WRITE #1 "        <register address='0xb880700' value='0x" DATA.LONG(A:0x880700) "' name='RPMH_VRM_VOLTAGE_VOTE_DRV8_REG7'/>"
WRITE #1 "        <register address='0xb880800' value='0x" DATA.LONG(A:0x880800) "' name='RPMH_VRM_VOLTAGE_VOTE_DRV8_REG8'/>"
WRITE #1 "        <register address='0xb880900' value='0x" DATA.LONG(A:0x880900) "' name='RPMH_VRM_VOLTAGE_VOTE_DRV8_REG9'/>"
WRITE #1 "        <register address='0xb880a00' value='0x" DATA.LONG(A:0x880a00) "' name='RPMH_VRM_VOLTAGE_VOTE_DRV8_REG10'/>"
WRITE #1 "        <register address='0xb880b00' value='0x" DATA.LONG(A:0x880b00) "' name='RPMH_VRM_VOLTAGE_VOTE_DRV8_REG11'/>"
WRITE #1 "        <register address='0xb880c00' value='0x" DATA.LONG(A:0x880c00) "' name='RPMH_VRM_VOLTAGE_VOTE_DRV8_REG12'/>"
WRITE #1 "        <register address='0xb880d00' value='0x" DATA.LONG(A:0x880d00) "' name='RPMH_VRM_VOLTAGE_VOTE_DRV8_REG13'/>"
WRITE #1 "        <register address='0xb880e00' value='0x" DATA.LONG(A:0x880e00) "' name='RPMH_VRM_VOLTAGE_VOTE_DRV8_REG14'/>"
WRITE #1 "        <register address='0xb880f00' value='0x" DATA.LONG(A:0x880f00) "' name='RPMH_VRM_VOLTAGE_VOTE_DRV8_REG15'/>"
WRITE #1 "        <register address='0xb881000' value='0x" DATA.LONG(A:0x881000) "' name='RPMH_VRM_VOLTAGE_VOTE_DRV8_REG16'/>"
WRITE #1 "        <register address='0xb881100' value='0x" DATA.LONG(A:0x881100) "' name='RPMH_VRM_VOLTAGE_VOTE_DRV8_REG17'/>"
WRITE #1 "        <register address='0xb881200' value='0x" DATA.LONG(A:0x881200) "' name='RPMH_VRM_VOLTAGE_VOTE_DRV8_REG18'/>"
WRITE #1 "        <register address='0xb881300' value='0x" DATA.LONG(A:0x881300) "' name='RPMH_VRM_VOLTAGE_VOTE_DRV8_REG19'/>"
WRITE #1 "        <register address='0xb881400' value='0x" DATA.LONG(A:0x881400) "' name='RPMH_VRM_VOLTAGE_VOTE_DRV8_REG20'/>"
WRITE #1 "        <register address='0xb881500' value='0x" DATA.LONG(A:0x881500) "' name='RPMH_VRM_VOLTAGE_VOTE_DRV8_REG21'/>"
WRITE #1 "        <register address='0xb881600' value='0x" DATA.LONG(A:0x881600) "' name='RPMH_VRM_VOLTAGE_VOTE_DRV8_REG22'/>"
WRITE #1 "        <register address='0xb881700' value='0x" DATA.LONG(A:0x881700) "' name='RPMH_VRM_VOLTAGE_VOTE_DRV8_REG23'/>"
WRITE #1 "        <register address='0xb881800' value='0x" DATA.LONG(A:0x881800) "' name='RPMH_VRM_VOLTAGE_VOTE_DRV8_REG24'/>"
WRITE #1 "        <register address='0xb881900' value='0x" DATA.LONG(A:0x881900) "' name='RPMH_VRM_VOLTAGE_VOTE_DRV8_REG25'/>"
WRITE #1 "        <register address='0xb881a00' value='0x" DATA.LONG(A:0x881a00) "' name='RPMH_VRM_VOLTAGE_VOTE_DRV8_REG26'/>"
WRITE #1 "        <register address='0xb881b00' value='0x" DATA.LONG(A:0x881b00) "' name='RPMH_VRM_VOLTAGE_VOTE_DRV8_REG27'/>"
WRITE #1 "        <register address='0xb881c00' value='0x" DATA.LONG(A:0x881c00) "' name='RPMH_VRM_VOLTAGE_VOTE_DRV8_REG28'/>"
WRITE #1 "        <register address='0xb881d00' value='0x" DATA.LONG(A:0x881d00) "' name='RPMH_VRM_VOLTAGE_VOTE_DRV8_REG29'/>"
WRITE #1 "        <register address='0xb881e00' value='0x" DATA.LONG(A:0x881e00) "' name='RPMH_VRM_VOLTAGE_VOTE_DRV8_REG30'/>"
WRITE #1 "        <register address='0xb881f00' value='0x" DATA.LONG(A:0x881f00) "' name='RPMH_VRM_VOLTAGE_VOTE_DRV8_REG31'/>"
WRITE #1 "        <register address='0xb882000' value='0x" DATA.LONG(A:0x882000) "' name='RPMH_VRM_VOLTAGE_VOTE_DRV8_REG32'/>"
WRITE #1 "        <register address='0xb882100' value='0x" DATA.LONG(A:0x882100) "' name='RPMH_VRM_VOLTAGE_VOTE_DRV8_REG33'/>"
WRITE #1 "        <register address='0xb882200' value='0x" DATA.LONG(A:0x882200) "' name='RPMH_VRM_VOLTAGE_VOTE_DRV8_REG34'/>"
WRITE #1 "        <register address='0xb882300' value='0x" DATA.LONG(A:0x882300) "' name='RPMH_VRM_VOLTAGE_VOTE_DRV8_REG35'/>"
WRITE #1 "        <register address='0xb882400' value='0x" DATA.LONG(A:0x882400) "' name='RPMH_VRM_VOLTAGE_VOTE_DRV8_REG36'/>"
WRITE #1 "        <register address='0xb882500' value='0x" DATA.LONG(A:0x882500) "' name='RPMH_VRM_VOLTAGE_VOTE_DRV8_REG37'/>"
WRITE #1 "        <register address='0xb882600' value='0x" DATA.LONG(A:0x882600) "' name='RPMH_VRM_VOLTAGE_VOTE_DRV8_REG38'/>"
WRITE #1 "        <register address='0xb882700' value='0x" DATA.LONG(A:0x882700) "' name='RPMH_VRM_VOLTAGE_VOTE_DRV8_REG39'/>"
WRITE #1 "        <register address='0xb882800' value='0x" DATA.LONG(A:0x882800) "' name='RPMH_VRM_VOLTAGE_VOTE_DRV8_REG40'/>"
WRITE #1 "        <register address='0xb882900' value='0x" DATA.LONG(A:0x882900) "' name='RPMH_VRM_VOLTAGE_VOTE_DRV8_REG41'/>"
WRITE #1 "        <register address='0xb882a00' value='0x" DATA.LONG(A:0x882a00) "' name='RPMH_VRM_VOLTAGE_VOTE_DRV8_REG42'/>"
WRITE #1 "        <register address='0xb882b00' value='0x" DATA.LONG(A:0x882b00) "' name='RPMH_VRM_VOLTAGE_VOTE_DRV8_REG43'/>"
WRITE #1 "        <register address='0xb882c00' value='0x" DATA.LONG(A:0x882c00) "' name='RPMH_VRM_VOLTAGE_VOTE_DRV8_REG44'/>"
WRITE #1 "        <register address='0xb882d00' value='0x" DATA.LONG(A:0x882d00) "' name='RPMH_VRM_VOLTAGE_VOTE_DRV8_REG45'/>"
WRITE #1 "        <register address='0xb890000' value='0x" DATA.LONG(A:0x890000) "' name='RPMH_VRM_VOLTAGE_VOTE_DRV9_REG0'/>"
WRITE #1 "        <register address='0xb890100' value='0x" DATA.LONG(A:0x890100) "' name='RPMH_VRM_VOLTAGE_VOTE_DRV9_REG1'/>"
WRITE #1 "        <register address='0xb890200' value='0x" DATA.LONG(A:0x890200) "' name='RPMH_VRM_VOLTAGE_VOTE_DRV9_REG2'/>"
WRITE #1 "        <register address='0xb890300' value='0x" DATA.LONG(A:0x890300) "' name='RPMH_VRM_VOLTAGE_VOTE_DRV9_REG3'/>"
WRITE #1 "        <register address='0xb890400' value='0x" DATA.LONG(A:0x890400) "' name='RPMH_VRM_VOLTAGE_VOTE_DRV9_REG4'/>"
WRITE #1 "        <register address='0xb890500' value='0x" DATA.LONG(A:0x890500) "' name='RPMH_VRM_VOLTAGE_VOTE_DRV9_REG5'/>"
WRITE #1 "        <register address='0xb890600' value='0x" DATA.LONG(A:0x890600) "' name='RPMH_VRM_VOLTAGE_VOTE_DRV9_REG6'/>"
WRITE #1 "        <register address='0xb890700' value='0x" DATA.LONG(A:0x890700) "' name='RPMH_VRM_VOLTAGE_VOTE_DRV9_REG7'/>"
WRITE #1 "        <register address='0xb890800' value='0x" DATA.LONG(A:0x890800) "' name='RPMH_VRM_VOLTAGE_VOTE_DRV9_REG8'/>"
WRITE #1 "        <register address='0xb890900' value='0x" DATA.LONG(A:0x890900) "' name='RPMH_VRM_VOLTAGE_VOTE_DRV9_REG9'/>"
WRITE #1 "        <register address='0xb890a00' value='0x" DATA.LONG(A:0x890a00) "' name='RPMH_VRM_VOLTAGE_VOTE_DRV9_REG10'/>"
WRITE #1 "        <register address='0xb890b00' value='0x" DATA.LONG(A:0x890b00) "' name='RPMH_VRM_VOLTAGE_VOTE_DRV9_REG11'/>"
WRITE #1 "        <register address='0xb890c00' value='0x" DATA.LONG(A:0x890c00) "' name='RPMH_VRM_VOLTAGE_VOTE_DRV9_REG12'/>"
WRITE #1 "        <register address='0xb890d00' value='0x" DATA.LONG(A:0x890d00) "' name='RPMH_VRM_VOLTAGE_VOTE_DRV9_REG13'/>"
WRITE #1 "        <register address='0xb890e00' value='0x" DATA.LONG(A:0x890e00) "' name='RPMH_VRM_VOLTAGE_VOTE_DRV9_REG14'/>"
WRITE #1 "        <register address='0xb890f00' value='0x" DATA.LONG(A:0x890f00) "' name='RPMH_VRM_VOLTAGE_VOTE_DRV9_REG15'/>"
WRITE #1 "        <register address='0xb891000' value='0x" DATA.LONG(A:0x891000) "' name='RPMH_VRM_VOLTAGE_VOTE_DRV9_REG16'/>"
WRITE #1 "        <register address='0xb891100' value='0x" DATA.LONG(A:0x891100) "' name='RPMH_VRM_VOLTAGE_VOTE_DRV9_REG17'/>"
WRITE #1 "        <register address='0xb891200' value='0x" DATA.LONG(A:0x891200) "' name='RPMH_VRM_VOLTAGE_VOTE_DRV9_REG18'/>"
WRITE #1 "        <register address='0xb891300' value='0x" DATA.LONG(A:0x891300) "' name='RPMH_VRM_VOLTAGE_VOTE_DRV9_REG19'/>"
WRITE #1 "        <register address='0xb891400' value='0x" DATA.LONG(A:0x891400) "' name='RPMH_VRM_VOLTAGE_VOTE_DRV9_REG20'/>"
WRITE #1 "        <register address='0xb891500' value='0x" DATA.LONG(A:0x891500) "' name='RPMH_VRM_VOLTAGE_VOTE_DRV9_REG21'/>"
WRITE #1 "        <register address='0xb891600' value='0x" DATA.LONG(A:0x891600) "' name='RPMH_VRM_VOLTAGE_VOTE_DRV9_REG22'/>"
WRITE #1 "        <register address='0xb891700' value='0x" DATA.LONG(A:0x891700) "' name='RPMH_VRM_VOLTAGE_VOTE_DRV9_REG23'/>"
WRITE #1 "        <register address='0xb891800' value='0x" DATA.LONG(A:0x891800) "' name='RPMH_VRM_VOLTAGE_VOTE_DRV9_REG24'/>"
WRITE #1 "        <register address='0xb891900' value='0x" DATA.LONG(A:0x891900) "' name='RPMH_VRM_VOLTAGE_VOTE_DRV9_REG25'/>"
WRITE #1 "        <register address='0xb891a00' value='0x" DATA.LONG(A:0x891a00) "' name='RPMH_VRM_VOLTAGE_VOTE_DRV9_REG26'/>"
WRITE #1 "        <register address='0xb891b00' value='0x" DATA.LONG(A:0x891b00) "' name='RPMH_VRM_VOLTAGE_VOTE_DRV9_REG27'/>"
WRITE #1 "        <register address='0xb891c00' value='0x" DATA.LONG(A:0x891c00) "' name='RPMH_VRM_VOLTAGE_VOTE_DRV9_REG28'/>"
WRITE #1 "        <register address='0xb891d00' value='0x" DATA.LONG(A:0x891d00) "' name='RPMH_VRM_VOLTAGE_VOTE_DRV9_REG29'/>"
WRITE #1 "        <register address='0xb891e00' value='0x" DATA.LONG(A:0x891e00) "' name='RPMH_VRM_VOLTAGE_VOTE_DRV9_REG30'/>"
WRITE #1 "        <register address='0xb891f00' value='0x" DATA.LONG(A:0x891f00) "' name='RPMH_VRM_VOLTAGE_VOTE_DRV9_REG31'/>"
WRITE #1 "        <register address='0xb892000' value='0x" DATA.LONG(A:0x892000) "' name='RPMH_VRM_VOLTAGE_VOTE_DRV9_REG32'/>"
WRITE #1 "        <register address='0xb892100' value='0x" DATA.LONG(A:0x892100) "' name='RPMH_VRM_VOLTAGE_VOTE_DRV9_REG33'/>"
WRITE #1 "        <register address='0xb892200' value='0x" DATA.LONG(A:0x892200) "' name='RPMH_VRM_VOLTAGE_VOTE_DRV9_REG34'/>"
WRITE #1 "        <register address='0xb892300' value='0x" DATA.LONG(A:0x892300) "' name='RPMH_VRM_VOLTAGE_VOTE_DRV9_REG35'/>"
WRITE #1 "        <register address='0xb892400' value='0x" DATA.LONG(A:0x892400) "' name='RPMH_VRM_VOLTAGE_VOTE_DRV9_REG36'/>"
WRITE #1 "        <register address='0xb892500' value='0x" DATA.LONG(A:0x892500) "' name='RPMH_VRM_VOLTAGE_VOTE_DRV9_REG37'/>"
WRITE #1 "        <register address='0xb892600' value='0x" DATA.LONG(A:0x892600) "' name='RPMH_VRM_VOLTAGE_VOTE_DRV9_REG38'/>"
WRITE #1 "        <register address='0xb892700' value='0x" DATA.LONG(A:0x892700) "' name='RPMH_VRM_VOLTAGE_VOTE_DRV9_REG39'/>"
WRITE #1 "        <register address='0xb892800' value='0x" DATA.LONG(A:0x892800) "' name='RPMH_VRM_VOLTAGE_VOTE_DRV9_REG40'/>"
WRITE #1 "        <register address='0xb892900' value='0x" DATA.LONG(A:0x892900) "' name='RPMH_VRM_VOLTAGE_VOTE_DRV9_REG41'/>"
WRITE #1 "        <register address='0xb892a00' value='0x" DATA.LONG(A:0x892a00) "' name='RPMH_VRM_VOLTAGE_VOTE_DRV9_REG42'/>"
WRITE #1 "        <register address='0xb892b00' value='0x" DATA.LONG(A:0x892b00) "' name='RPMH_VRM_VOLTAGE_VOTE_DRV9_REG43'/>"
WRITE #1 "        <register address='0xb892c00' value='0x" DATA.LONG(A:0x892c00) "' name='RPMH_VRM_VOLTAGE_VOTE_DRV9_REG44'/>"
WRITE #1 "        <register address='0xb892d00' value='0x" DATA.LONG(A:0x892d00) "' name='RPMH_VRM_VOLTAGE_VOTE_DRV9_REG45'/>"
WRITE #1 "        <register address='0xb8a0000' value='0x" DATA.LONG(A:0x8a0000) "' name='RPMH_VRM_VOLTAGE_VOTE_DRV10_REG0'/>"
WRITE #1 "        <register address='0xb8a0100' value='0x" DATA.LONG(A:0x8a0100) "' name='RPMH_VRM_VOLTAGE_VOTE_DRV10_REG1'/>"
WRITE #1 "        <register address='0xb8a0200' value='0x" DATA.LONG(A:0x8a0200) "' name='RPMH_VRM_VOLTAGE_VOTE_DRV10_REG2'/>"
WRITE #1 "        <register address='0xb8a0300' value='0x" DATA.LONG(A:0x8a0300) "' name='RPMH_VRM_VOLTAGE_VOTE_DRV10_REG3'/>"
WRITE #1 "        <register address='0xb8a0400' value='0x" DATA.LONG(A:0x8a0400) "' name='RPMH_VRM_VOLTAGE_VOTE_DRV10_REG4'/>"
WRITE #1 "        <register address='0xb8a0500' value='0x" DATA.LONG(A:0x8a0500) "' name='RPMH_VRM_VOLTAGE_VOTE_DRV10_REG5'/>"
WRITE #1 "        <register address='0xb8a0600' value='0x" DATA.LONG(A:0x8a0600) "' name='RPMH_VRM_VOLTAGE_VOTE_DRV10_REG6'/>"
WRITE #1 "        <register address='0xb8a0700' value='0x" DATA.LONG(A:0x8a0700) "' name='RPMH_VRM_VOLTAGE_VOTE_DRV10_REG7'/>"
WRITE #1 "        <register address='0xb8a0800' value='0x" DATA.LONG(A:0x8a0800) "' name='RPMH_VRM_VOLTAGE_VOTE_DRV10_REG8'/>"
WRITE #1 "        <register address='0xb8a0900' value='0x" DATA.LONG(A:0x8a0900) "' name='RPMH_VRM_VOLTAGE_VOTE_DRV10_REG9'/>"
WRITE #1 "        <register address='0xb8a0a00' value='0x" DATA.LONG(A:0x8a0a00) "' name='RPMH_VRM_VOLTAGE_VOTE_DRV10_REG10'/>"
WRITE #1 "        <register address='0xb8a0b00' value='0x" DATA.LONG(A:0x8a0b00) "' name='RPMH_VRM_VOLTAGE_VOTE_DRV10_REG11'/>"
WRITE #1 "        <register address='0xb8a0c00' value='0x" DATA.LONG(A:0x8a0c00) "' name='RPMH_VRM_VOLTAGE_VOTE_DRV10_REG12'/>"
WRITE #1 "        <register address='0xb8a0d00' value='0x" DATA.LONG(A:0x8a0d00) "' name='RPMH_VRM_VOLTAGE_VOTE_DRV10_REG13'/>"
WRITE #1 "        <register address='0xb8a0e00' value='0x" DATA.LONG(A:0x8a0e00) "' name='RPMH_VRM_VOLTAGE_VOTE_DRV10_REG14'/>"
WRITE #1 "        <register address='0xb8a0f00' value='0x" DATA.LONG(A:0x8a0f00) "' name='RPMH_VRM_VOLTAGE_VOTE_DRV10_REG15'/>"
WRITE #1 "        <register address='0xb8a1000' value='0x" DATA.LONG(A:0x8a1000) "' name='RPMH_VRM_VOLTAGE_VOTE_DRV10_REG16'/>"
WRITE #1 "        <register address='0xb8a1100' value='0x" DATA.LONG(A:0x8a1100) "' name='RPMH_VRM_VOLTAGE_VOTE_DRV10_REG17'/>"
WRITE #1 "        <register address='0xb8a1200' value='0x" DATA.LONG(A:0x8a1200) "' name='RPMH_VRM_VOLTAGE_VOTE_DRV10_REG18'/>"
WRITE #1 "        <register address='0xb8a1300' value='0x" DATA.LONG(A:0x8a1300) "' name='RPMH_VRM_VOLTAGE_VOTE_DRV10_REG19'/>"
WRITE #1 "        <register address='0xb8a1400' value='0x" DATA.LONG(A:0x8a1400) "' name='RPMH_VRM_VOLTAGE_VOTE_DRV10_REG20'/>"
WRITE #1 "        <register address='0xb8a1500' value='0x" DATA.LONG(A:0x8a1500) "' name='RPMH_VRM_VOLTAGE_VOTE_DRV10_REG21'/>"
WRITE #1 "        <register address='0xb8a1600' value='0x" DATA.LONG(A:0x8a1600) "' name='RPMH_VRM_VOLTAGE_VOTE_DRV10_REG22'/>"
WRITE #1 "        <register address='0xb8a1700' value='0x" DATA.LONG(A:0x8a1700) "' name='RPMH_VRM_VOLTAGE_VOTE_DRV10_REG23'/>"
WRITE #1 "        <register address='0xb8a1800' value='0x" DATA.LONG(A:0x8a1800) "' name='RPMH_VRM_VOLTAGE_VOTE_DRV10_REG24'/>"
WRITE #1 "        <register address='0xb8a1900' value='0x" DATA.LONG(A:0x8a1900) "' name='RPMH_VRM_VOLTAGE_VOTE_DRV10_REG25'/>"
WRITE #1 "        <register address='0xb8a1a00' value='0x" DATA.LONG(A:0x8a1a00) "' name='RPMH_VRM_VOLTAGE_VOTE_DRV10_REG26'/>"
WRITE #1 "        <register address='0xb8a1b00' value='0x" DATA.LONG(A:0x8a1b00) "' name='RPMH_VRM_VOLTAGE_VOTE_DRV10_REG27'/>"
WRITE #1 "        <register address='0xb8a1c00' value='0x" DATA.LONG(A:0x8a1c00) "' name='RPMH_VRM_VOLTAGE_VOTE_DRV10_REG28'/>"
WRITE #1 "        <register address='0xb8a1d00' value='0x" DATA.LONG(A:0x8a1d00) "' name='RPMH_VRM_VOLTAGE_VOTE_DRV10_REG29'/>"
WRITE #1 "        <register address='0xb8a1e00' value='0x" DATA.LONG(A:0x8a1e00) "' name='RPMH_VRM_VOLTAGE_VOTE_DRV10_REG30'/>"
WRITE #1 "        <register address='0xb8a1f00' value='0x" DATA.LONG(A:0x8a1f00) "' name='RPMH_VRM_VOLTAGE_VOTE_DRV10_REG31'/>"
WRITE #1 "        <register address='0xb8a2000' value='0x" DATA.LONG(A:0x8a2000) "' name='RPMH_VRM_VOLTAGE_VOTE_DRV10_REG32'/>"
WRITE #1 "        <register address='0xb8a2100' value='0x" DATA.LONG(A:0x8a2100) "' name='RPMH_VRM_VOLTAGE_VOTE_DRV10_REG33'/>"
WRITE #1 "        <register address='0xb8a2200' value='0x" DATA.LONG(A:0x8a2200) "' name='RPMH_VRM_VOLTAGE_VOTE_DRV10_REG34'/>"
WRITE #1 "        <register address='0xb8a2300' value='0x" DATA.LONG(A:0x8a2300) "' name='RPMH_VRM_VOLTAGE_VOTE_DRV10_REG35'/>"
WRITE #1 "        <register address='0xb8a2400' value='0x" DATA.LONG(A:0x8a2400) "' name='RPMH_VRM_VOLTAGE_VOTE_DRV10_REG36'/>"
WRITE #1 "        <register address='0xb8a2500' value='0x" DATA.LONG(A:0x8a2500) "' name='RPMH_VRM_VOLTAGE_VOTE_DRV10_REG37'/>"
WRITE #1 "        <register address='0xb8a2600' value='0x" DATA.LONG(A:0x8a2600) "' name='RPMH_VRM_VOLTAGE_VOTE_DRV10_REG38'/>"
WRITE #1 "        <register address='0xb8a2700' value='0x" DATA.LONG(A:0x8a2700) "' name='RPMH_VRM_VOLTAGE_VOTE_DRV10_REG39'/>"
WRITE #1 "        <register address='0xb8a2800' value='0x" DATA.LONG(A:0x8a2800) "' name='RPMH_VRM_VOLTAGE_VOTE_DRV10_REG40'/>"
WRITE #1 "        <register address='0xb8a2900' value='0x" DATA.LONG(A:0x8a2900) "' name='RPMH_VRM_VOLTAGE_VOTE_DRV10_REG41'/>"
WRITE #1 "        <register address='0xb8a2a00' value='0x" DATA.LONG(A:0x8a2a00) "' name='RPMH_VRM_VOLTAGE_VOTE_DRV10_REG42'/>"
WRITE #1 "        <register address='0xb8a2b00' value='0x" DATA.LONG(A:0x8a2b00) "' name='RPMH_VRM_VOLTAGE_VOTE_DRV10_REG43'/>"
WRITE #1 "        <register address='0xb8a2c00' value='0x" DATA.LONG(A:0x8a2c00) "' name='RPMH_VRM_VOLTAGE_VOTE_DRV10_REG44'/>"
WRITE #1 "        <register address='0xb8a2d00' value='0x" DATA.LONG(A:0x8a2d00) "' name='RPMH_VRM_VOLTAGE_VOTE_DRV10_REG45'/>"
WRITE #1 "        <register address='0xb8b0000' value='0x" DATA.LONG(A:0x8b0000) "' name='RPMH_VRM_VOLTAGE_VOTE_DRV11_REG0'/>"
WRITE #1 "        <register address='0xb8b0100' value='0x" DATA.LONG(A:0x8b0100) "' name='RPMH_VRM_VOLTAGE_VOTE_DRV11_REG1'/>"
WRITE #1 "        <register address='0xb8b0200' value='0x" DATA.LONG(A:0x8b0200) "' name='RPMH_VRM_VOLTAGE_VOTE_DRV11_REG2'/>"
WRITE #1 "        <register address='0xb8b0300' value='0x" DATA.LONG(A:0x8b0300) "' name='RPMH_VRM_VOLTAGE_VOTE_DRV11_REG3'/>"
WRITE #1 "        <register address='0xb8b0400' value='0x" DATA.LONG(A:0x8b0400) "' name='RPMH_VRM_VOLTAGE_VOTE_DRV11_REG4'/>"
WRITE #1 "        <register address='0xb8b0500' value='0x" DATA.LONG(A:0x8b0500) "' name='RPMH_VRM_VOLTAGE_VOTE_DRV11_REG5'/>"
WRITE #1 "        <register address='0xb8b0600' value='0x" DATA.LONG(A:0x8b0600) "' name='RPMH_VRM_VOLTAGE_VOTE_DRV11_REG6'/>"
WRITE #1 "        <register address='0xb8b0700' value='0x" DATA.LONG(A:0x8b0700) "' name='RPMH_VRM_VOLTAGE_VOTE_DRV11_REG7'/>"
WRITE #1 "        <register address='0xb8b0800' value='0x" DATA.LONG(A:0x8b0800) "' name='RPMH_VRM_VOLTAGE_VOTE_DRV11_REG8'/>"
WRITE #1 "        <register address='0xb8b0900' value='0x" DATA.LONG(A:0x8b0900) "' name='RPMH_VRM_VOLTAGE_VOTE_DRV11_REG9'/>"
WRITE #1 "        <register address='0xb8b0a00' value='0x" DATA.LONG(A:0x8b0a00) "' name='RPMH_VRM_VOLTAGE_VOTE_DRV11_REG10'/>"
WRITE #1 "        <register address='0xb8b0b00' value='0x" DATA.LONG(A:0x8b0b00) "' name='RPMH_VRM_VOLTAGE_VOTE_DRV11_REG11'/>"
WRITE #1 "        <register address='0xb8b0c00' value='0x" DATA.LONG(A:0x8b0c00) "' name='RPMH_VRM_VOLTAGE_VOTE_DRV11_REG12'/>"
WRITE #1 "        <register address='0xb8b0d00' value='0x" DATA.LONG(A:0x8b0d00) "' name='RPMH_VRM_VOLTAGE_VOTE_DRV11_REG13'/>"
WRITE #1 "        <register address='0xb8b0e00' value='0x" DATA.LONG(A:0x8b0e00) "' name='RPMH_VRM_VOLTAGE_VOTE_DRV11_REG14'/>"
WRITE #1 "        <register address='0xb8b0f00' value='0x" DATA.LONG(A:0x8b0f00) "' name='RPMH_VRM_VOLTAGE_VOTE_DRV11_REG15'/>"
WRITE #1 "        <register address='0xb8b1000' value='0x" DATA.LONG(A:0x8b1000) "' name='RPMH_VRM_VOLTAGE_VOTE_DRV11_REG16'/>"
WRITE #1 "        <register address='0xb8b1100' value='0x" DATA.LONG(A:0x8b1100) "' name='RPMH_VRM_VOLTAGE_VOTE_DRV11_REG17'/>"
WRITE #1 "        <register address='0xb8b1200' value='0x" DATA.LONG(A:0x8b1200) "' name='RPMH_VRM_VOLTAGE_VOTE_DRV11_REG18'/>"
WRITE #1 "        <register address='0xb8b1300' value='0x" DATA.LONG(A:0x8b1300) "' name='RPMH_VRM_VOLTAGE_VOTE_DRV11_REG19'/>"
WRITE #1 "        <register address='0xb8b1400' value='0x" DATA.LONG(A:0x8b1400) "' name='RPMH_VRM_VOLTAGE_VOTE_DRV11_REG20'/>"
WRITE #1 "        <register address='0xb8b1500' value='0x" DATA.LONG(A:0x8b1500) "' name='RPMH_VRM_VOLTAGE_VOTE_DRV11_REG21'/>"
WRITE #1 "        <register address='0xb8b1600' value='0x" DATA.LONG(A:0x8b1600) "' name='RPMH_VRM_VOLTAGE_VOTE_DRV11_REG22'/>"
WRITE #1 "        <register address='0xb8b1700' value='0x" DATA.LONG(A:0x8b1700) "' name='RPMH_VRM_VOLTAGE_VOTE_DRV11_REG23'/>"
WRITE #1 "        <register address='0xb8b1800' value='0x" DATA.LONG(A:0x8b1800) "' name='RPMH_VRM_VOLTAGE_VOTE_DRV11_REG24'/>"
WRITE #1 "        <register address='0xb8b1900' value='0x" DATA.LONG(A:0x8b1900) "' name='RPMH_VRM_VOLTAGE_VOTE_DRV11_REG25'/>"
WRITE #1 "        <register address='0xb8b1a00' value='0x" DATA.LONG(A:0x8b1a00) "' name='RPMH_VRM_VOLTAGE_VOTE_DRV11_REG26'/>"
WRITE #1 "        <register address='0xb8b1b00' value='0x" DATA.LONG(A:0x8b1b00) "' name='RPMH_VRM_VOLTAGE_VOTE_DRV11_REG27'/>"
WRITE #1 "        <register address='0xb8b1c00' value='0x" DATA.LONG(A:0x8b1c00) "' name='RPMH_VRM_VOLTAGE_VOTE_DRV11_REG28'/>"
WRITE #1 "        <register address='0xb8b1d00' value='0x" DATA.LONG(A:0x8b1d00) "' name='RPMH_VRM_VOLTAGE_VOTE_DRV11_REG29'/>"
WRITE #1 "        <register address='0xb8b1e00' value='0x" DATA.LONG(A:0x8b1e00) "' name='RPMH_VRM_VOLTAGE_VOTE_DRV11_REG30'/>"
WRITE #1 "        <register address='0xb8b1f00' value='0x" DATA.LONG(A:0x8b1f00) "' name='RPMH_VRM_VOLTAGE_VOTE_DRV11_REG31'/>"
WRITE #1 "        <register address='0xb8b2000' value='0x" DATA.LONG(A:0x8b2000) "' name='RPMH_VRM_VOLTAGE_VOTE_DRV11_REG32'/>"
WRITE #1 "        <register address='0xb8b2100' value='0x" DATA.LONG(A:0x8b2100) "' name='RPMH_VRM_VOLTAGE_VOTE_DRV11_REG33'/>"
WRITE #1 "        <register address='0xb8b2200' value='0x" DATA.LONG(A:0x8b2200) "' name='RPMH_VRM_VOLTAGE_VOTE_DRV11_REG34'/>"
WRITE #1 "        <register address='0xb8b2300' value='0x" DATA.LONG(A:0x8b2300) "' name='RPMH_VRM_VOLTAGE_VOTE_DRV11_REG35'/>"
WRITE #1 "        <register address='0xb8b2400' value='0x" DATA.LONG(A:0x8b2400) "' name='RPMH_VRM_VOLTAGE_VOTE_DRV11_REG36'/>"
WRITE #1 "        <register address='0xb8b2500' value='0x" DATA.LONG(A:0x8b2500) "' name='RPMH_VRM_VOLTAGE_VOTE_DRV11_REG37'/>"
WRITE #1 "        <register address='0xb8b2600' value='0x" DATA.LONG(A:0x8b2600) "' name='RPMH_VRM_VOLTAGE_VOTE_DRV11_REG38'/>"
WRITE #1 "        <register address='0xb8b2700' value='0x" DATA.LONG(A:0x8b2700) "' name='RPMH_VRM_VOLTAGE_VOTE_DRV11_REG39'/>"
WRITE #1 "        <register address='0xb8b2800' value='0x" DATA.LONG(A:0x8b2800) "' name='RPMH_VRM_VOLTAGE_VOTE_DRV11_REG40'/>"
WRITE #1 "        <register address='0xb8b2900' value='0x" DATA.LONG(A:0x8b2900) "' name='RPMH_VRM_VOLTAGE_VOTE_DRV11_REG41'/>"
WRITE #1 "        <register address='0xb8b2a00' value='0x" DATA.LONG(A:0x8b2a00) "' name='RPMH_VRM_VOLTAGE_VOTE_DRV11_REG42'/>"
WRITE #1 "        <register address='0xb8b2b00' value='0x" DATA.LONG(A:0x8b2b00) "' name='RPMH_VRM_VOLTAGE_VOTE_DRV11_REG43'/>"
WRITE #1 "        <register address='0xb8b2c00' value='0x" DATA.LONG(A:0x8b2c00) "' name='RPMH_VRM_VOLTAGE_VOTE_DRV11_REG44'/>"
WRITE #1 "        <register address='0xb8b2d00' value='0x" DATA.LONG(A:0x8b2d00) "' name='RPMH_VRM_VOLTAGE_VOTE_DRV11_REG45'/>"
WRITE #1 "        <register address='0xb800004' value='0x" DATA.LONG(A:0x800004) "' name='RPMH_VRM_ENABLE_VOTE_DRV0_REG0'/>"
WRITE #1 "        <register address='0xb800104' value='0x" DATA.LONG(A:0x800104) "' name='RPMH_VRM_ENABLE_VOTE_DRV0_REG1'/>"
WRITE #1 "        <register address='0xb800204' value='0x" DATA.LONG(A:0x800204) "' name='RPMH_VRM_ENABLE_VOTE_DRV0_REG2'/>"
WRITE #1 "        <register address='0xb800304' value='0x" DATA.LONG(A:0x800304) "' name='RPMH_VRM_ENABLE_VOTE_DRV0_REG3'/>"
WRITE #1 "        <register address='0xb800404' value='0x" DATA.LONG(A:0x800404) "' name='RPMH_VRM_ENABLE_VOTE_DRV0_REG4'/>"
WRITE #1 "        <register address='0xb800504' value='0x" DATA.LONG(A:0x800504) "' name='RPMH_VRM_ENABLE_VOTE_DRV0_REG5'/>"
WRITE #1 "        <register address='0xb800604' value='0x" DATA.LONG(A:0x800604) "' name='RPMH_VRM_ENABLE_VOTE_DRV0_REG6'/>"
WRITE #1 "        <register address='0xb800704' value='0x" DATA.LONG(A:0x800704) "' name='RPMH_VRM_ENABLE_VOTE_DRV0_REG7'/>"
WRITE #1 "        <register address='0xb800804' value='0x" DATA.LONG(A:0x800804) "' name='RPMH_VRM_ENABLE_VOTE_DRV0_REG8'/>"
WRITE #1 "        <register address='0xb800904' value='0x" DATA.LONG(A:0x800904) "' name='RPMH_VRM_ENABLE_VOTE_DRV0_REG9'/>"
WRITE #1 "        <register address='0xb800a04' value='0x" DATA.LONG(A:0x800a04) "' name='RPMH_VRM_ENABLE_VOTE_DRV0_REG10'/>"
WRITE #1 "        <register address='0xb800b04' value='0x" DATA.LONG(A:0x800b04) "' name='RPMH_VRM_ENABLE_VOTE_DRV0_REG11'/>"
WRITE #1 "        <register address='0xb800c04' value='0x" DATA.LONG(A:0x800c04) "' name='RPMH_VRM_ENABLE_VOTE_DRV0_REG12'/>"
WRITE #1 "        <register address='0xb800d04' value='0x" DATA.LONG(A:0x800d04) "' name='RPMH_VRM_ENABLE_VOTE_DRV0_REG13'/>"
WRITE #1 "        <register address='0xb800e04' value='0x" DATA.LONG(A:0x800e04) "' name='RPMH_VRM_ENABLE_VOTE_DRV0_REG14'/>"
WRITE #1 "        <register address='0xb800f04' value='0x" DATA.LONG(A:0x800f04) "' name='RPMH_VRM_ENABLE_VOTE_DRV0_REG15'/>"
WRITE #1 "        <register address='0xb801004' value='0x" DATA.LONG(A:0x801004) "' name='RPMH_VRM_ENABLE_VOTE_DRV0_REG16'/>"
WRITE #1 "        <register address='0xb801104' value='0x" DATA.LONG(A:0x801104) "' name='RPMH_VRM_ENABLE_VOTE_DRV0_REG17'/>"
WRITE #1 "        <register address='0xb801204' value='0x" DATA.LONG(A:0x801204) "' name='RPMH_VRM_ENABLE_VOTE_DRV0_REG18'/>"
WRITE #1 "        <register address='0xb801304' value='0x" DATA.LONG(A:0x801304) "' name='RPMH_VRM_ENABLE_VOTE_DRV0_REG19'/>"
WRITE #1 "        <register address='0xb801404' value='0x" DATA.LONG(A:0x801404) "' name='RPMH_VRM_ENABLE_VOTE_DRV0_REG20'/>"
WRITE #1 "        <register address='0xb801504' value='0x" DATA.LONG(A:0x801504) "' name='RPMH_VRM_ENABLE_VOTE_DRV0_REG21'/>"
WRITE #1 "        <register address='0xb801604' value='0x" DATA.LONG(A:0x801604) "' name='RPMH_VRM_ENABLE_VOTE_DRV0_REG22'/>"
WRITE #1 "        <register address='0xb801704' value='0x" DATA.LONG(A:0x801704) "' name='RPMH_VRM_ENABLE_VOTE_DRV0_REG23'/>"
WRITE #1 "        <register address='0xb801804' value='0x" DATA.LONG(A:0x801804) "' name='RPMH_VRM_ENABLE_VOTE_DRV0_REG24'/>"
WRITE #1 "        <register address='0xb801904' value='0x" DATA.LONG(A:0x801904) "' name='RPMH_VRM_ENABLE_VOTE_DRV0_REG25'/>"
WRITE #1 "        <register address='0xb801a04' value='0x" DATA.LONG(A:0x801a04) "' name='RPMH_VRM_ENABLE_VOTE_DRV0_REG26'/>"
WRITE #1 "        <register address='0xb801b04' value='0x" DATA.LONG(A:0x801b04) "' name='RPMH_VRM_ENABLE_VOTE_DRV0_REG27'/>"
WRITE #1 "        <register address='0xb801c04' value='0x" DATA.LONG(A:0x801c04) "' name='RPMH_VRM_ENABLE_VOTE_DRV0_REG28'/>"
WRITE #1 "        <register address='0xb801d04' value='0x" DATA.LONG(A:0x801d04) "' name='RPMH_VRM_ENABLE_VOTE_DRV0_REG29'/>"
WRITE #1 "        <register address='0xb801e04' value='0x" DATA.LONG(A:0x801e04) "' name='RPMH_VRM_ENABLE_VOTE_DRV0_REG30'/>"
WRITE #1 "        <register address='0xb801f04' value='0x" DATA.LONG(A:0x801f04) "' name='RPMH_VRM_ENABLE_VOTE_DRV0_REG31'/>"
WRITE #1 "        <register address='0xb802004' value='0x" DATA.LONG(A:0x802004) "' name='RPMH_VRM_ENABLE_VOTE_DRV0_REG32'/>"
WRITE #1 "        <register address='0xb802104' value='0x" DATA.LONG(A:0x802104) "' name='RPMH_VRM_ENABLE_VOTE_DRV0_REG33'/>"
WRITE #1 "        <register address='0xb802204' value='0x" DATA.LONG(A:0x802204) "' name='RPMH_VRM_ENABLE_VOTE_DRV0_REG34'/>"
WRITE #1 "        <register address='0xb802304' value='0x" DATA.LONG(A:0x802304) "' name='RPMH_VRM_ENABLE_VOTE_DRV0_REG35'/>"
WRITE #1 "        <register address='0xb802404' value='0x" DATA.LONG(A:0x802404) "' name='RPMH_VRM_ENABLE_VOTE_DRV0_REG36'/>"
WRITE #1 "        <register address='0xb802504' value='0x" DATA.LONG(A:0x802504) "' name='RPMH_VRM_ENABLE_VOTE_DRV0_REG37'/>"
WRITE #1 "        <register address='0xb802604' value='0x" DATA.LONG(A:0x802604) "' name='RPMH_VRM_ENABLE_VOTE_DRV0_REG38'/>"
WRITE #1 "        <register address='0xb802704' value='0x" DATA.LONG(A:0x802704) "' name='RPMH_VRM_ENABLE_VOTE_DRV0_REG39'/>"
WRITE #1 "        <register address='0xb802804' value='0x" DATA.LONG(A:0x802804) "' name='RPMH_VRM_ENABLE_VOTE_DRV0_REG40'/>"
WRITE #1 "        <register address='0xb802904' value='0x" DATA.LONG(A:0x802904) "' name='RPMH_VRM_ENABLE_VOTE_DRV0_REG41'/>"
WRITE #1 "        <register address='0xb802a04' value='0x" DATA.LONG(A:0x802a04) "' name='RPMH_VRM_ENABLE_VOTE_DRV0_REG42'/>"
WRITE #1 "        <register address='0xb802b04' value='0x" DATA.LONG(A:0x802b04) "' name='RPMH_VRM_ENABLE_VOTE_DRV0_REG43'/>"
WRITE #1 "        <register address='0xb802c04' value='0x" DATA.LONG(A:0x802c04) "' name='RPMH_VRM_ENABLE_VOTE_DRV0_REG44'/>"
WRITE #1 "        <register address='0xb802d04' value='0x" DATA.LONG(A:0x802d04) "' name='RPMH_VRM_ENABLE_VOTE_DRV0_REG45'/>"
WRITE #1 "        <register address='0xb810004' value='0x" DATA.LONG(A:0x810004) "' name='RPMH_VRM_ENABLE_VOTE_DRV1_REG0'/>"
WRITE #1 "        <register address='0xb810104' value='0x" DATA.LONG(A:0x810104) "' name='RPMH_VRM_ENABLE_VOTE_DRV1_REG1'/>"
WRITE #1 "        <register address='0xb810204' value='0x" DATA.LONG(A:0x810204) "' name='RPMH_VRM_ENABLE_VOTE_DRV1_REG2'/>"
WRITE #1 "        <register address='0xb810304' value='0x" DATA.LONG(A:0x810304) "' name='RPMH_VRM_ENABLE_VOTE_DRV1_REG3'/>"
WRITE #1 "        <register address='0xb810404' value='0x" DATA.LONG(A:0x810404) "' name='RPMH_VRM_ENABLE_VOTE_DRV1_REG4'/>"
WRITE #1 "        <register address='0xb810504' value='0x" DATA.LONG(A:0x810504) "' name='RPMH_VRM_ENABLE_VOTE_DRV1_REG5'/>"
WRITE #1 "        <register address='0xb810604' value='0x" DATA.LONG(A:0x810604) "' name='RPMH_VRM_ENABLE_VOTE_DRV1_REG6'/>"
WRITE #1 "        <register address='0xb810704' value='0x" DATA.LONG(A:0x810704) "' name='RPMH_VRM_ENABLE_VOTE_DRV1_REG7'/>"
WRITE #1 "        <register address='0xb810804' value='0x" DATA.LONG(A:0x810804) "' name='RPMH_VRM_ENABLE_VOTE_DRV1_REG8'/>"
WRITE #1 "        <register address='0xb810904' value='0x" DATA.LONG(A:0x810904) "' name='RPMH_VRM_ENABLE_VOTE_DRV1_REG9'/>"
WRITE #1 "        <register address='0xb810a04' value='0x" DATA.LONG(A:0x810a04) "' name='RPMH_VRM_ENABLE_VOTE_DRV1_REG10'/>"
WRITE #1 "        <register address='0xb810b04' value='0x" DATA.LONG(A:0x810b04) "' name='RPMH_VRM_ENABLE_VOTE_DRV1_REG11'/>"
WRITE #1 "        <register address='0xb810c04' value='0x" DATA.LONG(A:0x810c04) "' name='RPMH_VRM_ENABLE_VOTE_DRV1_REG12'/>"
WRITE #1 "        <register address='0xb810d04' value='0x" DATA.LONG(A:0x810d04) "' name='RPMH_VRM_ENABLE_VOTE_DRV1_REG13'/>"
WRITE #1 "        <register address='0xb810e04' value='0x" DATA.LONG(A:0x810e04) "' name='RPMH_VRM_ENABLE_VOTE_DRV1_REG14'/>"
WRITE #1 "        <register address='0xb810f04' value='0x" DATA.LONG(A:0x810f04) "' name='RPMH_VRM_ENABLE_VOTE_DRV1_REG15'/>"
WRITE #1 "        <register address='0xb811004' value='0x" DATA.LONG(A:0x811004) "' name='RPMH_VRM_ENABLE_VOTE_DRV1_REG16'/>"
WRITE #1 "        <register address='0xb811104' value='0x" DATA.LONG(A:0x811104) "' name='RPMH_VRM_ENABLE_VOTE_DRV1_REG17'/>"
WRITE #1 "        <register address='0xb811204' value='0x" DATA.LONG(A:0x811204) "' name='RPMH_VRM_ENABLE_VOTE_DRV1_REG18'/>"
WRITE #1 "        <register address='0xb811304' value='0x" DATA.LONG(A:0x811304) "' name='RPMH_VRM_ENABLE_VOTE_DRV1_REG19'/>"
WRITE #1 "        <register address='0xb811404' value='0x" DATA.LONG(A:0x811404) "' name='RPMH_VRM_ENABLE_VOTE_DRV1_REG20'/>"
WRITE #1 "        <register address='0xb811504' value='0x" DATA.LONG(A:0x811504) "' name='RPMH_VRM_ENABLE_VOTE_DRV1_REG21'/>"
WRITE #1 "        <register address='0xb811604' value='0x" DATA.LONG(A:0x811604) "' name='RPMH_VRM_ENABLE_VOTE_DRV1_REG22'/>"
WRITE #1 "        <register address='0xb811704' value='0x" DATA.LONG(A:0x811704) "' name='RPMH_VRM_ENABLE_VOTE_DRV1_REG23'/>"
WRITE #1 "        <register address='0xb811804' value='0x" DATA.LONG(A:0x811804) "' name='RPMH_VRM_ENABLE_VOTE_DRV1_REG24'/>"
WRITE #1 "        <register address='0xb811904' value='0x" DATA.LONG(A:0x811904) "' name='RPMH_VRM_ENABLE_VOTE_DRV1_REG25'/>"
WRITE #1 "        <register address='0xb811a04' value='0x" DATA.LONG(A:0x811a04) "' name='RPMH_VRM_ENABLE_VOTE_DRV1_REG26'/>"
WRITE #1 "        <register address='0xb811b04' value='0x" DATA.LONG(A:0x811b04) "' name='RPMH_VRM_ENABLE_VOTE_DRV1_REG27'/>"
WRITE #1 "        <register address='0xb811c04' value='0x" DATA.LONG(A:0x811c04) "' name='RPMH_VRM_ENABLE_VOTE_DRV1_REG28'/>"
WRITE #1 "        <register address='0xb811d04' value='0x" DATA.LONG(A:0x811d04) "' name='RPMH_VRM_ENABLE_VOTE_DRV1_REG29'/>"
WRITE #1 "        <register address='0xb811e04' value='0x" DATA.LONG(A:0x811e04) "' name='RPMH_VRM_ENABLE_VOTE_DRV1_REG30'/>"
WRITE #1 "        <register address='0xb811f04' value='0x" DATA.LONG(A:0x811f04) "' name='RPMH_VRM_ENABLE_VOTE_DRV1_REG31'/>"
WRITE #1 "        <register address='0xb812004' value='0x" DATA.LONG(A:0x812004) "' name='RPMH_VRM_ENABLE_VOTE_DRV1_REG32'/>"
WRITE #1 "        <register address='0xb812104' value='0x" DATA.LONG(A:0x812104) "' name='RPMH_VRM_ENABLE_VOTE_DRV1_REG33'/>"
WRITE #1 "        <register address='0xb812204' value='0x" DATA.LONG(A:0x812204) "' name='RPMH_VRM_ENABLE_VOTE_DRV1_REG34'/>"
WRITE #1 "        <register address='0xb812304' value='0x" DATA.LONG(A:0x812304) "' name='RPMH_VRM_ENABLE_VOTE_DRV1_REG35'/>"
WRITE #1 "        <register address='0xb812404' value='0x" DATA.LONG(A:0x812404) "' name='RPMH_VRM_ENABLE_VOTE_DRV1_REG36'/>"
WRITE #1 "        <register address='0xb812504' value='0x" DATA.LONG(A:0x812504) "' name='RPMH_VRM_ENABLE_VOTE_DRV1_REG37'/>"
WRITE #1 "        <register address='0xb812604' value='0x" DATA.LONG(A:0x812604) "' name='RPMH_VRM_ENABLE_VOTE_DRV1_REG38'/>"
WRITE #1 "        <register address='0xb812704' value='0x" DATA.LONG(A:0x812704) "' name='RPMH_VRM_ENABLE_VOTE_DRV1_REG39'/>"
WRITE #1 "        <register address='0xb812804' value='0x" DATA.LONG(A:0x812804) "' name='RPMH_VRM_ENABLE_VOTE_DRV1_REG40'/>"
WRITE #1 "        <register address='0xb812904' value='0x" DATA.LONG(A:0x812904) "' name='RPMH_VRM_ENABLE_VOTE_DRV1_REG41'/>"
WRITE #1 "        <register address='0xb812a04' value='0x" DATA.LONG(A:0x812a04) "' name='RPMH_VRM_ENABLE_VOTE_DRV1_REG42'/>"
WRITE #1 "        <register address='0xb812b04' value='0x" DATA.LONG(A:0x812b04) "' name='RPMH_VRM_ENABLE_VOTE_DRV1_REG43'/>"
WRITE #1 "        <register address='0xb812c04' value='0x" DATA.LONG(A:0x812c04) "' name='RPMH_VRM_ENABLE_VOTE_DRV1_REG44'/>"
WRITE #1 "        <register address='0xb812d04' value='0x" DATA.LONG(A:0x812d04) "' name='RPMH_VRM_ENABLE_VOTE_DRV1_REG45'/>"
WRITE #1 "        <register address='0xb820004' value='0x" DATA.LONG(A:0x820004) "' name='RPMH_VRM_ENABLE_VOTE_DRV2_REG0'/>"
WRITE #1 "        <register address='0xb820104' value='0x" DATA.LONG(A:0x820104) "' name='RPMH_VRM_ENABLE_VOTE_DRV2_REG1'/>"
WRITE #1 "        <register address='0xb820204' value='0x" DATA.LONG(A:0x820204) "' name='RPMH_VRM_ENABLE_VOTE_DRV2_REG2'/>"
WRITE #1 "        <register address='0xb820304' value='0x" DATA.LONG(A:0x820304) "' name='RPMH_VRM_ENABLE_VOTE_DRV2_REG3'/>"
WRITE #1 "        <register address='0xb820404' value='0x" DATA.LONG(A:0x820404) "' name='RPMH_VRM_ENABLE_VOTE_DRV2_REG4'/>"
WRITE #1 "        <register address='0xb820504' value='0x" DATA.LONG(A:0x820504) "' name='RPMH_VRM_ENABLE_VOTE_DRV2_REG5'/>"
WRITE #1 "        <register address='0xb820604' value='0x" DATA.LONG(A:0x820604) "' name='RPMH_VRM_ENABLE_VOTE_DRV2_REG6'/>"
WRITE #1 "        <register address='0xb820704' value='0x" DATA.LONG(A:0x820704) "' name='RPMH_VRM_ENABLE_VOTE_DRV2_REG7'/>"
WRITE #1 "        <register address='0xb820804' value='0x" DATA.LONG(A:0x820804) "' name='RPMH_VRM_ENABLE_VOTE_DRV2_REG8'/>"
WRITE #1 "        <register address='0xb820904' value='0x" DATA.LONG(A:0x820904) "' name='RPMH_VRM_ENABLE_VOTE_DRV2_REG9'/>"
WRITE #1 "        <register address='0xb820a04' value='0x" DATA.LONG(A:0x820a04) "' name='RPMH_VRM_ENABLE_VOTE_DRV2_REG10'/>"
WRITE #1 "        <register address='0xb820b04' value='0x" DATA.LONG(A:0x820b04) "' name='RPMH_VRM_ENABLE_VOTE_DRV2_REG11'/>"
WRITE #1 "        <register address='0xb820c04' value='0x" DATA.LONG(A:0x820c04) "' name='RPMH_VRM_ENABLE_VOTE_DRV2_REG12'/>"
WRITE #1 "        <register address='0xb820d04' value='0x" DATA.LONG(A:0x820d04) "' name='RPMH_VRM_ENABLE_VOTE_DRV2_REG13'/>"
WRITE #1 "        <register address='0xb820e04' value='0x" DATA.LONG(A:0x820e04) "' name='RPMH_VRM_ENABLE_VOTE_DRV2_REG14'/>"
WRITE #1 "        <register address='0xb820f04' value='0x" DATA.LONG(A:0x820f04) "' name='RPMH_VRM_ENABLE_VOTE_DRV2_REG15'/>"
WRITE #1 "        <register address='0xb821004' value='0x" DATA.LONG(A:0x821004) "' name='RPMH_VRM_ENABLE_VOTE_DRV2_REG16'/>"
WRITE #1 "        <register address='0xb821104' value='0x" DATA.LONG(A:0x821104) "' name='RPMH_VRM_ENABLE_VOTE_DRV2_REG17'/>"
WRITE #1 "        <register address='0xb821204' value='0x" DATA.LONG(A:0x821204) "' name='RPMH_VRM_ENABLE_VOTE_DRV2_REG18'/>"
WRITE #1 "        <register address='0xb821304' value='0x" DATA.LONG(A:0x821304) "' name='RPMH_VRM_ENABLE_VOTE_DRV2_REG19'/>"
WRITE #1 "        <register address='0xb821404' value='0x" DATA.LONG(A:0x821404) "' name='RPMH_VRM_ENABLE_VOTE_DRV2_REG20'/>"
WRITE #1 "        <register address='0xb821504' value='0x" DATA.LONG(A:0x821504) "' name='RPMH_VRM_ENABLE_VOTE_DRV2_REG21'/>"
WRITE #1 "        <register address='0xb821604' value='0x" DATA.LONG(A:0x821604) "' name='RPMH_VRM_ENABLE_VOTE_DRV2_REG22'/>"
WRITE #1 "        <register address='0xb821704' value='0x" DATA.LONG(A:0x821704) "' name='RPMH_VRM_ENABLE_VOTE_DRV2_REG23'/>"
WRITE #1 "        <register address='0xb821804' value='0x" DATA.LONG(A:0x821804) "' name='RPMH_VRM_ENABLE_VOTE_DRV2_REG24'/>"
WRITE #1 "        <register address='0xb821904' value='0x" DATA.LONG(A:0x821904) "' name='RPMH_VRM_ENABLE_VOTE_DRV2_REG25'/>"
WRITE #1 "        <register address='0xb821a04' value='0x" DATA.LONG(A:0x821a04) "' name='RPMH_VRM_ENABLE_VOTE_DRV2_REG26'/>"
WRITE #1 "        <register address='0xb821b04' value='0x" DATA.LONG(A:0x821b04) "' name='RPMH_VRM_ENABLE_VOTE_DRV2_REG27'/>"
WRITE #1 "        <register address='0xb821c04' value='0x" DATA.LONG(A:0x821c04) "' name='RPMH_VRM_ENABLE_VOTE_DRV2_REG28'/>"
WRITE #1 "        <register address='0xb821d04' value='0x" DATA.LONG(A:0x821d04) "' name='RPMH_VRM_ENABLE_VOTE_DRV2_REG29'/>"
WRITE #1 "        <register address='0xb821e04' value='0x" DATA.LONG(A:0x821e04) "' name='RPMH_VRM_ENABLE_VOTE_DRV2_REG30'/>"
WRITE #1 "        <register address='0xb821f04' value='0x" DATA.LONG(A:0x821f04) "' name='RPMH_VRM_ENABLE_VOTE_DRV2_REG31'/>"
WRITE #1 "        <register address='0xb822004' value='0x" DATA.LONG(A:0x822004) "' name='RPMH_VRM_ENABLE_VOTE_DRV2_REG32'/>"
WRITE #1 "        <register address='0xb822104' value='0x" DATA.LONG(A:0x822104) "' name='RPMH_VRM_ENABLE_VOTE_DRV2_REG33'/>"
WRITE #1 "        <register address='0xb822204' value='0x" DATA.LONG(A:0x822204) "' name='RPMH_VRM_ENABLE_VOTE_DRV2_REG34'/>"
WRITE #1 "        <register address='0xb822304' value='0x" DATA.LONG(A:0x822304) "' name='RPMH_VRM_ENABLE_VOTE_DRV2_REG35'/>"
WRITE #1 "        <register address='0xb822404' value='0x" DATA.LONG(A:0x822404) "' name='RPMH_VRM_ENABLE_VOTE_DRV2_REG36'/>"
WRITE #1 "        <register address='0xb822504' value='0x" DATA.LONG(A:0x822504) "' name='RPMH_VRM_ENABLE_VOTE_DRV2_REG37'/>"
WRITE #1 "        <register address='0xb822604' value='0x" DATA.LONG(A:0x822604) "' name='RPMH_VRM_ENABLE_VOTE_DRV2_REG38'/>"
WRITE #1 "        <register address='0xb822704' value='0x" DATA.LONG(A:0x822704) "' name='RPMH_VRM_ENABLE_VOTE_DRV2_REG39'/>"
WRITE #1 "        <register address='0xb822804' value='0x" DATA.LONG(A:0x822804) "' name='RPMH_VRM_ENABLE_VOTE_DRV2_REG40'/>"
WRITE #1 "        <register address='0xb822904' value='0x" DATA.LONG(A:0x822904) "' name='RPMH_VRM_ENABLE_VOTE_DRV2_REG41'/>"
WRITE #1 "        <register address='0xb822a04' value='0x" DATA.LONG(A:0x822a04) "' name='RPMH_VRM_ENABLE_VOTE_DRV2_REG42'/>"
WRITE #1 "        <register address='0xb822b04' value='0x" DATA.LONG(A:0x822b04) "' name='RPMH_VRM_ENABLE_VOTE_DRV2_REG43'/>"
WRITE #1 "        <register address='0xb822c04' value='0x" DATA.LONG(A:0x822c04) "' name='RPMH_VRM_ENABLE_VOTE_DRV2_REG44'/>"
WRITE #1 "        <register address='0xb822d04' value='0x" DATA.LONG(A:0x822d04) "' name='RPMH_VRM_ENABLE_VOTE_DRV2_REG45'/>"
WRITE #1 "        <register address='0xb830004' value='0x" DATA.LONG(A:0x830004) "' name='RPMH_VRM_ENABLE_VOTE_DRV3_REG0'/>"
WRITE #1 "        <register address='0xb830104' value='0x" DATA.LONG(A:0x830104) "' name='RPMH_VRM_ENABLE_VOTE_DRV3_REG1'/>"
WRITE #1 "        <register address='0xb830204' value='0x" DATA.LONG(A:0x830204) "' name='RPMH_VRM_ENABLE_VOTE_DRV3_REG2'/>"
WRITE #1 "        <register address='0xb830304' value='0x" DATA.LONG(A:0x830304) "' name='RPMH_VRM_ENABLE_VOTE_DRV3_REG3'/>"
WRITE #1 "        <register address='0xb830404' value='0x" DATA.LONG(A:0x830404) "' name='RPMH_VRM_ENABLE_VOTE_DRV3_REG4'/>"
WRITE #1 "        <register address='0xb830504' value='0x" DATA.LONG(A:0x830504) "' name='RPMH_VRM_ENABLE_VOTE_DRV3_REG5'/>"
WRITE #1 "        <register address='0xb830604' value='0x" DATA.LONG(A:0x830604) "' name='RPMH_VRM_ENABLE_VOTE_DRV3_REG6'/>"
WRITE #1 "        <register address='0xb830704' value='0x" DATA.LONG(A:0x830704) "' name='RPMH_VRM_ENABLE_VOTE_DRV3_REG7'/>"
WRITE #1 "        <register address='0xb830804' value='0x" DATA.LONG(A:0x830804) "' name='RPMH_VRM_ENABLE_VOTE_DRV3_REG8'/>"
WRITE #1 "        <register address='0xb830904' value='0x" DATA.LONG(A:0x830904) "' name='RPMH_VRM_ENABLE_VOTE_DRV3_REG9'/>"
WRITE #1 "        <register address='0xb830a04' value='0x" DATA.LONG(A:0x830a04) "' name='RPMH_VRM_ENABLE_VOTE_DRV3_REG10'/>"
WRITE #1 "        <register address='0xb830b04' value='0x" DATA.LONG(A:0x830b04) "' name='RPMH_VRM_ENABLE_VOTE_DRV3_REG11'/>"
WRITE #1 "        <register address='0xb830c04' value='0x" DATA.LONG(A:0x830c04) "' name='RPMH_VRM_ENABLE_VOTE_DRV3_REG12'/>"
WRITE #1 "        <register address='0xb830d04' value='0x" DATA.LONG(A:0x830d04) "' name='RPMH_VRM_ENABLE_VOTE_DRV3_REG13'/>"
WRITE #1 "        <register address='0xb830e04' value='0x" DATA.LONG(A:0x830e04) "' name='RPMH_VRM_ENABLE_VOTE_DRV3_REG14'/>"
WRITE #1 "        <register address='0xb830f04' value='0x" DATA.LONG(A:0x830f04) "' name='RPMH_VRM_ENABLE_VOTE_DRV3_REG15'/>"
WRITE #1 "        <register address='0xb831004' value='0x" DATA.LONG(A:0x831004) "' name='RPMH_VRM_ENABLE_VOTE_DRV3_REG16'/>"
WRITE #1 "        <register address='0xb831104' value='0x" DATA.LONG(A:0x831104) "' name='RPMH_VRM_ENABLE_VOTE_DRV3_REG17'/>"
WRITE #1 "        <register address='0xb831204' value='0x" DATA.LONG(A:0x831204) "' name='RPMH_VRM_ENABLE_VOTE_DRV3_REG18'/>"
WRITE #1 "        <register address='0xb831304' value='0x" DATA.LONG(A:0x831304) "' name='RPMH_VRM_ENABLE_VOTE_DRV3_REG19'/>"
WRITE #1 "        <register address='0xb831404' value='0x" DATA.LONG(A:0x831404) "' name='RPMH_VRM_ENABLE_VOTE_DRV3_REG20'/>"
WRITE #1 "        <register address='0xb831504' value='0x" DATA.LONG(A:0x831504) "' name='RPMH_VRM_ENABLE_VOTE_DRV3_REG21'/>"
WRITE #1 "        <register address='0xb831604' value='0x" DATA.LONG(A:0x831604) "' name='RPMH_VRM_ENABLE_VOTE_DRV3_REG22'/>"
WRITE #1 "        <register address='0xb831704' value='0x" DATA.LONG(A:0x831704) "' name='RPMH_VRM_ENABLE_VOTE_DRV3_REG23'/>"
WRITE #1 "        <register address='0xb831804' value='0x" DATA.LONG(A:0x831804) "' name='RPMH_VRM_ENABLE_VOTE_DRV3_REG24'/>"
WRITE #1 "        <register address='0xb831904' value='0x" DATA.LONG(A:0x831904) "' name='RPMH_VRM_ENABLE_VOTE_DRV3_REG25'/>"
WRITE #1 "        <register address='0xb831a04' value='0x" DATA.LONG(A:0x831a04) "' name='RPMH_VRM_ENABLE_VOTE_DRV3_REG26'/>"
WRITE #1 "        <register address='0xb831b04' value='0x" DATA.LONG(A:0x831b04) "' name='RPMH_VRM_ENABLE_VOTE_DRV3_REG27'/>"
WRITE #1 "        <register address='0xb831c04' value='0x" DATA.LONG(A:0x831c04) "' name='RPMH_VRM_ENABLE_VOTE_DRV3_REG28'/>"
WRITE #1 "        <register address='0xb831d04' value='0x" DATA.LONG(A:0x831d04) "' name='RPMH_VRM_ENABLE_VOTE_DRV3_REG29'/>"
WRITE #1 "        <register address='0xb831e04' value='0x" DATA.LONG(A:0x831e04) "' name='RPMH_VRM_ENABLE_VOTE_DRV3_REG30'/>"
WRITE #1 "        <register address='0xb831f04' value='0x" DATA.LONG(A:0x831f04) "' name='RPMH_VRM_ENABLE_VOTE_DRV3_REG31'/>"
WRITE #1 "        <register address='0xb832004' value='0x" DATA.LONG(A:0x832004) "' name='RPMH_VRM_ENABLE_VOTE_DRV3_REG32'/>"
WRITE #1 "        <register address='0xb832104' value='0x" DATA.LONG(A:0x832104) "' name='RPMH_VRM_ENABLE_VOTE_DRV3_REG33'/>"
WRITE #1 "        <register address='0xb832204' value='0x" DATA.LONG(A:0x832204) "' name='RPMH_VRM_ENABLE_VOTE_DRV3_REG34'/>"
WRITE #1 "        <register address='0xb832304' value='0x" DATA.LONG(A:0x832304) "' name='RPMH_VRM_ENABLE_VOTE_DRV3_REG35'/>"
WRITE #1 "        <register address='0xb832404' value='0x" DATA.LONG(A:0x832404) "' name='RPMH_VRM_ENABLE_VOTE_DRV3_REG36'/>"
WRITE #1 "        <register address='0xb832504' value='0x" DATA.LONG(A:0x832504) "' name='RPMH_VRM_ENABLE_VOTE_DRV3_REG37'/>"
WRITE #1 "        <register address='0xb832604' value='0x" DATA.LONG(A:0x832604) "' name='RPMH_VRM_ENABLE_VOTE_DRV3_REG38'/>"
WRITE #1 "        <register address='0xb832704' value='0x" DATA.LONG(A:0x832704) "' name='RPMH_VRM_ENABLE_VOTE_DRV3_REG39'/>"
WRITE #1 "        <register address='0xb832804' value='0x" DATA.LONG(A:0x832804) "' name='RPMH_VRM_ENABLE_VOTE_DRV3_REG40'/>"
WRITE #1 "        <register address='0xb832904' value='0x" DATA.LONG(A:0x832904) "' name='RPMH_VRM_ENABLE_VOTE_DRV3_REG41'/>"
WRITE #1 "        <register address='0xb832a04' value='0x" DATA.LONG(A:0x832a04) "' name='RPMH_VRM_ENABLE_VOTE_DRV3_REG42'/>"
WRITE #1 "        <register address='0xb832b04' value='0x" DATA.LONG(A:0x832b04) "' name='RPMH_VRM_ENABLE_VOTE_DRV3_REG43'/>"
WRITE #1 "        <register address='0xb832c04' value='0x" DATA.LONG(A:0x832c04) "' name='RPMH_VRM_ENABLE_VOTE_DRV3_REG44'/>"
WRITE #1 "        <register address='0xb832d04' value='0x" DATA.LONG(A:0x832d04) "' name='RPMH_VRM_ENABLE_VOTE_DRV3_REG45'/>"
WRITE #1 "        <register address='0xb840004' value='0x" DATA.LONG(A:0x840004) "' name='RPMH_VRM_ENABLE_VOTE_DRV4_REG0'/>"
WRITE #1 "        <register address='0xb840104' value='0x" DATA.LONG(A:0x840104) "' name='RPMH_VRM_ENABLE_VOTE_DRV4_REG1'/>"
WRITE #1 "        <register address='0xb840204' value='0x" DATA.LONG(A:0x840204) "' name='RPMH_VRM_ENABLE_VOTE_DRV4_REG2'/>"
WRITE #1 "        <register address='0xb840304' value='0x" DATA.LONG(A:0x840304) "' name='RPMH_VRM_ENABLE_VOTE_DRV4_REG3'/>"
WRITE #1 "        <register address='0xb840404' value='0x" DATA.LONG(A:0x840404) "' name='RPMH_VRM_ENABLE_VOTE_DRV4_REG4'/>"
WRITE #1 "        <register address='0xb840504' value='0x" DATA.LONG(A:0x840504) "' name='RPMH_VRM_ENABLE_VOTE_DRV4_REG5'/>"
WRITE #1 "        <register address='0xb840604' value='0x" DATA.LONG(A:0x840604) "' name='RPMH_VRM_ENABLE_VOTE_DRV4_REG6'/>"
WRITE #1 "        <register address='0xb840704' value='0x" DATA.LONG(A:0x840704) "' name='RPMH_VRM_ENABLE_VOTE_DRV4_REG7'/>"
WRITE #1 "        <register address='0xb840804' value='0x" DATA.LONG(A:0x840804) "' name='RPMH_VRM_ENABLE_VOTE_DRV4_REG8'/>"
WRITE #1 "        <register address='0xb840904' value='0x" DATA.LONG(A:0x840904) "' name='RPMH_VRM_ENABLE_VOTE_DRV4_REG9'/>"
WRITE #1 "        <register address='0xb840a04' value='0x" DATA.LONG(A:0x840a04) "' name='RPMH_VRM_ENABLE_VOTE_DRV4_REG10'/>"
WRITE #1 "        <register address='0xb840b04' value='0x" DATA.LONG(A:0x840b04) "' name='RPMH_VRM_ENABLE_VOTE_DRV4_REG11'/>"
WRITE #1 "        <register address='0xb840c04' value='0x" DATA.LONG(A:0x840c04) "' name='RPMH_VRM_ENABLE_VOTE_DRV4_REG12'/>"
WRITE #1 "        <register address='0xb840d04' value='0x" DATA.LONG(A:0x840d04) "' name='RPMH_VRM_ENABLE_VOTE_DRV4_REG13'/>"
WRITE #1 "        <register address='0xb840e04' value='0x" DATA.LONG(A:0x840e04) "' name='RPMH_VRM_ENABLE_VOTE_DRV4_REG14'/>"
WRITE #1 "        <register address='0xb840f04' value='0x" DATA.LONG(A:0x840f04) "' name='RPMH_VRM_ENABLE_VOTE_DRV4_REG15'/>"
WRITE #1 "        <register address='0xb841004' value='0x" DATA.LONG(A:0x841004) "' name='RPMH_VRM_ENABLE_VOTE_DRV4_REG16'/>"
WRITE #1 "        <register address='0xb841104' value='0x" DATA.LONG(A:0x841104) "' name='RPMH_VRM_ENABLE_VOTE_DRV4_REG17'/>"
WRITE #1 "        <register address='0xb841204' value='0x" DATA.LONG(A:0x841204) "' name='RPMH_VRM_ENABLE_VOTE_DRV4_REG18'/>"
WRITE #1 "        <register address='0xb841304' value='0x" DATA.LONG(A:0x841304) "' name='RPMH_VRM_ENABLE_VOTE_DRV4_REG19'/>"
WRITE #1 "        <register address='0xb841404' value='0x" DATA.LONG(A:0x841404) "' name='RPMH_VRM_ENABLE_VOTE_DRV4_REG20'/>"
WRITE #1 "        <register address='0xb841504' value='0x" DATA.LONG(A:0x841504) "' name='RPMH_VRM_ENABLE_VOTE_DRV4_REG21'/>"
WRITE #1 "        <register address='0xb841604' value='0x" DATA.LONG(A:0x841604) "' name='RPMH_VRM_ENABLE_VOTE_DRV4_REG22'/>"
WRITE #1 "        <register address='0xb841704' value='0x" DATA.LONG(A:0x841704) "' name='RPMH_VRM_ENABLE_VOTE_DRV4_REG23'/>"
WRITE #1 "        <register address='0xb841804' value='0x" DATA.LONG(A:0x841804) "' name='RPMH_VRM_ENABLE_VOTE_DRV4_REG24'/>"
WRITE #1 "        <register address='0xb841904' value='0x" DATA.LONG(A:0x841904) "' name='RPMH_VRM_ENABLE_VOTE_DRV4_REG25'/>"
WRITE #1 "        <register address='0xb841a04' value='0x" DATA.LONG(A:0x841a04) "' name='RPMH_VRM_ENABLE_VOTE_DRV4_REG26'/>"
WRITE #1 "        <register address='0xb841b04' value='0x" DATA.LONG(A:0x841b04) "' name='RPMH_VRM_ENABLE_VOTE_DRV4_REG27'/>"
WRITE #1 "        <register address='0xb841c04' value='0x" DATA.LONG(A:0x841c04) "' name='RPMH_VRM_ENABLE_VOTE_DRV4_REG28'/>"
WRITE #1 "        <register address='0xb841d04' value='0x" DATA.LONG(A:0x841d04) "' name='RPMH_VRM_ENABLE_VOTE_DRV4_REG29'/>"
WRITE #1 "        <register address='0xb841e04' value='0x" DATA.LONG(A:0x841e04) "' name='RPMH_VRM_ENABLE_VOTE_DRV4_REG30'/>"
WRITE #1 "        <register address='0xb841f04' value='0x" DATA.LONG(A:0x841f04) "' name='RPMH_VRM_ENABLE_VOTE_DRV4_REG31'/>"
WRITE #1 "        <register address='0xb842004' value='0x" DATA.LONG(A:0x842004) "' name='RPMH_VRM_ENABLE_VOTE_DRV4_REG32'/>"
WRITE #1 "        <register address='0xb842104' value='0x" DATA.LONG(A:0x842104) "' name='RPMH_VRM_ENABLE_VOTE_DRV4_REG33'/>"
WRITE #1 "        <register address='0xb842204' value='0x" DATA.LONG(A:0x842204) "' name='RPMH_VRM_ENABLE_VOTE_DRV4_REG34'/>"
WRITE #1 "        <register address='0xb842304' value='0x" DATA.LONG(A:0x842304) "' name='RPMH_VRM_ENABLE_VOTE_DRV4_REG35'/>"
WRITE #1 "        <register address='0xb842404' value='0x" DATA.LONG(A:0x842404) "' name='RPMH_VRM_ENABLE_VOTE_DRV4_REG36'/>"
WRITE #1 "        <register address='0xb842504' value='0x" DATA.LONG(A:0x842504) "' name='RPMH_VRM_ENABLE_VOTE_DRV4_REG37'/>"
WRITE #1 "        <register address='0xb842604' value='0x" DATA.LONG(A:0x842604) "' name='RPMH_VRM_ENABLE_VOTE_DRV4_REG38'/>"
WRITE #1 "        <register address='0xb842704' value='0x" DATA.LONG(A:0x842704) "' name='RPMH_VRM_ENABLE_VOTE_DRV4_REG39'/>"
WRITE #1 "        <register address='0xb842804' value='0x" DATA.LONG(A:0x842804) "' name='RPMH_VRM_ENABLE_VOTE_DRV4_REG40'/>"
WRITE #1 "        <register address='0xb842904' value='0x" DATA.LONG(A:0x842904) "' name='RPMH_VRM_ENABLE_VOTE_DRV4_REG41'/>"
WRITE #1 "        <register address='0xb842a04' value='0x" DATA.LONG(A:0x842a04) "' name='RPMH_VRM_ENABLE_VOTE_DRV4_REG42'/>"
WRITE #1 "        <register address='0xb842b04' value='0x" DATA.LONG(A:0x842b04) "' name='RPMH_VRM_ENABLE_VOTE_DRV4_REG43'/>"
WRITE #1 "        <register address='0xb842c04' value='0x" DATA.LONG(A:0x842c04) "' name='RPMH_VRM_ENABLE_VOTE_DRV4_REG44'/>"
WRITE #1 "        <register address='0xb842d04' value='0x" DATA.LONG(A:0x842d04) "' name='RPMH_VRM_ENABLE_VOTE_DRV4_REG45'/>"
WRITE #1 "        <register address='0xb850004' value='0x" DATA.LONG(A:0x850004) "' name='RPMH_VRM_ENABLE_VOTE_DRV5_REG0'/>"
WRITE #1 "        <register address='0xb850104' value='0x" DATA.LONG(A:0x850104) "' name='RPMH_VRM_ENABLE_VOTE_DRV5_REG1'/>"
WRITE #1 "        <register address='0xb850204' value='0x" DATA.LONG(A:0x850204) "' name='RPMH_VRM_ENABLE_VOTE_DRV5_REG2'/>"
WRITE #1 "        <register address='0xb850304' value='0x" DATA.LONG(A:0x850304) "' name='RPMH_VRM_ENABLE_VOTE_DRV5_REG3'/>"
WRITE #1 "        <register address='0xb850404' value='0x" DATA.LONG(A:0x850404) "' name='RPMH_VRM_ENABLE_VOTE_DRV5_REG4'/>"
WRITE #1 "        <register address='0xb850504' value='0x" DATA.LONG(A:0x850504) "' name='RPMH_VRM_ENABLE_VOTE_DRV5_REG5'/>"
WRITE #1 "        <register address='0xb850604' value='0x" DATA.LONG(A:0x850604) "' name='RPMH_VRM_ENABLE_VOTE_DRV5_REG6'/>"
WRITE #1 "        <register address='0xb850704' value='0x" DATA.LONG(A:0x850704) "' name='RPMH_VRM_ENABLE_VOTE_DRV5_REG7'/>"
WRITE #1 "        <register address='0xb850804' value='0x" DATA.LONG(A:0x850804) "' name='RPMH_VRM_ENABLE_VOTE_DRV5_REG8'/>"
WRITE #1 "        <register address='0xb850904' value='0x" DATA.LONG(A:0x850904) "' name='RPMH_VRM_ENABLE_VOTE_DRV5_REG9'/>"
WRITE #1 "        <register address='0xb850a04' value='0x" DATA.LONG(A:0x850a04) "' name='RPMH_VRM_ENABLE_VOTE_DRV5_REG10'/>"
WRITE #1 "        <register address='0xb850b04' value='0x" DATA.LONG(A:0x850b04) "' name='RPMH_VRM_ENABLE_VOTE_DRV5_REG11'/>"
WRITE #1 "        <register address='0xb850c04' value='0x" DATA.LONG(A:0x850c04) "' name='RPMH_VRM_ENABLE_VOTE_DRV5_REG12'/>"
WRITE #1 "        <register address='0xb850d04' value='0x" DATA.LONG(A:0x850d04) "' name='RPMH_VRM_ENABLE_VOTE_DRV5_REG13'/>"
WRITE #1 "        <register address='0xb850e04' value='0x" DATA.LONG(A:0x850e04) "' name='RPMH_VRM_ENABLE_VOTE_DRV5_REG14'/>"
WRITE #1 "        <register address='0xb850f04' value='0x" DATA.LONG(A:0x850f04) "' name='RPMH_VRM_ENABLE_VOTE_DRV5_REG15'/>"
WRITE #1 "        <register address='0xb851004' value='0x" DATA.LONG(A:0x851004) "' name='RPMH_VRM_ENABLE_VOTE_DRV5_REG16'/>"
WRITE #1 "        <register address='0xb851104' value='0x" DATA.LONG(A:0x851104) "' name='RPMH_VRM_ENABLE_VOTE_DRV5_REG17'/>"
WRITE #1 "        <register address='0xb851204' value='0x" DATA.LONG(A:0x851204) "' name='RPMH_VRM_ENABLE_VOTE_DRV5_REG18'/>"
WRITE #1 "        <register address='0xb851304' value='0x" DATA.LONG(A:0x851304) "' name='RPMH_VRM_ENABLE_VOTE_DRV5_REG19'/>"
WRITE #1 "        <register address='0xb851404' value='0x" DATA.LONG(A:0x851404) "' name='RPMH_VRM_ENABLE_VOTE_DRV5_REG20'/>"
WRITE #1 "        <register address='0xb851504' value='0x" DATA.LONG(A:0x851504) "' name='RPMH_VRM_ENABLE_VOTE_DRV5_REG21'/>"
WRITE #1 "        <register address='0xb851604' value='0x" DATA.LONG(A:0x851604) "' name='RPMH_VRM_ENABLE_VOTE_DRV5_REG22'/>"
WRITE #1 "        <register address='0xb851704' value='0x" DATA.LONG(A:0x851704) "' name='RPMH_VRM_ENABLE_VOTE_DRV5_REG23'/>"
WRITE #1 "        <register address='0xb851804' value='0x" DATA.LONG(A:0x851804) "' name='RPMH_VRM_ENABLE_VOTE_DRV5_REG24'/>"
WRITE #1 "        <register address='0xb851904' value='0x" DATA.LONG(A:0x851904) "' name='RPMH_VRM_ENABLE_VOTE_DRV5_REG25'/>"
WRITE #1 "        <register address='0xb851a04' value='0x" DATA.LONG(A:0x851a04) "' name='RPMH_VRM_ENABLE_VOTE_DRV5_REG26'/>"
WRITE #1 "        <register address='0xb851b04' value='0x" DATA.LONG(A:0x851b04) "' name='RPMH_VRM_ENABLE_VOTE_DRV5_REG27'/>"
WRITE #1 "        <register address='0xb851c04' value='0x" DATA.LONG(A:0x851c04) "' name='RPMH_VRM_ENABLE_VOTE_DRV5_REG28'/>"
WRITE #1 "        <register address='0xb851d04' value='0x" DATA.LONG(A:0x851d04) "' name='RPMH_VRM_ENABLE_VOTE_DRV5_REG29'/>"
WRITE #1 "        <register address='0xb851e04' value='0x" DATA.LONG(A:0x851e04) "' name='RPMH_VRM_ENABLE_VOTE_DRV5_REG30'/>"
WRITE #1 "        <register address='0xb851f04' value='0x" DATA.LONG(A:0x851f04) "' name='RPMH_VRM_ENABLE_VOTE_DRV5_REG31'/>"
WRITE #1 "        <register address='0xb852004' value='0x" DATA.LONG(A:0x852004) "' name='RPMH_VRM_ENABLE_VOTE_DRV5_REG32'/>"
WRITE #1 "        <register address='0xb852104' value='0x" DATA.LONG(A:0x852104) "' name='RPMH_VRM_ENABLE_VOTE_DRV5_REG33'/>"
WRITE #1 "        <register address='0xb852204' value='0x" DATA.LONG(A:0x852204) "' name='RPMH_VRM_ENABLE_VOTE_DRV5_REG34'/>"
WRITE #1 "        <register address='0xb852304' value='0x" DATA.LONG(A:0x852304) "' name='RPMH_VRM_ENABLE_VOTE_DRV5_REG35'/>"
WRITE #1 "        <register address='0xb852404' value='0x" DATA.LONG(A:0x852404) "' name='RPMH_VRM_ENABLE_VOTE_DRV5_REG36'/>"
WRITE #1 "        <register address='0xb852504' value='0x" DATA.LONG(A:0x852504) "' name='RPMH_VRM_ENABLE_VOTE_DRV5_REG37'/>"
WRITE #1 "        <register address='0xb852604' value='0x" DATA.LONG(A:0x852604) "' name='RPMH_VRM_ENABLE_VOTE_DRV5_REG38'/>"
WRITE #1 "        <register address='0xb852704' value='0x" DATA.LONG(A:0x852704) "' name='RPMH_VRM_ENABLE_VOTE_DRV5_REG39'/>"
WRITE #1 "        <register address='0xb852804' value='0x" DATA.LONG(A:0x852804) "' name='RPMH_VRM_ENABLE_VOTE_DRV5_REG40'/>"
WRITE #1 "        <register address='0xb852904' value='0x" DATA.LONG(A:0x852904) "' name='RPMH_VRM_ENABLE_VOTE_DRV5_REG41'/>"
WRITE #1 "        <register address='0xb852a04' value='0x" DATA.LONG(A:0x852a04) "' name='RPMH_VRM_ENABLE_VOTE_DRV5_REG42'/>"
WRITE #1 "        <register address='0xb852b04' value='0x" DATA.LONG(A:0x852b04) "' name='RPMH_VRM_ENABLE_VOTE_DRV5_REG43'/>"
WRITE #1 "        <register address='0xb852c04' value='0x" DATA.LONG(A:0x852c04) "' name='RPMH_VRM_ENABLE_VOTE_DRV5_REG44'/>"
WRITE #1 "        <register address='0xb852d04' value='0x" DATA.LONG(A:0x852d04) "' name='RPMH_VRM_ENABLE_VOTE_DRV5_REG45'/>"
WRITE #1 "        <register address='0xb860004' value='0x" DATA.LONG(A:0x860004) "' name='RPMH_VRM_ENABLE_VOTE_DRV6_REG0'/>"
WRITE #1 "        <register address='0xb860104' value='0x" DATA.LONG(A:0x860104) "' name='RPMH_VRM_ENABLE_VOTE_DRV6_REG1'/>"
WRITE #1 "        <register address='0xb860204' value='0x" DATA.LONG(A:0x860204) "' name='RPMH_VRM_ENABLE_VOTE_DRV6_REG2'/>"
WRITE #1 "        <register address='0xb860304' value='0x" DATA.LONG(A:0x860304) "' name='RPMH_VRM_ENABLE_VOTE_DRV6_REG3'/>"
WRITE #1 "        <register address='0xb860404' value='0x" DATA.LONG(A:0x860404) "' name='RPMH_VRM_ENABLE_VOTE_DRV6_REG4'/>"
WRITE #1 "        <register address='0xb860504' value='0x" DATA.LONG(A:0x860504) "' name='RPMH_VRM_ENABLE_VOTE_DRV6_REG5'/>"
WRITE #1 "        <register address='0xb860604' value='0x" DATA.LONG(A:0x860604) "' name='RPMH_VRM_ENABLE_VOTE_DRV6_REG6'/>"
WRITE #1 "        <register address='0xb860704' value='0x" DATA.LONG(A:0x860704) "' name='RPMH_VRM_ENABLE_VOTE_DRV6_REG7'/>"
WRITE #1 "        <register address='0xb860804' value='0x" DATA.LONG(A:0x860804) "' name='RPMH_VRM_ENABLE_VOTE_DRV6_REG8'/>"
WRITE #1 "        <register address='0xb860904' value='0x" DATA.LONG(A:0x860904) "' name='RPMH_VRM_ENABLE_VOTE_DRV6_REG9'/>"
WRITE #1 "        <register address='0xb860a04' value='0x" DATA.LONG(A:0x860a04) "' name='RPMH_VRM_ENABLE_VOTE_DRV6_REG10'/>"
WRITE #1 "        <register address='0xb860b04' value='0x" DATA.LONG(A:0x860b04) "' name='RPMH_VRM_ENABLE_VOTE_DRV6_REG11'/>"
WRITE #1 "        <register address='0xb860c04' value='0x" DATA.LONG(A:0x860c04) "' name='RPMH_VRM_ENABLE_VOTE_DRV6_REG12'/>"
WRITE #1 "        <register address='0xb860d04' value='0x" DATA.LONG(A:0x860d04) "' name='RPMH_VRM_ENABLE_VOTE_DRV6_REG13'/>"
WRITE #1 "        <register address='0xb860e04' value='0x" DATA.LONG(A:0x860e04) "' name='RPMH_VRM_ENABLE_VOTE_DRV6_REG14'/>"
WRITE #1 "        <register address='0xb860f04' value='0x" DATA.LONG(A:0x860f04) "' name='RPMH_VRM_ENABLE_VOTE_DRV6_REG15'/>"
WRITE #1 "        <register address='0xb861004' value='0x" DATA.LONG(A:0x861004) "' name='RPMH_VRM_ENABLE_VOTE_DRV6_REG16'/>"
WRITE #1 "        <register address='0xb861104' value='0x" DATA.LONG(A:0x861104) "' name='RPMH_VRM_ENABLE_VOTE_DRV6_REG17'/>"
WRITE #1 "        <register address='0xb861204' value='0x" DATA.LONG(A:0x861204) "' name='RPMH_VRM_ENABLE_VOTE_DRV6_REG18'/>"
WRITE #1 "        <register address='0xb861304' value='0x" DATA.LONG(A:0x861304) "' name='RPMH_VRM_ENABLE_VOTE_DRV6_REG19'/>"
WRITE #1 "        <register address='0xb861404' value='0x" DATA.LONG(A:0x861404) "' name='RPMH_VRM_ENABLE_VOTE_DRV6_REG20'/>"
WRITE #1 "        <register address='0xb861504' value='0x" DATA.LONG(A:0x861504) "' name='RPMH_VRM_ENABLE_VOTE_DRV6_REG21'/>"
WRITE #1 "        <register address='0xb861604' value='0x" DATA.LONG(A:0x861604) "' name='RPMH_VRM_ENABLE_VOTE_DRV6_REG22'/>"
WRITE #1 "        <register address='0xb861704' value='0x" DATA.LONG(A:0x861704) "' name='RPMH_VRM_ENABLE_VOTE_DRV6_REG23'/>"
WRITE #1 "        <register address='0xb861804' value='0x" DATA.LONG(A:0x861804) "' name='RPMH_VRM_ENABLE_VOTE_DRV6_REG24'/>"
WRITE #1 "        <register address='0xb861904' value='0x" DATA.LONG(A:0x861904) "' name='RPMH_VRM_ENABLE_VOTE_DRV6_REG25'/>"
WRITE #1 "        <register address='0xb861a04' value='0x" DATA.LONG(A:0x861a04) "' name='RPMH_VRM_ENABLE_VOTE_DRV6_REG26'/>"
WRITE #1 "        <register address='0xb861b04' value='0x" DATA.LONG(A:0x861b04) "' name='RPMH_VRM_ENABLE_VOTE_DRV6_REG27'/>"
WRITE #1 "        <register address='0xb861c04' value='0x" DATA.LONG(A:0x861c04) "' name='RPMH_VRM_ENABLE_VOTE_DRV6_REG28'/>"
WRITE #1 "        <register address='0xb861d04' value='0x" DATA.LONG(A:0x861d04) "' name='RPMH_VRM_ENABLE_VOTE_DRV6_REG29'/>"
WRITE #1 "        <register address='0xb861e04' value='0x" DATA.LONG(A:0x861e04) "' name='RPMH_VRM_ENABLE_VOTE_DRV6_REG30'/>"
WRITE #1 "        <register address='0xb861f04' value='0x" DATA.LONG(A:0x861f04) "' name='RPMH_VRM_ENABLE_VOTE_DRV6_REG31'/>"
WRITE #1 "        <register address='0xb862004' value='0x" DATA.LONG(A:0x862004) "' name='RPMH_VRM_ENABLE_VOTE_DRV6_REG32'/>"
WRITE #1 "        <register address='0xb862104' value='0x" DATA.LONG(A:0x862104) "' name='RPMH_VRM_ENABLE_VOTE_DRV6_REG33'/>"
WRITE #1 "        <register address='0xb862204' value='0x" DATA.LONG(A:0x862204) "' name='RPMH_VRM_ENABLE_VOTE_DRV6_REG34'/>"
WRITE #1 "        <register address='0xb862304' value='0x" DATA.LONG(A:0x862304) "' name='RPMH_VRM_ENABLE_VOTE_DRV6_REG35'/>"
WRITE #1 "        <register address='0xb862404' value='0x" DATA.LONG(A:0x862404) "' name='RPMH_VRM_ENABLE_VOTE_DRV6_REG36'/>"
WRITE #1 "        <register address='0xb862504' value='0x" DATA.LONG(A:0x862504) "' name='RPMH_VRM_ENABLE_VOTE_DRV6_REG37'/>"
WRITE #1 "        <register address='0xb862604' value='0x" DATA.LONG(A:0x862604) "' name='RPMH_VRM_ENABLE_VOTE_DRV6_REG38'/>"
WRITE #1 "        <register address='0xb862704' value='0x" DATA.LONG(A:0x862704) "' name='RPMH_VRM_ENABLE_VOTE_DRV6_REG39'/>"
WRITE #1 "        <register address='0xb862804' value='0x" DATA.LONG(A:0x862804) "' name='RPMH_VRM_ENABLE_VOTE_DRV6_REG40'/>"
WRITE #1 "        <register address='0xb862904' value='0x" DATA.LONG(A:0x862904) "' name='RPMH_VRM_ENABLE_VOTE_DRV6_REG41'/>"
WRITE #1 "        <register address='0xb862a04' value='0x" DATA.LONG(A:0x862a04) "' name='RPMH_VRM_ENABLE_VOTE_DRV6_REG42'/>"
WRITE #1 "        <register address='0xb862b04' value='0x" DATA.LONG(A:0x862b04) "' name='RPMH_VRM_ENABLE_VOTE_DRV6_REG43'/>"
WRITE #1 "        <register address='0xb862c04' value='0x" DATA.LONG(A:0x862c04) "' name='RPMH_VRM_ENABLE_VOTE_DRV6_REG44'/>"
WRITE #1 "        <register address='0xb862d04' value='0x" DATA.LONG(A:0x862d04) "' name='RPMH_VRM_ENABLE_VOTE_DRV6_REG45'/>"
WRITE #1 "        <register address='0xb870004' value='0x" DATA.LONG(A:0x870004) "' name='RPMH_VRM_ENABLE_VOTE_DRV7_REG0'/>"
WRITE #1 "        <register address='0xb870104' value='0x" DATA.LONG(A:0x870104) "' name='RPMH_VRM_ENABLE_VOTE_DRV7_REG1'/>"
WRITE #1 "        <register address='0xb870204' value='0x" DATA.LONG(A:0x870204) "' name='RPMH_VRM_ENABLE_VOTE_DRV7_REG2'/>"
WRITE #1 "        <register address='0xb870304' value='0x" DATA.LONG(A:0x870304) "' name='RPMH_VRM_ENABLE_VOTE_DRV7_REG3'/>"
WRITE #1 "        <register address='0xb870404' value='0x" DATA.LONG(A:0x870404) "' name='RPMH_VRM_ENABLE_VOTE_DRV7_REG4'/>"
WRITE #1 "        <register address='0xb870504' value='0x" DATA.LONG(A:0x870504) "' name='RPMH_VRM_ENABLE_VOTE_DRV7_REG5'/>"
WRITE #1 "        <register address='0xb870604' value='0x" DATA.LONG(A:0x870604) "' name='RPMH_VRM_ENABLE_VOTE_DRV7_REG6'/>"
WRITE #1 "        <register address='0xb870704' value='0x" DATA.LONG(A:0x870704) "' name='RPMH_VRM_ENABLE_VOTE_DRV7_REG7'/>"
WRITE #1 "        <register address='0xb870804' value='0x" DATA.LONG(A:0x870804) "' name='RPMH_VRM_ENABLE_VOTE_DRV7_REG8'/>"
WRITE #1 "        <register address='0xb870904' value='0x" DATA.LONG(A:0x870904) "' name='RPMH_VRM_ENABLE_VOTE_DRV7_REG9'/>"
WRITE #1 "        <register address='0xb870a04' value='0x" DATA.LONG(A:0x870a04) "' name='RPMH_VRM_ENABLE_VOTE_DRV7_REG10'/>"
WRITE #1 "        <register address='0xb870b04' value='0x" DATA.LONG(A:0x870b04) "' name='RPMH_VRM_ENABLE_VOTE_DRV7_REG11'/>"
WRITE #1 "        <register address='0xb870c04' value='0x" DATA.LONG(A:0x870c04) "' name='RPMH_VRM_ENABLE_VOTE_DRV7_REG12'/>"
WRITE #1 "        <register address='0xb870d04' value='0x" DATA.LONG(A:0x870d04) "' name='RPMH_VRM_ENABLE_VOTE_DRV7_REG13'/>"
WRITE #1 "        <register address='0xb870e04' value='0x" DATA.LONG(A:0x870e04) "' name='RPMH_VRM_ENABLE_VOTE_DRV7_REG14'/>"
WRITE #1 "        <register address='0xb870f04' value='0x" DATA.LONG(A:0x870f04) "' name='RPMH_VRM_ENABLE_VOTE_DRV7_REG15'/>"
WRITE #1 "        <register address='0xb871004' value='0x" DATA.LONG(A:0x871004) "' name='RPMH_VRM_ENABLE_VOTE_DRV7_REG16'/>"
WRITE #1 "        <register address='0xb871104' value='0x" DATA.LONG(A:0x871104) "' name='RPMH_VRM_ENABLE_VOTE_DRV7_REG17'/>"
WRITE #1 "        <register address='0xb871204' value='0x" DATA.LONG(A:0x871204) "' name='RPMH_VRM_ENABLE_VOTE_DRV7_REG18'/>"
WRITE #1 "        <register address='0xb871304' value='0x" DATA.LONG(A:0x871304) "' name='RPMH_VRM_ENABLE_VOTE_DRV7_REG19'/>"
WRITE #1 "        <register address='0xb871404' value='0x" DATA.LONG(A:0x871404) "' name='RPMH_VRM_ENABLE_VOTE_DRV7_REG20'/>"
WRITE #1 "        <register address='0xb871504' value='0x" DATA.LONG(A:0x871504) "' name='RPMH_VRM_ENABLE_VOTE_DRV7_REG21'/>"
WRITE #1 "        <register address='0xb871604' value='0x" DATA.LONG(A:0x871604) "' name='RPMH_VRM_ENABLE_VOTE_DRV7_REG22'/>"
WRITE #1 "        <register address='0xb871704' value='0x" DATA.LONG(A:0x871704) "' name='RPMH_VRM_ENABLE_VOTE_DRV7_REG23'/>"
WRITE #1 "        <register address='0xb871804' value='0x" DATA.LONG(A:0x871804) "' name='RPMH_VRM_ENABLE_VOTE_DRV7_REG24'/>"
WRITE #1 "        <register address='0xb871904' value='0x" DATA.LONG(A:0x871904) "' name='RPMH_VRM_ENABLE_VOTE_DRV7_REG25'/>"
WRITE #1 "        <register address='0xb871a04' value='0x" DATA.LONG(A:0x871a04) "' name='RPMH_VRM_ENABLE_VOTE_DRV7_REG26'/>"
WRITE #1 "        <register address='0xb871b04' value='0x" DATA.LONG(A:0x871b04) "' name='RPMH_VRM_ENABLE_VOTE_DRV7_REG27'/>"
WRITE #1 "        <register address='0xb871c04' value='0x" DATA.LONG(A:0x871c04) "' name='RPMH_VRM_ENABLE_VOTE_DRV7_REG28'/>"
WRITE #1 "        <register address='0xb871d04' value='0x" DATA.LONG(A:0x871d04) "' name='RPMH_VRM_ENABLE_VOTE_DRV7_REG29'/>"
WRITE #1 "        <register address='0xb871e04' value='0x" DATA.LONG(A:0x871e04) "' name='RPMH_VRM_ENABLE_VOTE_DRV7_REG30'/>"
WRITE #1 "        <register address='0xb871f04' value='0x" DATA.LONG(A:0x871f04) "' name='RPMH_VRM_ENABLE_VOTE_DRV7_REG31'/>"
WRITE #1 "        <register address='0xb872004' value='0x" DATA.LONG(A:0x872004) "' name='RPMH_VRM_ENABLE_VOTE_DRV7_REG32'/>"
WRITE #1 "        <register address='0xb872104' value='0x" DATA.LONG(A:0x872104) "' name='RPMH_VRM_ENABLE_VOTE_DRV7_REG33'/>"
WRITE #1 "        <register address='0xb872204' value='0x" DATA.LONG(A:0x872204) "' name='RPMH_VRM_ENABLE_VOTE_DRV7_REG34'/>"
WRITE #1 "        <register address='0xb872304' value='0x" DATA.LONG(A:0x872304) "' name='RPMH_VRM_ENABLE_VOTE_DRV7_REG35'/>"
WRITE #1 "        <register address='0xb872404' value='0x" DATA.LONG(A:0x872404) "' name='RPMH_VRM_ENABLE_VOTE_DRV7_REG36'/>"
WRITE #1 "        <register address='0xb872504' value='0x" DATA.LONG(A:0x872504) "' name='RPMH_VRM_ENABLE_VOTE_DRV7_REG37'/>"
WRITE #1 "        <register address='0xb872604' value='0x" DATA.LONG(A:0x872604) "' name='RPMH_VRM_ENABLE_VOTE_DRV7_REG38'/>"
WRITE #1 "        <register address='0xb872704' value='0x" DATA.LONG(A:0x872704) "' name='RPMH_VRM_ENABLE_VOTE_DRV7_REG39'/>"
WRITE #1 "        <register address='0xb872804' value='0x" DATA.LONG(A:0x872804) "' name='RPMH_VRM_ENABLE_VOTE_DRV7_REG40'/>"
WRITE #1 "        <register address='0xb872904' value='0x" DATA.LONG(A:0x872904) "' name='RPMH_VRM_ENABLE_VOTE_DRV7_REG41'/>"
WRITE #1 "        <register address='0xb872a04' value='0x" DATA.LONG(A:0x872a04) "' name='RPMH_VRM_ENABLE_VOTE_DRV7_REG42'/>"
WRITE #1 "        <register address='0xb872b04' value='0x" DATA.LONG(A:0x872b04) "' name='RPMH_VRM_ENABLE_VOTE_DRV7_REG43'/>"
WRITE #1 "        <register address='0xb872c04' value='0x" DATA.LONG(A:0x872c04) "' name='RPMH_VRM_ENABLE_VOTE_DRV7_REG44'/>"
WRITE #1 "        <register address='0xb872d04' value='0x" DATA.LONG(A:0x872d04) "' name='RPMH_VRM_ENABLE_VOTE_DRV7_REG45'/>"
WRITE #1 "        <register address='0xb880004' value='0x" DATA.LONG(A:0x880004) "' name='RPMH_VRM_ENABLE_VOTE_DRV8_REG0'/>"
WRITE #1 "        <register address='0xb880104' value='0x" DATA.LONG(A:0x880104) "' name='RPMH_VRM_ENABLE_VOTE_DRV8_REG1'/>"
WRITE #1 "        <register address='0xb880204' value='0x" DATA.LONG(A:0x880204) "' name='RPMH_VRM_ENABLE_VOTE_DRV8_REG2'/>"
WRITE #1 "        <register address='0xb880304' value='0x" DATA.LONG(A:0x880304) "' name='RPMH_VRM_ENABLE_VOTE_DRV8_REG3'/>"
WRITE #1 "        <register address='0xb880404' value='0x" DATA.LONG(A:0x880404) "' name='RPMH_VRM_ENABLE_VOTE_DRV8_REG4'/>"
WRITE #1 "        <register address='0xb880504' value='0x" DATA.LONG(A:0x880504) "' name='RPMH_VRM_ENABLE_VOTE_DRV8_REG5'/>"
WRITE #1 "        <register address='0xb880604' value='0x" DATA.LONG(A:0x880604) "' name='RPMH_VRM_ENABLE_VOTE_DRV8_REG6'/>"
WRITE #1 "        <register address='0xb880704' value='0x" DATA.LONG(A:0x880704) "' name='RPMH_VRM_ENABLE_VOTE_DRV8_REG7'/>"
WRITE #1 "        <register address='0xb880804' value='0x" DATA.LONG(A:0x880804) "' name='RPMH_VRM_ENABLE_VOTE_DRV8_REG8'/>"
WRITE #1 "        <register address='0xb880904' value='0x" DATA.LONG(A:0x880904) "' name='RPMH_VRM_ENABLE_VOTE_DRV8_REG9'/>"
WRITE #1 "        <register address='0xb880a04' value='0x" DATA.LONG(A:0x880a04) "' name='RPMH_VRM_ENABLE_VOTE_DRV8_REG10'/>"
WRITE #1 "        <register address='0xb880b04' value='0x" DATA.LONG(A:0x880b04) "' name='RPMH_VRM_ENABLE_VOTE_DRV8_REG11'/>"
WRITE #1 "        <register address='0xb880c04' value='0x" DATA.LONG(A:0x880c04) "' name='RPMH_VRM_ENABLE_VOTE_DRV8_REG12'/>"
WRITE #1 "        <register address='0xb880d04' value='0x" DATA.LONG(A:0x880d04) "' name='RPMH_VRM_ENABLE_VOTE_DRV8_REG13'/>"
WRITE #1 "        <register address='0xb880e04' value='0x" DATA.LONG(A:0x880e04) "' name='RPMH_VRM_ENABLE_VOTE_DRV8_REG14'/>"
WRITE #1 "        <register address='0xb880f04' value='0x" DATA.LONG(A:0x880f04) "' name='RPMH_VRM_ENABLE_VOTE_DRV8_REG15'/>"
WRITE #1 "        <register address='0xb881004' value='0x" DATA.LONG(A:0x881004) "' name='RPMH_VRM_ENABLE_VOTE_DRV8_REG16'/>"
WRITE #1 "        <register address='0xb881104' value='0x" DATA.LONG(A:0x881104) "' name='RPMH_VRM_ENABLE_VOTE_DRV8_REG17'/>"
WRITE #1 "        <register address='0xb881204' value='0x" DATA.LONG(A:0x881204) "' name='RPMH_VRM_ENABLE_VOTE_DRV8_REG18'/>"
WRITE #1 "        <register address='0xb881304' value='0x" DATA.LONG(A:0x881304) "' name='RPMH_VRM_ENABLE_VOTE_DRV8_REG19'/>"
WRITE #1 "        <register address='0xb881404' value='0x" DATA.LONG(A:0x881404) "' name='RPMH_VRM_ENABLE_VOTE_DRV8_REG20'/>"
WRITE #1 "        <register address='0xb881504' value='0x" DATA.LONG(A:0x881504) "' name='RPMH_VRM_ENABLE_VOTE_DRV8_REG21'/>"
WRITE #1 "        <register address='0xb881604' value='0x" DATA.LONG(A:0x881604) "' name='RPMH_VRM_ENABLE_VOTE_DRV8_REG22'/>"
WRITE #1 "        <register address='0xb881704' value='0x" DATA.LONG(A:0x881704) "' name='RPMH_VRM_ENABLE_VOTE_DRV8_REG23'/>"
WRITE #1 "        <register address='0xb881804' value='0x" DATA.LONG(A:0x881804) "' name='RPMH_VRM_ENABLE_VOTE_DRV8_REG24'/>"
WRITE #1 "        <register address='0xb881904' value='0x" DATA.LONG(A:0x881904) "' name='RPMH_VRM_ENABLE_VOTE_DRV8_REG25'/>"
WRITE #1 "        <register address='0xb881a04' value='0x" DATA.LONG(A:0x881a04) "' name='RPMH_VRM_ENABLE_VOTE_DRV8_REG26'/>"
WRITE #1 "        <register address='0xb881b04' value='0x" DATA.LONG(A:0x881b04) "' name='RPMH_VRM_ENABLE_VOTE_DRV8_REG27'/>"
WRITE #1 "        <register address='0xb881c04' value='0x" DATA.LONG(A:0x881c04) "' name='RPMH_VRM_ENABLE_VOTE_DRV8_REG28'/>"
WRITE #1 "        <register address='0xb881d04' value='0x" DATA.LONG(A:0x881d04) "' name='RPMH_VRM_ENABLE_VOTE_DRV8_REG29'/>"
WRITE #1 "        <register address='0xb881e04' value='0x" DATA.LONG(A:0x881e04) "' name='RPMH_VRM_ENABLE_VOTE_DRV8_REG30'/>"
WRITE #1 "        <register address='0xb881f04' value='0x" DATA.LONG(A:0x881f04) "' name='RPMH_VRM_ENABLE_VOTE_DRV8_REG31'/>"
WRITE #1 "        <register address='0xb882004' value='0x" DATA.LONG(A:0x882004) "' name='RPMH_VRM_ENABLE_VOTE_DRV8_REG32'/>"
WRITE #1 "        <register address='0xb882104' value='0x" DATA.LONG(A:0x882104) "' name='RPMH_VRM_ENABLE_VOTE_DRV8_REG33'/>"
WRITE #1 "        <register address='0xb882204' value='0x" DATA.LONG(A:0x882204) "' name='RPMH_VRM_ENABLE_VOTE_DRV8_REG34'/>"
WRITE #1 "        <register address='0xb882304' value='0x" DATA.LONG(A:0x882304) "' name='RPMH_VRM_ENABLE_VOTE_DRV8_REG35'/>"
WRITE #1 "        <register address='0xb882404' value='0x" DATA.LONG(A:0x882404) "' name='RPMH_VRM_ENABLE_VOTE_DRV8_REG36'/>"
WRITE #1 "        <register address='0xb882504' value='0x" DATA.LONG(A:0x882504) "' name='RPMH_VRM_ENABLE_VOTE_DRV8_REG37'/>"
WRITE #1 "        <register address='0xb882604' value='0x" DATA.LONG(A:0x882604) "' name='RPMH_VRM_ENABLE_VOTE_DRV8_REG38'/>"
WRITE #1 "        <register address='0xb882704' value='0x" DATA.LONG(A:0x882704) "' name='RPMH_VRM_ENABLE_VOTE_DRV8_REG39'/>"
WRITE #1 "        <register address='0xb882804' value='0x" DATA.LONG(A:0x882804) "' name='RPMH_VRM_ENABLE_VOTE_DRV8_REG40'/>"
WRITE #1 "        <register address='0xb882904' value='0x" DATA.LONG(A:0x882904) "' name='RPMH_VRM_ENABLE_VOTE_DRV8_REG41'/>"
WRITE #1 "        <register address='0xb882a04' value='0x" DATA.LONG(A:0x882a04) "' name='RPMH_VRM_ENABLE_VOTE_DRV8_REG42'/>"
WRITE #1 "        <register address='0xb882b04' value='0x" DATA.LONG(A:0x882b04) "' name='RPMH_VRM_ENABLE_VOTE_DRV8_REG43'/>"
WRITE #1 "        <register address='0xb882c04' value='0x" DATA.LONG(A:0x882c04) "' name='RPMH_VRM_ENABLE_VOTE_DRV8_REG44'/>"
WRITE #1 "        <register address='0xb882d04' value='0x" DATA.LONG(A:0x882d04) "' name='RPMH_VRM_ENABLE_VOTE_DRV8_REG45'/>"
WRITE #1 "        <register address='0xb890004' value='0x" DATA.LONG(A:0x890004) "' name='RPMH_VRM_ENABLE_VOTE_DRV9_REG0'/>"
WRITE #1 "        <register address='0xb890104' value='0x" DATA.LONG(A:0x890104) "' name='RPMH_VRM_ENABLE_VOTE_DRV9_REG1'/>"
WRITE #1 "        <register address='0xb890204' value='0x" DATA.LONG(A:0x890204) "' name='RPMH_VRM_ENABLE_VOTE_DRV9_REG2'/>"
WRITE #1 "        <register address='0xb890304' value='0x" DATA.LONG(A:0x890304) "' name='RPMH_VRM_ENABLE_VOTE_DRV9_REG3'/>"
WRITE #1 "        <register address='0xb890404' value='0x" DATA.LONG(A:0x890404) "' name='RPMH_VRM_ENABLE_VOTE_DRV9_REG4'/>"
WRITE #1 "        <register address='0xb890504' value='0x" DATA.LONG(A:0x890504) "' name='RPMH_VRM_ENABLE_VOTE_DRV9_REG5'/>"
WRITE #1 "        <register address='0xb890604' value='0x" DATA.LONG(A:0x890604) "' name='RPMH_VRM_ENABLE_VOTE_DRV9_REG6'/>"
WRITE #1 "        <register address='0xb890704' value='0x" DATA.LONG(A:0x890704) "' name='RPMH_VRM_ENABLE_VOTE_DRV9_REG7'/>"
WRITE #1 "        <register address='0xb890804' value='0x" DATA.LONG(A:0x890804) "' name='RPMH_VRM_ENABLE_VOTE_DRV9_REG8'/>"
WRITE #1 "        <register address='0xb890904' value='0x" DATA.LONG(A:0x890904) "' name='RPMH_VRM_ENABLE_VOTE_DRV9_REG9'/>"
WRITE #1 "        <register address='0xb890a04' value='0x" DATA.LONG(A:0x890a04) "' name='RPMH_VRM_ENABLE_VOTE_DRV9_REG10'/>"
WRITE #1 "        <register address='0xb890b04' value='0x" DATA.LONG(A:0x890b04) "' name='RPMH_VRM_ENABLE_VOTE_DRV9_REG11'/>"
WRITE #1 "        <register address='0xb890c04' value='0x" DATA.LONG(A:0x890c04) "' name='RPMH_VRM_ENABLE_VOTE_DRV9_REG12'/>"
WRITE #1 "        <register address='0xb890d04' value='0x" DATA.LONG(A:0x890d04) "' name='RPMH_VRM_ENABLE_VOTE_DRV9_REG13'/>"
WRITE #1 "        <register address='0xb890e04' value='0x" DATA.LONG(A:0x890e04) "' name='RPMH_VRM_ENABLE_VOTE_DRV9_REG14'/>"
WRITE #1 "        <register address='0xb890f04' value='0x" DATA.LONG(A:0x890f04) "' name='RPMH_VRM_ENABLE_VOTE_DRV9_REG15'/>"
WRITE #1 "        <register address='0xb891004' value='0x" DATA.LONG(A:0x891004) "' name='RPMH_VRM_ENABLE_VOTE_DRV9_REG16'/>"
WRITE #1 "        <register address='0xb891104' value='0x" DATA.LONG(A:0x891104) "' name='RPMH_VRM_ENABLE_VOTE_DRV9_REG17'/>"
WRITE #1 "        <register address='0xb891204' value='0x" DATA.LONG(A:0x891204) "' name='RPMH_VRM_ENABLE_VOTE_DRV9_REG18'/>"
WRITE #1 "        <register address='0xb891304' value='0x" DATA.LONG(A:0x891304) "' name='RPMH_VRM_ENABLE_VOTE_DRV9_REG19'/>"
WRITE #1 "        <register address='0xb891404' value='0x" DATA.LONG(A:0x891404) "' name='RPMH_VRM_ENABLE_VOTE_DRV9_REG20'/>"
WRITE #1 "        <register address='0xb891504' value='0x" DATA.LONG(A:0x891504) "' name='RPMH_VRM_ENABLE_VOTE_DRV9_REG21'/>"
WRITE #1 "        <register address='0xb891604' value='0x" DATA.LONG(A:0x891604) "' name='RPMH_VRM_ENABLE_VOTE_DRV9_REG22'/>"
WRITE #1 "        <register address='0xb891704' value='0x" DATA.LONG(A:0x891704) "' name='RPMH_VRM_ENABLE_VOTE_DRV9_REG23'/>"
WRITE #1 "        <register address='0xb891804' value='0x" DATA.LONG(A:0x891804) "' name='RPMH_VRM_ENABLE_VOTE_DRV9_REG24'/>"
WRITE #1 "        <register address='0xb891904' value='0x" DATA.LONG(A:0x891904) "' name='RPMH_VRM_ENABLE_VOTE_DRV9_REG25'/>"
WRITE #1 "        <register address='0xb891a04' value='0x" DATA.LONG(A:0x891a04) "' name='RPMH_VRM_ENABLE_VOTE_DRV9_REG26'/>"
WRITE #1 "        <register address='0xb891b04' value='0x" DATA.LONG(A:0x891b04) "' name='RPMH_VRM_ENABLE_VOTE_DRV9_REG27'/>"
WRITE #1 "        <register address='0xb891c04' value='0x" DATA.LONG(A:0x891c04) "' name='RPMH_VRM_ENABLE_VOTE_DRV9_REG28'/>"
WRITE #1 "        <register address='0xb891d04' value='0x" DATA.LONG(A:0x891d04) "' name='RPMH_VRM_ENABLE_VOTE_DRV9_REG29'/>"
WRITE #1 "        <register address='0xb891e04' value='0x" DATA.LONG(A:0x891e04) "' name='RPMH_VRM_ENABLE_VOTE_DRV9_REG30'/>"
WRITE #1 "        <register address='0xb891f04' value='0x" DATA.LONG(A:0x891f04) "' name='RPMH_VRM_ENABLE_VOTE_DRV9_REG31'/>"
WRITE #1 "        <register address='0xb892004' value='0x" DATA.LONG(A:0x892004) "' name='RPMH_VRM_ENABLE_VOTE_DRV9_REG32'/>"
WRITE #1 "        <register address='0xb892104' value='0x" DATA.LONG(A:0x892104) "' name='RPMH_VRM_ENABLE_VOTE_DRV9_REG33'/>"
WRITE #1 "        <register address='0xb892204' value='0x" DATA.LONG(A:0x892204) "' name='RPMH_VRM_ENABLE_VOTE_DRV9_REG34'/>"
WRITE #1 "        <register address='0xb892304' value='0x" DATA.LONG(A:0x892304) "' name='RPMH_VRM_ENABLE_VOTE_DRV9_REG35'/>"
WRITE #1 "        <register address='0xb892404' value='0x" DATA.LONG(A:0x892404) "' name='RPMH_VRM_ENABLE_VOTE_DRV9_REG36'/>"
WRITE #1 "        <register address='0xb892504' value='0x" DATA.LONG(A:0x892504) "' name='RPMH_VRM_ENABLE_VOTE_DRV9_REG37'/>"
WRITE #1 "        <register address='0xb892604' value='0x" DATA.LONG(A:0x892604) "' name='RPMH_VRM_ENABLE_VOTE_DRV9_REG38'/>"
WRITE #1 "        <register address='0xb892704' value='0x" DATA.LONG(A:0x892704) "' name='RPMH_VRM_ENABLE_VOTE_DRV9_REG39'/>"
WRITE #1 "        <register address='0xb892804' value='0x" DATA.LONG(A:0x892804) "' name='RPMH_VRM_ENABLE_VOTE_DRV9_REG40'/>"
WRITE #1 "        <register address='0xb892904' value='0x" DATA.LONG(A:0x892904) "' name='RPMH_VRM_ENABLE_VOTE_DRV9_REG41'/>"
WRITE #1 "        <register address='0xb892a04' value='0x" DATA.LONG(A:0x892a04) "' name='RPMH_VRM_ENABLE_VOTE_DRV9_REG42'/>"
WRITE #1 "        <register address='0xb892b04' value='0x" DATA.LONG(A:0x892b04) "' name='RPMH_VRM_ENABLE_VOTE_DRV9_REG43'/>"
WRITE #1 "        <register address='0xb892c04' value='0x" DATA.LONG(A:0x892c04) "' name='RPMH_VRM_ENABLE_VOTE_DRV9_REG44'/>"
WRITE #1 "        <register address='0xb892d04' value='0x" DATA.LONG(A:0x892d04) "' name='RPMH_VRM_ENABLE_VOTE_DRV9_REG45'/>"
WRITE #1 "        <register address='0xb8a0004' value='0x" DATA.LONG(A:0x8a0004) "' name='RPMH_VRM_ENABLE_VOTE_DRV10_REG0'/>"
WRITE #1 "        <register address='0xb8a0104' value='0x" DATA.LONG(A:0x8a0104) "' name='RPMH_VRM_ENABLE_VOTE_DRV10_REG1'/>"
WRITE #1 "        <register address='0xb8a0204' value='0x" DATA.LONG(A:0x8a0204) "' name='RPMH_VRM_ENABLE_VOTE_DRV10_REG2'/>"
WRITE #1 "        <register address='0xb8a0304' value='0x" DATA.LONG(A:0x8a0304) "' name='RPMH_VRM_ENABLE_VOTE_DRV10_REG3'/>"
WRITE #1 "        <register address='0xb8a0404' value='0x" DATA.LONG(A:0x8a0404) "' name='RPMH_VRM_ENABLE_VOTE_DRV10_REG4'/>"
WRITE #1 "        <register address='0xb8a0504' value='0x" DATA.LONG(A:0x8a0504) "' name='RPMH_VRM_ENABLE_VOTE_DRV10_REG5'/>"
WRITE #1 "        <register address='0xb8a0604' value='0x" DATA.LONG(A:0x8a0604) "' name='RPMH_VRM_ENABLE_VOTE_DRV10_REG6'/>"
WRITE #1 "        <register address='0xb8a0704' value='0x" DATA.LONG(A:0x8a0704) "' name='RPMH_VRM_ENABLE_VOTE_DRV10_REG7'/>"
WRITE #1 "        <register address='0xb8a0804' value='0x" DATA.LONG(A:0x8a0804) "' name='RPMH_VRM_ENABLE_VOTE_DRV10_REG8'/>"
WRITE #1 "        <register address='0xb8a0904' value='0x" DATA.LONG(A:0x8a0904) "' name='RPMH_VRM_ENABLE_VOTE_DRV10_REG9'/>"
WRITE #1 "        <register address='0xb8a0a04' value='0x" DATA.LONG(A:0x8a0a04) "' name='RPMH_VRM_ENABLE_VOTE_DRV10_REG10'/>"
WRITE #1 "        <register address='0xb8a0b04' value='0x" DATA.LONG(A:0x8a0b04) "' name='RPMH_VRM_ENABLE_VOTE_DRV10_REG11'/>"
WRITE #1 "        <register address='0xb8a0c04' value='0x" DATA.LONG(A:0x8a0c04) "' name='RPMH_VRM_ENABLE_VOTE_DRV10_REG12'/>"
WRITE #1 "        <register address='0xb8a0d04' value='0x" DATA.LONG(A:0x8a0d04) "' name='RPMH_VRM_ENABLE_VOTE_DRV10_REG13'/>"
WRITE #1 "        <register address='0xb8a0e04' value='0x" DATA.LONG(A:0x8a0e04) "' name='RPMH_VRM_ENABLE_VOTE_DRV10_REG14'/>"
WRITE #1 "        <register address='0xb8a0f04' value='0x" DATA.LONG(A:0x8a0f04) "' name='RPMH_VRM_ENABLE_VOTE_DRV10_REG15'/>"
WRITE #1 "        <register address='0xb8a1004' value='0x" DATA.LONG(A:0x8a1004) "' name='RPMH_VRM_ENABLE_VOTE_DRV10_REG16'/>"
WRITE #1 "        <register address='0xb8a1104' value='0x" DATA.LONG(A:0x8a1104) "' name='RPMH_VRM_ENABLE_VOTE_DRV10_REG17'/>"
WRITE #1 "        <register address='0xb8a1204' value='0x" DATA.LONG(A:0x8a1204) "' name='RPMH_VRM_ENABLE_VOTE_DRV10_REG18'/>"
WRITE #1 "        <register address='0xb8a1304' value='0x" DATA.LONG(A:0x8a1304) "' name='RPMH_VRM_ENABLE_VOTE_DRV10_REG19'/>"
WRITE #1 "        <register address='0xb8a1404' value='0x" DATA.LONG(A:0x8a1404) "' name='RPMH_VRM_ENABLE_VOTE_DRV10_REG20'/>"
WRITE #1 "        <register address='0xb8a1504' value='0x" DATA.LONG(A:0x8a1504) "' name='RPMH_VRM_ENABLE_VOTE_DRV10_REG21'/>"
WRITE #1 "        <register address='0xb8a1604' value='0x" DATA.LONG(A:0x8a1604) "' name='RPMH_VRM_ENABLE_VOTE_DRV10_REG22'/>"
WRITE #1 "        <register address='0xb8a1704' value='0x" DATA.LONG(A:0x8a1704) "' name='RPMH_VRM_ENABLE_VOTE_DRV10_REG23'/>"
WRITE #1 "        <register address='0xb8a1804' value='0x" DATA.LONG(A:0x8a1804) "' name='RPMH_VRM_ENABLE_VOTE_DRV10_REG24'/>"
WRITE #1 "        <register address='0xb8a1904' value='0x" DATA.LONG(A:0x8a1904) "' name='RPMH_VRM_ENABLE_VOTE_DRV10_REG25'/>"
WRITE #1 "        <register address='0xb8a1a04' value='0x" DATA.LONG(A:0x8a1a04) "' name='RPMH_VRM_ENABLE_VOTE_DRV10_REG26'/>"
WRITE #1 "        <register address='0xb8a1b04' value='0x" DATA.LONG(A:0x8a1b04) "' name='RPMH_VRM_ENABLE_VOTE_DRV10_REG27'/>"
WRITE #1 "        <register address='0xb8a1c04' value='0x" DATA.LONG(A:0x8a1c04) "' name='RPMH_VRM_ENABLE_VOTE_DRV10_REG28'/>"
WRITE #1 "        <register address='0xb8a1d04' value='0x" DATA.LONG(A:0x8a1d04) "' name='RPMH_VRM_ENABLE_VOTE_DRV10_REG29'/>"
WRITE #1 "        <register address='0xb8a1e04' value='0x" DATA.LONG(A:0x8a1e04) "' name='RPMH_VRM_ENABLE_VOTE_DRV10_REG30'/>"
WRITE #1 "        <register address='0xb8a1f04' value='0x" DATA.LONG(A:0x8a1f04) "' name='RPMH_VRM_ENABLE_VOTE_DRV10_REG31'/>"
WRITE #1 "        <register address='0xb8a2004' value='0x" DATA.LONG(A:0x8a2004) "' name='RPMH_VRM_ENABLE_VOTE_DRV10_REG32'/>"
WRITE #1 "        <register address='0xb8a2104' value='0x" DATA.LONG(A:0x8a2104) "' name='RPMH_VRM_ENABLE_VOTE_DRV10_REG33'/>"
WRITE #1 "        <register address='0xb8a2204' value='0x" DATA.LONG(A:0x8a2204) "' name='RPMH_VRM_ENABLE_VOTE_DRV10_REG34'/>"
WRITE #1 "        <register address='0xb8a2304' value='0x" DATA.LONG(A:0x8a2304) "' name='RPMH_VRM_ENABLE_VOTE_DRV10_REG35'/>"
WRITE #1 "        <register address='0xb8a2404' value='0x" DATA.LONG(A:0x8a2404) "' name='RPMH_VRM_ENABLE_VOTE_DRV10_REG36'/>"
WRITE #1 "        <register address='0xb8a2504' value='0x" DATA.LONG(A:0x8a2504) "' name='RPMH_VRM_ENABLE_VOTE_DRV10_REG37'/>"
WRITE #1 "        <register address='0xb8a2604' value='0x" DATA.LONG(A:0x8a2604) "' name='RPMH_VRM_ENABLE_VOTE_DRV10_REG38'/>"
WRITE #1 "        <register address='0xb8a2704' value='0x" DATA.LONG(A:0x8a2704) "' name='RPMH_VRM_ENABLE_VOTE_DRV10_REG39'/>"
WRITE #1 "        <register address='0xb8a2804' value='0x" DATA.LONG(A:0x8a2804) "' name='RPMH_VRM_ENABLE_VOTE_DRV10_REG40'/>"
WRITE #1 "        <register address='0xb8a2904' value='0x" DATA.LONG(A:0x8a2904) "' name='RPMH_VRM_ENABLE_VOTE_DRV10_REG41'/>"
WRITE #1 "        <register address='0xb8a2a04' value='0x" DATA.LONG(A:0x8a2a04) "' name='RPMH_VRM_ENABLE_VOTE_DRV10_REG42'/>"
WRITE #1 "        <register address='0xb8a2b04' value='0x" DATA.LONG(A:0x8a2b04) "' name='RPMH_VRM_ENABLE_VOTE_DRV10_REG43'/>"
WRITE #1 "        <register address='0xb8a2c04' value='0x" DATA.LONG(A:0x8a2c04) "' name='RPMH_VRM_ENABLE_VOTE_DRV10_REG44'/>"
WRITE #1 "        <register address='0xb8a2d04' value='0x" DATA.LONG(A:0x8a2d04) "' name='RPMH_VRM_ENABLE_VOTE_DRV10_REG45'/>"
WRITE #1 "        <register address='0xb8b0004' value='0x" DATA.LONG(A:0x8b0004) "' name='RPMH_VRM_ENABLE_VOTE_DRV11_REG0'/>"
WRITE #1 "        <register address='0xb8b0104' value='0x" DATA.LONG(A:0x8b0104) "' name='RPMH_VRM_ENABLE_VOTE_DRV11_REG1'/>"
WRITE #1 "        <register address='0xb8b0204' value='0x" DATA.LONG(A:0x8b0204) "' name='RPMH_VRM_ENABLE_VOTE_DRV11_REG2'/>"
WRITE #1 "        <register address='0xb8b0304' value='0x" DATA.LONG(A:0x8b0304) "' name='RPMH_VRM_ENABLE_VOTE_DRV11_REG3'/>"
WRITE #1 "        <register address='0xb8b0404' value='0x" DATA.LONG(A:0x8b0404) "' name='RPMH_VRM_ENABLE_VOTE_DRV11_REG4'/>"
WRITE #1 "        <register address='0xb8b0504' value='0x" DATA.LONG(A:0x8b0504) "' name='RPMH_VRM_ENABLE_VOTE_DRV11_REG5'/>"
WRITE #1 "        <register address='0xb8b0604' value='0x" DATA.LONG(A:0x8b0604) "' name='RPMH_VRM_ENABLE_VOTE_DRV11_REG6'/>"
WRITE #1 "        <register address='0xb8b0704' value='0x" DATA.LONG(A:0x8b0704) "' name='RPMH_VRM_ENABLE_VOTE_DRV11_REG7'/>"
WRITE #1 "        <register address='0xb8b0804' value='0x" DATA.LONG(A:0x8b0804) "' name='RPMH_VRM_ENABLE_VOTE_DRV11_REG8'/>"
WRITE #1 "        <register address='0xb8b0904' value='0x" DATA.LONG(A:0x8b0904) "' name='RPMH_VRM_ENABLE_VOTE_DRV11_REG9'/>"
WRITE #1 "        <register address='0xb8b0a04' value='0x" DATA.LONG(A:0x8b0a04) "' name='RPMH_VRM_ENABLE_VOTE_DRV11_REG10'/>"
WRITE #1 "        <register address='0xb8b0b04' value='0x" DATA.LONG(A:0x8b0b04) "' name='RPMH_VRM_ENABLE_VOTE_DRV11_REG11'/>"
WRITE #1 "        <register address='0xb8b0c04' value='0x" DATA.LONG(A:0x8b0c04) "' name='RPMH_VRM_ENABLE_VOTE_DRV11_REG12'/>"
WRITE #1 "        <register address='0xb8b0d04' value='0x" DATA.LONG(A:0x8b0d04) "' name='RPMH_VRM_ENABLE_VOTE_DRV11_REG13'/>"
WRITE #1 "        <register address='0xb8b0e04' value='0x" DATA.LONG(A:0x8b0e04) "' name='RPMH_VRM_ENABLE_VOTE_DRV11_REG14'/>"
WRITE #1 "        <register address='0xb8b0f04' value='0x" DATA.LONG(A:0x8b0f04) "' name='RPMH_VRM_ENABLE_VOTE_DRV11_REG15'/>"
WRITE #1 "        <register address='0xb8b1004' value='0x" DATA.LONG(A:0x8b1004) "' name='RPMH_VRM_ENABLE_VOTE_DRV11_REG16'/>"
WRITE #1 "        <register address='0xb8b1104' value='0x" DATA.LONG(A:0x8b1104) "' name='RPMH_VRM_ENABLE_VOTE_DRV11_REG17'/>"
WRITE #1 "        <register address='0xb8b1204' value='0x" DATA.LONG(A:0x8b1204) "' name='RPMH_VRM_ENABLE_VOTE_DRV11_REG18'/>"
WRITE #1 "        <register address='0xb8b1304' value='0x" DATA.LONG(A:0x8b1304) "' name='RPMH_VRM_ENABLE_VOTE_DRV11_REG19'/>"
WRITE #1 "        <register address='0xb8b1404' value='0x" DATA.LONG(A:0x8b1404) "' name='RPMH_VRM_ENABLE_VOTE_DRV11_REG20'/>"
WRITE #1 "        <register address='0xb8b1504' value='0x" DATA.LONG(A:0x8b1504) "' name='RPMH_VRM_ENABLE_VOTE_DRV11_REG21'/>"
WRITE #1 "        <register address='0xb8b1604' value='0x" DATA.LONG(A:0x8b1604) "' name='RPMH_VRM_ENABLE_VOTE_DRV11_REG22'/>"
WRITE #1 "        <register address='0xb8b1704' value='0x" DATA.LONG(A:0x8b1704) "' name='RPMH_VRM_ENABLE_VOTE_DRV11_REG23'/>"
WRITE #1 "        <register address='0xb8b1804' value='0x" DATA.LONG(A:0x8b1804) "' name='RPMH_VRM_ENABLE_VOTE_DRV11_REG24'/>"
WRITE #1 "        <register address='0xb8b1904' value='0x" DATA.LONG(A:0x8b1904) "' name='RPMH_VRM_ENABLE_VOTE_DRV11_REG25'/>"
WRITE #1 "        <register address='0xb8b1a04' value='0x" DATA.LONG(A:0x8b1a04) "' name='RPMH_VRM_ENABLE_VOTE_DRV11_REG26'/>"
WRITE #1 "        <register address='0xb8b1b04' value='0x" DATA.LONG(A:0x8b1b04) "' name='RPMH_VRM_ENABLE_VOTE_DRV11_REG27'/>"
WRITE #1 "        <register address='0xb8b1c04' value='0x" DATA.LONG(A:0x8b1c04) "' name='RPMH_VRM_ENABLE_VOTE_DRV11_REG28'/>"
WRITE #1 "        <register address='0xb8b1d04' value='0x" DATA.LONG(A:0x8b1d04) "' name='RPMH_VRM_ENABLE_VOTE_DRV11_REG29'/>"
WRITE #1 "        <register address='0xb8b1e04' value='0x" DATA.LONG(A:0x8b1e04) "' name='RPMH_VRM_ENABLE_VOTE_DRV11_REG30'/>"
WRITE #1 "        <register address='0xb8b1f04' value='0x" DATA.LONG(A:0x8b1f04) "' name='RPMH_VRM_ENABLE_VOTE_DRV11_REG31'/>"
WRITE #1 "        <register address='0xb8b2004' value='0x" DATA.LONG(A:0x8b2004) "' name='RPMH_VRM_ENABLE_VOTE_DRV11_REG32'/>"
WRITE #1 "        <register address='0xb8b2104' value='0x" DATA.LONG(A:0x8b2104) "' name='RPMH_VRM_ENABLE_VOTE_DRV11_REG33'/>"
WRITE #1 "        <register address='0xb8b2204' value='0x" DATA.LONG(A:0x8b2204) "' name='RPMH_VRM_ENABLE_VOTE_DRV11_REG34'/>"
WRITE #1 "        <register address='0xb8b2304' value='0x" DATA.LONG(A:0x8b2304) "' name='RPMH_VRM_ENABLE_VOTE_DRV11_REG35'/>"
WRITE #1 "        <register address='0xb8b2404' value='0x" DATA.LONG(A:0x8b2404) "' name='RPMH_VRM_ENABLE_VOTE_DRV11_REG36'/>"
WRITE #1 "        <register address='0xb8b2504' value='0x" DATA.LONG(A:0x8b2504) "' name='RPMH_VRM_ENABLE_VOTE_DRV11_REG37'/>"
WRITE #1 "        <register address='0xb8b2604' value='0x" DATA.LONG(A:0x8b2604) "' name='RPMH_VRM_ENABLE_VOTE_DRV11_REG38'/>"
WRITE #1 "        <register address='0xb8b2704' value='0x" DATA.LONG(A:0x8b2704) "' name='RPMH_VRM_ENABLE_VOTE_DRV11_REG39'/>"
WRITE #1 "        <register address='0xb8b2804' value='0x" DATA.LONG(A:0x8b2804) "' name='RPMH_VRM_ENABLE_VOTE_DRV11_REG40'/>"
WRITE #1 "        <register address='0xb8b2904' value='0x" DATA.LONG(A:0x8b2904) "' name='RPMH_VRM_ENABLE_VOTE_DRV11_REG41'/>"
WRITE #1 "        <register address='0xb8b2a04' value='0x" DATA.LONG(A:0x8b2a04) "' name='RPMH_VRM_ENABLE_VOTE_DRV11_REG42'/>"
WRITE #1 "        <register address='0xb8b2b04' value='0x" DATA.LONG(A:0x8b2b04) "' name='RPMH_VRM_ENABLE_VOTE_DRV11_REG43'/>"
WRITE #1 "        <register address='0xb8b2c04' value='0x" DATA.LONG(A:0x8b2c04) "' name='RPMH_VRM_ENABLE_VOTE_DRV11_REG44'/>"
WRITE #1 "        <register address='0xb8b2d04' value='0x" DATA.LONG(A:0x8b2d04) "' name='RPMH_VRM_ENABLE_VOTE_DRV11_REG45'/>"
WRITE #1 "        <register address='0xb800008' value='0x" DATA.LONG(A:0x800008) "' name='RPMH_VRM_MODE_VOTE_DRV0_REG0'/>"
WRITE #1 "        <register address='0xb800108' value='0x" DATA.LONG(A:0x800108) "' name='RPMH_VRM_MODE_VOTE_DRV0_REG1'/>"
WRITE #1 "        <register address='0xb800208' value='0x" DATA.LONG(A:0x800208) "' name='RPMH_VRM_MODE_VOTE_DRV0_REG2'/>"
WRITE #1 "        <register address='0xb800308' value='0x" DATA.LONG(A:0x800308) "' name='RPMH_VRM_MODE_VOTE_DRV0_REG3'/>"
WRITE #1 "        <register address='0xb800408' value='0x" DATA.LONG(A:0x800408) "' name='RPMH_VRM_MODE_VOTE_DRV0_REG4'/>"
WRITE #1 "        <register address='0xb800508' value='0x" DATA.LONG(A:0x800508) "' name='RPMH_VRM_MODE_VOTE_DRV0_REG5'/>"
WRITE #1 "        <register address='0xb800608' value='0x" DATA.LONG(A:0x800608) "' name='RPMH_VRM_MODE_VOTE_DRV0_REG6'/>"
WRITE #1 "        <register address='0xb800708' value='0x" DATA.LONG(A:0x800708) "' name='RPMH_VRM_MODE_VOTE_DRV0_REG7'/>"
WRITE #1 "        <register address='0xb800808' value='0x" DATA.LONG(A:0x800808) "' name='RPMH_VRM_MODE_VOTE_DRV0_REG8'/>"
WRITE #1 "        <register address='0xb800908' value='0x" DATA.LONG(A:0x800908) "' name='RPMH_VRM_MODE_VOTE_DRV0_REG9'/>"
WRITE #1 "        <register address='0xb800a08' value='0x" DATA.LONG(A:0x800a08) "' name='RPMH_VRM_MODE_VOTE_DRV0_REG10'/>"
WRITE #1 "        <register address='0xb800b08' value='0x" DATA.LONG(A:0x800b08) "' name='RPMH_VRM_MODE_VOTE_DRV0_REG11'/>"
WRITE #1 "        <register address='0xb800c08' value='0x" DATA.LONG(A:0x800c08) "' name='RPMH_VRM_MODE_VOTE_DRV0_REG12'/>"
WRITE #1 "        <register address='0xb800d08' value='0x" DATA.LONG(A:0x800d08) "' name='RPMH_VRM_MODE_VOTE_DRV0_REG13'/>"
WRITE #1 "        <register address='0xb800e08' value='0x" DATA.LONG(A:0x800e08) "' name='RPMH_VRM_MODE_VOTE_DRV0_REG14'/>"
WRITE #1 "        <register address='0xb800f08' value='0x" DATA.LONG(A:0x800f08) "' name='RPMH_VRM_MODE_VOTE_DRV0_REG15'/>"
WRITE #1 "        <register address='0xb801008' value='0x" DATA.LONG(A:0x801008) "' name='RPMH_VRM_MODE_VOTE_DRV0_REG16'/>"
WRITE #1 "        <register address='0xb801108' value='0x" DATA.LONG(A:0x801108) "' name='RPMH_VRM_MODE_VOTE_DRV0_REG17'/>"
WRITE #1 "        <register address='0xb801208' value='0x" DATA.LONG(A:0x801208) "' name='RPMH_VRM_MODE_VOTE_DRV0_REG18'/>"
WRITE #1 "        <register address='0xb801308' value='0x" DATA.LONG(A:0x801308) "' name='RPMH_VRM_MODE_VOTE_DRV0_REG19'/>"
WRITE #1 "        <register address='0xb801408' value='0x" DATA.LONG(A:0x801408) "' name='RPMH_VRM_MODE_VOTE_DRV0_REG20'/>"
WRITE #1 "        <register address='0xb801508' value='0x" DATA.LONG(A:0x801508) "' name='RPMH_VRM_MODE_VOTE_DRV0_REG21'/>"
WRITE #1 "        <register address='0xb801608' value='0x" DATA.LONG(A:0x801608) "' name='RPMH_VRM_MODE_VOTE_DRV0_REG22'/>"
WRITE #1 "        <register address='0xb801708' value='0x" DATA.LONG(A:0x801708) "' name='RPMH_VRM_MODE_VOTE_DRV0_REG23'/>"
WRITE #1 "        <register address='0xb801808' value='0x" DATA.LONG(A:0x801808) "' name='RPMH_VRM_MODE_VOTE_DRV0_REG24'/>"
WRITE #1 "        <register address='0xb801908' value='0x" DATA.LONG(A:0x801908) "' name='RPMH_VRM_MODE_VOTE_DRV0_REG25'/>"
WRITE #1 "        <register address='0xb801a08' value='0x" DATA.LONG(A:0x801a08) "' name='RPMH_VRM_MODE_VOTE_DRV0_REG26'/>"
WRITE #1 "        <register address='0xb801b08' value='0x" DATA.LONG(A:0x801b08) "' name='RPMH_VRM_MODE_VOTE_DRV0_REG27'/>"
WRITE #1 "        <register address='0xb801c08' value='0x" DATA.LONG(A:0x801c08) "' name='RPMH_VRM_MODE_VOTE_DRV0_REG28'/>"
WRITE #1 "        <register address='0xb801d08' value='0x" DATA.LONG(A:0x801d08) "' name='RPMH_VRM_MODE_VOTE_DRV0_REG29'/>"
WRITE #1 "        <register address='0xb801e08' value='0x" DATA.LONG(A:0x801e08) "' name='RPMH_VRM_MODE_VOTE_DRV0_REG30'/>"
WRITE #1 "        <register address='0xb801f08' value='0x" DATA.LONG(A:0x801f08) "' name='RPMH_VRM_MODE_VOTE_DRV0_REG31'/>"
WRITE #1 "        <register address='0xb802008' value='0x" DATA.LONG(A:0x802008) "' name='RPMH_VRM_MODE_VOTE_DRV0_REG32'/>"
WRITE #1 "        <register address='0xb802108' value='0x" DATA.LONG(A:0x802108) "' name='RPMH_VRM_MODE_VOTE_DRV0_REG33'/>"
WRITE #1 "        <register address='0xb802208' value='0x" DATA.LONG(A:0x802208) "' name='RPMH_VRM_MODE_VOTE_DRV0_REG34'/>"
WRITE #1 "        <register address='0xb802308' value='0x" DATA.LONG(A:0x802308) "' name='RPMH_VRM_MODE_VOTE_DRV0_REG35'/>"
WRITE #1 "        <register address='0xb802408' value='0x" DATA.LONG(A:0x802408) "' name='RPMH_VRM_MODE_VOTE_DRV0_REG36'/>"
WRITE #1 "        <register address='0xb802508' value='0x" DATA.LONG(A:0x802508) "' name='RPMH_VRM_MODE_VOTE_DRV0_REG37'/>"
WRITE #1 "        <register address='0xb802608' value='0x" DATA.LONG(A:0x802608) "' name='RPMH_VRM_MODE_VOTE_DRV0_REG38'/>"
WRITE #1 "        <register address='0xb802708' value='0x" DATA.LONG(A:0x802708) "' name='RPMH_VRM_MODE_VOTE_DRV0_REG39'/>"
WRITE #1 "        <register address='0xb802808' value='0x" DATA.LONG(A:0x802808) "' name='RPMH_VRM_MODE_VOTE_DRV0_REG40'/>"
WRITE #1 "        <register address='0xb802908' value='0x" DATA.LONG(A:0x802908) "' name='RPMH_VRM_MODE_VOTE_DRV0_REG41'/>"
WRITE #1 "        <register address='0xb802a08' value='0x" DATA.LONG(A:0x802a08) "' name='RPMH_VRM_MODE_VOTE_DRV0_REG42'/>"
WRITE #1 "        <register address='0xb802b08' value='0x" DATA.LONG(A:0x802b08) "' name='RPMH_VRM_MODE_VOTE_DRV0_REG43'/>"
WRITE #1 "        <register address='0xb802c08' value='0x" DATA.LONG(A:0x802c08) "' name='RPMH_VRM_MODE_VOTE_DRV0_REG44'/>"
WRITE #1 "        <register address='0xb802d08' value='0x" DATA.LONG(A:0x802d08) "' name='RPMH_VRM_MODE_VOTE_DRV0_REG45'/>"
WRITE #1 "        <register address='0xb810008' value='0x" DATA.LONG(A:0x810008) "' name='RPMH_VRM_MODE_VOTE_DRV1_REG0'/>"
WRITE #1 "        <register address='0xb810108' value='0x" DATA.LONG(A:0x810108) "' name='RPMH_VRM_MODE_VOTE_DRV1_REG1'/>"
WRITE #1 "        <register address='0xb810208' value='0x" DATA.LONG(A:0x810208) "' name='RPMH_VRM_MODE_VOTE_DRV1_REG2'/>"
WRITE #1 "        <register address='0xb810308' value='0x" DATA.LONG(A:0x810308) "' name='RPMH_VRM_MODE_VOTE_DRV1_REG3'/>"
WRITE #1 "        <register address='0xb810408' value='0x" DATA.LONG(A:0x810408) "' name='RPMH_VRM_MODE_VOTE_DRV1_REG4'/>"
WRITE #1 "        <register address='0xb810508' value='0x" DATA.LONG(A:0x810508) "' name='RPMH_VRM_MODE_VOTE_DRV1_REG5'/>"
WRITE #1 "        <register address='0xb810608' value='0x" DATA.LONG(A:0x810608) "' name='RPMH_VRM_MODE_VOTE_DRV1_REG6'/>"
WRITE #1 "        <register address='0xb810708' value='0x" DATA.LONG(A:0x810708) "' name='RPMH_VRM_MODE_VOTE_DRV1_REG7'/>"
WRITE #1 "        <register address='0xb810808' value='0x" DATA.LONG(A:0x810808) "' name='RPMH_VRM_MODE_VOTE_DRV1_REG8'/>"
WRITE #1 "        <register address='0xb810908' value='0x" DATA.LONG(A:0x810908) "' name='RPMH_VRM_MODE_VOTE_DRV1_REG9'/>"
WRITE #1 "        <register address='0xb810a08' value='0x" DATA.LONG(A:0x810a08) "' name='RPMH_VRM_MODE_VOTE_DRV1_REG10'/>"
WRITE #1 "        <register address='0xb810b08' value='0x" DATA.LONG(A:0x810b08) "' name='RPMH_VRM_MODE_VOTE_DRV1_REG11'/>"
WRITE #1 "        <register address='0xb810c08' value='0x" DATA.LONG(A:0x810c08) "' name='RPMH_VRM_MODE_VOTE_DRV1_REG12'/>"
WRITE #1 "        <register address='0xb810d08' value='0x" DATA.LONG(A:0x810d08) "' name='RPMH_VRM_MODE_VOTE_DRV1_REG13'/>"
WRITE #1 "        <register address='0xb810e08' value='0x" DATA.LONG(A:0x810e08) "' name='RPMH_VRM_MODE_VOTE_DRV1_REG14'/>"
WRITE #1 "        <register address='0xb810f08' value='0x" DATA.LONG(A:0x810f08) "' name='RPMH_VRM_MODE_VOTE_DRV1_REG15'/>"
WRITE #1 "        <register address='0xb811008' value='0x" DATA.LONG(A:0x811008) "' name='RPMH_VRM_MODE_VOTE_DRV1_REG16'/>"
WRITE #1 "        <register address='0xb811108' value='0x" DATA.LONG(A:0x811108) "' name='RPMH_VRM_MODE_VOTE_DRV1_REG17'/>"
WRITE #1 "        <register address='0xb811208' value='0x" DATA.LONG(A:0x811208) "' name='RPMH_VRM_MODE_VOTE_DRV1_REG18'/>"
WRITE #1 "        <register address='0xb811308' value='0x" DATA.LONG(A:0x811308) "' name='RPMH_VRM_MODE_VOTE_DRV1_REG19'/>"
WRITE #1 "        <register address='0xb811408' value='0x" DATA.LONG(A:0x811408) "' name='RPMH_VRM_MODE_VOTE_DRV1_REG20'/>"
WRITE #1 "        <register address='0xb811508' value='0x" DATA.LONG(A:0x811508) "' name='RPMH_VRM_MODE_VOTE_DRV1_REG21'/>"
WRITE #1 "        <register address='0xb811608' value='0x" DATA.LONG(A:0x811608) "' name='RPMH_VRM_MODE_VOTE_DRV1_REG22'/>"
WRITE #1 "        <register address='0xb811708' value='0x" DATA.LONG(A:0x811708) "' name='RPMH_VRM_MODE_VOTE_DRV1_REG23'/>"
WRITE #1 "        <register address='0xb811808' value='0x" DATA.LONG(A:0x811808) "' name='RPMH_VRM_MODE_VOTE_DRV1_REG24'/>"
WRITE #1 "        <register address='0xb811908' value='0x" DATA.LONG(A:0x811908) "' name='RPMH_VRM_MODE_VOTE_DRV1_REG25'/>"
WRITE #1 "        <register address='0xb811a08' value='0x" DATA.LONG(A:0x811a08) "' name='RPMH_VRM_MODE_VOTE_DRV1_REG26'/>"
WRITE #1 "        <register address='0xb811b08' value='0x" DATA.LONG(A:0x811b08) "' name='RPMH_VRM_MODE_VOTE_DRV1_REG27'/>"
WRITE #1 "        <register address='0xb811c08' value='0x" DATA.LONG(A:0x811c08) "' name='RPMH_VRM_MODE_VOTE_DRV1_REG28'/>"
WRITE #1 "        <register address='0xb811d08' value='0x" DATA.LONG(A:0x811d08) "' name='RPMH_VRM_MODE_VOTE_DRV1_REG29'/>"
WRITE #1 "        <register address='0xb811e08' value='0x" DATA.LONG(A:0x811e08) "' name='RPMH_VRM_MODE_VOTE_DRV1_REG30'/>"
WRITE #1 "        <register address='0xb811f08' value='0x" DATA.LONG(A:0x811f08) "' name='RPMH_VRM_MODE_VOTE_DRV1_REG31'/>"
WRITE #1 "        <register address='0xb812008' value='0x" DATA.LONG(A:0x812008) "' name='RPMH_VRM_MODE_VOTE_DRV1_REG32'/>"
WRITE #1 "        <register address='0xb812108' value='0x" DATA.LONG(A:0x812108) "' name='RPMH_VRM_MODE_VOTE_DRV1_REG33'/>"
WRITE #1 "        <register address='0xb812208' value='0x" DATA.LONG(A:0x812208) "' name='RPMH_VRM_MODE_VOTE_DRV1_REG34'/>"
WRITE #1 "        <register address='0xb812308' value='0x" DATA.LONG(A:0x812308) "' name='RPMH_VRM_MODE_VOTE_DRV1_REG35'/>"
WRITE #1 "        <register address='0xb812408' value='0x" DATA.LONG(A:0x812408) "' name='RPMH_VRM_MODE_VOTE_DRV1_REG36'/>"
WRITE #1 "        <register address='0xb812508' value='0x" DATA.LONG(A:0x812508) "' name='RPMH_VRM_MODE_VOTE_DRV1_REG37'/>"
WRITE #1 "        <register address='0xb812608' value='0x" DATA.LONG(A:0x812608) "' name='RPMH_VRM_MODE_VOTE_DRV1_REG38'/>"
WRITE #1 "        <register address='0xb812708' value='0x" DATA.LONG(A:0x812708) "' name='RPMH_VRM_MODE_VOTE_DRV1_REG39'/>"
WRITE #1 "        <register address='0xb812808' value='0x" DATA.LONG(A:0x812808) "' name='RPMH_VRM_MODE_VOTE_DRV1_REG40'/>"
WRITE #1 "        <register address='0xb812908' value='0x" DATA.LONG(A:0x812908) "' name='RPMH_VRM_MODE_VOTE_DRV1_REG41'/>"
WRITE #1 "        <register address='0xb812a08' value='0x" DATA.LONG(A:0x812a08) "' name='RPMH_VRM_MODE_VOTE_DRV1_REG42'/>"
WRITE #1 "        <register address='0xb812b08' value='0x" DATA.LONG(A:0x812b08) "' name='RPMH_VRM_MODE_VOTE_DRV1_REG43'/>"
WRITE #1 "        <register address='0xb812c08' value='0x" DATA.LONG(A:0x812c08) "' name='RPMH_VRM_MODE_VOTE_DRV1_REG44'/>"
WRITE #1 "        <register address='0xb812d08' value='0x" DATA.LONG(A:0x812d08) "' name='RPMH_VRM_MODE_VOTE_DRV1_REG45'/>"
WRITE #1 "        <register address='0xb820008' value='0x" DATA.LONG(A:0x820008) "' name='RPMH_VRM_MODE_VOTE_DRV2_REG0'/>"
WRITE #1 "        <register address='0xb820108' value='0x" DATA.LONG(A:0x820108) "' name='RPMH_VRM_MODE_VOTE_DRV2_REG1'/>"
WRITE #1 "        <register address='0xb820208' value='0x" DATA.LONG(A:0x820208) "' name='RPMH_VRM_MODE_VOTE_DRV2_REG2'/>"
WRITE #1 "        <register address='0xb820308' value='0x" DATA.LONG(A:0x820308) "' name='RPMH_VRM_MODE_VOTE_DRV2_REG3'/>"
WRITE #1 "        <register address='0xb820408' value='0x" DATA.LONG(A:0x820408) "' name='RPMH_VRM_MODE_VOTE_DRV2_REG4'/>"
WRITE #1 "        <register address='0xb820508' value='0x" DATA.LONG(A:0x820508) "' name='RPMH_VRM_MODE_VOTE_DRV2_REG5'/>"
WRITE #1 "        <register address='0xb820608' value='0x" DATA.LONG(A:0x820608) "' name='RPMH_VRM_MODE_VOTE_DRV2_REG6'/>"
WRITE #1 "        <register address='0xb820708' value='0x" DATA.LONG(A:0x820708) "' name='RPMH_VRM_MODE_VOTE_DRV2_REG7'/>"
WRITE #1 "        <register address='0xb820808' value='0x" DATA.LONG(A:0x820808) "' name='RPMH_VRM_MODE_VOTE_DRV2_REG8'/>"
WRITE #1 "        <register address='0xb820908' value='0x" DATA.LONG(A:0x820908) "' name='RPMH_VRM_MODE_VOTE_DRV2_REG9'/>"
WRITE #1 "        <register address='0xb820a08' value='0x" DATA.LONG(A:0x820a08) "' name='RPMH_VRM_MODE_VOTE_DRV2_REG10'/>"
WRITE #1 "        <register address='0xb820b08' value='0x" DATA.LONG(A:0x820b08) "' name='RPMH_VRM_MODE_VOTE_DRV2_REG11'/>"
WRITE #1 "        <register address='0xb820c08' value='0x" DATA.LONG(A:0x820c08) "' name='RPMH_VRM_MODE_VOTE_DRV2_REG12'/>"
WRITE #1 "        <register address='0xb820d08' value='0x" DATA.LONG(A:0x820d08) "' name='RPMH_VRM_MODE_VOTE_DRV2_REG13'/>"
WRITE #1 "        <register address='0xb820e08' value='0x" DATA.LONG(A:0x820e08) "' name='RPMH_VRM_MODE_VOTE_DRV2_REG14'/>"
WRITE #1 "        <register address='0xb820f08' value='0x" DATA.LONG(A:0x820f08) "' name='RPMH_VRM_MODE_VOTE_DRV2_REG15'/>"
WRITE #1 "        <register address='0xb821008' value='0x" DATA.LONG(A:0x821008) "' name='RPMH_VRM_MODE_VOTE_DRV2_REG16'/>"
WRITE #1 "        <register address='0xb821108' value='0x" DATA.LONG(A:0x821108) "' name='RPMH_VRM_MODE_VOTE_DRV2_REG17'/>"
WRITE #1 "        <register address='0xb821208' value='0x" DATA.LONG(A:0x821208) "' name='RPMH_VRM_MODE_VOTE_DRV2_REG18'/>"
WRITE #1 "        <register address='0xb821308' value='0x" DATA.LONG(A:0x821308) "' name='RPMH_VRM_MODE_VOTE_DRV2_REG19'/>"
WRITE #1 "        <register address='0xb821408' value='0x" DATA.LONG(A:0x821408) "' name='RPMH_VRM_MODE_VOTE_DRV2_REG20'/>"
WRITE #1 "        <register address='0xb821508' value='0x" DATA.LONG(A:0x821508) "' name='RPMH_VRM_MODE_VOTE_DRV2_REG21'/>"
WRITE #1 "        <register address='0xb821608' value='0x" DATA.LONG(A:0x821608) "' name='RPMH_VRM_MODE_VOTE_DRV2_REG22'/>"
WRITE #1 "        <register address='0xb821708' value='0x" DATA.LONG(A:0x821708) "' name='RPMH_VRM_MODE_VOTE_DRV2_REG23'/>"
WRITE #1 "        <register address='0xb821808' value='0x" DATA.LONG(A:0x821808) "' name='RPMH_VRM_MODE_VOTE_DRV2_REG24'/>"
WRITE #1 "        <register address='0xb821908' value='0x" DATA.LONG(A:0x821908) "' name='RPMH_VRM_MODE_VOTE_DRV2_REG25'/>"
WRITE #1 "        <register address='0xb821a08' value='0x" DATA.LONG(A:0x821a08) "' name='RPMH_VRM_MODE_VOTE_DRV2_REG26'/>"
WRITE #1 "        <register address='0xb821b08' value='0x" DATA.LONG(A:0x821b08) "' name='RPMH_VRM_MODE_VOTE_DRV2_REG27'/>"
WRITE #1 "        <register address='0xb821c08' value='0x" DATA.LONG(A:0x821c08) "' name='RPMH_VRM_MODE_VOTE_DRV2_REG28'/>"
WRITE #1 "        <register address='0xb821d08' value='0x" DATA.LONG(A:0x821d08) "' name='RPMH_VRM_MODE_VOTE_DRV2_REG29'/>"
WRITE #1 "        <register address='0xb821e08' value='0x" DATA.LONG(A:0x821e08) "' name='RPMH_VRM_MODE_VOTE_DRV2_REG30'/>"
WRITE #1 "        <register address='0xb821f08' value='0x" DATA.LONG(A:0x821f08) "' name='RPMH_VRM_MODE_VOTE_DRV2_REG31'/>"
WRITE #1 "        <register address='0xb822008' value='0x" DATA.LONG(A:0x822008) "' name='RPMH_VRM_MODE_VOTE_DRV2_REG32'/>"
WRITE #1 "        <register address='0xb822108' value='0x" DATA.LONG(A:0x822108) "' name='RPMH_VRM_MODE_VOTE_DRV2_REG33'/>"
WRITE #1 "        <register address='0xb822208' value='0x" DATA.LONG(A:0x822208) "' name='RPMH_VRM_MODE_VOTE_DRV2_REG34'/>"
WRITE #1 "        <register address='0xb822308' value='0x" DATA.LONG(A:0x822308) "' name='RPMH_VRM_MODE_VOTE_DRV2_REG35'/>"
WRITE #1 "        <register address='0xb822408' value='0x" DATA.LONG(A:0x822408) "' name='RPMH_VRM_MODE_VOTE_DRV2_REG36'/>"
WRITE #1 "        <register address='0xb822508' value='0x" DATA.LONG(A:0x822508) "' name='RPMH_VRM_MODE_VOTE_DRV2_REG37'/>"
WRITE #1 "        <register address='0xb822608' value='0x" DATA.LONG(A:0x822608) "' name='RPMH_VRM_MODE_VOTE_DRV2_REG38'/>"
WRITE #1 "        <register address='0xb822708' value='0x" DATA.LONG(A:0x822708) "' name='RPMH_VRM_MODE_VOTE_DRV2_REG39'/>"
WRITE #1 "        <register address='0xb822808' value='0x" DATA.LONG(A:0x822808) "' name='RPMH_VRM_MODE_VOTE_DRV2_REG40'/>"
WRITE #1 "        <register address='0xb822908' value='0x" DATA.LONG(A:0x822908) "' name='RPMH_VRM_MODE_VOTE_DRV2_REG41'/>"
WRITE #1 "        <register address='0xb822a08' value='0x" DATA.LONG(A:0x822a08) "' name='RPMH_VRM_MODE_VOTE_DRV2_REG42'/>"
WRITE #1 "        <register address='0xb822b08' value='0x" DATA.LONG(A:0x822b08) "' name='RPMH_VRM_MODE_VOTE_DRV2_REG43'/>"
WRITE #1 "        <register address='0xb822c08' value='0x" DATA.LONG(A:0x822c08) "' name='RPMH_VRM_MODE_VOTE_DRV2_REG44'/>"
WRITE #1 "        <register address='0xb822d08' value='0x" DATA.LONG(A:0x822d08) "' name='RPMH_VRM_MODE_VOTE_DRV2_REG45'/>"
WRITE #1 "        <register address='0xb830008' value='0x" DATA.LONG(A:0x830008) "' name='RPMH_VRM_MODE_VOTE_DRV3_REG0'/>"
WRITE #1 "        <register address='0xb830108' value='0x" DATA.LONG(A:0x830108) "' name='RPMH_VRM_MODE_VOTE_DRV3_REG1'/>"
WRITE #1 "        <register address='0xb830208' value='0x" DATA.LONG(A:0x830208) "' name='RPMH_VRM_MODE_VOTE_DRV3_REG2'/>"
WRITE #1 "        <register address='0xb830308' value='0x" DATA.LONG(A:0x830308) "' name='RPMH_VRM_MODE_VOTE_DRV3_REG3'/>"
WRITE #1 "        <register address='0xb830408' value='0x" DATA.LONG(A:0x830408) "' name='RPMH_VRM_MODE_VOTE_DRV3_REG4'/>"
WRITE #1 "        <register address='0xb830508' value='0x" DATA.LONG(A:0x830508) "' name='RPMH_VRM_MODE_VOTE_DRV3_REG5'/>"
WRITE #1 "        <register address='0xb830608' value='0x" DATA.LONG(A:0x830608) "' name='RPMH_VRM_MODE_VOTE_DRV3_REG6'/>"
WRITE #1 "        <register address='0xb830708' value='0x" DATA.LONG(A:0x830708) "' name='RPMH_VRM_MODE_VOTE_DRV3_REG7'/>"
WRITE #1 "        <register address='0xb830808' value='0x" DATA.LONG(A:0x830808) "' name='RPMH_VRM_MODE_VOTE_DRV3_REG8'/>"
WRITE #1 "        <register address='0xb830908' value='0x" DATA.LONG(A:0x830908) "' name='RPMH_VRM_MODE_VOTE_DRV3_REG9'/>"
WRITE #1 "        <register address='0xb830a08' value='0x" DATA.LONG(A:0x830a08) "' name='RPMH_VRM_MODE_VOTE_DRV3_REG10'/>"
WRITE #1 "        <register address='0xb830b08' value='0x" DATA.LONG(A:0x830b08) "' name='RPMH_VRM_MODE_VOTE_DRV3_REG11'/>"
WRITE #1 "        <register address='0xb830c08' value='0x" DATA.LONG(A:0x830c08) "' name='RPMH_VRM_MODE_VOTE_DRV3_REG12'/>"
WRITE #1 "        <register address='0xb830d08' value='0x" DATA.LONG(A:0x830d08) "' name='RPMH_VRM_MODE_VOTE_DRV3_REG13'/>"
WRITE #1 "        <register address='0xb830e08' value='0x" DATA.LONG(A:0x830e08) "' name='RPMH_VRM_MODE_VOTE_DRV3_REG14'/>"
WRITE #1 "        <register address='0xb830f08' value='0x" DATA.LONG(A:0x830f08) "' name='RPMH_VRM_MODE_VOTE_DRV3_REG15'/>"
WRITE #1 "        <register address='0xb831008' value='0x" DATA.LONG(A:0x831008) "' name='RPMH_VRM_MODE_VOTE_DRV3_REG16'/>"
WRITE #1 "        <register address='0xb831108' value='0x" DATA.LONG(A:0x831108) "' name='RPMH_VRM_MODE_VOTE_DRV3_REG17'/>"
WRITE #1 "        <register address='0xb831208' value='0x" DATA.LONG(A:0x831208) "' name='RPMH_VRM_MODE_VOTE_DRV3_REG18'/>"
WRITE #1 "        <register address='0xb831308' value='0x" DATA.LONG(A:0x831308) "' name='RPMH_VRM_MODE_VOTE_DRV3_REG19'/>"
WRITE #1 "        <register address='0xb831408' value='0x" DATA.LONG(A:0x831408) "' name='RPMH_VRM_MODE_VOTE_DRV3_REG20'/>"
WRITE #1 "        <register address='0xb831508' value='0x" DATA.LONG(A:0x831508) "' name='RPMH_VRM_MODE_VOTE_DRV3_REG21'/>"
WRITE #1 "        <register address='0xb831608' value='0x" DATA.LONG(A:0x831608) "' name='RPMH_VRM_MODE_VOTE_DRV3_REG22'/>"
WRITE #1 "        <register address='0xb831708' value='0x" DATA.LONG(A:0x831708) "' name='RPMH_VRM_MODE_VOTE_DRV3_REG23'/>"
WRITE #1 "        <register address='0xb831808' value='0x" DATA.LONG(A:0x831808) "' name='RPMH_VRM_MODE_VOTE_DRV3_REG24'/>"
WRITE #1 "        <register address='0xb831908' value='0x" DATA.LONG(A:0x831908) "' name='RPMH_VRM_MODE_VOTE_DRV3_REG25'/>"
WRITE #1 "        <register address='0xb831a08' value='0x" DATA.LONG(A:0x831a08) "' name='RPMH_VRM_MODE_VOTE_DRV3_REG26'/>"
WRITE #1 "        <register address='0xb831b08' value='0x" DATA.LONG(A:0x831b08) "' name='RPMH_VRM_MODE_VOTE_DRV3_REG27'/>"
WRITE #1 "        <register address='0xb831c08' value='0x" DATA.LONG(A:0x831c08) "' name='RPMH_VRM_MODE_VOTE_DRV3_REG28'/>"
WRITE #1 "        <register address='0xb831d08' value='0x" DATA.LONG(A:0x831d08) "' name='RPMH_VRM_MODE_VOTE_DRV3_REG29'/>"
WRITE #1 "        <register address='0xb831e08' value='0x" DATA.LONG(A:0x831e08) "' name='RPMH_VRM_MODE_VOTE_DRV3_REG30'/>"
WRITE #1 "        <register address='0xb831f08' value='0x" DATA.LONG(A:0x831f08) "' name='RPMH_VRM_MODE_VOTE_DRV3_REG31'/>"
WRITE #1 "        <register address='0xb832008' value='0x" DATA.LONG(A:0x832008) "' name='RPMH_VRM_MODE_VOTE_DRV3_REG32'/>"
WRITE #1 "        <register address='0xb832108' value='0x" DATA.LONG(A:0x832108) "' name='RPMH_VRM_MODE_VOTE_DRV3_REG33'/>"
WRITE #1 "        <register address='0xb832208' value='0x" DATA.LONG(A:0x832208) "' name='RPMH_VRM_MODE_VOTE_DRV3_REG34'/>"
WRITE #1 "        <register address='0xb832308' value='0x" DATA.LONG(A:0x832308) "' name='RPMH_VRM_MODE_VOTE_DRV3_REG35'/>"
WRITE #1 "        <register address='0xb832408' value='0x" DATA.LONG(A:0x832408) "' name='RPMH_VRM_MODE_VOTE_DRV3_REG36'/>"
WRITE #1 "        <register address='0xb832508' value='0x" DATA.LONG(A:0x832508) "' name='RPMH_VRM_MODE_VOTE_DRV3_REG37'/>"
WRITE #1 "        <register address='0xb832608' value='0x" DATA.LONG(A:0x832608) "' name='RPMH_VRM_MODE_VOTE_DRV3_REG38'/>"
WRITE #1 "        <register address='0xb832708' value='0x" DATA.LONG(A:0x832708) "' name='RPMH_VRM_MODE_VOTE_DRV3_REG39'/>"
WRITE #1 "        <register address='0xb832808' value='0x" DATA.LONG(A:0x832808) "' name='RPMH_VRM_MODE_VOTE_DRV3_REG40'/>"
WRITE #1 "        <register address='0xb832908' value='0x" DATA.LONG(A:0x832908) "' name='RPMH_VRM_MODE_VOTE_DRV3_REG41'/>"
WRITE #1 "        <register address='0xb832a08' value='0x" DATA.LONG(A:0x832a08) "' name='RPMH_VRM_MODE_VOTE_DRV3_REG42'/>"
WRITE #1 "        <register address='0xb832b08' value='0x" DATA.LONG(A:0x832b08) "' name='RPMH_VRM_MODE_VOTE_DRV3_REG43'/>"
WRITE #1 "        <register address='0xb832c08' value='0x" DATA.LONG(A:0x832c08) "' name='RPMH_VRM_MODE_VOTE_DRV3_REG44'/>"
WRITE #1 "        <register address='0xb832d08' value='0x" DATA.LONG(A:0x832d08) "' name='RPMH_VRM_MODE_VOTE_DRV3_REG45'/>"
WRITE #1 "        <register address='0xb840008' value='0x" DATA.LONG(A:0x840008) "' name='RPMH_VRM_MODE_VOTE_DRV4_REG0'/>"
WRITE #1 "        <register address='0xb840108' value='0x" DATA.LONG(A:0x840108) "' name='RPMH_VRM_MODE_VOTE_DRV4_REG1'/>"
WRITE #1 "        <register address='0xb840208' value='0x" DATA.LONG(A:0x840208) "' name='RPMH_VRM_MODE_VOTE_DRV4_REG2'/>"
WRITE #1 "        <register address='0xb840308' value='0x" DATA.LONG(A:0x840308) "' name='RPMH_VRM_MODE_VOTE_DRV4_REG3'/>"
WRITE #1 "        <register address='0xb840408' value='0x" DATA.LONG(A:0x840408) "' name='RPMH_VRM_MODE_VOTE_DRV4_REG4'/>"
WRITE #1 "        <register address='0xb840508' value='0x" DATA.LONG(A:0x840508) "' name='RPMH_VRM_MODE_VOTE_DRV4_REG5'/>"
WRITE #1 "        <register address='0xb840608' value='0x" DATA.LONG(A:0x840608) "' name='RPMH_VRM_MODE_VOTE_DRV4_REG6'/>"
WRITE #1 "        <register address='0xb840708' value='0x" DATA.LONG(A:0x840708) "' name='RPMH_VRM_MODE_VOTE_DRV4_REG7'/>"
WRITE #1 "        <register address='0xb840808' value='0x" DATA.LONG(A:0x840808) "' name='RPMH_VRM_MODE_VOTE_DRV4_REG8'/>"
WRITE #1 "        <register address='0xb840908' value='0x" DATA.LONG(A:0x840908) "' name='RPMH_VRM_MODE_VOTE_DRV4_REG9'/>"
WRITE #1 "        <register address='0xb840a08' value='0x" DATA.LONG(A:0x840a08) "' name='RPMH_VRM_MODE_VOTE_DRV4_REG10'/>"
WRITE #1 "        <register address='0xb840b08' value='0x" DATA.LONG(A:0x840b08) "' name='RPMH_VRM_MODE_VOTE_DRV4_REG11'/>"
WRITE #1 "        <register address='0xb840c08' value='0x" DATA.LONG(A:0x840c08) "' name='RPMH_VRM_MODE_VOTE_DRV4_REG12'/>"
WRITE #1 "        <register address='0xb840d08' value='0x" DATA.LONG(A:0x840d08) "' name='RPMH_VRM_MODE_VOTE_DRV4_REG13'/>"
WRITE #1 "        <register address='0xb840e08' value='0x" DATA.LONG(A:0x840e08) "' name='RPMH_VRM_MODE_VOTE_DRV4_REG14'/>"
WRITE #1 "        <register address='0xb840f08' value='0x" DATA.LONG(A:0x840f08) "' name='RPMH_VRM_MODE_VOTE_DRV4_REG15'/>"
WRITE #1 "        <register address='0xb841008' value='0x" DATA.LONG(A:0x841008) "' name='RPMH_VRM_MODE_VOTE_DRV4_REG16'/>"
WRITE #1 "        <register address='0xb841108' value='0x" DATA.LONG(A:0x841108) "' name='RPMH_VRM_MODE_VOTE_DRV4_REG17'/>"
WRITE #1 "        <register address='0xb841208' value='0x" DATA.LONG(A:0x841208) "' name='RPMH_VRM_MODE_VOTE_DRV4_REG18'/>"
WRITE #1 "        <register address='0xb841308' value='0x" DATA.LONG(A:0x841308) "' name='RPMH_VRM_MODE_VOTE_DRV4_REG19'/>"
WRITE #1 "        <register address='0xb841408' value='0x" DATA.LONG(A:0x841408) "' name='RPMH_VRM_MODE_VOTE_DRV4_REG20'/>"
WRITE #1 "        <register address='0xb841508' value='0x" DATA.LONG(A:0x841508) "' name='RPMH_VRM_MODE_VOTE_DRV4_REG21'/>"
WRITE #1 "        <register address='0xb841608' value='0x" DATA.LONG(A:0x841608) "' name='RPMH_VRM_MODE_VOTE_DRV4_REG22'/>"
WRITE #1 "        <register address='0xb841708' value='0x" DATA.LONG(A:0x841708) "' name='RPMH_VRM_MODE_VOTE_DRV4_REG23'/>"
WRITE #1 "        <register address='0xb841808' value='0x" DATA.LONG(A:0x841808) "' name='RPMH_VRM_MODE_VOTE_DRV4_REG24'/>"
WRITE #1 "        <register address='0xb841908' value='0x" DATA.LONG(A:0x841908) "' name='RPMH_VRM_MODE_VOTE_DRV4_REG25'/>"
WRITE #1 "        <register address='0xb841a08' value='0x" DATA.LONG(A:0x841a08) "' name='RPMH_VRM_MODE_VOTE_DRV4_REG26'/>"
WRITE #1 "        <register address='0xb841b08' value='0x" DATA.LONG(A:0x841b08) "' name='RPMH_VRM_MODE_VOTE_DRV4_REG27'/>"
WRITE #1 "        <register address='0xb841c08' value='0x" DATA.LONG(A:0x841c08) "' name='RPMH_VRM_MODE_VOTE_DRV4_REG28'/>"
WRITE #1 "        <register address='0xb841d08' value='0x" DATA.LONG(A:0x841d08) "' name='RPMH_VRM_MODE_VOTE_DRV4_REG29'/>"
WRITE #1 "        <register address='0xb841e08' value='0x" DATA.LONG(A:0x841e08) "' name='RPMH_VRM_MODE_VOTE_DRV4_REG30'/>"
WRITE #1 "        <register address='0xb841f08' value='0x" DATA.LONG(A:0x841f08) "' name='RPMH_VRM_MODE_VOTE_DRV4_REG31'/>"
WRITE #1 "        <register address='0xb842008' value='0x" DATA.LONG(A:0x842008) "' name='RPMH_VRM_MODE_VOTE_DRV4_REG32'/>"
WRITE #1 "        <register address='0xb842108' value='0x" DATA.LONG(A:0x842108) "' name='RPMH_VRM_MODE_VOTE_DRV4_REG33'/>"
WRITE #1 "        <register address='0xb842208' value='0x" DATA.LONG(A:0x842208) "' name='RPMH_VRM_MODE_VOTE_DRV4_REG34'/>"
WRITE #1 "        <register address='0xb842308' value='0x" DATA.LONG(A:0x842308) "' name='RPMH_VRM_MODE_VOTE_DRV4_REG35'/>"
WRITE #1 "        <register address='0xb842408' value='0x" DATA.LONG(A:0x842408) "' name='RPMH_VRM_MODE_VOTE_DRV4_REG36'/>"
WRITE #1 "        <register address='0xb842508' value='0x" DATA.LONG(A:0x842508) "' name='RPMH_VRM_MODE_VOTE_DRV4_REG37'/>"
WRITE #1 "        <register address='0xb842608' value='0x" DATA.LONG(A:0x842608) "' name='RPMH_VRM_MODE_VOTE_DRV4_REG38'/>"
WRITE #1 "        <register address='0xb842708' value='0x" DATA.LONG(A:0x842708) "' name='RPMH_VRM_MODE_VOTE_DRV4_REG39'/>"
WRITE #1 "        <register address='0xb842808' value='0x" DATA.LONG(A:0x842808) "' name='RPMH_VRM_MODE_VOTE_DRV4_REG40'/>"
WRITE #1 "        <register address='0xb842908' value='0x" DATA.LONG(A:0x842908) "' name='RPMH_VRM_MODE_VOTE_DRV4_REG41'/>"
WRITE #1 "        <register address='0xb842a08' value='0x" DATA.LONG(A:0x842a08) "' name='RPMH_VRM_MODE_VOTE_DRV4_REG42'/>"
WRITE #1 "        <register address='0xb842b08' value='0x" DATA.LONG(A:0x842b08) "' name='RPMH_VRM_MODE_VOTE_DRV4_REG43'/>"
WRITE #1 "        <register address='0xb842c08' value='0x" DATA.LONG(A:0x842c08) "' name='RPMH_VRM_MODE_VOTE_DRV4_REG44'/>"
WRITE #1 "        <register address='0xb842d08' value='0x" DATA.LONG(A:0x842d08) "' name='RPMH_VRM_MODE_VOTE_DRV4_REG45'/>"
WRITE #1 "        <register address='0xb850008' value='0x" DATA.LONG(A:0x850008) "' name='RPMH_VRM_MODE_VOTE_DRV5_REG0'/>"
WRITE #1 "        <register address='0xb850108' value='0x" DATA.LONG(A:0x850108) "' name='RPMH_VRM_MODE_VOTE_DRV5_REG1'/>"
WRITE #1 "        <register address='0xb850208' value='0x" DATA.LONG(A:0x850208) "' name='RPMH_VRM_MODE_VOTE_DRV5_REG2'/>"
WRITE #1 "        <register address='0xb850308' value='0x" DATA.LONG(A:0x850308) "' name='RPMH_VRM_MODE_VOTE_DRV5_REG3'/>"
WRITE #1 "        <register address='0xb850408' value='0x" DATA.LONG(A:0x850408) "' name='RPMH_VRM_MODE_VOTE_DRV5_REG4'/>"
WRITE #1 "        <register address='0xb850508' value='0x" DATA.LONG(A:0x850508) "' name='RPMH_VRM_MODE_VOTE_DRV5_REG5'/>"
WRITE #1 "        <register address='0xb850608' value='0x" DATA.LONG(A:0x850608) "' name='RPMH_VRM_MODE_VOTE_DRV5_REG6'/>"
WRITE #1 "        <register address='0xb850708' value='0x" DATA.LONG(A:0x850708) "' name='RPMH_VRM_MODE_VOTE_DRV5_REG7'/>"
WRITE #1 "        <register address='0xb850808' value='0x" DATA.LONG(A:0x850808) "' name='RPMH_VRM_MODE_VOTE_DRV5_REG8'/>"
WRITE #1 "        <register address='0xb850908' value='0x" DATA.LONG(A:0x850908) "' name='RPMH_VRM_MODE_VOTE_DRV5_REG9'/>"
WRITE #1 "        <register address='0xb850a08' value='0x" DATA.LONG(A:0x850a08) "' name='RPMH_VRM_MODE_VOTE_DRV5_REG10'/>"
WRITE #1 "        <register address='0xb850b08' value='0x" DATA.LONG(A:0x850b08) "' name='RPMH_VRM_MODE_VOTE_DRV5_REG11'/>"
WRITE #1 "        <register address='0xb850c08' value='0x" DATA.LONG(A:0x850c08) "' name='RPMH_VRM_MODE_VOTE_DRV5_REG12'/>"
WRITE #1 "        <register address='0xb850d08' value='0x" DATA.LONG(A:0x850d08) "' name='RPMH_VRM_MODE_VOTE_DRV5_REG13'/>"
WRITE #1 "        <register address='0xb850e08' value='0x" DATA.LONG(A:0x850e08) "' name='RPMH_VRM_MODE_VOTE_DRV5_REG14'/>"
WRITE #1 "        <register address='0xb850f08' value='0x" DATA.LONG(A:0x850f08) "' name='RPMH_VRM_MODE_VOTE_DRV5_REG15'/>"
WRITE #1 "        <register address='0xb851008' value='0x" DATA.LONG(A:0x851008) "' name='RPMH_VRM_MODE_VOTE_DRV5_REG16'/>"
WRITE #1 "        <register address='0xb851108' value='0x" DATA.LONG(A:0x851108) "' name='RPMH_VRM_MODE_VOTE_DRV5_REG17'/>"
WRITE #1 "        <register address='0xb851208' value='0x" DATA.LONG(A:0x851208) "' name='RPMH_VRM_MODE_VOTE_DRV5_REG18'/>"
WRITE #1 "        <register address='0xb851308' value='0x" DATA.LONG(A:0x851308) "' name='RPMH_VRM_MODE_VOTE_DRV5_REG19'/>"
WRITE #1 "        <register address='0xb851408' value='0x" DATA.LONG(A:0x851408) "' name='RPMH_VRM_MODE_VOTE_DRV5_REG20'/>"
WRITE #1 "        <register address='0xb851508' value='0x" DATA.LONG(A:0x851508) "' name='RPMH_VRM_MODE_VOTE_DRV5_REG21'/>"
WRITE #1 "        <register address='0xb851608' value='0x" DATA.LONG(A:0x851608) "' name='RPMH_VRM_MODE_VOTE_DRV5_REG22'/>"
WRITE #1 "        <register address='0xb851708' value='0x" DATA.LONG(A:0x851708) "' name='RPMH_VRM_MODE_VOTE_DRV5_REG23'/>"
WRITE #1 "        <register address='0xb851808' value='0x" DATA.LONG(A:0x851808) "' name='RPMH_VRM_MODE_VOTE_DRV5_REG24'/>"
WRITE #1 "        <register address='0xb851908' value='0x" DATA.LONG(A:0x851908) "' name='RPMH_VRM_MODE_VOTE_DRV5_REG25'/>"
WRITE #1 "        <register address='0xb851a08' value='0x" DATA.LONG(A:0x851a08) "' name='RPMH_VRM_MODE_VOTE_DRV5_REG26'/>"
WRITE #1 "        <register address='0xb851b08' value='0x" DATA.LONG(A:0x851b08) "' name='RPMH_VRM_MODE_VOTE_DRV5_REG27'/>"
WRITE #1 "        <register address='0xb851c08' value='0x" DATA.LONG(A:0x851c08) "' name='RPMH_VRM_MODE_VOTE_DRV5_REG28'/>"
WRITE #1 "        <register address='0xb851d08' value='0x" DATA.LONG(A:0x851d08) "' name='RPMH_VRM_MODE_VOTE_DRV5_REG29'/>"
WRITE #1 "        <register address='0xb851e08' value='0x" DATA.LONG(A:0x851e08) "' name='RPMH_VRM_MODE_VOTE_DRV5_REG30'/>"
WRITE #1 "        <register address='0xb851f08' value='0x" DATA.LONG(A:0x851f08) "' name='RPMH_VRM_MODE_VOTE_DRV5_REG31'/>"
WRITE #1 "        <register address='0xb852008' value='0x" DATA.LONG(A:0x852008) "' name='RPMH_VRM_MODE_VOTE_DRV5_REG32'/>"
WRITE #1 "        <register address='0xb852108' value='0x" DATA.LONG(A:0x852108) "' name='RPMH_VRM_MODE_VOTE_DRV5_REG33'/>"
WRITE #1 "        <register address='0xb852208' value='0x" DATA.LONG(A:0x852208) "' name='RPMH_VRM_MODE_VOTE_DRV5_REG34'/>"
WRITE #1 "        <register address='0xb852308' value='0x" DATA.LONG(A:0x852308) "' name='RPMH_VRM_MODE_VOTE_DRV5_REG35'/>"
WRITE #1 "        <register address='0xb852408' value='0x" DATA.LONG(A:0x852408) "' name='RPMH_VRM_MODE_VOTE_DRV5_REG36'/>"
WRITE #1 "        <register address='0xb852508' value='0x" DATA.LONG(A:0x852508) "' name='RPMH_VRM_MODE_VOTE_DRV5_REG37'/>"
WRITE #1 "        <register address='0xb852608' value='0x" DATA.LONG(A:0x852608) "' name='RPMH_VRM_MODE_VOTE_DRV5_REG38'/>"
WRITE #1 "        <register address='0xb852708' value='0x" DATA.LONG(A:0x852708) "' name='RPMH_VRM_MODE_VOTE_DRV5_REG39'/>"
WRITE #1 "        <register address='0xb852808' value='0x" DATA.LONG(A:0x852808) "' name='RPMH_VRM_MODE_VOTE_DRV5_REG40'/>"
WRITE #1 "        <register address='0xb852908' value='0x" DATA.LONG(A:0x852908) "' name='RPMH_VRM_MODE_VOTE_DRV5_REG41'/>"
WRITE #1 "        <register address='0xb852a08' value='0x" DATA.LONG(A:0x852a08) "' name='RPMH_VRM_MODE_VOTE_DRV5_REG42'/>"
WRITE #1 "        <register address='0xb852b08' value='0x" DATA.LONG(A:0x852b08) "' name='RPMH_VRM_MODE_VOTE_DRV5_REG43'/>"
WRITE #1 "        <register address='0xb852c08' value='0x" DATA.LONG(A:0x852c08) "' name='RPMH_VRM_MODE_VOTE_DRV5_REG44'/>"
WRITE #1 "        <register address='0xb852d08' value='0x" DATA.LONG(A:0x852d08) "' name='RPMH_VRM_MODE_VOTE_DRV5_REG45'/>"
WRITE #1 "        <register address='0xb860008' value='0x" DATA.LONG(A:0x860008) "' name='RPMH_VRM_MODE_VOTE_DRV6_REG0'/>"
WRITE #1 "        <register address='0xb860108' value='0x" DATA.LONG(A:0x860108) "' name='RPMH_VRM_MODE_VOTE_DRV6_REG1'/>"
WRITE #1 "        <register address='0xb860208' value='0x" DATA.LONG(A:0x860208) "' name='RPMH_VRM_MODE_VOTE_DRV6_REG2'/>"
WRITE #1 "        <register address='0xb860308' value='0x" DATA.LONG(A:0x860308) "' name='RPMH_VRM_MODE_VOTE_DRV6_REG3'/>"
WRITE #1 "        <register address='0xb860408' value='0x" DATA.LONG(A:0x860408) "' name='RPMH_VRM_MODE_VOTE_DRV6_REG4'/>"
WRITE #1 "        <register address='0xb860508' value='0x" DATA.LONG(A:0x860508) "' name='RPMH_VRM_MODE_VOTE_DRV6_REG5'/>"
WRITE #1 "        <register address='0xb860608' value='0x" DATA.LONG(A:0x860608) "' name='RPMH_VRM_MODE_VOTE_DRV6_REG6'/>"
WRITE #1 "        <register address='0xb860708' value='0x" DATA.LONG(A:0x860708) "' name='RPMH_VRM_MODE_VOTE_DRV6_REG7'/>"
WRITE #1 "        <register address='0xb860808' value='0x" DATA.LONG(A:0x860808) "' name='RPMH_VRM_MODE_VOTE_DRV6_REG8'/>"
WRITE #1 "        <register address='0xb860908' value='0x" DATA.LONG(A:0x860908) "' name='RPMH_VRM_MODE_VOTE_DRV6_REG9'/>"
WRITE #1 "        <register address='0xb860a08' value='0x" DATA.LONG(A:0x860a08) "' name='RPMH_VRM_MODE_VOTE_DRV6_REG10'/>"
WRITE #1 "        <register address='0xb860b08' value='0x" DATA.LONG(A:0x860b08) "' name='RPMH_VRM_MODE_VOTE_DRV6_REG11'/>"
WRITE #1 "        <register address='0xb860c08' value='0x" DATA.LONG(A:0x860c08) "' name='RPMH_VRM_MODE_VOTE_DRV6_REG12'/>"
WRITE #1 "        <register address='0xb860d08' value='0x" DATA.LONG(A:0x860d08) "' name='RPMH_VRM_MODE_VOTE_DRV6_REG13'/>"
WRITE #1 "        <register address='0xb860e08' value='0x" DATA.LONG(A:0x860e08) "' name='RPMH_VRM_MODE_VOTE_DRV6_REG14'/>"
WRITE #1 "        <register address='0xb860f08' value='0x" DATA.LONG(A:0x860f08) "' name='RPMH_VRM_MODE_VOTE_DRV6_REG15'/>"
WRITE #1 "        <register address='0xb861008' value='0x" DATA.LONG(A:0x861008) "' name='RPMH_VRM_MODE_VOTE_DRV6_REG16'/>"
WRITE #1 "        <register address='0xb861108' value='0x" DATA.LONG(A:0x861108) "' name='RPMH_VRM_MODE_VOTE_DRV6_REG17'/>"
WRITE #1 "        <register address='0xb861208' value='0x" DATA.LONG(A:0x861208) "' name='RPMH_VRM_MODE_VOTE_DRV6_REG18'/>"
WRITE #1 "        <register address='0xb861308' value='0x" DATA.LONG(A:0x861308) "' name='RPMH_VRM_MODE_VOTE_DRV6_REG19'/>"
WRITE #1 "        <register address='0xb861408' value='0x" DATA.LONG(A:0x861408) "' name='RPMH_VRM_MODE_VOTE_DRV6_REG20'/>"
WRITE #1 "        <register address='0xb861508' value='0x" DATA.LONG(A:0x861508) "' name='RPMH_VRM_MODE_VOTE_DRV6_REG21'/>"
WRITE #1 "        <register address='0xb861608' value='0x" DATA.LONG(A:0x861608) "' name='RPMH_VRM_MODE_VOTE_DRV6_REG22'/>"
WRITE #1 "        <register address='0xb861708' value='0x" DATA.LONG(A:0x861708) "' name='RPMH_VRM_MODE_VOTE_DRV6_REG23'/>"
WRITE #1 "        <register address='0xb861808' value='0x" DATA.LONG(A:0x861808) "' name='RPMH_VRM_MODE_VOTE_DRV6_REG24'/>"
WRITE #1 "        <register address='0xb861908' value='0x" DATA.LONG(A:0x861908) "' name='RPMH_VRM_MODE_VOTE_DRV6_REG25'/>"
WRITE #1 "        <register address='0xb861a08' value='0x" DATA.LONG(A:0x861a08) "' name='RPMH_VRM_MODE_VOTE_DRV6_REG26'/>"
WRITE #1 "        <register address='0xb861b08' value='0x" DATA.LONG(A:0x861b08) "' name='RPMH_VRM_MODE_VOTE_DRV6_REG27'/>"
WRITE #1 "        <register address='0xb861c08' value='0x" DATA.LONG(A:0x861c08) "' name='RPMH_VRM_MODE_VOTE_DRV6_REG28'/>"
WRITE #1 "        <register address='0xb861d08' value='0x" DATA.LONG(A:0x861d08) "' name='RPMH_VRM_MODE_VOTE_DRV6_REG29'/>"
WRITE #1 "        <register address='0xb861e08' value='0x" DATA.LONG(A:0x861e08) "' name='RPMH_VRM_MODE_VOTE_DRV6_REG30'/>"
WRITE #1 "        <register address='0xb861f08' value='0x" DATA.LONG(A:0x861f08) "' name='RPMH_VRM_MODE_VOTE_DRV6_REG31'/>"
WRITE #1 "        <register address='0xb862008' value='0x" DATA.LONG(A:0x862008) "' name='RPMH_VRM_MODE_VOTE_DRV6_REG32'/>"
WRITE #1 "        <register address='0xb862108' value='0x" DATA.LONG(A:0x862108) "' name='RPMH_VRM_MODE_VOTE_DRV6_REG33'/>"
WRITE #1 "        <register address='0xb862208' value='0x" DATA.LONG(A:0x862208) "' name='RPMH_VRM_MODE_VOTE_DRV6_REG34'/>"
WRITE #1 "        <register address='0xb862308' value='0x" DATA.LONG(A:0x862308) "' name='RPMH_VRM_MODE_VOTE_DRV6_REG35'/>"
WRITE #1 "        <register address='0xb862408' value='0x" DATA.LONG(A:0x862408) "' name='RPMH_VRM_MODE_VOTE_DRV6_REG36'/>"
WRITE #1 "        <register address='0xb862508' value='0x" DATA.LONG(A:0x862508) "' name='RPMH_VRM_MODE_VOTE_DRV6_REG37'/>"
WRITE #1 "        <register address='0xb862608' value='0x" DATA.LONG(A:0x862608) "' name='RPMH_VRM_MODE_VOTE_DRV6_REG38'/>"
WRITE #1 "        <register address='0xb862708' value='0x" DATA.LONG(A:0x862708) "' name='RPMH_VRM_MODE_VOTE_DRV6_REG39'/>"
WRITE #1 "        <register address='0xb862808' value='0x" DATA.LONG(A:0x862808) "' name='RPMH_VRM_MODE_VOTE_DRV6_REG40'/>"
WRITE #1 "        <register address='0xb862908' value='0x" DATA.LONG(A:0x862908) "' name='RPMH_VRM_MODE_VOTE_DRV6_REG41'/>"
WRITE #1 "        <register address='0xb862a08' value='0x" DATA.LONG(A:0x862a08) "' name='RPMH_VRM_MODE_VOTE_DRV6_REG42'/>"
WRITE #1 "        <register address='0xb862b08' value='0x" DATA.LONG(A:0x862b08) "' name='RPMH_VRM_MODE_VOTE_DRV6_REG43'/>"
WRITE #1 "        <register address='0xb862c08' value='0x" DATA.LONG(A:0x862c08) "' name='RPMH_VRM_MODE_VOTE_DRV6_REG44'/>"
WRITE #1 "        <register address='0xb862d08' value='0x" DATA.LONG(A:0x862d08) "' name='RPMH_VRM_MODE_VOTE_DRV6_REG45'/>"
WRITE #1 "        <register address='0xb870008' value='0x" DATA.LONG(A:0x870008) "' name='RPMH_VRM_MODE_VOTE_DRV7_REG0'/>"
WRITE #1 "        <register address='0xb870108' value='0x" DATA.LONG(A:0x870108) "' name='RPMH_VRM_MODE_VOTE_DRV7_REG1'/>"
WRITE #1 "        <register address='0xb870208' value='0x" DATA.LONG(A:0x870208) "' name='RPMH_VRM_MODE_VOTE_DRV7_REG2'/>"
WRITE #1 "        <register address='0xb870308' value='0x" DATA.LONG(A:0x870308) "' name='RPMH_VRM_MODE_VOTE_DRV7_REG3'/>"
WRITE #1 "        <register address='0xb870408' value='0x" DATA.LONG(A:0x870408) "' name='RPMH_VRM_MODE_VOTE_DRV7_REG4'/>"
WRITE #1 "        <register address='0xb870508' value='0x" DATA.LONG(A:0x870508) "' name='RPMH_VRM_MODE_VOTE_DRV7_REG5'/>"
WRITE #1 "        <register address='0xb870608' value='0x" DATA.LONG(A:0x870608) "' name='RPMH_VRM_MODE_VOTE_DRV7_REG6'/>"
WRITE #1 "        <register address='0xb870708' value='0x" DATA.LONG(A:0x870708) "' name='RPMH_VRM_MODE_VOTE_DRV7_REG7'/>"
WRITE #1 "        <register address='0xb870808' value='0x" DATA.LONG(A:0x870808) "' name='RPMH_VRM_MODE_VOTE_DRV7_REG8'/>"
WRITE #1 "        <register address='0xb870908' value='0x" DATA.LONG(A:0x870908) "' name='RPMH_VRM_MODE_VOTE_DRV7_REG9'/>"
WRITE #1 "        <register address='0xb870a08' value='0x" DATA.LONG(A:0x870a08) "' name='RPMH_VRM_MODE_VOTE_DRV7_REG10'/>"
WRITE #1 "        <register address='0xb870b08' value='0x" DATA.LONG(A:0x870b08) "' name='RPMH_VRM_MODE_VOTE_DRV7_REG11'/>"
WRITE #1 "        <register address='0xb870c08' value='0x" DATA.LONG(A:0x870c08) "' name='RPMH_VRM_MODE_VOTE_DRV7_REG12'/>"
WRITE #1 "        <register address='0xb870d08' value='0x" DATA.LONG(A:0x870d08) "' name='RPMH_VRM_MODE_VOTE_DRV7_REG13'/>"
WRITE #1 "        <register address='0xb870e08' value='0x" DATA.LONG(A:0x870e08) "' name='RPMH_VRM_MODE_VOTE_DRV7_REG14'/>"
WRITE #1 "        <register address='0xb870f08' value='0x" DATA.LONG(A:0x870f08) "' name='RPMH_VRM_MODE_VOTE_DRV7_REG15'/>"
WRITE #1 "        <register address='0xb871008' value='0x" DATA.LONG(A:0x871008) "' name='RPMH_VRM_MODE_VOTE_DRV7_REG16'/>"
WRITE #1 "        <register address='0xb871108' value='0x" DATA.LONG(A:0x871108) "' name='RPMH_VRM_MODE_VOTE_DRV7_REG17'/>"
WRITE #1 "        <register address='0xb871208' value='0x" DATA.LONG(A:0x871208) "' name='RPMH_VRM_MODE_VOTE_DRV7_REG18'/>"
WRITE #1 "        <register address='0xb871308' value='0x" DATA.LONG(A:0x871308) "' name='RPMH_VRM_MODE_VOTE_DRV7_REG19'/>"
WRITE #1 "        <register address='0xb871408' value='0x" DATA.LONG(A:0x871408) "' name='RPMH_VRM_MODE_VOTE_DRV7_REG20'/>"
WRITE #1 "        <register address='0xb871508' value='0x" DATA.LONG(A:0x871508) "' name='RPMH_VRM_MODE_VOTE_DRV7_REG21'/>"
WRITE #1 "        <register address='0xb871608' value='0x" DATA.LONG(A:0x871608) "' name='RPMH_VRM_MODE_VOTE_DRV7_REG22'/>"
WRITE #1 "        <register address='0xb871708' value='0x" DATA.LONG(A:0x871708) "' name='RPMH_VRM_MODE_VOTE_DRV7_REG23'/>"
WRITE #1 "        <register address='0xb871808' value='0x" DATA.LONG(A:0x871808) "' name='RPMH_VRM_MODE_VOTE_DRV7_REG24'/>"
WRITE #1 "        <register address='0xb871908' value='0x" DATA.LONG(A:0x871908) "' name='RPMH_VRM_MODE_VOTE_DRV7_REG25'/>"
WRITE #1 "        <register address='0xb871a08' value='0x" DATA.LONG(A:0x871a08) "' name='RPMH_VRM_MODE_VOTE_DRV7_REG26'/>"
WRITE #1 "        <register address='0xb871b08' value='0x" DATA.LONG(A:0x871b08) "' name='RPMH_VRM_MODE_VOTE_DRV7_REG27'/>"
WRITE #1 "        <register address='0xb871c08' value='0x" DATA.LONG(A:0x871c08) "' name='RPMH_VRM_MODE_VOTE_DRV7_REG28'/>"
WRITE #1 "        <register address='0xb871d08' value='0x" DATA.LONG(A:0x871d08) "' name='RPMH_VRM_MODE_VOTE_DRV7_REG29'/>"
WRITE #1 "        <register address='0xb871e08' value='0x" DATA.LONG(A:0x871e08) "' name='RPMH_VRM_MODE_VOTE_DRV7_REG30'/>"
WRITE #1 "        <register address='0xb871f08' value='0x" DATA.LONG(A:0x871f08) "' name='RPMH_VRM_MODE_VOTE_DRV7_REG31'/>"
WRITE #1 "        <register address='0xb872008' value='0x" DATA.LONG(A:0x872008) "' name='RPMH_VRM_MODE_VOTE_DRV7_REG32'/>"
WRITE #1 "        <register address='0xb872108' value='0x" DATA.LONG(A:0x872108) "' name='RPMH_VRM_MODE_VOTE_DRV7_REG33'/>"
WRITE #1 "        <register address='0xb872208' value='0x" DATA.LONG(A:0x872208) "' name='RPMH_VRM_MODE_VOTE_DRV7_REG34'/>"
WRITE #1 "        <register address='0xb872308' value='0x" DATA.LONG(A:0x872308) "' name='RPMH_VRM_MODE_VOTE_DRV7_REG35'/>"
WRITE #1 "        <register address='0xb872408' value='0x" DATA.LONG(A:0x872408) "' name='RPMH_VRM_MODE_VOTE_DRV7_REG36'/>"
WRITE #1 "        <register address='0xb872508' value='0x" DATA.LONG(A:0x872508) "' name='RPMH_VRM_MODE_VOTE_DRV7_REG37'/>"
WRITE #1 "        <register address='0xb872608' value='0x" DATA.LONG(A:0x872608) "' name='RPMH_VRM_MODE_VOTE_DRV7_REG38'/>"
WRITE #1 "        <register address='0xb872708' value='0x" DATA.LONG(A:0x872708) "' name='RPMH_VRM_MODE_VOTE_DRV7_REG39'/>"
WRITE #1 "        <register address='0xb872808' value='0x" DATA.LONG(A:0x872808) "' name='RPMH_VRM_MODE_VOTE_DRV7_REG40'/>"
WRITE #1 "        <register address='0xb872908' value='0x" DATA.LONG(A:0x872908) "' name='RPMH_VRM_MODE_VOTE_DRV7_REG41'/>"
WRITE #1 "        <register address='0xb872a08' value='0x" DATA.LONG(A:0x872a08) "' name='RPMH_VRM_MODE_VOTE_DRV7_REG42'/>"
WRITE #1 "        <register address='0xb872b08' value='0x" DATA.LONG(A:0x872b08) "' name='RPMH_VRM_MODE_VOTE_DRV7_REG43'/>"
WRITE #1 "        <register address='0xb872c08' value='0x" DATA.LONG(A:0x872c08) "' name='RPMH_VRM_MODE_VOTE_DRV7_REG44'/>"
WRITE #1 "        <register address='0xb872d08' value='0x" DATA.LONG(A:0x872d08) "' name='RPMH_VRM_MODE_VOTE_DRV7_REG45'/>"
WRITE #1 "        <register address='0xb880008' value='0x" DATA.LONG(A:0x880008) "' name='RPMH_VRM_MODE_VOTE_DRV8_REG0'/>"
WRITE #1 "        <register address='0xb880108' value='0x" DATA.LONG(A:0x880108) "' name='RPMH_VRM_MODE_VOTE_DRV8_REG1'/>"
WRITE #1 "        <register address='0xb880208' value='0x" DATA.LONG(A:0x880208) "' name='RPMH_VRM_MODE_VOTE_DRV8_REG2'/>"
WRITE #1 "        <register address='0xb880308' value='0x" DATA.LONG(A:0x880308) "' name='RPMH_VRM_MODE_VOTE_DRV8_REG3'/>"
WRITE #1 "        <register address='0xb880408' value='0x" DATA.LONG(A:0x880408) "' name='RPMH_VRM_MODE_VOTE_DRV8_REG4'/>"
WRITE #1 "        <register address='0xb880508' value='0x" DATA.LONG(A:0x880508) "' name='RPMH_VRM_MODE_VOTE_DRV8_REG5'/>"
WRITE #1 "        <register address='0xb880608' value='0x" DATA.LONG(A:0x880608) "' name='RPMH_VRM_MODE_VOTE_DRV8_REG6'/>"
WRITE #1 "        <register address='0xb880708' value='0x" DATA.LONG(A:0x880708) "' name='RPMH_VRM_MODE_VOTE_DRV8_REG7'/>"
WRITE #1 "        <register address='0xb880808' value='0x" DATA.LONG(A:0x880808) "' name='RPMH_VRM_MODE_VOTE_DRV8_REG8'/>"
WRITE #1 "        <register address='0xb880908' value='0x" DATA.LONG(A:0x880908) "' name='RPMH_VRM_MODE_VOTE_DRV8_REG9'/>"
WRITE #1 "        <register address='0xb880a08' value='0x" DATA.LONG(A:0x880a08) "' name='RPMH_VRM_MODE_VOTE_DRV8_REG10'/>"
WRITE #1 "        <register address='0xb880b08' value='0x" DATA.LONG(A:0x880b08) "' name='RPMH_VRM_MODE_VOTE_DRV8_REG11'/>"
WRITE #1 "        <register address='0xb880c08' value='0x" DATA.LONG(A:0x880c08) "' name='RPMH_VRM_MODE_VOTE_DRV8_REG12'/>"
WRITE #1 "        <register address='0xb880d08' value='0x" DATA.LONG(A:0x880d08) "' name='RPMH_VRM_MODE_VOTE_DRV8_REG13'/>"
WRITE #1 "        <register address='0xb880e08' value='0x" DATA.LONG(A:0x880e08) "' name='RPMH_VRM_MODE_VOTE_DRV8_REG14'/>"
WRITE #1 "        <register address='0xb880f08' value='0x" DATA.LONG(A:0x880f08) "' name='RPMH_VRM_MODE_VOTE_DRV8_REG15'/>"
WRITE #1 "        <register address='0xb881008' value='0x" DATA.LONG(A:0x881008) "' name='RPMH_VRM_MODE_VOTE_DRV8_REG16'/>"
WRITE #1 "        <register address='0xb881108' value='0x" DATA.LONG(A:0x881108) "' name='RPMH_VRM_MODE_VOTE_DRV8_REG17'/>"
WRITE #1 "        <register address='0xb881208' value='0x" DATA.LONG(A:0x881208) "' name='RPMH_VRM_MODE_VOTE_DRV8_REG18'/>"
WRITE #1 "        <register address='0xb881308' value='0x" DATA.LONG(A:0x881308) "' name='RPMH_VRM_MODE_VOTE_DRV8_REG19'/>"
WRITE #1 "        <register address='0xb881408' value='0x" DATA.LONG(A:0x881408) "' name='RPMH_VRM_MODE_VOTE_DRV8_REG20'/>"
WRITE #1 "        <register address='0xb881508' value='0x" DATA.LONG(A:0x881508) "' name='RPMH_VRM_MODE_VOTE_DRV8_REG21'/>"
WRITE #1 "        <register address='0xb881608' value='0x" DATA.LONG(A:0x881608) "' name='RPMH_VRM_MODE_VOTE_DRV8_REG22'/>"
WRITE #1 "        <register address='0xb881708' value='0x" DATA.LONG(A:0x881708) "' name='RPMH_VRM_MODE_VOTE_DRV8_REG23'/>"
WRITE #1 "        <register address='0xb881808' value='0x" DATA.LONG(A:0x881808) "' name='RPMH_VRM_MODE_VOTE_DRV8_REG24'/>"
WRITE #1 "        <register address='0xb881908' value='0x" DATA.LONG(A:0x881908) "' name='RPMH_VRM_MODE_VOTE_DRV8_REG25'/>"
WRITE #1 "        <register address='0xb881a08' value='0x" DATA.LONG(A:0x881a08) "' name='RPMH_VRM_MODE_VOTE_DRV8_REG26'/>"
WRITE #1 "        <register address='0xb881b08' value='0x" DATA.LONG(A:0x881b08) "' name='RPMH_VRM_MODE_VOTE_DRV8_REG27'/>"
WRITE #1 "        <register address='0xb881c08' value='0x" DATA.LONG(A:0x881c08) "' name='RPMH_VRM_MODE_VOTE_DRV8_REG28'/>"
WRITE #1 "        <register address='0xb881d08' value='0x" DATA.LONG(A:0x881d08) "' name='RPMH_VRM_MODE_VOTE_DRV8_REG29'/>"
WRITE #1 "        <register address='0xb881e08' value='0x" DATA.LONG(A:0x881e08) "' name='RPMH_VRM_MODE_VOTE_DRV8_REG30'/>"
WRITE #1 "        <register address='0xb881f08' value='0x" DATA.LONG(A:0x881f08) "' name='RPMH_VRM_MODE_VOTE_DRV8_REG31'/>"
WRITE #1 "        <register address='0xb882008' value='0x" DATA.LONG(A:0x882008) "' name='RPMH_VRM_MODE_VOTE_DRV8_REG32'/>"
WRITE #1 "        <register address='0xb882108' value='0x" DATA.LONG(A:0x882108) "' name='RPMH_VRM_MODE_VOTE_DRV8_REG33'/>"
WRITE #1 "        <register address='0xb882208' value='0x" DATA.LONG(A:0x882208) "' name='RPMH_VRM_MODE_VOTE_DRV8_REG34'/>"
WRITE #1 "        <register address='0xb882308' value='0x" DATA.LONG(A:0x882308) "' name='RPMH_VRM_MODE_VOTE_DRV8_REG35'/>"
WRITE #1 "        <register address='0xb882408' value='0x" DATA.LONG(A:0x882408) "' name='RPMH_VRM_MODE_VOTE_DRV8_REG36'/>"
WRITE #1 "        <register address='0xb882508' value='0x" DATA.LONG(A:0x882508) "' name='RPMH_VRM_MODE_VOTE_DRV8_REG37'/>"
WRITE #1 "        <register address='0xb882608' value='0x" DATA.LONG(A:0x882608) "' name='RPMH_VRM_MODE_VOTE_DRV8_REG38'/>"
WRITE #1 "        <register address='0xb882708' value='0x" DATA.LONG(A:0x882708) "' name='RPMH_VRM_MODE_VOTE_DRV8_REG39'/>"
WRITE #1 "        <register address='0xb882808' value='0x" DATA.LONG(A:0x882808) "' name='RPMH_VRM_MODE_VOTE_DRV8_REG40'/>"
WRITE #1 "        <register address='0xb882908' value='0x" DATA.LONG(A:0x882908) "' name='RPMH_VRM_MODE_VOTE_DRV8_REG41'/>"
WRITE #1 "        <register address='0xb882a08' value='0x" DATA.LONG(A:0x882a08) "' name='RPMH_VRM_MODE_VOTE_DRV8_REG42'/>"
WRITE #1 "        <register address='0xb882b08' value='0x" DATA.LONG(A:0x882b08) "' name='RPMH_VRM_MODE_VOTE_DRV8_REG43'/>"
WRITE #1 "        <register address='0xb882c08' value='0x" DATA.LONG(A:0x882c08) "' name='RPMH_VRM_MODE_VOTE_DRV8_REG44'/>"
WRITE #1 "        <register address='0xb882d08' value='0x" DATA.LONG(A:0x882d08) "' name='RPMH_VRM_MODE_VOTE_DRV8_REG45'/>"
WRITE #1 "        <register address='0xb890008' value='0x" DATA.LONG(A:0x890008) "' name='RPMH_VRM_MODE_VOTE_DRV9_REG0'/>"
WRITE #1 "        <register address='0xb890108' value='0x" DATA.LONG(A:0x890108) "' name='RPMH_VRM_MODE_VOTE_DRV9_REG1'/>"
WRITE #1 "        <register address='0xb890208' value='0x" DATA.LONG(A:0x890208) "' name='RPMH_VRM_MODE_VOTE_DRV9_REG2'/>"
WRITE #1 "        <register address='0xb890308' value='0x" DATA.LONG(A:0x890308) "' name='RPMH_VRM_MODE_VOTE_DRV9_REG3'/>"
WRITE #1 "        <register address='0xb890408' value='0x" DATA.LONG(A:0x890408) "' name='RPMH_VRM_MODE_VOTE_DRV9_REG4'/>"
WRITE #1 "        <register address='0xb890508' value='0x" DATA.LONG(A:0x890508) "' name='RPMH_VRM_MODE_VOTE_DRV9_REG5'/>"
WRITE #1 "        <register address='0xb890608' value='0x" DATA.LONG(A:0x890608) "' name='RPMH_VRM_MODE_VOTE_DRV9_REG6'/>"
WRITE #1 "        <register address='0xb890708' value='0x" DATA.LONG(A:0x890708) "' name='RPMH_VRM_MODE_VOTE_DRV9_REG7'/>"
WRITE #1 "        <register address='0xb890808' value='0x" DATA.LONG(A:0x890808) "' name='RPMH_VRM_MODE_VOTE_DRV9_REG8'/>"
WRITE #1 "        <register address='0xb890908' value='0x" DATA.LONG(A:0x890908) "' name='RPMH_VRM_MODE_VOTE_DRV9_REG9'/>"
WRITE #1 "        <register address='0xb890a08' value='0x" DATA.LONG(A:0x890a08) "' name='RPMH_VRM_MODE_VOTE_DRV9_REG10'/>"
WRITE #1 "        <register address='0xb890b08' value='0x" DATA.LONG(A:0x890b08) "' name='RPMH_VRM_MODE_VOTE_DRV9_REG11'/>"
WRITE #1 "        <register address='0xb890c08' value='0x" DATA.LONG(A:0x890c08) "' name='RPMH_VRM_MODE_VOTE_DRV9_REG12'/>"
WRITE #1 "        <register address='0xb890d08' value='0x" DATA.LONG(A:0x890d08) "' name='RPMH_VRM_MODE_VOTE_DRV9_REG13'/>"
WRITE #1 "        <register address='0xb890e08' value='0x" DATA.LONG(A:0x890e08) "' name='RPMH_VRM_MODE_VOTE_DRV9_REG14'/>"
WRITE #1 "        <register address='0xb890f08' value='0x" DATA.LONG(A:0x890f08) "' name='RPMH_VRM_MODE_VOTE_DRV9_REG15'/>"
WRITE #1 "        <register address='0xb891008' value='0x" DATA.LONG(A:0x891008) "' name='RPMH_VRM_MODE_VOTE_DRV9_REG16'/>"
WRITE #1 "        <register address='0xb891108' value='0x" DATA.LONG(A:0x891108) "' name='RPMH_VRM_MODE_VOTE_DRV9_REG17'/>"
WRITE #1 "        <register address='0xb891208' value='0x" DATA.LONG(A:0x891208) "' name='RPMH_VRM_MODE_VOTE_DRV9_REG18'/>"
WRITE #1 "        <register address='0xb891308' value='0x" DATA.LONG(A:0x891308) "' name='RPMH_VRM_MODE_VOTE_DRV9_REG19'/>"
WRITE #1 "        <register address='0xb891408' value='0x" DATA.LONG(A:0x891408) "' name='RPMH_VRM_MODE_VOTE_DRV9_REG20'/>"
WRITE #1 "        <register address='0xb891508' value='0x" DATA.LONG(A:0x891508) "' name='RPMH_VRM_MODE_VOTE_DRV9_REG21'/>"
WRITE #1 "        <register address='0xb891608' value='0x" DATA.LONG(A:0x891608) "' name='RPMH_VRM_MODE_VOTE_DRV9_REG22'/>"
WRITE #1 "        <register address='0xb891708' value='0x" DATA.LONG(A:0x891708) "' name='RPMH_VRM_MODE_VOTE_DRV9_REG23'/>"
WRITE #1 "        <register address='0xb891808' value='0x" DATA.LONG(A:0x891808) "' name='RPMH_VRM_MODE_VOTE_DRV9_REG24'/>"
WRITE #1 "        <register address='0xb891908' value='0x" DATA.LONG(A:0x891908) "' name='RPMH_VRM_MODE_VOTE_DRV9_REG25'/>"
WRITE #1 "        <register address='0xb891a08' value='0x" DATA.LONG(A:0x891a08) "' name='RPMH_VRM_MODE_VOTE_DRV9_REG26'/>"
WRITE #1 "        <register address='0xb891b08' value='0x" DATA.LONG(A:0x891b08) "' name='RPMH_VRM_MODE_VOTE_DRV9_REG27'/>"
WRITE #1 "        <register address='0xb891c08' value='0x" DATA.LONG(A:0x891c08) "' name='RPMH_VRM_MODE_VOTE_DRV9_REG28'/>"
WRITE #1 "        <register address='0xb891d08' value='0x" DATA.LONG(A:0x891d08) "' name='RPMH_VRM_MODE_VOTE_DRV9_REG29'/>"
WRITE #1 "        <register address='0xb891e08' value='0x" DATA.LONG(A:0x891e08) "' name='RPMH_VRM_MODE_VOTE_DRV9_REG30'/>"
WRITE #1 "        <register address='0xb891f08' value='0x" DATA.LONG(A:0x891f08) "' name='RPMH_VRM_MODE_VOTE_DRV9_REG31'/>"
WRITE #1 "        <register address='0xb892008' value='0x" DATA.LONG(A:0x892008) "' name='RPMH_VRM_MODE_VOTE_DRV9_REG32'/>"
WRITE #1 "        <register address='0xb892108' value='0x" DATA.LONG(A:0x892108) "' name='RPMH_VRM_MODE_VOTE_DRV9_REG33'/>"
WRITE #1 "        <register address='0xb892208' value='0x" DATA.LONG(A:0x892208) "' name='RPMH_VRM_MODE_VOTE_DRV9_REG34'/>"
WRITE #1 "        <register address='0xb892308' value='0x" DATA.LONG(A:0x892308) "' name='RPMH_VRM_MODE_VOTE_DRV9_REG35'/>"
WRITE #1 "        <register address='0xb892408' value='0x" DATA.LONG(A:0x892408) "' name='RPMH_VRM_MODE_VOTE_DRV9_REG36'/>"
WRITE #1 "        <register address='0xb892508' value='0x" DATA.LONG(A:0x892508) "' name='RPMH_VRM_MODE_VOTE_DRV9_REG37'/>"
WRITE #1 "        <register address='0xb892608' value='0x" DATA.LONG(A:0x892608) "' name='RPMH_VRM_MODE_VOTE_DRV9_REG38'/>"
WRITE #1 "        <register address='0xb892708' value='0x" DATA.LONG(A:0x892708) "' name='RPMH_VRM_MODE_VOTE_DRV9_REG39'/>"
WRITE #1 "        <register address='0xb892808' value='0x" DATA.LONG(A:0x892808) "' name='RPMH_VRM_MODE_VOTE_DRV9_REG40'/>"
WRITE #1 "        <register address='0xb892908' value='0x" DATA.LONG(A:0x892908) "' name='RPMH_VRM_MODE_VOTE_DRV9_REG41'/>"
WRITE #1 "        <register address='0xb892a08' value='0x" DATA.LONG(A:0x892a08) "' name='RPMH_VRM_MODE_VOTE_DRV9_REG42'/>"
WRITE #1 "        <register address='0xb892b08' value='0x" DATA.LONG(A:0x892b08) "' name='RPMH_VRM_MODE_VOTE_DRV9_REG43'/>"
WRITE #1 "        <register address='0xb892c08' value='0x" DATA.LONG(A:0x892c08) "' name='RPMH_VRM_MODE_VOTE_DRV9_REG44'/>"
WRITE #1 "        <register address='0xb892d08' value='0x" DATA.LONG(A:0x892d08) "' name='RPMH_VRM_MODE_VOTE_DRV9_REG45'/>"
WRITE #1 "        <register address='0xb8a0008' value='0x" DATA.LONG(A:0x8a0008) "' name='RPMH_VRM_MODE_VOTE_DRV10_REG0'/>"
WRITE #1 "        <register address='0xb8a0108' value='0x" DATA.LONG(A:0x8a0108) "' name='RPMH_VRM_MODE_VOTE_DRV10_REG1'/>"
WRITE #1 "        <register address='0xb8a0208' value='0x" DATA.LONG(A:0x8a0208) "' name='RPMH_VRM_MODE_VOTE_DRV10_REG2'/>"
WRITE #1 "        <register address='0xb8a0308' value='0x" DATA.LONG(A:0x8a0308) "' name='RPMH_VRM_MODE_VOTE_DRV10_REG3'/>"
WRITE #1 "        <register address='0xb8a0408' value='0x" DATA.LONG(A:0x8a0408) "' name='RPMH_VRM_MODE_VOTE_DRV10_REG4'/>"
WRITE #1 "        <register address='0xb8a0508' value='0x" DATA.LONG(A:0x8a0508) "' name='RPMH_VRM_MODE_VOTE_DRV10_REG5'/>"
WRITE #1 "        <register address='0xb8a0608' value='0x" DATA.LONG(A:0x8a0608) "' name='RPMH_VRM_MODE_VOTE_DRV10_REG6'/>"
WRITE #1 "        <register address='0xb8a0708' value='0x" DATA.LONG(A:0x8a0708) "' name='RPMH_VRM_MODE_VOTE_DRV10_REG7'/>"
WRITE #1 "        <register address='0xb8a0808' value='0x" DATA.LONG(A:0x8a0808) "' name='RPMH_VRM_MODE_VOTE_DRV10_REG8'/>"
WRITE #1 "        <register address='0xb8a0908' value='0x" DATA.LONG(A:0x8a0908) "' name='RPMH_VRM_MODE_VOTE_DRV10_REG9'/>"
WRITE #1 "        <register address='0xb8a0a08' value='0x" DATA.LONG(A:0x8a0a08) "' name='RPMH_VRM_MODE_VOTE_DRV10_REG10'/>"
WRITE #1 "        <register address='0xb8a0b08' value='0x" DATA.LONG(A:0x8a0b08) "' name='RPMH_VRM_MODE_VOTE_DRV10_REG11'/>"
WRITE #1 "        <register address='0xb8a0c08' value='0x" DATA.LONG(A:0x8a0c08) "' name='RPMH_VRM_MODE_VOTE_DRV10_REG12'/>"
WRITE #1 "        <register address='0xb8a0d08' value='0x" DATA.LONG(A:0x8a0d08) "' name='RPMH_VRM_MODE_VOTE_DRV10_REG13'/>"
WRITE #1 "        <register address='0xb8a0e08' value='0x" DATA.LONG(A:0x8a0e08) "' name='RPMH_VRM_MODE_VOTE_DRV10_REG14'/>"
WRITE #1 "        <register address='0xb8a0f08' value='0x" DATA.LONG(A:0x8a0f08) "' name='RPMH_VRM_MODE_VOTE_DRV10_REG15'/>"
WRITE #1 "        <register address='0xb8a1008' value='0x" DATA.LONG(A:0x8a1008) "' name='RPMH_VRM_MODE_VOTE_DRV10_REG16'/>"
WRITE #1 "        <register address='0xb8a1108' value='0x" DATA.LONG(A:0x8a1108) "' name='RPMH_VRM_MODE_VOTE_DRV10_REG17'/>"
WRITE #1 "        <register address='0xb8a1208' value='0x" DATA.LONG(A:0x8a1208) "' name='RPMH_VRM_MODE_VOTE_DRV10_REG18'/>"
WRITE #1 "        <register address='0xb8a1308' value='0x" DATA.LONG(A:0x8a1308) "' name='RPMH_VRM_MODE_VOTE_DRV10_REG19'/>"
WRITE #1 "        <register address='0xb8a1408' value='0x" DATA.LONG(A:0x8a1408) "' name='RPMH_VRM_MODE_VOTE_DRV10_REG20'/>"
WRITE #1 "        <register address='0xb8a1508' value='0x" DATA.LONG(A:0x8a1508) "' name='RPMH_VRM_MODE_VOTE_DRV10_REG21'/>"
WRITE #1 "        <register address='0xb8a1608' value='0x" DATA.LONG(A:0x8a1608) "' name='RPMH_VRM_MODE_VOTE_DRV10_REG22'/>"
WRITE #1 "        <register address='0xb8a1708' value='0x" DATA.LONG(A:0x8a1708) "' name='RPMH_VRM_MODE_VOTE_DRV10_REG23'/>"
WRITE #1 "        <register address='0xb8a1808' value='0x" DATA.LONG(A:0x8a1808) "' name='RPMH_VRM_MODE_VOTE_DRV10_REG24'/>"
WRITE #1 "        <register address='0xb8a1908' value='0x" DATA.LONG(A:0x8a1908) "' name='RPMH_VRM_MODE_VOTE_DRV10_REG25'/>"
WRITE #1 "        <register address='0xb8a1a08' value='0x" DATA.LONG(A:0x8a1a08) "' name='RPMH_VRM_MODE_VOTE_DRV10_REG26'/>"
WRITE #1 "        <register address='0xb8a1b08' value='0x" DATA.LONG(A:0x8a1b08) "' name='RPMH_VRM_MODE_VOTE_DRV10_REG27'/>"
WRITE #1 "        <register address='0xb8a1c08' value='0x" DATA.LONG(A:0x8a1c08) "' name='RPMH_VRM_MODE_VOTE_DRV10_REG28'/>"
WRITE #1 "        <register address='0xb8a1d08' value='0x" DATA.LONG(A:0x8a1d08) "' name='RPMH_VRM_MODE_VOTE_DRV10_REG29'/>"
WRITE #1 "        <register address='0xb8a1e08' value='0x" DATA.LONG(A:0x8a1e08) "' name='RPMH_VRM_MODE_VOTE_DRV10_REG30'/>"
WRITE #1 "        <register address='0xb8a1f08' value='0x" DATA.LONG(A:0x8a1f08) "' name='RPMH_VRM_MODE_VOTE_DRV10_REG31'/>"
WRITE #1 "        <register address='0xb8a2008' value='0x" DATA.LONG(A:0x8a2008) "' name='RPMH_VRM_MODE_VOTE_DRV10_REG32'/>"
WRITE #1 "        <register address='0xb8a2108' value='0x" DATA.LONG(A:0x8a2108) "' name='RPMH_VRM_MODE_VOTE_DRV10_REG33'/>"
WRITE #1 "        <register address='0xb8a2208' value='0x" DATA.LONG(A:0x8a2208) "' name='RPMH_VRM_MODE_VOTE_DRV10_REG34'/>"
WRITE #1 "        <register address='0xb8a2308' value='0x" DATA.LONG(A:0x8a2308) "' name='RPMH_VRM_MODE_VOTE_DRV10_REG35'/>"
WRITE #1 "        <register address='0xb8a2408' value='0x" DATA.LONG(A:0x8a2408) "' name='RPMH_VRM_MODE_VOTE_DRV10_REG36'/>"
WRITE #1 "        <register address='0xb8a2508' value='0x" DATA.LONG(A:0x8a2508) "' name='RPMH_VRM_MODE_VOTE_DRV10_REG37'/>"
WRITE #1 "        <register address='0xb8a2608' value='0x" DATA.LONG(A:0x8a2608) "' name='RPMH_VRM_MODE_VOTE_DRV10_REG38'/>"
WRITE #1 "        <register address='0xb8a2708' value='0x" DATA.LONG(A:0x8a2708) "' name='RPMH_VRM_MODE_VOTE_DRV10_REG39'/>"
WRITE #1 "        <register address='0xb8a2808' value='0x" DATA.LONG(A:0x8a2808) "' name='RPMH_VRM_MODE_VOTE_DRV10_REG40'/>"
WRITE #1 "        <register address='0xb8a2908' value='0x" DATA.LONG(A:0x8a2908) "' name='RPMH_VRM_MODE_VOTE_DRV10_REG41'/>"
WRITE #1 "        <register address='0xb8a2a08' value='0x" DATA.LONG(A:0x8a2a08) "' name='RPMH_VRM_MODE_VOTE_DRV10_REG42'/>"
WRITE #1 "        <register address='0xb8a2b08' value='0x" DATA.LONG(A:0x8a2b08) "' name='RPMH_VRM_MODE_VOTE_DRV10_REG43'/>"
WRITE #1 "        <register address='0xb8a2c08' value='0x" DATA.LONG(A:0x8a2c08) "' name='RPMH_VRM_MODE_VOTE_DRV10_REG44'/>"
WRITE #1 "        <register address='0xb8a2d08' value='0x" DATA.LONG(A:0x8a2d08) "' name='RPMH_VRM_MODE_VOTE_DRV10_REG45'/>"
WRITE #1 "        <register address='0xb8b0008' value='0x" DATA.LONG(A:0x8b0008) "' name='RPMH_VRM_MODE_VOTE_DRV11_REG0'/>"
WRITE #1 "        <register address='0xb8b0108' value='0x" DATA.LONG(A:0x8b0108) "' name='RPMH_VRM_MODE_VOTE_DRV11_REG1'/>"
WRITE #1 "        <register address='0xb8b0208' value='0x" DATA.LONG(A:0x8b0208) "' name='RPMH_VRM_MODE_VOTE_DRV11_REG2'/>"
WRITE #1 "        <register address='0xb8b0308' value='0x" DATA.LONG(A:0x8b0308) "' name='RPMH_VRM_MODE_VOTE_DRV11_REG3'/>"
WRITE #1 "        <register address='0xb8b0408' value='0x" DATA.LONG(A:0x8b0408) "' name='RPMH_VRM_MODE_VOTE_DRV11_REG4'/>"
WRITE #1 "        <register address='0xb8b0508' value='0x" DATA.LONG(A:0x8b0508) "' name='RPMH_VRM_MODE_VOTE_DRV11_REG5'/>"
WRITE #1 "        <register address='0xb8b0608' value='0x" DATA.LONG(A:0x8b0608) "' name='RPMH_VRM_MODE_VOTE_DRV11_REG6'/>"
WRITE #1 "        <register address='0xb8b0708' value='0x" DATA.LONG(A:0x8b0708) "' name='RPMH_VRM_MODE_VOTE_DRV11_REG7'/>"
WRITE #1 "        <register address='0xb8b0808' value='0x" DATA.LONG(A:0x8b0808) "' name='RPMH_VRM_MODE_VOTE_DRV11_REG8'/>"
WRITE #1 "        <register address='0xb8b0908' value='0x" DATA.LONG(A:0x8b0908) "' name='RPMH_VRM_MODE_VOTE_DRV11_REG9'/>"
WRITE #1 "        <register address='0xb8b0a08' value='0x" DATA.LONG(A:0x8b0a08) "' name='RPMH_VRM_MODE_VOTE_DRV11_REG10'/>"
WRITE #1 "        <register address='0xb8b0b08' value='0x" DATA.LONG(A:0x8b0b08) "' name='RPMH_VRM_MODE_VOTE_DRV11_REG11'/>"
WRITE #1 "        <register address='0xb8b0c08' value='0x" DATA.LONG(A:0x8b0c08) "' name='RPMH_VRM_MODE_VOTE_DRV11_REG12'/>"
WRITE #1 "        <register address='0xb8b0d08' value='0x" DATA.LONG(A:0x8b0d08) "' name='RPMH_VRM_MODE_VOTE_DRV11_REG13'/>"
WRITE #1 "        <register address='0xb8b0e08' value='0x" DATA.LONG(A:0x8b0e08) "' name='RPMH_VRM_MODE_VOTE_DRV11_REG14'/>"
WRITE #1 "        <register address='0xb8b0f08' value='0x" DATA.LONG(A:0x8b0f08) "' name='RPMH_VRM_MODE_VOTE_DRV11_REG15'/>"
WRITE #1 "        <register address='0xb8b1008' value='0x" DATA.LONG(A:0x8b1008) "' name='RPMH_VRM_MODE_VOTE_DRV11_REG16'/>"
WRITE #1 "        <register address='0xb8b1108' value='0x" DATA.LONG(A:0x8b1108) "' name='RPMH_VRM_MODE_VOTE_DRV11_REG17'/>"
WRITE #1 "        <register address='0xb8b1208' value='0x" DATA.LONG(A:0x8b1208) "' name='RPMH_VRM_MODE_VOTE_DRV11_REG18'/>"
WRITE #1 "        <register address='0xb8b1308' value='0x" DATA.LONG(A:0x8b1308) "' name='RPMH_VRM_MODE_VOTE_DRV11_REG19'/>"
WRITE #1 "        <register address='0xb8b1408' value='0x" DATA.LONG(A:0x8b1408) "' name='RPMH_VRM_MODE_VOTE_DRV11_REG20'/>"
WRITE #1 "        <register address='0xb8b1508' value='0x" DATA.LONG(A:0x8b1508) "' name='RPMH_VRM_MODE_VOTE_DRV11_REG21'/>"
WRITE #1 "        <register address='0xb8b1608' value='0x" DATA.LONG(A:0x8b1608) "' name='RPMH_VRM_MODE_VOTE_DRV11_REG22'/>"
WRITE #1 "        <register address='0xb8b1708' value='0x" DATA.LONG(A:0x8b1708) "' name='RPMH_VRM_MODE_VOTE_DRV11_REG23'/>"
WRITE #1 "        <register address='0xb8b1808' value='0x" DATA.LONG(A:0x8b1808) "' name='RPMH_VRM_MODE_VOTE_DRV11_REG24'/>"
WRITE #1 "        <register address='0xb8b1908' value='0x" DATA.LONG(A:0x8b1908) "' name='RPMH_VRM_MODE_VOTE_DRV11_REG25'/>"
WRITE #1 "        <register address='0xb8b1a08' value='0x" DATA.LONG(A:0x8b1a08) "' name='RPMH_VRM_MODE_VOTE_DRV11_REG26'/>"
WRITE #1 "        <register address='0xb8b1b08' value='0x" DATA.LONG(A:0x8b1b08) "' name='RPMH_VRM_MODE_VOTE_DRV11_REG27'/>"
WRITE #1 "        <register address='0xb8b1c08' value='0x" DATA.LONG(A:0x8b1c08) "' name='RPMH_VRM_MODE_VOTE_DRV11_REG28'/>"
WRITE #1 "        <register address='0xb8b1d08' value='0x" DATA.LONG(A:0x8b1d08) "' name='RPMH_VRM_MODE_VOTE_DRV11_REG29'/>"
WRITE #1 "        <register address='0xb8b1e08' value='0x" DATA.LONG(A:0x8b1e08) "' name='RPMH_VRM_MODE_VOTE_DRV11_REG30'/>"
WRITE #1 "        <register address='0xb8b1f08' value='0x" DATA.LONG(A:0x8b1f08) "' name='RPMH_VRM_MODE_VOTE_DRV11_REG31'/>"
WRITE #1 "        <register address='0xb8b2008' value='0x" DATA.LONG(A:0x8b2008) "' name='RPMH_VRM_MODE_VOTE_DRV11_REG32'/>"
WRITE #1 "        <register address='0xb8b2108' value='0x" DATA.LONG(A:0x8b2108) "' name='RPMH_VRM_MODE_VOTE_DRV11_REG33'/>"
WRITE #1 "        <register address='0xb8b2208' value='0x" DATA.LONG(A:0x8b2208) "' name='RPMH_VRM_MODE_VOTE_DRV11_REG34'/>"
WRITE #1 "        <register address='0xb8b2308' value='0x" DATA.LONG(A:0x8b2308) "' name='RPMH_VRM_MODE_VOTE_DRV11_REG35'/>"
WRITE #1 "        <register address='0xb8b2408' value='0x" DATA.LONG(A:0x8b2408) "' name='RPMH_VRM_MODE_VOTE_DRV11_REG36'/>"
WRITE #1 "        <register address='0xb8b2508' value='0x" DATA.LONG(A:0x8b2508) "' name='RPMH_VRM_MODE_VOTE_DRV11_REG37'/>"
WRITE #1 "        <register address='0xb8b2608' value='0x" DATA.LONG(A:0x8b2608) "' name='RPMH_VRM_MODE_VOTE_DRV11_REG38'/>"
WRITE #1 "        <register address='0xb8b2708' value='0x" DATA.LONG(A:0x8b2708) "' name='RPMH_VRM_MODE_VOTE_DRV11_REG39'/>"
WRITE #1 "        <register address='0xb8b2808' value='0x" DATA.LONG(A:0x8b2808) "' name='RPMH_VRM_MODE_VOTE_DRV11_REG40'/>"
WRITE #1 "        <register address='0xb8b2908' value='0x" DATA.LONG(A:0x8b2908) "' name='RPMH_VRM_MODE_VOTE_DRV11_REG41'/>"
WRITE #1 "        <register address='0xb8b2a08' value='0x" DATA.LONG(A:0x8b2a08) "' name='RPMH_VRM_MODE_VOTE_DRV11_REG42'/>"
WRITE #1 "        <register address='0xb8b2b08' value='0x" DATA.LONG(A:0x8b2b08) "' name='RPMH_VRM_MODE_VOTE_DRV11_REG43'/>"
WRITE #1 "        <register address='0xb8b2c08' value='0x" DATA.LONG(A:0x8b2c08) "' name='RPMH_VRM_MODE_VOTE_DRV11_REG44'/>"
WRITE #1 "        <register address='0xb8b2d08' value='0x" DATA.LONG(A:0x8b2d08) "' name='RPMH_VRM_MODE_VOTE_DRV11_REG45'/>"
WRITE #1 "        <register address='0xb802e04' value='0x" DATA.LONG(A:0x802e04) "' name='RPMH_VRM_ENABLE_VOTE_DRV0_XOB0'/>"
WRITE #1 "        <register address='0xb802f04' value='0x" DATA.LONG(A:0x802f04) "' name='RPMH_VRM_ENABLE_VOTE_DRV0_XOB1'/>"
WRITE #1 "        <register address='0xb803004' value='0x" DATA.LONG(A:0x803004) "' name='RPMH_VRM_ENABLE_VOTE_DRV0_XOB2'/>"
WRITE #1 "        <register address='0xb803104' value='0x" DATA.LONG(A:0x803104) "' name='RPMH_VRM_ENABLE_VOTE_DRV0_XOB3'/>"
WRITE #1 "        <register address='0xb803204' value='0x" DATA.LONG(A:0x803204) "' name='RPMH_VRM_ENABLE_VOTE_DRV0_XOB4'/>"
WRITE #1 "        <register address='0xb803304' value='0x" DATA.LONG(A:0x803304) "' name='RPMH_VRM_ENABLE_VOTE_DRV0_XOB5'/>"
WRITE #1 "        <register address='0xb803404' value='0x" DATA.LONG(A:0x803404) "' name='RPMH_VRM_ENABLE_VOTE_DRV0_XOB6'/>"
WRITE #1 "        <register address='0xb803504' value='0x" DATA.LONG(A:0x803504) "' name='RPMH_VRM_ENABLE_VOTE_DRV0_XOB7'/>"
WRITE #1 "        <register address='0xb803604' value='0x" DATA.LONG(A:0x803604) "' name='RPMH_VRM_ENABLE_VOTE_DRV0_XOB8'/>"
WRITE #1 "        <register address='0xb803704' value='0x" DATA.LONG(A:0x803704) "' name='RPMH_VRM_ENABLE_VOTE_DRV0_XOB9'/>"
WRITE #1 "        <register address='0xb803804' value='0x" DATA.LONG(A:0x803804) "' name='RPMH_VRM_ENABLE_VOTE_DRV0_XOB10'/>"
WRITE #1 "        <register address='0xb803904' value='0x" DATA.LONG(A:0x803904) "' name='RPMH_VRM_ENABLE_VOTE_DRV0_XOB11'/>"
WRITE #1 "        <register address='0xb803a04' value='0x" DATA.LONG(A:0x803a04) "' name='RPMH_VRM_ENABLE_VOTE_DRV0_XOB12'/>"
WRITE #1 "        <register address='0xb803b04' value='0x" DATA.LONG(A:0x803b04) "' name='RPMH_VRM_ENABLE_VOTE_DRV0_XOB13'/>"
WRITE #1 "        <register address='0xb803c04' value='0x" DATA.LONG(A:0x803c04) "' name='RPMH_VRM_ENABLE_VOTE_DRV0_XOB14'/>"
WRITE #1 "        <register address='0xb803d04' value='0x" DATA.LONG(A:0x803d04) "' name='RPMH_VRM_ENABLE_VOTE_DRV0_XOB15'/>"
WRITE #1 "        <register address='0xb812e04' value='0x" DATA.LONG(A:0x812e04) "' name='RPMH_VRM_ENABLE_VOTE_DRV1_XOB0'/>"
WRITE #1 "        <register address='0xb812f04' value='0x" DATA.LONG(A:0x812f04) "' name='RPMH_VRM_ENABLE_VOTE_DRV1_XOB1'/>"
WRITE #1 "        <register address='0xb813004' value='0x" DATA.LONG(A:0x813004) "' name='RPMH_VRM_ENABLE_VOTE_DRV1_XOB2'/>"
WRITE #1 "        <register address='0xb813104' value='0x" DATA.LONG(A:0x813104) "' name='RPMH_VRM_ENABLE_VOTE_DRV1_XOB3'/>"
WRITE #1 "        <register address='0xb813204' value='0x" DATA.LONG(A:0x813204) "' name='RPMH_VRM_ENABLE_VOTE_DRV1_XOB4'/>"
WRITE #1 "        <register address='0xb813304' value='0x" DATA.LONG(A:0x813304) "' name='RPMH_VRM_ENABLE_VOTE_DRV1_XOB5'/>"
WRITE #1 "        <register address='0xb813404' value='0x" DATA.LONG(A:0x813404) "' name='RPMH_VRM_ENABLE_VOTE_DRV1_XOB6'/>"
WRITE #1 "        <register address='0xb813504' value='0x" DATA.LONG(A:0x813504) "' name='RPMH_VRM_ENABLE_VOTE_DRV1_XOB7'/>"
WRITE #1 "        <register address='0xb813604' value='0x" DATA.LONG(A:0x813604) "' name='RPMH_VRM_ENABLE_VOTE_DRV1_XOB8'/>"
WRITE #1 "        <register address='0xb813704' value='0x" DATA.LONG(A:0x813704) "' name='RPMH_VRM_ENABLE_VOTE_DRV1_XOB9'/>"
WRITE #1 "        <register address='0xb813804' value='0x" DATA.LONG(A:0x813804) "' name='RPMH_VRM_ENABLE_VOTE_DRV1_XOB10'/>"
WRITE #1 "        <register address='0xb813904' value='0x" DATA.LONG(A:0x813904) "' name='RPMH_VRM_ENABLE_VOTE_DRV1_XOB11'/>"
WRITE #1 "        <register address='0xb813a04' value='0x" DATA.LONG(A:0x813a04) "' name='RPMH_VRM_ENABLE_VOTE_DRV1_XOB12'/>"
WRITE #1 "        <register address='0xb813b04' value='0x" DATA.LONG(A:0x813b04) "' name='RPMH_VRM_ENABLE_VOTE_DRV1_XOB13'/>"
WRITE #1 "        <register address='0xb813c04' value='0x" DATA.LONG(A:0x813c04) "' name='RPMH_VRM_ENABLE_VOTE_DRV1_XOB14'/>"
WRITE #1 "        <register address='0xb813d04' value='0x" DATA.LONG(A:0x813d04) "' name='RPMH_VRM_ENABLE_VOTE_DRV1_XOB15'/>"
WRITE #1 "        <register address='0xb822e04' value='0x" DATA.LONG(A:0x822e04) "' name='RPMH_VRM_ENABLE_VOTE_DRV2_XOB0'/>"
WRITE #1 "        <register address='0xb822f04' value='0x" DATA.LONG(A:0x822f04) "' name='RPMH_VRM_ENABLE_VOTE_DRV2_XOB1'/>"
WRITE #1 "        <register address='0xb823004' value='0x" DATA.LONG(A:0x823004) "' name='RPMH_VRM_ENABLE_VOTE_DRV2_XOB2'/>"
WRITE #1 "        <register address='0xb823104' value='0x" DATA.LONG(A:0x823104) "' name='RPMH_VRM_ENABLE_VOTE_DRV2_XOB3'/>"
WRITE #1 "        <register address='0xb823204' value='0x" DATA.LONG(A:0x823204) "' name='RPMH_VRM_ENABLE_VOTE_DRV2_XOB4'/>"
WRITE #1 "        <register address='0xb823304' value='0x" DATA.LONG(A:0x823304) "' name='RPMH_VRM_ENABLE_VOTE_DRV2_XOB5'/>"
WRITE #1 "        <register address='0xb823404' value='0x" DATA.LONG(A:0x823404) "' name='RPMH_VRM_ENABLE_VOTE_DRV2_XOB6'/>"
WRITE #1 "        <register address='0xb823504' value='0x" DATA.LONG(A:0x823504) "' name='RPMH_VRM_ENABLE_VOTE_DRV2_XOB7'/>"
WRITE #1 "        <register address='0xb823604' value='0x" DATA.LONG(A:0x823604) "' name='RPMH_VRM_ENABLE_VOTE_DRV2_XOB8'/>"
WRITE #1 "        <register address='0xb823704' value='0x" DATA.LONG(A:0x823704) "' name='RPMH_VRM_ENABLE_VOTE_DRV2_XOB9'/>"
WRITE #1 "        <register address='0xb823804' value='0x" DATA.LONG(A:0x823804) "' name='RPMH_VRM_ENABLE_VOTE_DRV2_XOB10'/>"
WRITE #1 "        <register address='0xb823904' value='0x" DATA.LONG(A:0x823904) "' name='RPMH_VRM_ENABLE_VOTE_DRV2_XOB11'/>"
WRITE #1 "        <register address='0xb823a04' value='0x" DATA.LONG(A:0x823a04) "' name='RPMH_VRM_ENABLE_VOTE_DRV2_XOB12'/>"
WRITE #1 "        <register address='0xb823b04' value='0x" DATA.LONG(A:0x823b04) "' name='RPMH_VRM_ENABLE_VOTE_DRV2_XOB13'/>"
WRITE #1 "        <register address='0xb823c04' value='0x" DATA.LONG(A:0x823c04) "' name='RPMH_VRM_ENABLE_VOTE_DRV2_XOB14'/>"
WRITE #1 "        <register address='0xb823d04' value='0x" DATA.LONG(A:0x823d04) "' name='RPMH_VRM_ENABLE_VOTE_DRV2_XOB15'/>"
WRITE #1 "        <register address='0xb832e04' value='0x" DATA.LONG(A:0x832e04) "' name='RPMH_VRM_ENABLE_VOTE_DRV3_XOB0'/>"
WRITE #1 "        <register address='0xb832f04' value='0x" DATA.LONG(A:0x832f04) "' name='RPMH_VRM_ENABLE_VOTE_DRV3_XOB1'/>"
WRITE #1 "        <register address='0xb833004' value='0x" DATA.LONG(A:0x833004) "' name='RPMH_VRM_ENABLE_VOTE_DRV3_XOB2'/>"
WRITE #1 "        <register address='0xb833104' value='0x" DATA.LONG(A:0x833104) "' name='RPMH_VRM_ENABLE_VOTE_DRV3_XOB3'/>"
WRITE #1 "        <register address='0xb833204' value='0x" DATA.LONG(A:0x833204) "' name='RPMH_VRM_ENABLE_VOTE_DRV3_XOB4'/>"
WRITE #1 "        <register address='0xb833304' value='0x" DATA.LONG(A:0x833304) "' name='RPMH_VRM_ENABLE_VOTE_DRV3_XOB5'/>"
WRITE #1 "        <register address='0xb833404' value='0x" DATA.LONG(A:0x833404) "' name='RPMH_VRM_ENABLE_VOTE_DRV3_XOB6'/>"
WRITE #1 "        <register address='0xb833504' value='0x" DATA.LONG(A:0x833504) "' name='RPMH_VRM_ENABLE_VOTE_DRV3_XOB7'/>"
WRITE #1 "        <register address='0xb833604' value='0x" DATA.LONG(A:0x833604) "' name='RPMH_VRM_ENABLE_VOTE_DRV3_XOB8'/>"
WRITE #1 "        <register address='0xb833704' value='0x" DATA.LONG(A:0x833704) "' name='RPMH_VRM_ENABLE_VOTE_DRV3_XOB9'/>"
WRITE #1 "        <register address='0xb833804' value='0x" DATA.LONG(A:0x833804) "' name='RPMH_VRM_ENABLE_VOTE_DRV3_XOB10'/>"
WRITE #1 "        <register address='0xb833904' value='0x" DATA.LONG(A:0x833904) "' name='RPMH_VRM_ENABLE_VOTE_DRV3_XOB11'/>"
WRITE #1 "        <register address='0xb833a04' value='0x" DATA.LONG(A:0x833a04) "' name='RPMH_VRM_ENABLE_VOTE_DRV3_XOB12'/>"
WRITE #1 "        <register address='0xb833b04' value='0x" DATA.LONG(A:0x833b04) "' name='RPMH_VRM_ENABLE_VOTE_DRV3_XOB13'/>"
WRITE #1 "        <register address='0xb833c04' value='0x" DATA.LONG(A:0x833c04) "' name='RPMH_VRM_ENABLE_VOTE_DRV3_XOB14'/>"
WRITE #1 "        <register address='0xb833d04' value='0x" DATA.LONG(A:0x833d04) "' name='RPMH_VRM_ENABLE_VOTE_DRV3_XOB15'/>"
WRITE #1 "        <register address='0xb842e04' value='0x" DATA.LONG(A:0x842e04) "' name='RPMH_VRM_ENABLE_VOTE_DRV4_XOB0'/>"
WRITE #1 "        <register address='0xb842f04' value='0x" DATA.LONG(A:0x842f04) "' name='RPMH_VRM_ENABLE_VOTE_DRV4_XOB1'/>"
WRITE #1 "        <register address='0xb843004' value='0x" DATA.LONG(A:0x843004) "' name='RPMH_VRM_ENABLE_VOTE_DRV4_XOB2'/>"
WRITE #1 "        <register address='0xb843104' value='0x" DATA.LONG(A:0x843104) "' name='RPMH_VRM_ENABLE_VOTE_DRV4_XOB3'/>"
WRITE #1 "        <register address='0xb843204' value='0x" DATA.LONG(A:0x843204) "' name='RPMH_VRM_ENABLE_VOTE_DRV4_XOB4'/>"
WRITE #1 "        <register address='0xb843304' value='0x" DATA.LONG(A:0x843304) "' name='RPMH_VRM_ENABLE_VOTE_DRV4_XOB5'/>"
WRITE #1 "        <register address='0xb843404' value='0x" DATA.LONG(A:0x843404) "' name='RPMH_VRM_ENABLE_VOTE_DRV4_XOB6'/>"
WRITE #1 "        <register address='0xb843504' value='0x" DATA.LONG(A:0x843504) "' name='RPMH_VRM_ENABLE_VOTE_DRV4_XOB7'/>"
WRITE #1 "        <register address='0xb843604' value='0x" DATA.LONG(A:0x843604) "' name='RPMH_VRM_ENABLE_VOTE_DRV4_XOB8'/>"
WRITE #1 "        <register address='0xb843704' value='0x" DATA.LONG(A:0x843704) "' name='RPMH_VRM_ENABLE_VOTE_DRV4_XOB9'/>"
WRITE #1 "        <register address='0xb843804' value='0x" DATA.LONG(A:0x843804) "' name='RPMH_VRM_ENABLE_VOTE_DRV4_XOB10'/>"
WRITE #1 "        <register address='0xb843904' value='0x" DATA.LONG(A:0x843904) "' name='RPMH_VRM_ENABLE_VOTE_DRV4_XOB11'/>"
WRITE #1 "        <register address='0xb843a04' value='0x" DATA.LONG(A:0x843a04) "' name='RPMH_VRM_ENABLE_VOTE_DRV4_XOB12'/>"
WRITE #1 "        <register address='0xb843b04' value='0x" DATA.LONG(A:0x843b04) "' name='RPMH_VRM_ENABLE_VOTE_DRV4_XOB13'/>"
WRITE #1 "        <register address='0xb843c04' value='0x" DATA.LONG(A:0x843c04) "' name='RPMH_VRM_ENABLE_VOTE_DRV4_XOB14'/>"
WRITE #1 "        <register address='0xb843d04' value='0x" DATA.LONG(A:0x843d04) "' name='RPMH_VRM_ENABLE_VOTE_DRV4_XOB15'/>"
WRITE #1 "        <register address='0xb852e04' value='0x" DATA.LONG(A:0x852e04) "' name='RPMH_VRM_ENABLE_VOTE_DRV5_XOB0'/>"
WRITE #1 "        <register address='0xb852f04' value='0x" DATA.LONG(A:0x852f04) "' name='RPMH_VRM_ENABLE_VOTE_DRV5_XOB1'/>"
WRITE #1 "        <register address='0xb853004' value='0x" DATA.LONG(A:0x853004) "' name='RPMH_VRM_ENABLE_VOTE_DRV5_XOB2'/>"
WRITE #1 "        <register address='0xb853104' value='0x" DATA.LONG(A:0x853104) "' name='RPMH_VRM_ENABLE_VOTE_DRV5_XOB3'/>"
WRITE #1 "        <register address='0xb853204' value='0x" DATA.LONG(A:0x853204) "' name='RPMH_VRM_ENABLE_VOTE_DRV5_XOB4'/>"
WRITE #1 "        <register address='0xb853304' value='0x" DATA.LONG(A:0x853304) "' name='RPMH_VRM_ENABLE_VOTE_DRV5_XOB5'/>"
WRITE #1 "        <register address='0xb853404' value='0x" DATA.LONG(A:0x853404) "' name='RPMH_VRM_ENABLE_VOTE_DRV5_XOB6'/>"
WRITE #1 "        <register address='0xb853504' value='0x" DATA.LONG(A:0x853504) "' name='RPMH_VRM_ENABLE_VOTE_DRV5_XOB7'/>"
WRITE #1 "        <register address='0xb853604' value='0x" DATA.LONG(A:0x853604) "' name='RPMH_VRM_ENABLE_VOTE_DRV5_XOB8'/>"
WRITE #1 "        <register address='0xb853704' value='0x" DATA.LONG(A:0x853704) "' name='RPMH_VRM_ENABLE_VOTE_DRV5_XOB9'/>"
WRITE #1 "        <register address='0xb853804' value='0x" DATA.LONG(A:0x853804) "' name='RPMH_VRM_ENABLE_VOTE_DRV5_XOB10'/>"
WRITE #1 "        <register address='0xb853904' value='0x" DATA.LONG(A:0x853904) "' name='RPMH_VRM_ENABLE_VOTE_DRV5_XOB11'/>"
WRITE #1 "        <register address='0xb853a04' value='0x" DATA.LONG(A:0x853a04) "' name='RPMH_VRM_ENABLE_VOTE_DRV5_XOB12'/>"
WRITE #1 "        <register address='0xb853b04' value='0x" DATA.LONG(A:0x853b04) "' name='RPMH_VRM_ENABLE_VOTE_DRV5_XOB13'/>"
WRITE #1 "        <register address='0xb853c04' value='0x" DATA.LONG(A:0x853c04) "' name='RPMH_VRM_ENABLE_VOTE_DRV5_XOB14'/>"
WRITE #1 "        <register address='0xb853d04' value='0x" DATA.LONG(A:0x853d04) "' name='RPMH_VRM_ENABLE_VOTE_DRV5_XOB15'/>"
WRITE #1 "        <register address='0xb862e04' value='0x" DATA.LONG(A:0x862e04) "' name='RPMH_VRM_ENABLE_VOTE_DRV6_XOB0'/>"
WRITE #1 "        <register address='0xb862f04' value='0x" DATA.LONG(A:0x862f04) "' name='RPMH_VRM_ENABLE_VOTE_DRV6_XOB1'/>"
WRITE #1 "        <register address='0xb863004' value='0x" DATA.LONG(A:0x863004) "' name='RPMH_VRM_ENABLE_VOTE_DRV6_XOB2'/>"
WRITE #1 "        <register address='0xb863104' value='0x" DATA.LONG(A:0x863104) "' name='RPMH_VRM_ENABLE_VOTE_DRV6_XOB3'/>"
WRITE #1 "        <register address='0xb863204' value='0x" DATA.LONG(A:0x863204) "' name='RPMH_VRM_ENABLE_VOTE_DRV6_XOB4'/>"
WRITE #1 "        <register address='0xb863304' value='0x" DATA.LONG(A:0x863304) "' name='RPMH_VRM_ENABLE_VOTE_DRV6_XOB5'/>"
WRITE #1 "        <register address='0xb863404' value='0x" DATA.LONG(A:0x863404) "' name='RPMH_VRM_ENABLE_VOTE_DRV6_XOB6'/>"
WRITE #1 "        <register address='0xb863504' value='0x" DATA.LONG(A:0x863504) "' name='RPMH_VRM_ENABLE_VOTE_DRV6_XOB7'/>"
WRITE #1 "        <register address='0xb863604' value='0x" DATA.LONG(A:0x863604) "' name='RPMH_VRM_ENABLE_VOTE_DRV6_XOB8'/>"
WRITE #1 "        <register address='0xb863704' value='0x" DATA.LONG(A:0x863704) "' name='RPMH_VRM_ENABLE_VOTE_DRV6_XOB9'/>"
WRITE #1 "        <register address='0xb863804' value='0x" DATA.LONG(A:0x863804) "' name='RPMH_VRM_ENABLE_VOTE_DRV6_XOB10'/>"
WRITE #1 "        <register address='0xb863904' value='0x" DATA.LONG(A:0x863904) "' name='RPMH_VRM_ENABLE_VOTE_DRV6_XOB11'/>"
WRITE #1 "        <register address='0xb863a04' value='0x" DATA.LONG(A:0x863a04) "' name='RPMH_VRM_ENABLE_VOTE_DRV6_XOB12'/>"
WRITE #1 "        <register address='0xb863b04' value='0x" DATA.LONG(A:0x863b04) "' name='RPMH_VRM_ENABLE_VOTE_DRV6_XOB13'/>"
WRITE #1 "        <register address='0xb863c04' value='0x" DATA.LONG(A:0x863c04) "' name='RPMH_VRM_ENABLE_VOTE_DRV6_XOB14'/>"
WRITE #1 "        <register address='0xb863d04' value='0x" DATA.LONG(A:0x863d04) "' name='RPMH_VRM_ENABLE_VOTE_DRV6_XOB15'/>"
WRITE #1 "        <register address='0xb872e04' value='0x" DATA.LONG(A:0x872e04) "' name='RPMH_VRM_ENABLE_VOTE_DRV7_XOB0'/>"
WRITE #1 "        <register address='0xb872f04' value='0x" DATA.LONG(A:0x872f04) "' name='RPMH_VRM_ENABLE_VOTE_DRV7_XOB1'/>"
WRITE #1 "        <register address='0xb873004' value='0x" DATA.LONG(A:0x873004) "' name='RPMH_VRM_ENABLE_VOTE_DRV7_XOB2'/>"
WRITE #1 "        <register address='0xb873104' value='0x" DATA.LONG(A:0x873104) "' name='RPMH_VRM_ENABLE_VOTE_DRV7_XOB3'/>"
WRITE #1 "        <register address='0xb873204' value='0x" DATA.LONG(A:0x873204) "' name='RPMH_VRM_ENABLE_VOTE_DRV7_XOB4'/>"
WRITE #1 "        <register address='0xb873304' value='0x" DATA.LONG(A:0x873304) "' name='RPMH_VRM_ENABLE_VOTE_DRV7_XOB5'/>"
WRITE #1 "        <register address='0xb873404' value='0x" DATA.LONG(A:0x873404) "' name='RPMH_VRM_ENABLE_VOTE_DRV7_XOB6'/>"
WRITE #1 "        <register address='0xb873504' value='0x" DATA.LONG(A:0x873504) "' name='RPMH_VRM_ENABLE_VOTE_DRV7_XOB7'/>"
WRITE #1 "        <register address='0xb873604' value='0x" DATA.LONG(A:0x873604) "' name='RPMH_VRM_ENABLE_VOTE_DRV7_XOB8'/>"
WRITE #1 "        <register address='0xb873704' value='0x" DATA.LONG(A:0x873704) "' name='RPMH_VRM_ENABLE_VOTE_DRV7_XOB9'/>"
WRITE #1 "        <register address='0xb873804' value='0x" DATA.LONG(A:0x873804) "' name='RPMH_VRM_ENABLE_VOTE_DRV7_XOB10'/>"
WRITE #1 "        <register address='0xb873904' value='0x" DATA.LONG(A:0x873904) "' name='RPMH_VRM_ENABLE_VOTE_DRV7_XOB11'/>"
WRITE #1 "        <register address='0xb873a04' value='0x" DATA.LONG(A:0x873a04) "' name='RPMH_VRM_ENABLE_VOTE_DRV7_XOB12'/>"
WRITE #1 "        <register address='0xb873b04' value='0x" DATA.LONG(A:0x873b04) "' name='RPMH_VRM_ENABLE_VOTE_DRV7_XOB13'/>"
WRITE #1 "        <register address='0xb873c04' value='0x" DATA.LONG(A:0x873c04) "' name='RPMH_VRM_ENABLE_VOTE_DRV7_XOB14'/>"
WRITE #1 "        <register address='0xb873d04' value='0x" DATA.LONG(A:0x873d04) "' name='RPMH_VRM_ENABLE_VOTE_DRV7_XOB15'/>"
WRITE #1 "        <register address='0xb882e04' value='0x" DATA.LONG(A:0x882e04) "' name='RPMH_VRM_ENABLE_VOTE_DRV8_XOB0'/>"
WRITE #1 "        <register address='0xb882f04' value='0x" DATA.LONG(A:0x882f04) "' name='RPMH_VRM_ENABLE_VOTE_DRV8_XOB1'/>"
WRITE #1 "        <register address='0xb883004' value='0x" DATA.LONG(A:0x883004) "' name='RPMH_VRM_ENABLE_VOTE_DRV8_XOB2'/>"
WRITE #1 "        <register address='0xb883104' value='0x" DATA.LONG(A:0x883104) "' name='RPMH_VRM_ENABLE_VOTE_DRV8_XOB3'/>"
WRITE #1 "        <register address='0xb883204' value='0x" DATA.LONG(A:0x883204) "' name='RPMH_VRM_ENABLE_VOTE_DRV8_XOB4'/>"
WRITE #1 "        <register address='0xb883304' value='0x" DATA.LONG(A:0x883304) "' name='RPMH_VRM_ENABLE_VOTE_DRV8_XOB5'/>"
WRITE #1 "        <register address='0xb883404' value='0x" DATA.LONG(A:0x883404) "' name='RPMH_VRM_ENABLE_VOTE_DRV8_XOB6'/>"
WRITE #1 "        <register address='0xb883504' value='0x" DATA.LONG(A:0x883504) "' name='RPMH_VRM_ENABLE_VOTE_DRV8_XOB7'/>"
WRITE #1 "        <register address='0xb883604' value='0x" DATA.LONG(A:0x883604) "' name='RPMH_VRM_ENABLE_VOTE_DRV8_XOB8'/>"
WRITE #1 "        <register address='0xb883704' value='0x" DATA.LONG(A:0x883704) "' name='RPMH_VRM_ENABLE_VOTE_DRV8_XOB9'/>"
WRITE #1 "        <register address='0xb883804' value='0x" DATA.LONG(A:0x883804) "' name='RPMH_VRM_ENABLE_VOTE_DRV8_XOB10'/>"
WRITE #1 "        <register address='0xb883904' value='0x" DATA.LONG(A:0x883904) "' name='RPMH_VRM_ENABLE_VOTE_DRV8_XOB11'/>"
WRITE #1 "        <register address='0xb883a04' value='0x" DATA.LONG(A:0x883a04) "' name='RPMH_VRM_ENABLE_VOTE_DRV8_XOB12'/>"
WRITE #1 "        <register address='0xb883b04' value='0x" DATA.LONG(A:0x883b04) "' name='RPMH_VRM_ENABLE_VOTE_DRV8_XOB13'/>"
WRITE #1 "        <register address='0xb883c04' value='0x" DATA.LONG(A:0x883c04) "' name='RPMH_VRM_ENABLE_VOTE_DRV8_XOB14'/>"
WRITE #1 "        <register address='0xb883d04' value='0x" DATA.LONG(A:0x883d04) "' name='RPMH_VRM_ENABLE_VOTE_DRV8_XOB15'/>"
WRITE #1 "        <register address='0xb892e04' value='0x" DATA.LONG(A:0x892e04) "' name='RPMH_VRM_ENABLE_VOTE_DRV9_XOB0'/>"
WRITE #1 "        <register address='0xb892f04' value='0x" DATA.LONG(A:0x892f04) "' name='RPMH_VRM_ENABLE_VOTE_DRV9_XOB1'/>"
WRITE #1 "        <register address='0xb893004' value='0x" DATA.LONG(A:0x893004) "' name='RPMH_VRM_ENABLE_VOTE_DRV9_XOB2'/>"
WRITE #1 "        <register address='0xb893104' value='0x" DATA.LONG(A:0x893104) "' name='RPMH_VRM_ENABLE_VOTE_DRV9_XOB3'/>"
WRITE #1 "        <register address='0xb893204' value='0x" DATA.LONG(A:0x893204) "' name='RPMH_VRM_ENABLE_VOTE_DRV9_XOB4'/>"
WRITE #1 "        <register address='0xb893304' value='0x" DATA.LONG(A:0x893304) "' name='RPMH_VRM_ENABLE_VOTE_DRV9_XOB5'/>"
WRITE #1 "        <register address='0xb893404' value='0x" DATA.LONG(A:0x893404) "' name='RPMH_VRM_ENABLE_VOTE_DRV9_XOB6'/>"
WRITE #1 "        <register address='0xb893504' value='0x" DATA.LONG(A:0x893504) "' name='RPMH_VRM_ENABLE_VOTE_DRV9_XOB7'/>"
WRITE #1 "        <register address='0xb893604' value='0x" DATA.LONG(A:0x893604) "' name='RPMH_VRM_ENABLE_VOTE_DRV9_XOB8'/>"
WRITE #1 "        <register address='0xb893704' value='0x" DATA.LONG(A:0x893704) "' name='RPMH_VRM_ENABLE_VOTE_DRV9_XOB9'/>"
WRITE #1 "        <register address='0xb893804' value='0x" DATA.LONG(A:0x893804) "' name='RPMH_VRM_ENABLE_VOTE_DRV9_XOB10'/>"
WRITE #1 "        <register address='0xb893904' value='0x" DATA.LONG(A:0x893904) "' name='RPMH_VRM_ENABLE_VOTE_DRV9_XOB11'/>"
WRITE #1 "        <register address='0xb893a04' value='0x" DATA.LONG(A:0x893a04) "' name='RPMH_VRM_ENABLE_VOTE_DRV9_XOB12'/>"
WRITE #1 "        <register address='0xb893b04' value='0x" DATA.LONG(A:0x893b04) "' name='RPMH_VRM_ENABLE_VOTE_DRV9_XOB13'/>"
WRITE #1 "        <register address='0xb893c04' value='0x" DATA.LONG(A:0x893c04) "' name='RPMH_VRM_ENABLE_VOTE_DRV9_XOB14'/>"
WRITE #1 "        <register address='0xb893d04' value='0x" DATA.LONG(A:0x893d04) "' name='RPMH_VRM_ENABLE_VOTE_DRV9_XOB15'/>"
WRITE #1 "        <register address='0xb8a2e04' value='0x" DATA.LONG(A:0x8a2e04) "' name='RPMH_VRM_ENABLE_VOTE_DRV10_XOB0'/>"
WRITE #1 "        <register address='0xb8a2f04' value='0x" DATA.LONG(A:0x8a2f04) "' name='RPMH_VRM_ENABLE_VOTE_DRV10_XOB1'/>"
WRITE #1 "        <register address='0xb8a3004' value='0x" DATA.LONG(A:0x8a3004) "' name='RPMH_VRM_ENABLE_VOTE_DRV10_XOB2'/>"
WRITE #1 "        <register address='0xb8a3104' value='0x" DATA.LONG(A:0x8a3104) "' name='RPMH_VRM_ENABLE_VOTE_DRV10_XOB3'/>"
WRITE #1 "        <register address='0xb8a3204' value='0x" DATA.LONG(A:0x8a3204) "' name='RPMH_VRM_ENABLE_VOTE_DRV10_XOB4'/>"
WRITE #1 "        <register address='0xb8a3304' value='0x" DATA.LONG(A:0x8a3304) "' name='RPMH_VRM_ENABLE_VOTE_DRV10_XOB5'/>"
WRITE #1 "        <register address='0xb8a3404' value='0x" DATA.LONG(A:0x8a3404) "' name='RPMH_VRM_ENABLE_VOTE_DRV10_XOB6'/>"
WRITE #1 "        <register address='0xb8a3504' value='0x" DATA.LONG(A:0x8a3504) "' name='RPMH_VRM_ENABLE_VOTE_DRV10_XOB7'/>"
WRITE #1 "        <register address='0xb8a3604' value='0x" DATA.LONG(A:0x8a3604) "' name='RPMH_VRM_ENABLE_VOTE_DRV10_XOB8'/>"
WRITE #1 "        <register address='0xb8a3704' value='0x" DATA.LONG(A:0x8a3704) "' name='RPMH_VRM_ENABLE_VOTE_DRV10_XOB9'/>"
WRITE #1 "        <register address='0xb8a3804' value='0x" DATA.LONG(A:0x8a3804) "' name='RPMH_VRM_ENABLE_VOTE_DRV10_XOB10'/>"
WRITE #1 "        <register address='0xb8a3904' value='0x" DATA.LONG(A:0x8a3904) "' name='RPMH_VRM_ENABLE_VOTE_DRV10_XOB11'/>"
WRITE #1 "        <register address='0xb8a3a04' value='0x" DATA.LONG(A:0x8a3a04) "' name='RPMH_VRM_ENABLE_VOTE_DRV10_XOB12'/>"
WRITE #1 "        <register address='0xb8a3b04' value='0x" DATA.LONG(A:0x8a3b04) "' name='RPMH_VRM_ENABLE_VOTE_DRV10_XOB13'/>"
WRITE #1 "        <register address='0xb8a3c04' value='0x" DATA.LONG(A:0x8a3c04) "' name='RPMH_VRM_ENABLE_VOTE_DRV10_XOB14'/>"
WRITE #1 "        <register address='0xb8a3d04' value='0x" DATA.LONG(A:0x8a3d04) "' name='RPMH_VRM_ENABLE_VOTE_DRV10_XOB15'/>"
WRITE #1 "        <register address='0xb8b2e04' value='0x" DATA.LONG(A:0x8b2e04) "' name='RPMH_VRM_ENABLE_VOTE_DRV11_XOB0'/>"
WRITE #1 "        <register address='0xb8b2f04' value='0x" DATA.LONG(A:0x8b2f04) "' name='RPMH_VRM_ENABLE_VOTE_DRV11_XOB1'/>"
WRITE #1 "        <register address='0xb8b3004' value='0x" DATA.LONG(A:0x8b3004) "' name='RPMH_VRM_ENABLE_VOTE_DRV11_XOB2'/>"
WRITE #1 "        <register address='0xb8b3104' value='0x" DATA.LONG(A:0x8b3104) "' name='RPMH_VRM_ENABLE_VOTE_DRV11_XOB3'/>"
WRITE #1 "        <register address='0xb8b3204' value='0x" DATA.LONG(A:0x8b3204) "' name='RPMH_VRM_ENABLE_VOTE_DRV11_XOB4'/>"
WRITE #1 "        <register address='0xb8b3304' value='0x" DATA.LONG(A:0x8b3304) "' name='RPMH_VRM_ENABLE_VOTE_DRV11_XOB5'/>"
WRITE #1 "        <register address='0xb8b3404' value='0x" DATA.LONG(A:0x8b3404) "' name='RPMH_VRM_ENABLE_VOTE_DRV11_XOB6'/>"
WRITE #1 "        <register address='0xb8b3504' value='0x" DATA.LONG(A:0x8b3504) "' name='RPMH_VRM_ENABLE_VOTE_DRV11_XOB7'/>"
WRITE #1 "        <register address='0xb8b3604' value='0x" DATA.LONG(A:0x8b3604) "' name='RPMH_VRM_ENABLE_VOTE_DRV11_XOB8'/>"
WRITE #1 "        <register address='0xb8b3704' value='0x" DATA.LONG(A:0x8b3704) "' name='RPMH_VRM_ENABLE_VOTE_DRV11_XOB9'/>"
WRITE #1 "        <register address='0xb8b3804' value='0x" DATA.LONG(A:0x8b3804) "' name='RPMH_VRM_ENABLE_VOTE_DRV11_XOB10'/>"
WRITE #1 "        <register address='0xb8b3904' value='0x" DATA.LONG(A:0x8b3904) "' name='RPMH_VRM_ENABLE_VOTE_DRV11_XOB11'/>"
WRITE #1 "        <register address='0xb8b3a04' value='0x" DATA.LONG(A:0x8b3a04) "' name='RPMH_VRM_ENABLE_VOTE_DRV11_XOB12'/>"
WRITE #1 "        <register address='0xb8b3b04' value='0x" DATA.LONG(A:0x8b3b04) "' name='RPMH_VRM_ENABLE_VOTE_DRV11_XOB13'/>"
WRITE #1 "        <register address='0xb8b3c04' value='0x" DATA.LONG(A:0x8b3c04) "' name='RPMH_VRM_ENABLE_VOTE_DRV11_XOB14'/>"
WRITE #1 "        <register address='0xb8b3d04' value='0x" DATA.LONG(A:0x8b3d04) "' name='RPMH_VRM_ENABLE_VOTE_DRV11_XOB15'/>"
WRITE #1 "        <register address='0xb803e04' value='0x" DATA.LONG(A:0x803e04) "' name='RPMH_VRM_ENABLE_VOTE_DRV0_XO0'/>"
WRITE #1 "        <register address='0xb813e04' value='0x" DATA.LONG(A:0x813e04) "' name='RPMH_VRM_ENABLE_VOTE_DRV1_XO0'/>"
WRITE #1 "        <register address='0xb823e04' value='0x" DATA.LONG(A:0x823e04) "' name='RPMH_VRM_ENABLE_VOTE_DRV2_XO0'/>"
WRITE #1 "        <register address='0xb833e04' value='0x" DATA.LONG(A:0x833e04) "' name='RPMH_VRM_ENABLE_VOTE_DRV3_XO0'/>"
WRITE #1 "        <register address='0xb843e04' value='0x" DATA.LONG(A:0x843e04) "' name='RPMH_VRM_ENABLE_VOTE_DRV4_XO0'/>"
WRITE #1 "        <register address='0xb853e04' value='0x" DATA.LONG(A:0x853e04) "' name='RPMH_VRM_ENABLE_VOTE_DRV5_XO0'/>"
WRITE #1 "        <register address='0xb863e04' value='0x" DATA.LONG(A:0x863e04) "' name='RPMH_VRM_ENABLE_VOTE_DRV6_XO0'/>"
WRITE #1 "        <register address='0xb873e04' value='0x" DATA.LONG(A:0x873e04) "' name='RPMH_VRM_ENABLE_VOTE_DRV7_XO0'/>"
WRITE #1 "        <register address='0xb883e04' value='0x" DATA.LONG(A:0x883e04) "' name='RPMH_VRM_ENABLE_VOTE_DRV8_XO0'/>"
WRITE #1 "        <register address='0xb893e04' value='0x" DATA.LONG(A:0x893e04) "' name='RPMH_VRM_ENABLE_VOTE_DRV9_XO0'/>"
WRITE #1 "        <register address='0xb8a3e04' value='0x" DATA.LONG(A:0x8a3e04) "' name='RPMH_VRM_ENABLE_VOTE_DRV10_XO0'/>"
WRITE #1 "        <register address='0xb8b3e04' value='0x" DATA.LONG(A:0x8b3e04) "' name='RPMH_VRM_ENABLE_VOTE_DRV11_XO0'/>"
WRITE #1 "        <register address='0xb800020' value='0x" DATA.LONG(A:0x800020) "' name='RPMH_VRM_VOLTAGE_CRS_DRV0_REG0'/>"
WRITE #1 "        <register address='0xb800120' value='0x" DATA.LONG(A:0x800120) "' name='RPMH_VRM_VOLTAGE_CRS_DRV0_REG1'/>"
WRITE #1 "        <register address='0xb800220' value='0x" DATA.LONG(A:0x800220) "' name='RPMH_VRM_VOLTAGE_CRS_DRV0_REG2'/>"
WRITE #1 "        <register address='0xb800320' value='0x" DATA.LONG(A:0x800320) "' name='RPMH_VRM_VOLTAGE_CRS_DRV0_REG3'/>"
WRITE #1 "        <register address='0xb800420' value='0x" DATA.LONG(A:0x800420) "' name='RPMH_VRM_VOLTAGE_CRS_DRV0_REG4'/>"
WRITE #1 "        <register address='0xb800520' value='0x" DATA.LONG(A:0x800520) "' name='RPMH_VRM_VOLTAGE_CRS_DRV0_REG5'/>"
WRITE #1 "        <register address='0xb800620' value='0x" DATA.LONG(A:0x800620) "' name='RPMH_VRM_VOLTAGE_CRS_DRV0_REG6'/>"
WRITE #1 "        <register address='0xb800720' value='0x" DATA.LONG(A:0x800720) "' name='RPMH_VRM_VOLTAGE_CRS_DRV0_REG7'/>"
WRITE #1 "        <register address='0xb800820' value='0x" DATA.LONG(A:0x800820) "' name='RPMH_VRM_VOLTAGE_CRS_DRV0_REG8'/>"
WRITE #1 "        <register address='0xb800920' value='0x" DATA.LONG(A:0x800920) "' name='RPMH_VRM_VOLTAGE_CRS_DRV0_REG9'/>"
WRITE #1 "        <register address='0xb800a20' value='0x" DATA.LONG(A:0x800a20) "' name='RPMH_VRM_VOLTAGE_CRS_DRV0_REG10'/>"
WRITE #1 "        <register address='0xb800b20' value='0x" DATA.LONG(A:0x800b20) "' name='RPMH_VRM_VOLTAGE_CRS_DRV0_REG11'/>"
WRITE #1 "        <register address='0xb800c20' value='0x" DATA.LONG(A:0x800c20) "' name='RPMH_VRM_VOLTAGE_CRS_DRV0_REG12'/>"
WRITE #1 "        <register address='0xb800d20' value='0x" DATA.LONG(A:0x800d20) "' name='RPMH_VRM_VOLTAGE_CRS_DRV0_REG13'/>"
WRITE #1 "        <register address='0xb800e20' value='0x" DATA.LONG(A:0x800e20) "' name='RPMH_VRM_VOLTAGE_CRS_DRV0_REG14'/>"
WRITE #1 "        <register address='0xb800f20' value='0x" DATA.LONG(A:0x800f20) "' name='RPMH_VRM_VOLTAGE_CRS_DRV0_REG15'/>"
WRITE #1 "        <register address='0xb801020' value='0x" DATA.LONG(A:0x801020) "' name='RPMH_VRM_VOLTAGE_CRS_DRV0_REG16'/>"
WRITE #1 "        <register address='0xb801120' value='0x" DATA.LONG(A:0x801120) "' name='RPMH_VRM_VOLTAGE_CRS_DRV0_REG17'/>"
WRITE #1 "        <register address='0xb801220' value='0x" DATA.LONG(A:0x801220) "' name='RPMH_VRM_VOLTAGE_CRS_DRV0_REG18'/>"
WRITE #1 "        <register address='0xb801320' value='0x" DATA.LONG(A:0x801320) "' name='RPMH_VRM_VOLTAGE_CRS_DRV0_REG19'/>"
WRITE #1 "        <register address='0xb801420' value='0x" DATA.LONG(A:0x801420) "' name='RPMH_VRM_VOLTAGE_CRS_DRV0_REG20'/>"
WRITE #1 "        <register address='0xb801520' value='0x" DATA.LONG(A:0x801520) "' name='RPMH_VRM_VOLTAGE_CRS_DRV0_REG21'/>"
WRITE #1 "        <register address='0xb801620' value='0x" DATA.LONG(A:0x801620) "' name='RPMH_VRM_VOLTAGE_CRS_DRV0_REG22'/>"
WRITE #1 "        <register address='0xb801720' value='0x" DATA.LONG(A:0x801720) "' name='RPMH_VRM_VOLTAGE_CRS_DRV0_REG23'/>"
WRITE #1 "        <register address='0xb801820' value='0x" DATA.LONG(A:0x801820) "' name='RPMH_VRM_VOLTAGE_CRS_DRV0_REG24'/>"
WRITE #1 "        <register address='0xb801920' value='0x" DATA.LONG(A:0x801920) "' name='RPMH_VRM_VOLTAGE_CRS_DRV0_REG25'/>"
WRITE #1 "        <register address='0xb801a20' value='0x" DATA.LONG(A:0x801a20) "' name='RPMH_VRM_VOLTAGE_CRS_DRV0_REG26'/>"
WRITE #1 "        <register address='0xb801b20' value='0x" DATA.LONG(A:0x801b20) "' name='RPMH_VRM_VOLTAGE_CRS_DRV0_REG27'/>"
WRITE #1 "        <register address='0xb801c20' value='0x" DATA.LONG(A:0x801c20) "' name='RPMH_VRM_VOLTAGE_CRS_DRV0_REG28'/>"
WRITE #1 "        <register address='0xb801d20' value='0x" DATA.LONG(A:0x801d20) "' name='RPMH_VRM_VOLTAGE_CRS_DRV0_REG29'/>"
WRITE #1 "        <register address='0xb801e20' value='0x" DATA.LONG(A:0x801e20) "' name='RPMH_VRM_VOLTAGE_CRS_DRV0_REG30'/>"
WRITE #1 "        <register address='0xb801f20' value='0x" DATA.LONG(A:0x801f20) "' name='RPMH_VRM_VOLTAGE_CRS_DRV0_REG31'/>"
WRITE #1 "        <register address='0xb802020' value='0x" DATA.LONG(A:0x802020) "' name='RPMH_VRM_VOLTAGE_CRS_DRV0_REG32'/>"
WRITE #1 "        <register address='0xb802120' value='0x" DATA.LONG(A:0x802120) "' name='RPMH_VRM_VOLTAGE_CRS_DRV0_REG33'/>"
WRITE #1 "        <register address='0xb802220' value='0x" DATA.LONG(A:0x802220) "' name='RPMH_VRM_VOLTAGE_CRS_DRV0_REG34'/>"
WRITE #1 "        <register address='0xb802320' value='0x" DATA.LONG(A:0x802320) "' name='RPMH_VRM_VOLTAGE_CRS_DRV0_REG35'/>"
WRITE #1 "        <register address='0xb802420' value='0x" DATA.LONG(A:0x802420) "' name='RPMH_VRM_VOLTAGE_CRS_DRV0_REG36'/>"
WRITE #1 "        <register address='0xb802520' value='0x" DATA.LONG(A:0x802520) "' name='RPMH_VRM_VOLTAGE_CRS_DRV0_REG37'/>"
WRITE #1 "        <register address='0xb802620' value='0x" DATA.LONG(A:0x802620) "' name='RPMH_VRM_VOLTAGE_CRS_DRV0_REG38'/>"
WRITE #1 "        <register address='0xb802720' value='0x" DATA.LONG(A:0x802720) "' name='RPMH_VRM_VOLTAGE_CRS_DRV0_REG39'/>"
WRITE #1 "        <register address='0xb802820' value='0x" DATA.LONG(A:0x802820) "' name='RPMH_VRM_VOLTAGE_CRS_DRV0_REG40'/>"
WRITE #1 "        <register address='0xb802920' value='0x" DATA.LONG(A:0x802920) "' name='RPMH_VRM_VOLTAGE_CRS_DRV0_REG41'/>"
WRITE #1 "        <register address='0xb802a20' value='0x" DATA.LONG(A:0x802a20) "' name='RPMH_VRM_VOLTAGE_CRS_DRV0_REG42'/>"
WRITE #1 "        <register address='0xb802b20' value='0x" DATA.LONG(A:0x802b20) "' name='RPMH_VRM_VOLTAGE_CRS_DRV0_REG43'/>"
WRITE #1 "        <register address='0xb802c20' value='0x" DATA.LONG(A:0x802c20) "' name='RPMH_VRM_VOLTAGE_CRS_DRV0_REG44'/>"
WRITE #1 "        <register address='0xb802d20' value='0x" DATA.LONG(A:0x802d20) "' name='RPMH_VRM_VOLTAGE_CRS_DRV0_REG45'/>"
WRITE #1 "        <register address='0xb810020' value='0x" DATA.LONG(A:0x810020) "' name='RPMH_VRM_VOLTAGE_CRS_DRV1_REG0'/>"
WRITE #1 "        <register address='0xb810120' value='0x" DATA.LONG(A:0x810120) "' name='RPMH_VRM_VOLTAGE_CRS_DRV1_REG1'/>"
WRITE #1 "        <register address='0xb810220' value='0x" DATA.LONG(A:0x810220) "' name='RPMH_VRM_VOLTAGE_CRS_DRV1_REG2'/>"
WRITE #1 "        <register address='0xb810320' value='0x" DATA.LONG(A:0x810320) "' name='RPMH_VRM_VOLTAGE_CRS_DRV1_REG3'/>"
WRITE #1 "        <register address='0xb810420' value='0x" DATA.LONG(A:0x810420) "' name='RPMH_VRM_VOLTAGE_CRS_DRV1_REG4'/>"
WRITE #1 "        <register address='0xb810520' value='0x" DATA.LONG(A:0x810520) "' name='RPMH_VRM_VOLTAGE_CRS_DRV1_REG5'/>"
WRITE #1 "        <register address='0xb810620' value='0x" DATA.LONG(A:0x810620) "' name='RPMH_VRM_VOLTAGE_CRS_DRV1_REG6'/>"
WRITE #1 "        <register address='0xb810720' value='0x" DATA.LONG(A:0x810720) "' name='RPMH_VRM_VOLTAGE_CRS_DRV1_REG7'/>"
WRITE #1 "        <register address='0xb810820' value='0x" DATA.LONG(A:0x810820) "' name='RPMH_VRM_VOLTAGE_CRS_DRV1_REG8'/>"
WRITE #1 "        <register address='0xb810920' value='0x" DATA.LONG(A:0x810920) "' name='RPMH_VRM_VOLTAGE_CRS_DRV1_REG9'/>"
WRITE #1 "        <register address='0xb810a20' value='0x" DATA.LONG(A:0x810a20) "' name='RPMH_VRM_VOLTAGE_CRS_DRV1_REG10'/>"
WRITE #1 "        <register address='0xb810b20' value='0x" DATA.LONG(A:0x810b20) "' name='RPMH_VRM_VOLTAGE_CRS_DRV1_REG11'/>"
WRITE #1 "        <register address='0xb810c20' value='0x" DATA.LONG(A:0x810c20) "' name='RPMH_VRM_VOLTAGE_CRS_DRV1_REG12'/>"
WRITE #1 "        <register address='0xb810d20' value='0x" DATA.LONG(A:0x810d20) "' name='RPMH_VRM_VOLTAGE_CRS_DRV1_REG13'/>"
WRITE #1 "        <register address='0xb810e20' value='0x" DATA.LONG(A:0x810e20) "' name='RPMH_VRM_VOLTAGE_CRS_DRV1_REG14'/>"
WRITE #1 "        <register address='0xb810f20' value='0x" DATA.LONG(A:0x810f20) "' name='RPMH_VRM_VOLTAGE_CRS_DRV1_REG15'/>"
WRITE #1 "        <register address='0xb811020' value='0x" DATA.LONG(A:0x811020) "' name='RPMH_VRM_VOLTAGE_CRS_DRV1_REG16'/>"
WRITE #1 "        <register address='0xb811120' value='0x" DATA.LONG(A:0x811120) "' name='RPMH_VRM_VOLTAGE_CRS_DRV1_REG17'/>"
WRITE #1 "        <register address='0xb811220' value='0x" DATA.LONG(A:0x811220) "' name='RPMH_VRM_VOLTAGE_CRS_DRV1_REG18'/>"
WRITE #1 "        <register address='0xb811320' value='0x" DATA.LONG(A:0x811320) "' name='RPMH_VRM_VOLTAGE_CRS_DRV1_REG19'/>"
WRITE #1 "        <register address='0xb811420' value='0x" DATA.LONG(A:0x811420) "' name='RPMH_VRM_VOLTAGE_CRS_DRV1_REG20'/>"
WRITE #1 "        <register address='0xb811520' value='0x" DATA.LONG(A:0x811520) "' name='RPMH_VRM_VOLTAGE_CRS_DRV1_REG21'/>"
WRITE #1 "        <register address='0xb811620' value='0x" DATA.LONG(A:0x811620) "' name='RPMH_VRM_VOLTAGE_CRS_DRV1_REG22'/>"
WRITE #1 "        <register address='0xb811720' value='0x" DATA.LONG(A:0x811720) "' name='RPMH_VRM_VOLTAGE_CRS_DRV1_REG23'/>"
WRITE #1 "        <register address='0xb811820' value='0x" DATA.LONG(A:0x811820) "' name='RPMH_VRM_VOLTAGE_CRS_DRV1_REG24'/>"
WRITE #1 "        <register address='0xb811920' value='0x" DATA.LONG(A:0x811920) "' name='RPMH_VRM_VOLTAGE_CRS_DRV1_REG25'/>"
WRITE #1 "        <register address='0xb811a20' value='0x" DATA.LONG(A:0x811a20) "' name='RPMH_VRM_VOLTAGE_CRS_DRV1_REG26'/>"
WRITE #1 "        <register address='0xb811b20' value='0x" DATA.LONG(A:0x811b20) "' name='RPMH_VRM_VOLTAGE_CRS_DRV1_REG27'/>"
WRITE #1 "        <register address='0xb811c20' value='0x" DATA.LONG(A:0x811c20) "' name='RPMH_VRM_VOLTAGE_CRS_DRV1_REG28'/>"
WRITE #1 "        <register address='0xb811d20' value='0x" DATA.LONG(A:0x811d20) "' name='RPMH_VRM_VOLTAGE_CRS_DRV1_REG29'/>"
WRITE #1 "        <register address='0xb811e20' value='0x" DATA.LONG(A:0x811e20) "' name='RPMH_VRM_VOLTAGE_CRS_DRV1_REG30'/>"
WRITE #1 "        <register address='0xb811f20' value='0x" DATA.LONG(A:0x811f20) "' name='RPMH_VRM_VOLTAGE_CRS_DRV1_REG31'/>"
WRITE #1 "        <register address='0xb812020' value='0x" DATA.LONG(A:0x812020) "' name='RPMH_VRM_VOLTAGE_CRS_DRV1_REG32'/>"
WRITE #1 "        <register address='0xb812120' value='0x" DATA.LONG(A:0x812120) "' name='RPMH_VRM_VOLTAGE_CRS_DRV1_REG33'/>"
WRITE #1 "        <register address='0xb812220' value='0x" DATA.LONG(A:0x812220) "' name='RPMH_VRM_VOLTAGE_CRS_DRV1_REG34'/>"
WRITE #1 "        <register address='0xb812320' value='0x" DATA.LONG(A:0x812320) "' name='RPMH_VRM_VOLTAGE_CRS_DRV1_REG35'/>"
WRITE #1 "        <register address='0xb812420' value='0x" DATA.LONG(A:0x812420) "' name='RPMH_VRM_VOLTAGE_CRS_DRV1_REG36'/>"
WRITE #1 "        <register address='0xb812520' value='0x" DATA.LONG(A:0x812520) "' name='RPMH_VRM_VOLTAGE_CRS_DRV1_REG37'/>"
WRITE #1 "        <register address='0xb812620' value='0x" DATA.LONG(A:0x812620) "' name='RPMH_VRM_VOLTAGE_CRS_DRV1_REG38'/>"
WRITE #1 "        <register address='0xb812720' value='0x" DATA.LONG(A:0x812720) "' name='RPMH_VRM_VOLTAGE_CRS_DRV1_REG39'/>"
WRITE #1 "        <register address='0xb812820' value='0x" DATA.LONG(A:0x812820) "' name='RPMH_VRM_VOLTAGE_CRS_DRV1_REG40'/>"
WRITE #1 "        <register address='0xb812920' value='0x" DATA.LONG(A:0x812920) "' name='RPMH_VRM_VOLTAGE_CRS_DRV1_REG41'/>"
WRITE #1 "        <register address='0xb812a20' value='0x" DATA.LONG(A:0x812a20) "' name='RPMH_VRM_VOLTAGE_CRS_DRV1_REG42'/>"
WRITE #1 "        <register address='0xb812b20' value='0x" DATA.LONG(A:0x812b20) "' name='RPMH_VRM_VOLTAGE_CRS_DRV1_REG43'/>"
WRITE #1 "        <register address='0xb812c20' value='0x" DATA.LONG(A:0x812c20) "' name='RPMH_VRM_VOLTAGE_CRS_DRV1_REG44'/>"
WRITE #1 "        <register address='0xb812d20' value='0x" DATA.LONG(A:0x812d20) "' name='RPMH_VRM_VOLTAGE_CRS_DRV1_REG45'/>"
WRITE #1 "        <register address='0xb820020' value='0x" DATA.LONG(A:0x820020) "' name='RPMH_VRM_VOLTAGE_CRS_DRV2_REG0'/>"
WRITE #1 "        <register address='0xb820120' value='0x" DATA.LONG(A:0x820120) "' name='RPMH_VRM_VOLTAGE_CRS_DRV2_REG1'/>"
WRITE #1 "        <register address='0xb820220' value='0x" DATA.LONG(A:0x820220) "' name='RPMH_VRM_VOLTAGE_CRS_DRV2_REG2'/>"
WRITE #1 "        <register address='0xb820320' value='0x" DATA.LONG(A:0x820320) "' name='RPMH_VRM_VOLTAGE_CRS_DRV2_REG3'/>"
WRITE #1 "        <register address='0xb820420' value='0x" DATA.LONG(A:0x820420) "' name='RPMH_VRM_VOLTAGE_CRS_DRV2_REG4'/>"
WRITE #1 "        <register address='0xb820520' value='0x" DATA.LONG(A:0x820520) "' name='RPMH_VRM_VOLTAGE_CRS_DRV2_REG5'/>"
WRITE #1 "        <register address='0xb820620' value='0x" DATA.LONG(A:0x820620) "' name='RPMH_VRM_VOLTAGE_CRS_DRV2_REG6'/>"
WRITE #1 "        <register address='0xb820720' value='0x" DATA.LONG(A:0x820720) "' name='RPMH_VRM_VOLTAGE_CRS_DRV2_REG7'/>"
WRITE #1 "        <register address='0xb820820' value='0x" DATA.LONG(A:0x820820) "' name='RPMH_VRM_VOLTAGE_CRS_DRV2_REG8'/>"
WRITE #1 "        <register address='0xb820920' value='0x" DATA.LONG(A:0x820920) "' name='RPMH_VRM_VOLTAGE_CRS_DRV2_REG9'/>"
WRITE #1 "        <register address='0xb820a20' value='0x" DATA.LONG(A:0x820a20) "' name='RPMH_VRM_VOLTAGE_CRS_DRV2_REG10'/>"
WRITE #1 "        <register address='0xb820b20' value='0x" DATA.LONG(A:0x820b20) "' name='RPMH_VRM_VOLTAGE_CRS_DRV2_REG11'/>"
WRITE #1 "        <register address='0xb820c20' value='0x" DATA.LONG(A:0x820c20) "' name='RPMH_VRM_VOLTAGE_CRS_DRV2_REG12'/>"
WRITE #1 "        <register address='0xb820d20' value='0x" DATA.LONG(A:0x820d20) "' name='RPMH_VRM_VOLTAGE_CRS_DRV2_REG13'/>"
WRITE #1 "        <register address='0xb820e20' value='0x" DATA.LONG(A:0x820e20) "' name='RPMH_VRM_VOLTAGE_CRS_DRV2_REG14'/>"
WRITE #1 "        <register address='0xb820f20' value='0x" DATA.LONG(A:0x820f20) "' name='RPMH_VRM_VOLTAGE_CRS_DRV2_REG15'/>"
WRITE #1 "        <register address='0xb821020' value='0x" DATA.LONG(A:0x821020) "' name='RPMH_VRM_VOLTAGE_CRS_DRV2_REG16'/>"
WRITE #1 "        <register address='0xb821120' value='0x" DATA.LONG(A:0x821120) "' name='RPMH_VRM_VOLTAGE_CRS_DRV2_REG17'/>"
WRITE #1 "        <register address='0xb821220' value='0x" DATA.LONG(A:0x821220) "' name='RPMH_VRM_VOLTAGE_CRS_DRV2_REG18'/>"
WRITE #1 "        <register address='0xb821320' value='0x" DATA.LONG(A:0x821320) "' name='RPMH_VRM_VOLTAGE_CRS_DRV2_REG19'/>"
WRITE #1 "        <register address='0xb821420' value='0x" DATA.LONG(A:0x821420) "' name='RPMH_VRM_VOLTAGE_CRS_DRV2_REG20'/>"
WRITE #1 "        <register address='0xb821520' value='0x" DATA.LONG(A:0x821520) "' name='RPMH_VRM_VOLTAGE_CRS_DRV2_REG21'/>"
WRITE #1 "        <register address='0xb821620' value='0x" DATA.LONG(A:0x821620) "' name='RPMH_VRM_VOLTAGE_CRS_DRV2_REG22'/>"
WRITE #1 "        <register address='0xb821720' value='0x" DATA.LONG(A:0x821720) "' name='RPMH_VRM_VOLTAGE_CRS_DRV2_REG23'/>"
WRITE #1 "        <register address='0xb821820' value='0x" DATA.LONG(A:0x821820) "' name='RPMH_VRM_VOLTAGE_CRS_DRV2_REG24'/>"
WRITE #1 "        <register address='0xb821920' value='0x" DATA.LONG(A:0x821920) "' name='RPMH_VRM_VOLTAGE_CRS_DRV2_REG25'/>"
WRITE #1 "        <register address='0xb821a20' value='0x" DATA.LONG(A:0x821a20) "' name='RPMH_VRM_VOLTAGE_CRS_DRV2_REG26'/>"
WRITE #1 "        <register address='0xb821b20' value='0x" DATA.LONG(A:0x821b20) "' name='RPMH_VRM_VOLTAGE_CRS_DRV2_REG27'/>"
WRITE #1 "        <register address='0xb821c20' value='0x" DATA.LONG(A:0x821c20) "' name='RPMH_VRM_VOLTAGE_CRS_DRV2_REG28'/>"
WRITE #1 "        <register address='0xb821d20' value='0x" DATA.LONG(A:0x821d20) "' name='RPMH_VRM_VOLTAGE_CRS_DRV2_REG29'/>"
WRITE #1 "        <register address='0xb821e20' value='0x" DATA.LONG(A:0x821e20) "' name='RPMH_VRM_VOLTAGE_CRS_DRV2_REG30'/>"
WRITE #1 "        <register address='0xb821f20' value='0x" DATA.LONG(A:0x821f20) "' name='RPMH_VRM_VOLTAGE_CRS_DRV2_REG31'/>"
WRITE #1 "        <register address='0xb822020' value='0x" DATA.LONG(A:0x822020) "' name='RPMH_VRM_VOLTAGE_CRS_DRV2_REG32'/>"
WRITE #1 "        <register address='0xb822120' value='0x" DATA.LONG(A:0x822120) "' name='RPMH_VRM_VOLTAGE_CRS_DRV2_REG33'/>"
WRITE #1 "        <register address='0xb822220' value='0x" DATA.LONG(A:0x822220) "' name='RPMH_VRM_VOLTAGE_CRS_DRV2_REG34'/>"
WRITE #1 "        <register address='0xb822320' value='0x" DATA.LONG(A:0x822320) "' name='RPMH_VRM_VOLTAGE_CRS_DRV2_REG35'/>"
WRITE #1 "        <register address='0xb822420' value='0x" DATA.LONG(A:0x822420) "' name='RPMH_VRM_VOLTAGE_CRS_DRV2_REG36'/>"
WRITE #1 "        <register address='0xb822520' value='0x" DATA.LONG(A:0x822520) "' name='RPMH_VRM_VOLTAGE_CRS_DRV2_REG37'/>"
WRITE #1 "        <register address='0xb822620' value='0x" DATA.LONG(A:0x822620) "' name='RPMH_VRM_VOLTAGE_CRS_DRV2_REG38'/>"
WRITE #1 "        <register address='0xb822720' value='0x" DATA.LONG(A:0x822720) "' name='RPMH_VRM_VOLTAGE_CRS_DRV2_REG39'/>"
WRITE #1 "        <register address='0xb822820' value='0x" DATA.LONG(A:0x822820) "' name='RPMH_VRM_VOLTAGE_CRS_DRV2_REG40'/>"
WRITE #1 "        <register address='0xb822920' value='0x" DATA.LONG(A:0x822920) "' name='RPMH_VRM_VOLTAGE_CRS_DRV2_REG41'/>"
WRITE #1 "        <register address='0xb822a20' value='0x" DATA.LONG(A:0x822a20) "' name='RPMH_VRM_VOLTAGE_CRS_DRV2_REG42'/>"
WRITE #1 "        <register address='0xb822b20' value='0x" DATA.LONG(A:0x822b20) "' name='RPMH_VRM_VOLTAGE_CRS_DRV2_REG43'/>"
WRITE #1 "        <register address='0xb822c20' value='0x" DATA.LONG(A:0x822c20) "' name='RPMH_VRM_VOLTAGE_CRS_DRV2_REG44'/>"
WRITE #1 "        <register address='0xb822d20' value='0x" DATA.LONG(A:0x822d20) "' name='RPMH_VRM_VOLTAGE_CRS_DRV2_REG45'/>"
WRITE #1 "        <register address='0xb830020' value='0x" DATA.LONG(A:0x830020) "' name='RPMH_VRM_VOLTAGE_CRS_DRV3_REG0'/>"
WRITE #1 "        <register address='0xb830120' value='0x" DATA.LONG(A:0x830120) "' name='RPMH_VRM_VOLTAGE_CRS_DRV3_REG1'/>"
WRITE #1 "        <register address='0xb830220' value='0x" DATA.LONG(A:0x830220) "' name='RPMH_VRM_VOLTAGE_CRS_DRV3_REG2'/>"
WRITE #1 "        <register address='0xb830320' value='0x" DATA.LONG(A:0x830320) "' name='RPMH_VRM_VOLTAGE_CRS_DRV3_REG3'/>"
WRITE #1 "        <register address='0xb830420' value='0x" DATA.LONG(A:0x830420) "' name='RPMH_VRM_VOLTAGE_CRS_DRV3_REG4'/>"
WRITE #1 "        <register address='0xb830520' value='0x" DATA.LONG(A:0x830520) "' name='RPMH_VRM_VOLTAGE_CRS_DRV3_REG5'/>"
WRITE #1 "        <register address='0xb830620' value='0x" DATA.LONG(A:0x830620) "' name='RPMH_VRM_VOLTAGE_CRS_DRV3_REG6'/>"
WRITE #1 "        <register address='0xb830720' value='0x" DATA.LONG(A:0x830720) "' name='RPMH_VRM_VOLTAGE_CRS_DRV3_REG7'/>"
WRITE #1 "        <register address='0xb830820' value='0x" DATA.LONG(A:0x830820) "' name='RPMH_VRM_VOLTAGE_CRS_DRV3_REG8'/>"
WRITE #1 "        <register address='0xb830920' value='0x" DATA.LONG(A:0x830920) "' name='RPMH_VRM_VOLTAGE_CRS_DRV3_REG9'/>"
WRITE #1 "        <register address='0xb830a20' value='0x" DATA.LONG(A:0x830a20) "' name='RPMH_VRM_VOLTAGE_CRS_DRV3_REG10'/>"
WRITE #1 "        <register address='0xb830b20' value='0x" DATA.LONG(A:0x830b20) "' name='RPMH_VRM_VOLTAGE_CRS_DRV3_REG11'/>"
WRITE #1 "        <register address='0xb830c20' value='0x" DATA.LONG(A:0x830c20) "' name='RPMH_VRM_VOLTAGE_CRS_DRV3_REG12'/>"
WRITE #1 "        <register address='0xb830d20' value='0x" DATA.LONG(A:0x830d20) "' name='RPMH_VRM_VOLTAGE_CRS_DRV3_REG13'/>"
WRITE #1 "        <register address='0xb830e20' value='0x" DATA.LONG(A:0x830e20) "' name='RPMH_VRM_VOLTAGE_CRS_DRV3_REG14'/>"
WRITE #1 "        <register address='0xb830f20' value='0x" DATA.LONG(A:0x830f20) "' name='RPMH_VRM_VOLTAGE_CRS_DRV3_REG15'/>"
WRITE #1 "        <register address='0xb831020' value='0x" DATA.LONG(A:0x831020) "' name='RPMH_VRM_VOLTAGE_CRS_DRV3_REG16'/>"
WRITE #1 "        <register address='0xb831120' value='0x" DATA.LONG(A:0x831120) "' name='RPMH_VRM_VOLTAGE_CRS_DRV3_REG17'/>"
WRITE #1 "        <register address='0xb831220' value='0x" DATA.LONG(A:0x831220) "' name='RPMH_VRM_VOLTAGE_CRS_DRV3_REG18'/>"
WRITE #1 "        <register address='0xb831320' value='0x" DATA.LONG(A:0x831320) "' name='RPMH_VRM_VOLTAGE_CRS_DRV3_REG19'/>"
WRITE #1 "        <register address='0xb831420' value='0x" DATA.LONG(A:0x831420) "' name='RPMH_VRM_VOLTAGE_CRS_DRV3_REG20'/>"
WRITE #1 "        <register address='0xb831520' value='0x" DATA.LONG(A:0x831520) "' name='RPMH_VRM_VOLTAGE_CRS_DRV3_REG21'/>"
WRITE #1 "        <register address='0xb831620' value='0x" DATA.LONG(A:0x831620) "' name='RPMH_VRM_VOLTAGE_CRS_DRV3_REG22'/>"
WRITE #1 "        <register address='0xb831720' value='0x" DATA.LONG(A:0x831720) "' name='RPMH_VRM_VOLTAGE_CRS_DRV3_REG23'/>"
WRITE #1 "        <register address='0xb831820' value='0x" DATA.LONG(A:0x831820) "' name='RPMH_VRM_VOLTAGE_CRS_DRV3_REG24'/>"
WRITE #1 "        <register address='0xb831920' value='0x" DATA.LONG(A:0x831920) "' name='RPMH_VRM_VOLTAGE_CRS_DRV3_REG25'/>"
WRITE #1 "        <register address='0xb831a20' value='0x" DATA.LONG(A:0x831a20) "' name='RPMH_VRM_VOLTAGE_CRS_DRV3_REG26'/>"
WRITE #1 "        <register address='0xb831b20' value='0x" DATA.LONG(A:0x831b20) "' name='RPMH_VRM_VOLTAGE_CRS_DRV3_REG27'/>"
WRITE #1 "        <register address='0xb831c20' value='0x" DATA.LONG(A:0x831c20) "' name='RPMH_VRM_VOLTAGE_CRS_DRV3_REG28'/>"
WRITE #1 "        <register address='0xb831d20' value='0x" DATA.LONG(A:0x831d20) "' name='RPMH_VRM_VOLTAGE_CRS_DRV3_REG29'/>"
WRITE #1 "        <register address='0xb831e20' value='0x" DATA.LONG(A:0x831e20) "' name='RPMH_VRM_VOLTAGE_CRS_DRV3_REG30'/>"
WRITE #1 "        <register address='0xb831f20' value='0x" DATA.LONG(A:0x831f20) "' name='RPMH_VRM_VOLTAGE_CRS_DRV3_REG31'/>"
WRITE #1 "        <register address='0xb832020' value='0x" DATA.LONG(A:0x832020) "' name='RPMH_VRM_VOLTAGE_CRS_DRV3_REG32'/>"
WRITE #1 "        <register address='0xb832120' value='0x" DATA.LONG(A:0x832120) "' name='RPMH_VRM_VOLTAGE_CRS_DRV3_REG33'/>"
WRITE #1 "        <register address='0xb832220' value='0x" DATA.LONG(A:0x832220) "' name='RPMH_VRM_VOLTAGE_CRS_DRV3_REG34'/>"
WRITE #1 "        <register address='0xb832320' value='0x" DATA.LONG(A:0x832320) "' name='RPMH_VRM_VOLTAGE_CRS_DRV3_REG35'/>"
WRITE #1 "        <register address='0xb832420' value='0x" DATA.LONG(A:0x832420) "' name='RPMH_VRM_VOLTAGE_CRS_DRV3_REG36'/>"
WRITE #1 "        <register address='0xb832520' value='0x" DATA.LONG(A:0x832520) "' name='RPMH_VRM_VOLTAGE_CRS_DRV3_REG37'/>"
WRITE #1 "        <register address='0xb832620' value='0x" DATA.LONG(A:0x832620) "' name='RPMH_VRM_VOLTAGE_CRS_DRV3_REG38'/>"
WRITE #1 "        <register address='0xb832720' value='0x" DATA.LONG(A:0x832720) "' name='RPMH_VRM_VOLTAGE_CRS_DRV3_REG39'/>"
WRITE #1 "        <register address='0xb832820' value='0x" DATA.LONG(A:0x832820) "' name='RPMH_VRM_VOLTAGE_CRS_DRV3_REG40'/>"
WRITE #1 "        <register address='0xb832920' value='0x" DATA.LONG(A:0x832920) "' name='RPMH_VRM_VOLTAGE_CRS_DRV3_REG41'/>"
WRITE #1 "        <register address='0xb832a20' value='0x" DATA.LONG(A:0x832a20) "' name='RPMH_VRM_VOLTAGE_CRS_DRV3_REG42'/>"
WRITE #1 "        <register address='0xb832b20' value='0x" DATA.LONG(A:0x832b20) "' name='RPMH_VRM_VOLTAGE_CRS_DRV3_REG43'/>"
WRITE #1 "        <register address='0xb832c20' value='0x" DATA.LONG(A:0x832c20) "' name='RPMH_VRM_VOLTAGE_CRS_DRV3_REG44'/>"
WRITE #1 "        <register address='0xb832d20' value='0x" DATA.LONG(A:0x832d20) "' name='RPMH_VRM_VOLTAGE_CRS_DRV3_REG45'/>"
WRITE #1 "        <register address='0xb840020' value='0x" DATA.LONG(A:0x840020) "' name='RPMH_VRM_VOLTAGE_CRS_DRV4_REG0'/>"
WRITE #1 "        <register address='0xb840120' value='0x" DATA.LONG(A:0x840120) "' name='RPMH_VRM_VOLTAGE_CRS_DRV4_REG1'/>"
WRITE #1 "        <register address='0xb840220' value='0x" DATA.LONG(A:0x840220) "' name='RPMH_VRM_VOLTAGE_CRS_DRV4_REG2'/>"
WRITE #1 "        <register address='0xb840320' value='0x" DATA.LONG(A:0x840320) "' name='RPMH_VRM_VOLTAGE_CRS_DRV4_REG3'/>"
WRITE #1 "        <register address='0xb840420' value='0x" DATA.LONG(A:0x840420) "' name='RPMH_VRM_VOLTAGE_CRS_DRV4_REG4'/>"
WRITE #1 "        <register address='0xb840520' value='0x" DATA.LONG(A:0x840520) "' name='RPMH_VRM_VOLTAGE_CRS_DRV4_REG5'/>"
WRITE #1 "        <register address='0xb840620' value='0x" DATA.LONG(A:0x840620) "' name='RPMH_VRM_VOLTAGE_CRS_DRV4_REG6'/>"
WRITE #1 "        <register address='0xb840720' value='0x" DATA.LONG(A:0x840720) "' name='RPMH_VRM_VOLTAGE_CRS_DRV4_REG7'/>"
WRITE #1 "        <register address='0xb840820' value='0x" DATA.LONG(A:0x840820) "' name='RPMH_VRM_VOLTAGE_CRS_DRV4_REG8'/>"
WRITE #1 "        <register address='0xb840920' value='0x" DATA.LONG(A:0x840920) "' name='RPMH_VRM_VOLTAGE_CRS_DRV4_REG9'/>"
WRITE #1 "        <register address='0xb840a20' value='0x" DATA.LONG(A:0x840a20) "' name='RPMH_VRM_VOLTAGE_CRS_DRV4_REG10'/>"
WRITE #1 "        <register address='0xb840b20' value='0x" DATA.LONG(A:0x840b20) "' name='RPMH_VRM_VOLTAGE_CRS_DRV4_REG11'/>"
WRITE #1 "        <register address='0xb840c20' value='0x" DATA.LONG(A:0x840c20) "' name='RPMH_VRM_VOLTAGE_CRS_DRV4_REG12'/>"
WRITE #1 "        <register address='0xb840d20' value='0x" DATA.LONG(A:0x840d20) "' name='RPMH_VRM_VOLTAGE_CRS_DRV4_REG13'/>"
WRITE #1 "        <register address='0xb840e20' value='0x" DATA.LONG(A:0x840e20) "' name='RPMH_VRM_VOLTAGE_CRS_DRV4_REG14'/>"
WRITE #1 "        <register address='0xb840f20' value='0x" DATA.LONG(A:0x840f20) "' name='RPMH_VRM_VOLTAGE_CRS_DRV4_REG15'/>"
WRITE #1 "        <register address='0xb841020' value='0x" DATA.LONG(A:0x841020) "' name='RPMH_VRM_VOLTAGE_CRS_DRV4_REG16'/>"
WRITE #1 "        <register address='0xb841120' value='0x" DATA.LONG(A:0x841120) "' name='RPMH_VRM_VOLTAGE_CRS_DRV4_REG17'/>"
WRITE #1 "        <register address='0xb841220' value='0x" DATA.LONG(A:0x841220) "' name='RPMH_VRM_VOLTAGE_CRS_DRV4_REG18'/>"
WRITE #1 "        <register address='0xb841320' value='0x" DATA.LONG(A:0x841320) "' name='RPMH_VRM_VOLTAGE_CRS_DRV4_REG19'/>"
WRITE #1 "        <register address='0xb841420' value='0x" DATA.LONG(A:0x841420) "' name='RPMH_VRM_VOLTAGE_CRS_DRV4_REG20'/>"
WRITE #1 "        <register address='0xb841520' value='0x" DATA.LONG(A:0x841520) "' name='RPMH_VRM_VOLTAGE_CRS_DRV4_REG21'/>"
WRITE #1 "        <register address='0xb841620' value='0x" DATA.LONG(A:0x841620) "' name='RPMH_VRM_VOLTAGE_CRS_DRV4_REG22'/>"
WRITE #1 "        <register address='0xb841720' value='0x" DATA.LONG(A:0x841720) "' name='RPMH_VRM_VOLTAGE_CRS_DRV4_REG23'/>"
WRITE #1 "        <register address='0xb841820' value='0x" DATA.LONG(A:0x841820) "' name='RPMH_VRM_VOLTAGE_CRS_DRV4_REG24'/>"
WRITE #1 "        <register address='0xb841920' value='0x" DATA.LONG(A:0x841920) "' name='RPMH_VRM_VOLTAGE_CRS_DRV4_REG25'/>"
WRITE #1 "        <register address='0xb841a20' value='0x" DATA.LONG(A:0x841a20) "' name='RPMH_VRM_VOLTAGE_CRS_DRV4_REG26'/>"
WRITE #1 "        <register address='0xb841b20' value='0x" DATA.LONG(A:0x841b20) "' name='RPMH_VRM_VOLTAGE_CRS_DRV4_REG27'/>"
WRITE #1 "        <register address='0xb841c20' value='0x" DATA.LONG(A:0x841c20) "' name='RPMH_VRM_VOLTAGE_CRS_DRV4_REG28'/>"
WRITE #1 "        <register address='0xb841d20' value='0x" DATA.LONG(A:0x841d20) "' name='RPMH_VRM_VOLTAGE_CRS_DRV4_REG29'/>"
WRITE #1 "        <register address='0xb841e20' value='0x" DATA.LONG(A:0x841e20) "' name='RPMH_VRM_VOLTAGE_CRS_DRV4_REG30'/>"
WRITE #1 "        <register address='0xb841f20' value='0x" DATA.LONG(A:0x841f20) "' name='RPMH_VRM_VOLTAGE_CRS_DRV4_REG31'/>"
WRITE #1 "        <register address='0xb842020' value='0x" DATA.LONG(A:0x842020) "' name='RPMH_VRM_VOLTAGE_CRS_DRV4_REG32'/>"
WRITE #1 "        <register address='0xb842120' value='0x" DATA.LONG(A:0x842120) "' name='RPMH_VRM_VOLTAGE_CRS_DRV4_REG33'/>"
WRITE #1 "        <register address='0xb842220' value='0x" DATA.LONG(A:0x842220) "' name='RPMH_VRM_VOLTAGE_CRS_DRV4_REG34'/>"
WRITE #1 "        <register address='0xb842320' value='0x" DATA.LONG(A:0x842320) "' name='RPMH_VRM_VOLTAGE_CRS_DRV4_REG35'/>"
WRITE #1 "        <register address='0xb842420' value='0x" DATA.LONG(A:0x842420) "' name='RPMH_VRM_VOLTAGE_CRS_DRV4_REG36'/>"
WRITE #1 "        <register address='0xb842520' value='0x" DATA.LONG(A:0x842520) "' name='RPMH_VRM_VOLTAGE_CRS_DRV4_REG37'/>"
WRITE #1 "        <register address='0xb842620' value='0x" DATA.LONG(A:0x842620) "' name='RPMH_VRM_VOLTAGE_CRS_DRV4_REG38'/>"
WRITE #1 "        <register address='0xb842720' value='0x" DATA.LONG(A:0x842720) "' name='RPMH_VRM_VOLTAGE_CRS_DRV4_REG39'/>"
WRITE #1 "        <register address='0xb842820' value='0x" DATA.LONG(A:0x842820) "' name='RPMH_VRM_VOLTAGE_CRS_DRV4_REG40'/>"
WRITE #1 "        <register address='0xb842920' value='0x" DATA.LONG(A:0x842920) "' name='RPMH_VRM_VOLTAGE_CRS_DRV4_REG41'/>"
WRITE #1 "        <register address='0xb842a20' value='0x" DATA.LONG(A:0x842a20) "' name='RPMH_VRM_VOLTAGE_CRS_DRV4_REG42'/>"
WRITE #1 "        <register address='0xb842b20' value='0x" DATA.LONG(A:0x842b20) "' name='RPMH_VRM_VOLTAGE_CRS_DRV4_REG43'/>"
WRITE #1 "        <register address='0xb842c20' value='0x" DATA.LONG(A:0x842c20) "' name='RPMH_VRM_VOLTAGE_CRS_DRV4_REG44'/>"
WRITE #1 "        <register address='0xb842d20' value='0x" DATA.LONG(A:0x842d20) "' name='RPMH_VRM_VOLTAGE_CRS_DRV4_REG45'/>"
WRITE #1 "        <register address='0xb850020' value='0x" DATA.LONG(A:0x850020) "' name='RPMH_VRM_VOLTAGE_CRS_DRV5_REG0'/>"
WRITE #1 "        <register address='0xb850120' value='0x" DATA.LONG(A:0x850120) "' name='RPMH_VRM_VOLTAGE_CRS_DRV5_REG1'/>"
WRITE #1 "        <register address='0xb850220' value='0x" DATA.LONG(A:0x850220) "' name='RPMH_VRM_VOLTAGE_CRS_DRV5_REG2'/>"
WRITE #1 "        <register address='0xb850320' value='0x" DATA.LONG(A:0x850320) "' name='RPMH_VRM_VOLTAGE_CRS_DRV5_REG3'/>"
WRITE #1 "        <register address='0xb850420' value='0x" DATA.LONG(A:0x850420) "' name='RPMH_VRM_VOLTAGE_CRS_DRV5_REG4'/>"
WRITE #1 "        <register address='0xb850520' value='0x" DATA.LONG(A:0x850520) "' name='RPMH_VRM_VOLTAGE_CRS_DRV5_REG5'/>"
WRITE #1 "        <register address='0xb850620' value='0x" DATA.LONG(A:0x850620) "' name='RPMH_VRM_VOLTAGE_CRS_DRV5_REG6'/>"
WRITE #1 "        <register address='0xb850720' value='0x" DATA.LONG(A:0x850720) "' name='RPMH_VRM_VOLTAGE_CRS_DRV5_REG7'/>"
WRITE #1 "        <register address='0xb850820' value='0x" DATA.LONG(A:0x850820) "' name='RPMH_VRM_VOLTAGE_CRS_DRV5_REG8'/>"
WRITE #1 "        <register address='0xb850920' value='0x" DATA.LONG(A:0x850920) "' name='RPMH_VRM_VOLTAGE_CRS_DRV5_REG9'/>"
WRITE #1 "        <register address='0xb850a20' value='0x" DATA.LONG(A:0x850a20) "' name='RPMH_VRM_VOLTAGE_CRS_DRV5_REG10'/>"
WRITE #1 "        <register address='0xb850b20' value='0x" DATA.LONG(A:0x850b20) "' name='RPMH_VRM_VOLTAGE_CRS_DRV5_REG11'/>"
WRITE #1 "        <register address='0xb850c20' value='0x" DATA.LONG(A:0x850c20) "' name='RPMH_VRM_VOLTAGE_CRS_DRV5_REG12'/>"
WRITE #1 "        <register address='0xb850d20' value='0x" DATA.LONG(A:0x850d20) "' name='RPMH_VRM_VOLTAGE_CRS_DRV5_REG13'/>"
WRITE #1 "        <register address='0xb850e20' value='0x" DATA.LONG(A:0x850e20) "' name='RPMH_VRM_VOLTAGE_CRS_DRV5_REG14'/>"
WRITE #1 "        <register address='0xb850f20' value='0x" DATA.LONG(A:0x850f20) "' name='RPMH_VRM_VOLTAGE_CRS_DRV5_REG15'/>"
WRITE #1 "        <register address='0xb851020' value='0x" DATA.LONG(A:0x851020) "' name='RPMH_VRM_VOLTAGE_CRS_DRV5_REG16'/>"
WRITE #1 "        <register address='0xb851120' value='0x" DATA.LONG(A:0x851120) "' name='RPMH_VRM_VOLTAGE_CRS_DRV5_REG17'/>"
WRITE #1 "        <register address='0xb851220' value='0x" DATA.LONG(A:0x851220) "' name='RPMH_VRM_VOLTAGE_CRS_DRV5_REG18'/>"
WRITE #1 "        <register address='0xb851320' value='0x" DATA.LONG(A:0x851320) "' name='RPMH_VRM_VOLTAGE_CRS_DRV5_REG19'/>"
WRITE #1 "        <register address='0xb851420' value='0x" DATA.LONG(A:0x851420) "' name='RPMH_VRM_VOLTAGE_CRS_DRV5_REG20'/>"
WRITE #1 "        <register address='0xb851520' value='0x" DATA.LONG(A:0x851520) "' name='RPMH_VRM_VOLTAGE_CRS_DRV5_REG21'/>"
WRITE #1 "        <register address='0xb851620' value='0x" DATA.LONG(A:0x851620) "' name='RPMH_VRM_VOLTAGE_CRS_DRV5_REG22'/>"
WRITE #1 "        <register address='0xb851720' value='0x" DATA.LONG(A:0x851720) "' name='RPMH_VRM_VOLTAGE_CRS_DRV5_REG23'/>"
WRITE #1 "        <register address='0xb851820' value='0x" DATA.LONG(A:0x851820) "' name='RPMH_VRM_VOLTAGE_CRS_DRV5_REG24'/>"
WRITE #1 "        <register address='0xb851920' value='0x" DATA.LONG(A:0x851920) "' name='RPMH_VRM_VOLTAGE_CRS_DRV5_REG25'/>"
WRITE #1 "        <register address='0xb851a20' value='0x" DATA.LONG(A:0x851a20) "' name='RPMH_VRM_VOLTAGE_CRS_DRV5_REG26'/>"
WRITE #1 "        <register address='0xb851b20' value='0x" DATA.LONG(A:0x851b20) "' name='RPMH_VRM_VOLTAGE_CRS_DRV5_REG27'/>"
WRITE #1 "        <register address='0xb851c20' value='0x" DATA.LONG(A:0x851c20) "' name='RPMH_VRM_VOLTAGE_CRS_DRV5_REG28'/>"
WRITE #1 "        <register address='0xb851d20' value='0x" DATA.LONG(A:0x851d20) "' name='RPMH_VRM_VOLTAGE_CRS_DRV5_REG29'/>"
WRITE #1 "        <register address='0xb851e20' value='0x" DATA.LONG(A:0x851e20) "' name='RPMH_VRM_VOLTAGE_CRS_DRV5_REG30'/>"
WRITE #1 "        <register address='0xb851f20' value='0x" DATA.LONG(A:0x851f20) "' name='RPMH_VRM_VOLTAGE_CRS_DRV5_REG31'/>"
WRITE #1 "        <register address='0xb852020' value='0x" DATA.LONG(A:0x852020) "' name='RPMH_VRM_VOLTAGE_CRS_DRV5_REG32'/>"
WRITE #1 "        <register address='0xb852120' value='0x" DATA.LONG(A:0x852120) "' name='RPMH_VRM_VOLTAGE_CRS_DRV5_REG33'/>"
WRITE #1 "        <register address='0xb852220' value='0x" DATA.LONG(A:0x852220) "' name='RPMH_VRM_VOLTAGE_CRS_DRV5_REG34'/>"
WRITE #1 "        <register address='0xb852320' value='0x" DATA.LONG(A:0x852320) "' name='RPMH_VRM_VOLTAGE_CRS_DRV5_REG35'/>"
WRITE #1 "        <register address='0xb852420' value='0x" DATA.LONG(A:0x852420) "' name='RPMH_VRM_VOLTAGE_CRS_DRV5_REG36'/>"
WRITE #1 "        <register address='0xb852520' value='0x" DATA.LONG(A:0x852520) "' name='RPMH_VRM_VOLTAGE_CRS_DRV5_REG37'/>"
WRITE #1 "        <register address='0xb852620' value='0x" DATA.LONG(A:0x852620) "' name='RPMH_VRM_VOLTAGE_CRS_DRV5_REG38'/>"
WRITE #1 "        <register address='0xb852720' value='0x" DATA.LONG(A:0x852720) "' name='RPMH_VRM_VOLTAGE_CRS_DRV5_REG39'/>"
WRITE #1 "        <register address='0xb852820' value='0x" DATA.LONG(A:0x852820) "' name='RPMH_VRM_VOLTAGE_CRS_DRV5_REG40'/>"
WRITE #1 "        <register address='0xb852920' value='0x" DATA.LONG(A:0x852920) "' name='RPMH_VRM_VOLTAGE_CRS_DRV5_REG41'/>"
WRITE #1 "        <register address='0xb852a20' value='0x" DATA.LONG(A:0x852a20) "' name='RPMH_VRM_VOLTAGE_CRS_DRV5_REG42'/>"
WRITE #1 "        <register address='0xb852b20' value='0x" DATA.LONG(A:0x852b20) "' name='RPMH_VRM_VOLTAGE_CRS_DRV5_REG43'/>"
WRITE #1 "        <register address='0xb852c20' value='0x" DATA.LONG(A:0x852c20) "' name='RPMH_VRM_VOLTAGE_CRS_DRV5_REG44'/>"
WRITE #1 "        <register address='0xb852d20' value='0x" DATA.LONG(A:0x852d20) "' name='RPMH_VRM_VOLTAGE_CRS_DRV5_REG45'/>"
WRITE #1 "        <register address='0xb860020' value='0x" DATA.LONG(A:0x860020) "' name='RPMH_VRM_VOLTAGE_CRS_DRV6_REG0'/>"
WRITE #1 "        <register address='0xb860120' value='0x" DATA.LONG(A:0x860120) "' name='RPMH_VRM_VOLTAGE_CRS_DRV6_REG1'/>"
WRITE #1 "        <register address='0xb860220' value='0x" DATA.LONG(A:0x860220) "' name='RPMH_VRM_VOLTAGE_CRS_DRV6_REG2'/>"
WRITE #1 "        <register address='0xb860320' value='0x" DATA.LONG(A:0x860320) "' name='RPMH_VRM_VOLTAGE_CRS_DRV6_REG3'/>"
WRITE #1 "        <register address='0xb860420' value='0x" DATA.LONG(A:0x860420) "' name='RPMH_VRM_VOLTAGE_CRS_DRV6_REG4'/>"
WRITE #1 "        <register address='0xb860520' value='0x" DATA.LONG(A:0x860520) "' name='RPMH_VRM_VOLTAGE_CRS_DRV6_REG5'/>"
WRITE #1 "        <register address='0xb860620' value='0x" DATA.LONG(A:0x860620) "' name='RPMH_VRM_VOLTAGE_CRS_DRV6_REG6'/>"
WRITE #1 "        <register address='0xb860720' value='0x" DATA.LONG(A:0x860720) "' name='RPMH_VRM_VOLTAGE_CRS_DRV6_REG7'/>"
WRITE #1 "        <register address='0xb860820' value='0x" DATA.LONG(A:0x860820) "' name='RPMH_VRM_VOLTAGE_CRS_DRV6_REG8'/>"
WRITE #1 "        <register address='0xb860920' value='0x" DATA.LONG(A:0x860920) "' name='RPMH_VRM_VOLTAGE_CRS_DRV6_REG9'/>"
WRITE #1 "        <register address='0xb860a20' value='0x" DATA.LONG(A:0x860a20) "' name='RPMH_VRM_VOLTAGE_CRS_DRV6_REG10'/>"
WRITE #1 "        <register address='0xb860b20' value='0x" DATA.LONG(A:0x860b20) "' name='RPMH_VRM_VOLTAGE_CRS_DRV6_REG11'/>"
WRITE #1 "        <register address='0xb860c20' value='0x" DATA.LONG(A:0x860c20) "' name='RPMH_VRM_VOLTAGE_CRS_DRV6_REG12'/>"
WRITE #1 "        <register address='0xb860d20' value='0x" DATA.LONG(A:0x860d20) "' name='RPMH_VRM_VOLTAGE_CRS_DRV6_REG13'/>"
WRITE #1 "        <register address='0xb860e20' value='0x" DATA.LONG(A:0x860e20) "' name='RPMH_VRM_VOLTAGE_CRS_DRV6_REG14'/>"
WRITE #1 "        <register address='0xb860f20' value='0x" DATA.LONG(A:0x860f20) "' name='RPMH_VRM_VOLTAGE_CRS_DRV6_REG15'/>"
WRITE #1 "        <register address='0xb861020' value='0x" DATA.LONG(A:0x861020) "' name='RPMH_VRM_VOLTAGE_CRS_DRV6_REG16'/>"
WRITE #1 "        <register address='0xb861120' value='0x" DATA.LONG(A:0x861120) "' name='RPMH_VRM_VOLTAGE_CRS_DRV6_REG17'/>"
WRITE #1 "        <register address='0xb861220' value='0x" DATA.LONG(A:0x861220) "' name='RPMH_VRM_VOLTAGE_CRS_DRV6_REG18'/>"
WRITE #1 "        <register address='0xb861320' value='0x" DATA.LONG(A:0x861320) "' name='RPMH_VRM_VOLTAGE_CRS_DRV6_REG19'/>"
WRITE #1 "        <register address='0xb861420' value='0x" DATA.LONG(A:0x861420) "' name='RPMH_VRM_VOLTAGE_CRS_DRV6_REG20'/>"
WRITE #1 "        <register address='0xb861520' value='0x" DATA.LONG(A:0x861520) "' name='RPMH_VRM_VOLTAGE_CRS_DRV6_REG21'/>"
WRITE #1 "        <register address='0xb861620' value='0x" DATA.LONG(A:0x861620) "' name='RPMH_VRM_VOLTAGE_CRS_DRV6_REG22'/>"
WRITE #1 "        <register address='0xb861720' value='0x" DATA.LONG(A:0x861720) "' name='RPMH_VRM_VOLTAGE_CRS_DRV6_REG23'/>"
WRITE #1 "        <register address='0xb861820' value='0x" DATA.LONG(A:0x861820) "' name='RPMH_VRM_VOLTAGE_CRS_DRV6_REG24'/>"
WRITE #1 "        <register address='0xb861920' value='0x" DATA.LONG(A:0x861920) "' name='RPMH_VRM_VOLTAGE_CRS_DRV6_REG25'/>"
WRITE #1 "        <register address='0xb861a20' value='0x" DATA.LONG(A:0x861a20) "' name='RPMH_VRM_VOLTAGE_CRS_DRV6_REG26'/>"
WRITE #1 "        <register address='0xb861b20' value='0x" DATA.LONG(A:0x861b20) "' name='RPMH_VRM_VOLTAGE_CRS_DRV6_REG27'/>"
WRITE #1 "        <register address='0xb861c20' value='0x" DATA.LONG(A:0x861c20) "' name='RPMH_VRM_VOLTAGE_CRS_DRV6_REG28'/>"
WRITE #1 "        <register address='0xb861d20' value='0x" DATA.LONG(A:0x861d20) "' name='RPMH_VRM_VOLTAGE_CRS_DRV6_REG29'/>"
WRITE #1 "        <register address='0xb861e20' value='0x" DATA.LONG(A:0x861e20) "' name='RPMH_VRM_VOLTAGE_CRS_DRV6_REG30'/>"
WRITE #1 "        <register address='0xb861f20' value='0x" DATA.LONG(A:0x861f20) "' name='RPMH_VRM_VOLTAGE_CRS_DRV6_REG31'/>"
WRITE #1 "        <register address='0xb862020' value='0x" DATA.LONG(A:0x862020) "' name='RPMH_VRM_VOLTAGE_CRS_DRV6_REG32'/>"
WRITE #1 "        <register address='0xb862120' value='0x" DATA.LONG(A:0x862120) "' name='RPMH_VRM_VOLTAGE_CRS_DRV6_REG33'/>"
WRITE #1 "        <register address='0xb862220' value='0x" DATA.LONG(A:0x862220) "' name='RPMH_VRM_VOLTAGE_CRS_DRV6_REG34'/>"
WRITE #1 "        <register address='0xb862320' value='0x" DATA.LONG(A:0x862320) "' name='RPMH_VRM_VOLTAGE_CRS_DRV6_REG35'/>"
WRITE #1 "        <register address='0xb862420' value='0x" DATA.LONG(A:0x862420) "' name='RPMH_VRM_VOLTAGE_CRS_DRV6_REG36'/>"
WRITE #1 "        <register address='0xb862520' value='0x" DATA.LONG(A:0x862520) "' name='RPMH_VRM_VOLTAGE_CRS_DRV6_REG37'/>"
WRITE #1 "        <register address='0xb862620' value='0x" DATA.LONG(A:0x862620) "' name='RPMH_VRM_VOLTAGE_CRS_DRV6_REG38'/>"
WRITE #1 "        <register address='0xb862720' value='0x" DATA.LONG(A:0x862720) "' name='RPMH_VRM_VOLTAGE_CRS_DRV6_REG39'/>"
WRITE #1 "        <register address='0xb862820' value='0x" DATA.LONG(A:0x862820) "' name='RPMH_VRM_VOLTAGE_CRS_DRV6_REG40'/>"
WRITE #1 "        <register address='0xb862920' value='0x" DATA.LONG(A:0x862920) "' name='RPMH_VRM_VOLTAGE_CRS_DRV6_REG41'/>"
WRITE #1 "        <register address='0xb862a20' value='0x" DATA.LONG(A:0x862a20) "' name='RPMH_VRM_VOLTAGE_CRS_DRV6_REG42'/>"
WRITE #1 "        <register address='0xb862b20' value='0x" DATA.LONG(A:0x862b20) "' name='RPMH_VRM_VOLTAGE_CRS_DRV6_REG43'/>"
WRITE #1 "        <register address='0xb862c20' value='0x" DATA.LONG(A:0x862c20) "' name='RPMH_VRM_VOLTAGE_CRS_DRV6_REG44'/>"
WRITE #1 "        <register address='0xb862d20' value='0x" DATA.LONG(A:0x862d20) "' name='RPMH_VRM_VOLTAGE_CRS_DRV6_REG45'/>"
WRITE #1 "        <register address='0xb870020' value='0x" DATA.LONG(A:0x870020) "' name='RPMH_VRM_VOLTAGE_CRS_DRV7_REG0'/>"
WRITE #1 "        <register address='0xb870120' value='0x" DATA.LONG(A:0x870120) "' name='RPMH_VRM_VOLTAGE_CRS_DRV7_REG1'/>"
WRITE #1 "        <register address='0xb870220' value='0x" DATA.LONG(A:0x870220) "' name='RPMH_VRM_VOLTAGE_CRS_DRV7_REG2'/>"
WRITE #1 "        <register address='0xb870320' value='0x" DATA.LONG(A:0x870320) "' name='RPMH_VRM_VOLTAGE_CRS_DRV7_REG3'/>"
WRITE #1 "        <register address='0xb870420' value='0x" DATA.LONG(A:0x870420) "' name='RPMH_VRM_VOLTAGE_CRS_DRV7_REG4'/>"
WRITE #1 "        <register address='0xb870520' value='0x" DATA.LONG(A:0x870520) "' name='RPMH_VRM_VOLTAGE_CRS_DRV7_REG5'/>"
WRITE #1 "        <register address='0xb870620' value='0x" DATA.LONG(A:0x870620) "' name='RPMH_VRM_VOLTAGE_CRS_DRV7_REG6'/>"
WRITE #1 "        <register address='0xb870720' value='0x" DATA.LONG(A:0x870720) "' name='RPMH_VRM_VOLTAGE_CRS_DRV7_REG7'/>"
WRITE #1 "        <register address='0xb870820' value='0x" DATA.LONG(A:0x870820) "' name='RPMH_VRM_VOLTAGE_CRS_DRV7_REG8'/>"
WRITE #1 "        <register address='0xb870920' value='0x" DATA.LONG(A:0x870920) "' name='RPMH_VRM_VOLTAGE_CRS_DRV7_REG9'/>"
WRITE #1 "        <register address='0xb870a20' value='0x" DATA.LONG(A:0x870a20) "' name='RPMH_VRM_VOLTAGE_CRS_DRV7_REG10'/>"
WRITE #1 "        <register address='0xb870b20' value='0x" DATA.LONG(A:0x870b20) "' name='RPMH_VRM_VOLTAGE_CRS_DRV7_REG11'/>"
WRITE #1 "        <register address='0xb870c20' value='0x" DATA.LONG(A:0x870c20) "' name='RPMH_VRM_VOLTAGE_CRS_DRV7_REG12'/>"
WRITE #1 "        <register address='0xb870d20' value='0x" DATA.LONG(A:0x870d20) "' name='RPMH_VRM_VOLTAGE_CRS_DRV7_REG13'/>"
WRITE #1 "        <register address='0xb870e20' value='0x" DATA.LONG(A:0x870e20) "' name='RPMH_VRM_VOLTAGE_CRS_DRV7_REG14'/>"
WRITE #1 "        <register address='0xb870f20' value='0x" DATA.LONG(A:0x870f20) "' name='RPMH_VRM_VOLTAGE_CRS_DRV7_REG15'/>"
WRITE #1 "        <register address='0xb871020' value='0x" DATA.LONG(A:0x871020) "' name='RPMH_VRM_VOLTAGE_CRS_DRV7_REG16'/>"
WRITE #1 "        <register address='0xb871120' value='0x" DATA.LONG(A:0x871120) "' name='RPMH_VRM_VOLTAGE_CRS_DRV7_REG17'/>"
WRITE #1 "        <register address='0xb871220' value='0x" DATA.LONG(A:0x871220) "' name='RPMH_VRM_VOLTAGE_CRS_DRV7_REG18'/>"
WRITE #1 "        <register address='0xb871320' value='0x" DATA.LONG(A:0x871320) "' name='RPMH_VRM_VOLTAGE_CRS_DRV7_REG19'/>"
WRITE #1 "        <register address='0xb871420' value='0x" DATA.LONG(A:0x871420) "' name='RPMH_VRM_VOLTAGE_CRS_DRV7_REG20'/>"
WRITE #1 "        <register address='0xb871520' value='0x" DATA.LONG(A:0x871520) "' name='RPMH_VRM_VOLTAGE_CRS_DRV7_REG21'/>"
WRITE #1 "        <register address='0xb871620' value='0x" DATA.LONG(A:0x871620) "' name='RPMH_VRM_VOLTAGE_CRS_DRV7_REG22'/>"
WRITE #1 "        <register address='0xb871720' value='0x" DATA.LONG(A:0x871720) "' name='RPMH_VRM_VOLTAGE_CRS_DRV7_REG23'/>"
WRITE #1 "        <register address='0xb871820' value='0x" DATA.LONG(A:0x871820) "' name='RPMH_VRM_VOLTAGE_CRS_DRV7_REG24'/>"
WRITE #1 "        <register address='0xb871920' value='0x" DATA.LONG(A:0x871920) "' name='RPMH_VRM_VOLTAGE_CRS_DRV7_REG25'/>"
WRITE #1 "        <register address='0xb871a20' value='0x" DATA.LONG(A:0x871a20) "' name='RPMH_VRM_VOLTAGE_CRS_DRV7_REG26'/>"
WRITE #1 "        <register address='0xb871b20' value='0x" DATA.LONG(A:0x871b20) "' name='RPMH_VRM_VOLTAGE_CRS_DRV7_REG27'/>"
WRITE #1 "        <register address='0xb871c20' value='0x" DATA.LONG(A:0x871c20) "' name='RPMH_VRM_VOLTAGE_CRS_DRV7_REG28'/>"
WRITE #1 "        <register address='0xb871d20' value='0x" DATA.LONG(A:0x871d20) "' name='RPMH_VRM_VOLTAGE_CRS_DRV7_REG29'/>"
WRITE #1 "        <register address='0xb871e20' value='0x" DATA.LONG(A:0x871e20) "' name='RPMH_VRM_VOLTAGE_CRS_DRV7_REG30'/>"
WRITE #1 "        <register address='0xb871f20' value='0x" DATA.LONG(A:0x871f20) "' name='RPMH_VRM_VOLTAGE_CRS_DRV7_REG31'/>"
WRITE #1 "        <register address='0xb872020' value='0x" DATA.LONG(A:0x872020) "' name='RPMH_VRM_VOLTAGE_CRS_DRV7_REG32'/>"
WRITE #1 "        <register address='0xb872120' value='0x" DATA.LONG(A:0x872120) "' name='RPMH_VRM_VOLTAGE_CRS_DRV7_REG33'/>"
WRITE #1 "        <register address='0xb872220' value='0x" DATA.LONG(A:0x872220) "' name='RPMH_VRM_VOLTAGE_CRS_DRV7_REG34'/>"
WRITE #1 "        <register address='0xb872320' value='0x" DATA.LONG(A:0x872320) "' name='RPMH_VRM_VOLTAGE_CRS_DRV7_REG35'/>"
WRITE #1 "        <register address='0xb872420' value='0x" DATA.LONG(A:0x872420) "' name='RPMH_VRM_VOLTAGE_CRS_DRV7_REG36'/>"
WRITE #1 "        <register address='0xb872520' value='0x" DATA.LONG(A:0x872520) "' name='RPMH_VRM_VOLTAGE_CRS_DRV7_REG37'/>"
WRITE #1 "        <register address='0xb872620' value='0x" DATA.LONG(A:0x872620) "' name='RPMH_VRM_VOLTAGE_CRS_DRV7_REG38'/>"
WRITE #1 "        <register address='0xb872720' value='0x" DATA.LONG(A:0x872720) "' name='RPMH_VRM_VOLTAGE_CRS_DRV7_REG39'/>"
WRITE #1 "        <register address='0xb872820' value='0x" DATA.LONG(A:0x872820) "' name='RPMH_VRM_VOLTAGE_CRS_DRV7_REG40'/>"
WRITE #1 "        <register address='0xb872920' value='0x" DATA.LONG(A:0x872920) "' name='RPMH_VRM_VOLTAGE_CRS_DRV7_REG41'/>"
WRITE #1 "        <register address='0xb872a20' value='0x" DATA.LONG(A:0x872a20) "' name='RPMH_VRM_VOLTAGE_CRS_DRV7_REG42'/>"
WRITE #1 "        <register address='0xb872b20' value='0x" DATA.LONG(A:0x872b20) "' name='RPMH_VRM_VOLTAGE_CRS_DRV7_REG43'/>"
WRITE #1 "        <register address='0xb872c20' value='0x" DATA.LONG(A:0x872c20) "' name='RPMH_VRM_VOLTAGE_CRS_DRV7_REG44'/>"
WRITE #1 "        <register address='0xb872d20' value='0x" DATA.LONG(A:0x872d20) "' name='RPMH_VRM_VOLTAGE_CRS_DRV7_REG45'/>"
WRITE #1 "        <register address='0xb880020' value='0x" DATA.LONG(A:0x880020) "' name='RPMH_VRM_VOLTAGE_CRS_DRV8_REG0'/>"
WRITE #1 "        <register address='0xb880120' value='0x" DATA.LONG(A:0x880120) "' name='RPMH_VRM_VOLTAGE_CRS_DRV8_REG1'/>"
WRITE #1 "        <register address='0xb880220' value='0x" DATA.LONG(A:0x880220) "' name='RPMH_VRM_VOLTAGE_CRS_DRV8_REG2'/>"
WRITE #1 "        <register address='0xb880320' value='0x" DATA.LONG(A:0x880320) "' name='RPMH_VRM_VOLTAGE_CRS_DRV8_REG3'/>"
WRITE #1 "        <register address='0xb880420' value='0x" DATA.LONG(A:0x880420) "' name='RPMH_VRM_VOLTAGE_CRS_DRV8_REG4'/>"
WRITE #1 "        <register address='0xb880520' value='0x" DATA.LONG(A:0x880520) "' name='RPMH_VRM_VOLTAGE_CRS_DRV8_REG5'/>"
WRITE #1 "        <register address='0xb880620' value='0x" DATA.LONG(A:0x880620) "' name='RPMH_VRM_VOLTAGE_CRS_DRV8_REG6'/>"
WRITE #1 "        <register address='0xb880720' value='0x" DATA.LONG(A:0x880720) "' name='RPMH_VRM_VOLTAGE_CRS_DRV8_REG7'/>"
WRITE #1 "        <register address='0xb880820' value='0x" DATA.LONG(A:0x880820) "' name='RPMH_VRM_VOLTAGE_CRS_DRV8_REG8'/>"
WRITE #1 "        <register address='0xb880920' value='0x" DATA.LONG(A:0x880920) "' name='RPMH_VRM_VOLTAGE_CRS_DRV8_REG9'/>"
WRITE #1 "        <register address='0xb880a20' value='0x" DATA.LONG(A:0x880a20) "' name='RPMH_VRM_VOLTAGE_CRS_DRV8_REG10'/>"
WRITE #1 "        <register address='0xb880b20' value='0x" DATA.LONG(A:0x880b20) "' name='RPMH_VRM_VOLTAGE_CRS_DRV8_REG11'/>"
WRITE #1 "        <register address='0xb880c20' value='0x" DATA.LONG(A:0x880c20) "' name='RPMH_VRM_VOLTAGE_CRS_DRV8_REG12'/>"
WRITE #1 "        <register address='0xb880d20' value='0x" DATA.LONG(A:0x880d20) "' name='RPMH_VRM_VOLTAGE_CRS_DRV8_REG13'/>"
WRITE #1 "        <register address='0xb880e20' value='0x" DATA.LONG(A:0x880e20) "' name='RPMH_VRM_VOLTAGE_CRS_DRV8_REG14'/>"
WRITE #1 "        <register address='0xb880f20' value='0x" DATA.LONG(A:0x880f20) "' name='RPMH_VRM_VOLTAGE_CRS_DRV8_REG15'/>"
WRITE #1 "        <register address='0xb881020' value='0x" DATA.LONG(A:0x881020) "' name='RPMH_VRM_VOLTAGE_CRS_DRV8_REG16'/>"
WRITE #1 "        <register address='0xb881120' value='0x" DATA.LONG(A:0x881120) "' name='RPMH_VRM_VOLTAGE_CRS_DRV8_REG17'/>"
WRITE #1 "        <register address='0xb881220' value='0x" DATA.LONG(A:0x881220) "' name='RPMH_VRM_VOLTAGE_CRS_DRV8_REG18'/>"
WRITE #1 "        <register address='0xb881320' value='0x" DATA.LONG(A:0x881320) "' name='RPMH_VRM_VOLTAGE_CRS_DRV8_REG19'/>"
WRITE #1 "        <register address='0xb881420' value='0x" DATA.LONG(A:0x881420) "' name='RPMH_VRM_VOLTAGE_CRS_DRV8_REG20'/>"
WRITE #1 "        <register address='0xb881520' value='0x" DATA.LONG(A:0x881520) "' name='RPMH_VRM_VOLTAGE_CRS_DRV8_REG21'/>"
WRITE #1 "        <register address='0xb881620' value='0x" DATA.LONG(A:0x881620) "' name='RPMH_VRM_VOLTAGE_CRS_DRV8_REG22'/>"
WRITE #1 "        <register address='0xb881720' value='0x" DATA.LONG(A:0x881720) "' name='RPMH_VRM_VOLTAGE_CRS_DRV8_REG23'/>"
WRITE #1 "        <register address='0xb881820' value='0x" DATA.LONG(A:0x881820) "' name='RPMH_VRM_VOLTAGE_CRS_DRV8_REG24'/>"
WRITE #1 "        <register address='0xb881920' value='0x" DATA.LONG(A:0x881920) "' name='RPMH_VRM_VOLTAGE_CRS_DRV8_REG25'/>"
WRITE #1 "        <register address='0xb881a20' value='0x" DATA.LONG(A:0x881a20) "' name='RPMH_VRM_VOLTAGE_CRS_DRV8_REG26'/>"
WRITE #1 "        <register address='0xb881b20' value='0x" DATA.LONG(A:0x881b20) "' name='RPMH_VRM_VOLTAGE_CRS_DRV8_REG27'/>"
WRITE #1 "        <register address='0xb881c20' value='0x" DATA.LONG(A:0x881c20) "' name='RPMH_VRM_VOLTAGE_CRS_DRV8_REG28'/>"
WRITE #1 "        <register address='0xb881d20' value='0x" DATA.LONG(A:0x881d20) "' name='RPMH_VRM_VOLTAGE_CRS_DRV8_REG29'/>"
WRITE #1 "        <register address='0xb881e20' value='0x" DATA.LONG(A:0x881e20) "' name='RPMH_VRM_VOLTAGE_CRS_DRV8_REG30'/>"
WRITE #1 "        <register address='0xb881f20' value='0x" DATA.LONG(A:0x881f20) "' name='RPMH_VRM_VOLTAGE_CRS_DRV8_REG31'/>"
WRITE #1 "        <register address='0xb882020' value='0x" DATA.LONG(A:0x882020) "' name='RPMH_VRM_VOLTAGE_CRS_DRV8_REG32'/>"
WRITE #1 "        <register address='0xb882120' value='0x" DATA.LONG(A:0x882120) "' name='RPMH_VRM_VOLTAGE_CRS_DRV8_REG33'/>"
WRITE #1 "        <register address='0xb882220' value='0x" DATA.LONG(A:0x882220) "' name='RPMH_VRM_VOLTAGE_CRS_DRV8_REG34'/>"
WRITE #1 "        <register address='0xb882320' value='0x" DATA.LONG(A:0x882320) "' name='RPMH_VRM_VOLTAGE_CRS_DRV8_REG35'/>"
WRITE #1 "        <register address='0xb882420' value='0x" DATA.LONG(A:0x882420) "' name='RPMH_VRM_VOLTAGE_CRS_DRV8_REG36'/>"
WRITE #1 "        <register address='0xb882520' value='0x" DATA.LONG(A:0x882520) "' name='RPMH_VRM_VOLTAGE_CRS_DRV8_REG37'/>"
WRITE #1 "        <register address='0xb882620' value='0x" DATA.LONG(A:0x882620) "' name='RPMH_VRM_VOLTAGE_CRS_DRV8_REG38'/>"
WRITE #1 "        <register address='0xb882720' value='0x" DATA.LONG(A:0x882720) "' name='RPMH_VRM_VOLTAGE_CRS_DRV8_REG39'/>"
WRITE #1 "        <register address='0xb882820' value='0x" DATA.LONG(A:0x882820) "' name='RPMH_VRM_VOLTAGE_CRS_DRV8_REG40'/>"
WRITE #1 "        <register address='0xb882920' value='0x" DATA.LONG(A:0x882920) "' name='RPMH_VRM_VOLTAGE_CRS_DRV8_REG41'/>"
WRITE #1 "        <register address='0xb882a20' value='0x" DATA.LONG(A:0x882a20) "' name='RPMH_VRM_VOLTAGE_CRS_DRV8_REG42'/>"
WRITE #1 "        <register address='0xb882b20' value='0x" DATA.LONG(A:0x882b20) "' name='RPMH_VRM_VOLTAGE_CRS_DRV8_REG43'/>"
WRITE #1 "        <register address='0xb882c20' value='0x" DATA.LONG(A:0x882c20) "' name='RPMH_VRM_VOLTAGE_CRS_DRV8_REG44'/>"
WRITE #1 "        <register address='0xb882d20' value='0x" DATA.LONG(A:0x882d20) "' name='RPMH_VRM_VOLTAGE_CRS_DRV8_REG45'/>"
WRITE #1 "        <register address='0xb890020' value='0x" DATA.LONG(A:0x890020) "' name='RPMH_VRM_VOLTAGE_CRS_DRV9_REG0'/>"
WRITE #1 "        <register address='0xb890120' value='0x" DATA.LONG(A:0x890120) "' name='RPMH_VRM_VOLTAGE_CRS_DRV9_REG1'/>"
WRITE #1 "        <register address='0xb890220' value='0x" DATA.LONG(A:0x890220) "' name='RPMH_VRM_VOLTAGE_CRS_DRV9_REG2'/>"
WRITE #1 "        <register address='0xb890320' value='0x" DATA.LONG(A:0x890320) "' name='RPMH_VRM_VOLTAGE_CRS_DRV9_REG3'/>"
WRITE #1 "        <register address='0xb890420' value='0x" DATA.LONG(A:0x890420) "' name='RPMH_VRM_VOLTAGE_CRS_DRV9_REG4'/>"
WRITE #1 "        <register address='0xb890520' value='0x" DATA.LONG(A:0x890520) "' name='RPMH_VRM_VOLTAGE_CRS_DRV9_REG5'/>"
WRITE #1 "        <register address='0xb890620' value='0x" DATA.LONG(A:0x890620) "' name='RPMH_VRM_VOLTAGE_CRS_DRV9_REG6'/>"
WRITE #1 "        <register address='0xb890720' value='0x" DATA.LONG(A:0x890720) "' name='RPMH_VRM_VOLTAGE_CRS_DRV9_REG7'/>"
WRITE #1 "        <register address='0xb890820' value='0x" DATA.LONG(A:0x890820) "' name='RPMH_VRM_VOLTAGE_CRS_DRV9_REG8'/>"
WRITE #1 "        <register address='0xb890920' value='0x" DATA.LONG(A:0x890920) "' name='RPMH_VRM_VOLTAGE_CRS_DRV9_REG9'/>"
WRITE #1 "        <register address='0xb890a20' value='0x" DATA.LONG(A:0x890a20) "' name='RPMH_VRM_VOLTAGE_CRS_DRV9_REG10'/>"
WRITE #1 "        <register address='0xb890b20' value='0x" DATA.LONG(A:0x890b20) "' name='RPMH_VRM_VOLTAGE_CRS_DRV9_REG11'/>"
WRITE #1 "        <register address='0xb890c20' value='0x" DATA.LONG(A:0x890c20) "' name='RPMH_VRM_VOLTAGE_CRS_DRV9_REG12'/>"
WRITE #1 "        <register address='0xb890d20' value='0x" DATA.LONG(A:0x890d20) "' name='RPMH_VRM_VOLTAGE_CRS_DRV9_REG13'/>"
WRITE #1 "        <register address='0xb890e20' value='0x" DATA.LONG(A:0x890e20) "' name='RPMH_VRM_VOLTAGE_CRS_DRV9_REG14'/>"
WRITE #1 "        <register address='0xb890f20' value='0x" DATA.LONG(A:0x890f20) "' name='RPMH_VRM_VOLTAGE_CRS_DRV9_REG15'/>"
WRITE #1 "        <register address='0xb891020' value='0x" DATA.LONG(A:0x891020) "' name='RPMH_VRM_VOLTAGE_CRS_DRV9_REG16'/>"
WRITE #1 "        <register address='0xb891120' value='0x" DATA.LONG(A:0x891120) "' name='RPMH_VRM_VOLTAGE_CRS_DRV9_REG17'/>"
WRITE #1 "        <register address='0xb891220' value='0x" DATA.LONG(A:0x891220) "' name='RPMH_VRM_VOLTAGE_CRS_DRV9_REG18'/>"
WRITE #1 "        <register address='0xb891320' value='0x" DATA.LONG(A:0x891320) "' name='RPMH_VRM_VOLTAGE_CRS_DRV9_REG19'/>"
WRITE #1 "        <register address='0xb891420' value='0x" DATA.LONG(A:0x891420) "' name='RPMH_VRM_VOLTAGE_CRS_DRV9_REG20'/>"
WRITE #1 "        <register address='0xb891520' value='0x" DATA.LONG(A:0x891520) "' name='RPMH_VRM_VOLTAGE_CRS_DRV9_REG21'/>"
WRITE #1 "        <register address='0xb891620' value='0x" DATA.LONG(A:0x891620) "' name='RPMH_VRM_VOLTAGE_CRS_DRV9_REG22'/>"
WRITE #1 "        <register address='0xb891720' value='0x" DATA.LONG(A:0x891720) "' name='RPMH_VRM_VOLTAGE_CRS_DRV9_REG23'/>"
WRITE #1 "        <register address='0xb891820' value='0x" DATA.LONG(A:0x891820) "' name='RPMH_VRM_VOLTAGE_CRS_DRV9_REG24'/>"
WRITE #1 "        <register address='0xb891920' value='0x" DATA.LONG(A:0x891920) "' name='RPMH_VRM_VOLTAGE_CRS_DRV9_REG25'/>"
WRITE #1 "        <register address='0xb891a20' value='0x" DATA.LONG(A:0x891a20) "' name='RPMH_VRM_VOLTAGE_CRS_DRV9_REG26'/>"
WRITE #1 "        <register address='0xb891b20' value='0x" DATA.LONG(A:0x891b20) "' name='RPMH_VRM_VOLTAGE_CRS_DRV9_REG27'/>"
WRITE #1 "        <register address='0xb891c20' value='0x" DATA.LONG(A:0x891c20) "' name='RPMH_VRM_VOLTAGE_CRS_DRV9_REG28'/>"
WRITE #1 "        <register address='0xb891d20' value='0x" DATA.LONG(A:0x891d20) "' name='RPMH_VRM_VOLTAGE_CRS_DRV9_REG29'/>"
WRITE #1 "        <register address='0xb891e20' value='0x" DATA.LONG(A:0x891e20) "' name='RPMH_VRM_VOLTAGE_CRS_DRV9_REG30'/>"
WRITE #1 "        <register address='0xb891f20' value='0x" DATA.LONG(A:0x891f20) "' name='RPMH_VRM_VOLTAGE_CRS_DRV9_REG31'/>"
WRITE #1 "        <register address='0xb892020' value='0x" DATA.LONG(A:0x892020) "' name='RPMH_VRM_VOLTAGE_CRS_DRV9_REG32'/>"
WRITE #1 "        <register address='0xb892120' value='0x" DATA.LONG(A:0x892120) "' name='RPMH_VRM_VOLTAGE_CRS_DRV9_REG33'/>"
WRITE #1 "        <register address='0xb892220' value='0x" DATA.LONG(A:0x892220) "' name='RPMH_VRM_VOLTAGE_CRS_DRV9_REG34'/>"
WRITE #1 "        <register address='0xb892320' value='0x" DATA.LONG(A:0x892320) "' name='RPMH_VRM_VOLTAGE_CRS_DRV9_REG35'/>"
WRITE #1 "        <register address='0xb892420' value='0x" DATA.LONG(A:0x892420) "' name='RPMH_VRM_VOLTAGE_CRS_DRV9_REG36'/>"
WRITE #1 "        <register address='0xb892520' value='0x" DATA.LONG(A:0x892520) "' name='RPMH_VRM_VOLTAGE_CRS_DRV9_REG37'/>"
WRITE #1 "        <register address='0xb892620' value='0x" DATA.LONG(A:0x892620) "' name='RPMH_VRM_VOLTAGE_CRS_DRV9_REG38'/>"
WRITE #1 "        <register address='0xb892720' value='0x" DATA.LONG(A:0x892720) "' name='RPMH_VRM_VOLTAGE_CRS_DRV9_REG39'/>"
WRITE #1 "        <register address='0xb892820' value='0x" DATA.LONG(A:0x892820) "' name='RPMH_VRM_VOLTAGE_CRS_DRV9_REG40'/>"
WRITE #1 "        <register address='0xb892920' value='0x" DATA.LONG(A:0x892920) "' name='RPMH_VRM_VOLTAGE_CRS_DRV9_REG41'/>"
WRITE #1 "        <register address='0xb892a20' value='0x" DATA.LONG(A:0x892a20) "' name='RPMH_VRM_VOLTAGE_CRS_DRV9_REG42'/>"
WRITE #1 "        <register address='0xb892b20' value='0x" DATA.LONG(A:0x892b20) "' name='RPMH_VRM_VOLTAGE_CRS_DRV9_REG43'/>"
WRITE #1 "        <register address='0xb892c20' value='0x" DATA.LONG(A:0x892c20) "' name='RPMH_VRM_VOLTAGE_CRS_DRV9_REG44'/>"
WRITE #1 "        <register address='0xb892d20' value='0x" DATA.LONG(A:0x892d20) "' name='RPMH_VRM_VOLTAGE_CRS_DRV9_REG45'/>"
WRITE #1 "        <register address='0xb8a0020' value='0x" DATA.LONG(A:0x8a0020) "' name='RPMH_VRM_VOLTAGE_CRS_DRV10_REG0'/>"
WRITE #1 "        <register address='0xb8a0120' value='0x" DATA.LONG(A:0x8a0120) "' name='RPMH_VRM_VOLTAGE_CRS_DRV10_REG1'/>"
WRITE #1 "        <register address='0xb8a0220' value='0x" DATA.LONG(A:0x8a0220) "' name='RPMH_VRM_VOLTAGE_CRS_DRV10_REG2'/>"
WRITE #1 "        <register address='0xb8a0320' value='0x" DATA.LONG(A:0x8a0320) "' name='RPMH_VRM_VOLTAGE_CRS_DRV10_REG3'/>"
WRITE #1 "        <register address='0xb8a0420' value='0x" DATA.LONG(A:0x8a0420) "' name='RPMH_VRM_VOLTAGE_CRS_DRV10_REG4'/>"
WRITE #1 "        <register address='0xb8a0520' value='0x" DATA.LONG(A:0x8a0520) "' name='RPMH_VRM_VOLTAGE_CRS_DRV10_REG5'/>"
WRITE #1 "        <register address='0xb8a0620' value='0x" DATA.LONG(A:0x8a0620) "' name='RPMH_VRM_VOLTAGE_CRS_DRV10_REG6'/>"
WRITE #1 "        <register address='0xb8a0720' value='0x" DATA.LONG(A:0x8a0720) "' name='RPMH_VRM_VOLTAGE_CRS_DRV10_REG7'/>"
WRITE #1 "        <register address='0xb8a0820' value='0x" DATA.LONG(A:0x8a0820) "' name='RPMH_VRM_VOLTAGE_CRS_DRV10_REG8'/>"
WRITE #1 "        <register address='0xb8a0920' value='0x" DATA.LONG(A:0x8a0920) "' name='RPMH_VRM_VOLTAGE_CRS_DRV10_REG9'/>"
WRITE #1 "        <register address='0xb8a0a20' value='0x" DATA.LONG(A:0x8a0a20) "' name='RPMH_VRM_VOLTAGE_CRS_DRV10_REG10'/>"
WRITE #1 "        <register address='0xb8a0b20' value='0x" DATA.LONG(A:0x8a0b20) "' name='RPMH_VRM_VOLTAGE_CRS_DRV10_REG11'/>"
WRITE #1 "        <register address='0xb8a0c20' value='0x" DATA.LONG(A:0x8a0c20) "' name='RPMH_VRM_VOLTAGE_CRS_DRV10_REG12'/>"
WRITE #1 "        <register address='0xb8a0d20' value='0x" DATA.LONG(A:0x8a0d20) "' name='RPMH_VRM_VOLTAGE_CRS_DRV10_REG13'/>"
WRITE #1 "        <register address='0xb8a0e20' value='0x" DATA.LONG(A:0x8a0e20) "' name='RPMH_VRM_VOLTAGE_CRS_DRV10_REG14'/>"
WRITE #1 "        <register address='0xb8a0f20' value='0x" DATA.LONG(A:0x8a0f20) "' name='RPMH_VRM_VOLTAGE_CRS_DRV10_REG15'/>"
WRITE #1 "        <register address='0xb8a1020' value='0x" DATA.LONG(A:0x8a1020) "' name='RPMH_VRM_VOLTAGE_CRS_DRV10_REG16'/>"
WRITE #1 "        <register address='0xb8a1120' value='0x" DATA.LONG(A:0x8a1120) "' name='RPMH_VRM_VOLTAGE_CRS_DRV10_REG17'/>"
WRITE #1 "        <register address='0xb8a1220' value='0x" DATA.LONG(A:0x8a1220) "' name='RPMH_VRM_VOLTAGE_CRS_DRV10_REG18'/>"
WRITE #1 "        <register address='0xb8a1320' value='0x" DATA.LONG(A:0x8a1320) "' name='RPMH_VRM_VOLTAGE_CRS_DRV10_REG19'/>"
WRITE #1 "        <register address='0xb8a1420' value='0x" DATA.LONG(A:0x8a1420) "' name='RPMH_VRM_VOLTAGE_CRS_DRV10_REG20'/>"
WRITE #1 "        <register address='0xb8a1520' value='0x" DATA.LONG(A:0x8a1520) "' name='RPMH_VRM_VOLTAGE_CRS_DRV10_REG21'/>"
WRITE #1 "        <register address='0xb8a1620' value='0x" DATA.LONG(A:0x8a1620) "' name='RPMH_VRM_VOLTAGE_CRS_DRV10_REG22'/>"
WRITE #1 "        <register address='0xb8a1720' value='0x" DATA.LONG(A:0x8a1720) "' name='RPMH_VRM_VOLTAGE_CRS_DRV10_REG23'/>"
WRITE #1 "        <register address='0xb8a1820' value='0x" DATA.LONG(A:0x8a1820) "' name='RPMH_VRM_VOLTAGE_CRS_DRV10_REG24'/>"
WRITE #1 "        <register address='0xb8a1920' value='0x" DATA.LONG(A:0x8a1920) "' name='RPMH_VRM_VOLTAGE_CRS_DRV10_REG25'/>"
WRITE #1 "        <register address='0xb8a1a20' value='0x" DATA.LONG(A:0x8a1a20) "' name='RPMH_VRM_VOLTAGE_CRS_DRV10_REG26'/>"
WRITE #1 "        <register address='0xb8a1b20' value='0x" DATA.LONG(A:0x8a1b20) "' name='RPMH_VRM_VOLTAGE_CRS_DRV10_REG27'/>"
WRITE #1 "        <register address='0xb8a1c20' value='0x" DATA.LONG(A:0x8a1c20) "' name='RPMH_VRM_VOLTAGE_CRS_DRV10_REG28'/>"
WRITE #1 "        <register address='0xb8a1d20' value='0x" DATA.LONG(A:0x8a1d20) "' name='RPMH_VRM_VOLTAGE_CRS_DRV10_REG29'/>"
WRITE #1 "        <register address='0xb8a1e20' value='0x" DATA.LONG(A:0x8a1e20) "' name='RPMH_VRM_VOLTAGE_CRS_DRV10_REG30'/>"
WRITE #1 "        <register address='0xb8a1f20' value='0x" DATA.LONG(A:0x8a1f20) "' name='RPMH_VRM_VOLTAGE_CRS_DRV10_REG31'/>"
WRITE #1 "        <register address='0xb8a2020' value='0x" DATA.LONG(A:0x8a2020) "' name='RPMH_VRM_VOLTAGE_CRS_DRV10_REG32'/>"
WRITE #1 "        <register address='0xb8a2120' value='0x" DATA.LONG(A:0x8a2120) "' name='RPMH_VRM_VOLTAGE_CRS_DRV10_REG33'/>"
WRITE #1 "        <register address='0xb8a2220' value='0x" DATA.LONG(A:0x8a2220) "' name='RPMH_VRM_VOLTAGE_CRS_DRV10_REG34'/>"
WRITE #1 "        <register address='0xb8a2320' value='0x" DATA.LONG(A:0x8a2320) "' name='RPMH_VRM_VOLTAGE_CRS_DRV10_REG35'/>"
WRITE #1 "        <register address='0xb8a2420' value='0x" DATA.LONG(A:0x8a2420) "' name='RPMH_VRM_VOLTAGE_CRS_DRV10_REG36'/>"
WRITE #1 "        <register address='0xb8a2520' value='0x" DATA.LONG(A:0x8a2520) "' name='RPMH_VRM_VOLTAGE_CRS_DRV10_REG37'/>"
WRITE #1 "        <register address='0xb8a2620' value='0x" DATA.LONG(A:0x8a2620) "' name='RPMH_VRM_VOLTAGE_CRS_DRV10_REG38'/>"
WRITE #1 "        <register address='0xb8a2720' value='0x" DATA.LONG(A:0x8a2720) "' name='RPMH_VRM_VOLTAGE_CRS_DRV10_REG39'/>"
WRITE #1 "        <register address='0xb8a2820' value='0x" DATA.LONG(A:0x8a2820) "' name='RPMH_VRM_VOLTAGE_CRS_DRV10_REG40'/>"
WRITE #1 "        <register address='0xb8a2920' value='0x" DATA.LONG(A:0x8a2920) "' name='RPMH_VRM_VOLTAGE_CRS_DRV10_REG41'/>"
WRITE #1 "        <register address='0xb8a2a20' value='0x" DATA.LONG(A:0x8a2a20) "' name='RPMH_VRM_VOLTAGE_CRS_DRV10_REG42'/>"
WRITE #1 "        <register address='0xb8a2b20' value='0x" DATA.LONG(A:0x8a2b20) "' name='RPMH_VRM_VOLTAGE_CRS_DRV10_REG43'/>"
WRITE #1 "        <register address='0xb8a2c20' value='0x" DATA.LONG(A:0x8a2c20) "' name='RPMH_VRM_VOLTAGE_CRS_DRV10_REG44'/>"
WRITE #1 "        <register address='0xb8a2d20' value='0x" DATA.LONG(A:0x8a2d20) "' name='RPMH_VRM_VOLTAGE_CRS_DRV10_REG45'/>"
WRITE #1 "        <register address='0xb8b0020' value='0x" DATA.LONG(A:0x8b0020) "' name='RPMH_VRM_VOLTAGE_CRS_DRV11_REG0'/>"
WRITE #1 "        <register address='0xb8b0120' value='0x" DATA.LONG(A:0x8b0120) "' name='RPMH_VRM_VOLTAGE_CRS_DRV11_REG1'/>"
WRITE #1 "        <register address='0xb8b0220' value='0x" DATA.LONG(A:0x8b0220) "' name='RPMH_VRM_VOLTAGE_CRS_DRV11_REG2'/>"
WRITE #1 "        <register address='0xb8b0320' value='0x" DATA.LONG(A:0x8b0320) "' name='RPMH_VRM_VOLTAGE_CRS_DRV11_REG3'/>"
WRITE #1 "        <register address='0xb8b0420' value='0x" DATA.LONG(A:0x8b0420) "' name='RPMH_VRM_VOLTAGE_CRS_DRV11_REG4'/>"
WRITE #1 "        <register address='0xb8b0520' value='0x" DATA.LONG(A:0x8b0520) "' name='RPMH_VRM_VOLTAGE_CRS_DRV11_REG5'/>"
WRITE #1 "        <register address='0xb8b0620' value='0x" DATA.LONG(A:0x8b0620) "' name='RPMH_VRM_VOLTAGE_CRS_DRV11_REG6'/>"
WRITE #1 "        <register address='0xb8b0720' value='0x" DATA.LONG(A:0x8b0720) "' name='RPMH_VRM_VOLTAGE_CRS_DRV11_REG7'/>"
WRITE #1 "        <register address='0xb8b0820' value='0x" DATA.LONG(A:0x8b0820) "' name='RPMH_VRM_VOLTAGE_CRS_DRV11_REG8'/>"
WRITE #1 "        <register address='0xb8b0920' value='0x" DATA.LONG(A:0x8b0920) "' name='RPMH_VRM_VOLTAGE_CRS_DRV11_REG9'/>"
WRITE #1 "        <register address='0xb8b0a20' value='0x" DATA.LONG(A:0x8b0a20) "' name='RPMH_VRM_VOLTAGE_CRS_DRV11_REG10'/>"
WRITE #1 "        <register address='0xb8b0b20' value='0x" DATA.LONG(A:0x8b0b20) "' name='RPMH_VRM_VOLTAGE_CRS_DRV11_REG11'/>"
WRITE #1 "        <register address='0xb8b0c20' value='0x" DATA.LONG(A:0x8b0c20) "' name='RPMH_VRM_VOLTAGE_CRS_DRV11_REG12'/>"
WRITE #1 "        <register address='0xb8b0d20' value='0x" DATA.LONG(A:0x8b0d20) "' name='RPMH_VRM_VOLTAGE_CRS_DRV11_REG13'/>"
WRITE #1 "        <register address='0xb8b0e20' value='0x" DATA.LONG(A:0x8b0e20) "' name='RPMH_VRM_VOLTAGE_CRS_DRV11_REG14'/>"
WRITE #1 "        <register address='0xb8b0f20' value='0x" DATA.LONG(A:0x8b0f20) "' name='RPMH_VRM_VOLTAGE_CRS_DRV11_REG15'/>"
WRITE #1 "        <register address='0xb8b1020' value='0x" DATA.LONG(A:0x8b1020) "' name='RPMH_VRM_VOLTAGE_CRS_DRV11_REG16'/>"
WRITE #1 "        <register address='0xb8b1120' value='0x" DATA.LONG(A:0x8b1120) "' name='RPMH_VRM_VOLTAGE_CRS_DRV11_REG17'/>"
WRITE #1 "        <register address='0xb8b1220' value='0x" DATA.LONG(A:0x8b1220) "' name='RPMH_VRM_VOLTAGE_CRS_DRV11_REG18'/>"
WRITE #1 "        <register address='0xb8b1320' value='0x" DATA.LONG(A:0x8b1320) "' name='RPMH_VRM_VOLTAGE_CRS_DRV11_REG19'/>"
WRITE #1 "        <register address='0xb8b1420' value='0x" DATA.LONG(A:0x8b1420) "' name='RPMH_VRM_VOLTAGE_CRS_DRV11_REG20'/>"
WRITE #1 "        <register address='0xb8b1520' value='0x" DATA.LONG(A:0x8b1520) "' name='RPMH_VRM_VOLTAGE_CRS_DRV11_REG21'/>"
WRITE #1 "        <register address='0xb8b1620' value='0x" DATA.LONG(A:0x8b1620) "' name='RPMH_VRM_VOLTAGE_CRS_DRV11_REG22'/>"
WRITE #1 "        <register address='0xb8b1720' value='0x" DATA.LONG(A:0x8b1720) "' name='RPMH_VRM_VOLTAGE_CRS_DRV11_REG23'/>"
WRITE #1 "        <register address='0xb8b1820' value='0x" DATA.LONG(A:0x8b1820) "' name='RPMH_VRM_VOLTAGE_CRS_DRV11_REG24'/>"
WRITE #1 "        <register address='0xb8b1920' value='0x" DATA.LONG(A:0x8b1920) "' name='RPMH_VRM_VOLTAGE_CRS_DRV11_REG25'/>"
WRITE #1 "        <register address='0xb8b1a20' value='0x" DATA.LONG(A:0x8b1a20) "' name='RPMH_VRM_VOLTAGE_CRS_DRV11_REG26'/>"
WRITE #1 "        <register address='0xb8b1b20' value='0x" DATA.LONG(A:0x8b1b20) "' name='RPMH_VRM_VOLTAGE_CRS_DRV11_REG27'/>"
WRITE #1 "        <register address='0xb8b1c20' value='0x" DATA.LONG(A:0x8b1c20) "' name='RPMH_VRM_VOLTAGE_CRS_DRV11_REG28'/>"
WRITE #1 "        <register address='0xb8b1d20' value='0x" DATA.LONG(A:0x8b1d20) "' name='RPMH_VRM_VOLTAGE_CRS_DRV11_REG29'/>"
WRITE #1 "        <register address='0xb8b1e20' value='0x" DATA.LONG(A:0x8b1e20) "' name='RPMH_VRM_VOLTAGE_CRS_DRV11_REG30'/>"
WRITE #1 "        <register address='0xb8b1f20' value='0x" DATA.LONG(A:0x8b1f20) "' name='RPMH_VRM_VOLTAGE_CRS_DRV11_REG31'/>"
WRITE #1 "        <register address='0xb8b2020' value='0x" DATA.LONG(A:0x8b2020) "' name='RPMH_VRM_VOLTAGE_CRS_DRV11_REG32'/>"
WRITE #1 "        <register address='0xb8b2120' value='0x" DATA.LONG(A:0x8b2120) "' name='RPMH_VRM_VOLTAGE_CRS_DRV11_REG33'/>"
WRITE #1 "        <register address='0xb8b2220' value='0x" DATA.LONG(A:0x8b2220) "' name='RPMH_VRM_VOLTAGE_CRS_DRV11_REG34'/>"
WRITE #1 "        <register address='0xb8b2320' value='0x" DATA.LONG(A:0x8b2320) "' name='RPMH_VRM_VOLTAGE_CRS_DRV11_REG35'/>"
WRITE #1 "        <register address='0xb8b2420' value='0x" DATA.LONG(A:0x8b2420) "' name='RPMH_VRM_VOLTAGE_CRS_DRV11_REG36'/>"
WRITE #1 "        <register address='0xb8b2520' value='0x" DATA.LONG(A:0x8b2520) "' name='RPMH_VRM_VOLTAGE_CRS_DRV11_REG37'/>"
WRITE #1 "        <register address='0xb8b2620' value='0x" DATA.LONG(A:0x8b2620) "' name='RPMH_VRM_VOLTAGE_CRS_DRV11_REG38'/>"
WRITE #1 "        <register address='0xb8b2720' value='0x" DATA.LONG(A:0x8b2720) "' name='RPMH_VRM_VOLTAGE_CRS_DRV11_REG39'/>"
WRITE #1 "        <register address='0xb8b2820' value='0x" DATA.LONG(A:0x8b2820) "' name='RPMH_VRM_VOLTAGE_CRS_DRV11_REG40'/>"
WRITE #1 "        <register address='0xb8b2920' value='0x" DATA.LONG(A:0x8b2920) "' name='RPMH_VRM_VOLTAGE_CRS_DRV11_REG41'/>"
WRITE #1 "        <register address='0xb8b2a20' value='0x" DATA.LONG(A:0x8b2a20) "' name='RPMH_VRM_VOLTAGE_CRS_DRV11_REG42'/>"
WRITE #1 "        <register address='0xb8b2b20' value='0x" DATA.LONG(A:0x8b2b20) "' name='RPMH_VRM_VOLTAGE_CRS_DRV11_REG43'/>"
WRITE #1 "        <register address='0xb8b2c20' value='0x" DATA.LONG(A:0x8b2c20) "' name='RPMH_VRM_VOLTAGE_CRS_DRV11_REG44'/>"
WRITE #1 "        <register address='0xb8b2d20' value='0x" DATA.LONG(A:0x8b2d20) "' name='RPMH_VRM_VOLTAGE_CRS_DRV11_REG45'/>"
WRITE #1 "        <register address='0xb800024' value='0x" DATA.LONG(A:0x800024) "' name='RPMH_VRM_ENABLE_CRS_DRV0_REG0'/>"
WRITE #1 "        <register address='0xb800124' value='0x" DATA.LONG(A:0x800124) "' name='RPMH_VRM_ENABLE_CRS_DRV0_REG1'/>"
WRITE #1 "        <register address='0xb800224' value='0x" DATA.LONG(A:0x800224) "' name='RPMH_VRM_ENABLE_CRS_DRV0_REG2'/>"
WRITE #1 "        <register address='0xb800324' value='0x" DATA.LONG(A:0x800324) "' name='RPMH_VRM_ENABLE_CRS_DRV0_REG3'/>"
WRITE #1 "        <register address='0xb800424' value='0x" DATA.LONG(A:0x800424) "' name='RPMH_VRM_ENABLE_CRS_DRV0_REG4'/>"
WRITE #1 "        <register address='0xb800524' value='0x" DATA.LONG(A:0x800524) "' name='RPMH_VRM_ENABLE_CRS_DRV0_REG5'/>"
WRITE #1 "        <register address='0xb800624' value='0x" DATA.LONG(A:0x800624) "' name='RPMH_VRM_ENABLE_CRS_DRV0_REG6'/>"
WRITE #1 "        <register address='0xb800724' value='0x" DATA.LONG(A:0x800724) "' name='RPMH_VRM_ENABLE_CRS_DRV0_REG7'/>"
WRITE #1 "        <register address='0xb800824' value='0x" DATA.LONG(A:0x800824) "' name='RPMH_VRM_ENABLE_CRS_DRV0_REG8'/>"
WRITE #1 "        <register address='0xb800924' value='0x" DATA.LONG(A:0x800924) "' name='RPMH_VRM_ENABLE_CRS_DRV0_REG9'/>"
WRITE #1 "        <register address='0xb800a24' value='0x" DATA.LONG(A:0x800a24) "' name='RPMH_VRM_ENABLE_CRS_DRV0_REG10'/>"
WRITE #1 "        <register address='0xb800b24' value='0x" DATA.LONG(A:0x800b24) "' name='RPMH_VRM_ENABLE_CRS_DRV0_REG11'/>"
WRITE #1 "        <register address='0xb800c24' value='0x" DATA.LONG(A:0x800c24) "' name='RPMH_VRM_ENABLE_CRS_DRV0_REG12'/>"
WRITE #1 "        <register address='0xb800d24' value='0x" DATA.LONG(A:0x800d24) "' name='RPMH_VRM_ENABLE_CRS_DRV0_REG13'/>"
WRITE #1 "        <register address='0xb800e24' value='0x" DATA.LONG(A:0x800e24) "' name='RPMH_VRM_ENABLE_CRS_DRV0_REG14'/>"
WRITE #1 "        <register address='0xb800f24' value='0x" DATA.LONG(A:0x800f24) "' name='RPMH_VRM_ENABLE_CRS_DRV0_REG15'/>"
WRITE #1 "        <register address='0xb801024' value='0x" DATA.LONG(A:0x801024) "' name='RPMH_VRM_ENABLE_CRS_DRV0_REG16'/>"
WRITE #1 "        <register address='0xb801124' value='0x" DATA.LONG(A:0x801124) "' name='RPMH_VRM_ENABLE_CRS_DRV0_REG17'/>"
WRITE #1 "        <register address='0xb801224' value='0x" DATA.LONG(A:0x801224) "' name='RPMH_VRM_ENABLE_CRS_DRV0_REG18'/>"
WRITE #1 "        <register address='0xb801324' value='0x" DATA.LONG(A:0x801324) "' name='RPMH_VRM_ENABLE_CRS_DRV0_REG19'/>"
WRITE #1 "        <register address='0xb801424' value='0x" DATA.LONG(A:0x801424) "' name='RPMH_VRM_ENABLE_CRS_DRV0_REG20'/>"
WRITE #1 "        <register address='0xb801524' value='0x" DATA.LONG(A:0x801524) "' name='RPMH_VRM_ENABLE_CRS_DRV0_REG21'/>"
WRITE #1 "        <register address='0xb801624' value='0x" DATA.LONG(A:0x801624) "' name='RPMH_VRM_ENABLE_CRS_DRV0_REG22'/>"
WRITE #1 "        <register address='0xb801724' value='0x" DATA.LONG(A:0x801724) "' name='RPMH_VRM_ENABLE_CRS_DRV0_REG23'/>"
WRITE #1 "        <register address='0xb801824' value='0x" DATA.LONG(A:0x801824) "' name='RPMH_VRM_ENABLE_CRS_DRV0_REG24'/>"
WRITE #1 "        <register address='0xb801924' value='0x" DATA.LONG(A:0x801924) "' name='RPMH_VRM_ENABLE_CRS_DRV0_REG25'/>"
WRITE #1 "        <register address='0xb801a24' value='0x" DATA.LONG(A:0x801a24) "' name='RPMH_VRM_ENABLE_CRS_DRV0_REG26'/>"
WRITE #1 "        <register address='0xb801b24' value='0x" DATA.LONG(A:0x801b24) "' name='RPMH_VRM_ENABLE_CRS_DRV0_REG27'/>"
WRITE #1 "        <register address='0xb801c24' value='0x" DATA.LONG(A:0x801c24) "' name='RPMH_VRM_ENABLE_CRS_DRV0_REG28'/>"
WRITE #1 "        <register address='0xb801d24' value='0x" DATA.LONG(A:0x801d24) "' name='RPMH_VRM_ENABLE_CRS_DRV0_REG29'/>"
WRITE #1 "        <register address='0xb801e24' value='0x" DATA.LONG(A:0x801e24) "' name='RPMH_VRM_ENABLE_CRS_DRV0_REG30'/>"
WRITE #1 "        <register address='0xb801f24' value='0x" DATA.LONG(A:0x801f24) "' name='RPMH_VRM_ENABLE_CRS_DRV0_REG31'/>"
WRITE #1 "        <register address='0xb802024' value='0x" DATA.LONG(A:0x802024) "' name='RPMH_VRM_ENABLE_CRS_DRV0_REG32'/>"
WRITE #1 "        <register address='0xb802124' value='0x" DATA.LONG(A:0x802124) "' name='RPMH_VRM_ENABLE_CRS_DRV0_REG33'/>"
WRITE #1 "        <register address='0xb802224' value='0x" DATA.LONG(A:0x802224) "' name='RPMH_VRM_ENABLE_CRS_DRV0_REG34'/>"
WRITE #1 "        <register address='0xb802324' value='0x" DATA.LONG(A:0x802324) "' name='RPMH_VRM_ENABLE_CRS_DRV0_REG35'/>"
WRITE #1 "        <register address='0xb802424' value='0x" DATA.LONG(A:0x802424) "' name='RPMH_VRM_ENABLE_CRS_DRV0_REG36'/>"
WRITE #1 "        <register address='0xb802524' value='0x" DATA.LONG(A:0x802524) "' name='RPMH_VRM_ENABLE_CRS_DRV0_REG37'/>"
WRITE #1 "        <register address='0xb802624' value='0x" DATA.LONG(A:0x802624) "' name='RPMH_VRM_ENABLE_CRS_DRV0_REG38'/>"
WRITE #1 "        <register address='0xb802724' value='0x" DATA.LONG(A:0x802724) "' name='RPMH_VRM_ENABLE_CRS_DRV0_REG39'/>"
WRITE #1 "        <register address='0xb802824' value='0x" DATA.LONG(A:0x802824) "' name='RPMH_VRM_ENABLE_CRS_DRV0_REG40'/>"
WRITE #1 "        <register address='0xb802924' value='0x" DATA.LONG(A:0x802924) "' name='RPMH_VRM_ENABLE_CRS_DRV0_REG41'/>"
WRITE #1 "        <register address='0xb802a24' value='0x" DATA.LONG(A:0x802a24) "' name='RPMH_VRM_ENABLE_CRS_DRV0_REG42'/>"
WRITE #1 "        <register address='0xb802b24' value='0x" DATA.LONG(A:0x802b24) "' name='RPMH_VRM_ENABLE_CRS_DRV0_REG43'/>"
WRITE #1 "        <register address='0xb802c24' value='0x" DATA.LONG(A:0x802c24) "' name='RPMH_VRM_ENABLE_CRS_DRV0_REG44'/>"
WRITE #1 "        <register address='0xb802d24' value='0x" DATA.LONG(A:0x802d24) "' name='RPMH_VRM_ENABLE_CRS_DRV0_REG45'/>"
WRITE #1 "        <register address='0xb810024' value='0x" DATA.LONG(A:0x810024) "' name='RPMH_VRM_ENABLE_CRS_DRV1_REG0'/>"
WRITE #1 "        <register address='0xb810124' value='0x" DATA.LONG(A:0x810124) "' name='RPMH_VRM_ENABLE_CRS_DRV1_REG1'/>"
WRITE #1 "        <register address='0xb810224' value='0x" DATA.LONG(A:0x810224) "' name='RPMH_VRM_ENABLE_CRS_DRV1_REG2'/>"
WRITE #1 "        <register address='0xb810324' value='0x" DATA.LONG(A:0x810324) "' name='RPMH_VRM_ENABLE_CRS_DRV1_REG3'/>"
WRITE #1 "        <register address='0xb810424' value='0x" DATA.LONG(A:0x810424) "' name='RPMH_VRM_ENABLE_CRS_DRV1_REG4'/>"
WRITE #1 "        <register address='0xb810524' value='0x" DATA.LONG(A:0x810524) "' name='RPMH_VRM_ENABLE_CRS_DRV1_REG5'/>"
WRITE #1 "        <register address='0xb810624' value='0x" DATA.LONG(A:0x810624) "' name='RPMH_VRM_ENABLE_CRS_DRV1_REG6'/>"
WRITE #1 "        <register address='0xb810724' value='0x" DATA.LONG(A:0x810724) "' name='RPMH_VRM_ENABLE_CRS_DRV1_REG7'/>"
WRITE #1 "        <register address='0xb810824' value='0x" DATA.LONG(A:0x810824) "' name='RPMH_VRM_ENABLE_CRS_DRV1_REG8'/>"
WRITE #1 "        <register address='0xb810924' value='0x" DATA.LONG(A:0x810924) "' name='RPMH_VRM_ENABLE_CRS_DRV1_REG9'/>"
WRITE #1 "        <register address='0xb810a24' value='0x" DATA.LONG(A:0x810a24) "' name='RPMH_VRM_ENABLE_CRS_DRV1_REG10'/>"
WRITE #1 "        <register address='0xb810b24' value='0x" DATA.LONG(A:0x810b24) "' name='RPMH_VRM_ENABLE_CRS_DRV1_REG11'/>"
WRITE #1 "        <register address='0xb810c24' value='0x" DATA.LONG(A:0x810c24) "' name='RPMH_VRM_ENABLE_CRS_DRV1_REG12'/>"
WRITE #1 "        <register address='0xb810d24' value='0x" DATA.LONG(A:0x810d24) "' name='RPMH_VRM_ENABLE_CRS_DRV1_REG13'/>"
WRITE #1 "        <register address='0xb810e24' value='0x" DATA.LONG(A:0x810e24) "' name='RPMH_VRM_ENABLE_CRS_DRV1_REG14'/>"
WRITE #1 "        <register address='0xb810f24' value='0x" DATA.LONG(A:0x810f24) "' name='RPMH_VRM_ENABLE_CRS_DRV1_REG15'/>"
WRITE #1 "        <register address='0xb811024' value='0x" DATA.LONG(A:0x811024) "' name='RPMH_VRM_ENABLE_CRS_DRV1_REG16'/>"
WRITE #1 "        <register address='0xb811124' value='0x" DATA.LONG(A:0x811124) "' name='RPMH_VRM_ENABLE_CRS_DRV1_REG17'/>"
WRITE #1 "        <register address='0xb811224' value='0x" DATA.LONG(A:0x811224) "' name='RPMH_VRM_ENABLE_CRS_DRV1_REG18'/>"
WRITE #1 "        <register address='0xb811324' value='0x" DATA.LONG(A:0x811324) "' name='RPMH_VRM_ENABLE_CRS_DRV1_REG19'/>"
WRITE #1 "        <register address='0xb811424' value='0x" DATA.LONG(A:0x811424) "' name='RPMH_VRM_ENABLE_CRS_DRV1_REG20'/>"
WRITE #1 "        <register address='0xb811524' value='0x" DATA.LONG(A:0x811524) "' name='RPMH_VRM_ENABLE_CRS_DRV1_REG21'/>"
WRITE #1 "        <register address='0xb811624' value='0x" DATA.LONG(A:0x811624) "' name='RPMH_VRM_ENABLE_CRS_DRV1_REG22'/>"
WRITE #1 "        <register address='0xb811724' value='0x" DATA.LONG(A:0x811724) "' name='RPMH_VRM_ENABLE_CRS_DRV1_REG23'/>"
WRITE #1 "        <register address='0xb811824' value='0x" DATA.LONG(A:0x811824) "' name='RPMH_VRM_ENABLE_CRS_DRV1_REG24'/>"
WRITE #1 "        <register address='0xb811924' value='0x" DATA.LONG(A:0x811924) "' name='RPMH_VRM_ENABLE_CRS_DRV1_REG25'/>"
WRITE #1 "        <register address='0xb811a24' value='0x" DATA.LONG(A:0x811a24) "' name='RPMH_VRM_ENABLE_CRS_DRV1_REG26'/>"
WRITE #1 "        <register address='0xb811b24' value='0x" DATA.LONG(A:0x811b24) "' name='RPMH_VRM_ENABLE_CRS_DRV1_REG27'/>"
WRITE #1 "        <register address='0xb811c24' value='0x" DATA.LONG(A:0x811c24) "' name='RPMH_VRM_ENABLE_CRS_DRV1_REG28'/>"
WRITE #1 "        <register address='0xb811d24' value='0x" DATA.LONG(A:0x811d24) "' name='RPMH_VRM_ENABLE_CRS_DRV1_REG29'/>"
WRITE #1 "        <register address='0xb811e24' value='0x" DATA.LONG(A:0x811e24) "' name='RPMH_VRM_ENABLE_CRS_DRV1_REG30'/>"
WRITE #1 "        <register address='0xb811f24' value='0x" DATA.LONG(A:0x811f24) "' name='RPMH_VRM_ENABLE_CRS_DRV1_REG31'/>"
WRITE #1 "        <register address='0xb812024' value='0x" DATA.LONG(A:0x812024) "' name='RPMH_VRM_ENABLE_CRS_DRV1_REG32'/>"
WRITE #1 "        <register address='0xb812124' value='0x" DATA.LONG(A:0x812124) "' name='RPMH_VRM_ENABLE_CRS_DRV1_REG33'/>"
WRITE #1 "        <register address='0xb812224' value='0x" DATA.LONG(A:0x812224) "' name='RPMH_VRM_ENABLE_CRS_DRV1_REG34'/>"
WRITE #1 "        <register address='0xb812324' value='0x" DATA.LONG(A:0x812324) "' name='RPMH_VRM_ENABLE_CRS_DRV1_REG35'/>"
WRITE #1 "        <register address='0xb812424' value='0x" DATA.LONG(A:0x812424) "' name='RPMH_VRM_ENABLE_CRS_DRV1_REG36'/>"
WRITE #1 "        <register address='0xb812524' value='0x" DATA.LONG(A:0x812524) "' name='RPMH_VRM_ENABLE_CRS_DRV1_REG37'/>"
WRITE #1 "        <register address='0xb812624' value='0x" DATA.LONG(A:0x812624) "' name='RPMH_VRM_ENABLE_CRS_DRV1_REG38'/>"
WRITE #1 "        <register address='0xb812724' value='0x" DATA.LONG(A:0x812724) "' name='RPMH_VRM_ENABLE_CRS_DRV1_REG39'/>"
WRITE #1 "        <register address='0xb812824' value='0x" DATA.LONG(A:0x812824) "' name='RPMH_VRM_ENABLE_CRS_DRV1_REG40'/>"
WRITE #1 "        <register address='0xb812924' value='0x" DATA.LONG(A:0x812924) "' name='RPMH_VRM_ENABLE_CRS_DRV1_REG41'/>"
WRITE #1 "        <register address='0xb812a24' value='0x" DATA.LONG(A:0x812a24) "' name='RPMH_VRM_ENABLE_CRS_DRV1_REG42'/>"
WRITE #1 "        <register address='0xb812b24' value='0x" DATA.LONG(A:0x812b24) "' name='RPMH_VRM_ENABLE_CRS_DRV1_REG43'/>"
WRITE #1 "        <register address='0xb812c24' value='0x" DATA.LONG(A:0x812c24) "' name='RPMH_VRM_ENABLE_CRS_DRV1_REG44'/>"
WRITE #1 "        <register address='0xb812d24' value='0x" DATA.LONG(A:0x812d24) "' name='RPMH_VRM_ENABLE_CRS_DRV1_REG45'/>"
WRITE #1 "        <register address='0xb820024' value='0x" DATA.LONG(A:0x820024) "' name='RPMH_VRM_ENABLE_CRS_DRV2_REG0'/>"
WRITE #1 "        <register address='0xb820124' value='0x" DATA.LONG(A:0x820124) "' name='RPMH_VRM_ENABLE_CRS_DRV2_REG1'/>"
WRITE #1 "        <register address='0xb820224' value='0x" DATA.LONG(A:0x820224) "' name='RPMH_VRM_ENABLE_CRS_DRV2_REG2'/>"
WRITE #1 "        <register address='0xb820324' value='0x" DATA.LONG(A:0x820324) "' name='RPMH_VRM_ENABLE_CRS_DRV2_REG3'/>"
WRITE #1 "        <register address='0xb820424' value='0x" DATA.LONG(A:0x820424) "' name='RPMH_VRM_ENABLE_CRS_DRV2_REG4'/>"
WRITE #1 "        <register address='0xb820524' value='0x" DATA.LONG(A:0x820524) "' name='RPMH_VRM_ENABLE_CRS_DRV2_REG5'/>"
WRITE #1 "        <register address='0xb820624' value='0x" DATA.LONG(A:0x820624) "' name='RPMH_VRM_ENABLE_CRS_DRV2_REG6'/>"
WRITE #1 "        <register address='0xb820724' value='0x" DATA.LONG(A:0x820724) "' name='RPMH_VRM_ENABLE_CRS_DRV2_REG7'/>"
WRITE #1 "        <register address='0xb820824' value='0x" DATA.LONG(A:0x820824) "' name='RPMH_VRM_ENABLE_CRS_DRV2_REG8'/>"
WRITE #1 "        <register address='0xb820924' value='0x" DATA.LONG(A:0x820924) "' name='RPMH_VRM_ENABLE_CRS_DRV2_REG9'/>"
WRITE #1 "        <register address='0xb820a24' value='0x" DATA.LONG(A:0x820a24) "' name='RPMH_VRM_ENABLE_CRS_DRV2_REG10'/>"
WRITE #1 "        <register address='0xb820b24' value='0x" DATA.LONG(A:0x820b24) "' name='RPMH_VRM_ENABLE_CRS_DRV2_REG11'/>"
WRITE #1 "        <register address='0xb820c24' value='0x" DATA.LONG(A:0x820c24) "' name='RPMH_VRM_ENABLE_CRS_DRV2_REG12'/>"
WRITE #1 "        <register address='0xb820d24' value='0x" DATA.LONG(A:0x820d24) "' name='RPMH_VRM_ENABLE_CRS_DRV2_REG13'/>"
WRITE #1 "        <register address='0xb820e24' value='0x" DATA.LONG(A:0x820e24) "' name='RPMH_VRM_ENABLE_CRS_DRV2_REG14'/>"
WRITE #1 "        <register address='0xb820f24' value='0x" DATA.LONG(A:0x820f24) "' name='RPMH_VRM_ENABLE_CRS_DRV2_REG15'/>"
WRITE #1 "        <register address='0xb821024' value='0x" DATA.LONG(A:0x821024) "' name='RPMH_VRM_ENABLE_CRS_DRV2_REG16'/>"
WRITE #1 "        <register address='0xb821124' value='0x" DATA.LONG(A:0x821124) "' name='RPMH_VRM_ENABLE_CRS_DRV2_REG17'/>"
WRITE #1 "        <register address='0xb821224' value='0x" DATA.LONG(A:0x821224) "' name='RPMH_VRM_ENABLE_CRS_DRV2_REG18'/>"
WRITE #1 "        <register address='0xb821324' value='0x" DATA.LONG(A:0x821324) "' name='RPMH_VRM_ENABLE_CRS_DRV2_REG19'/>"
WRITE #1 "        <register address='0xb821424' value='0x" DATA.LONG(A:0x821424) "' name='RPMH_VRM_ENABLE_CRS_DRV2_REG20'/>"
WRITE #1 "        <register address='0xb821524' value='0x" DATA.LONG(A:0x821524) "' name='RPMH_VRM_ENABLE_CRS_DRV2_REG21'/>"
WRITE #1 "        <register address='0xb821624' value='0x" DATA.LONG(A:0x821624) "' name='RPMH_VRM_ENABLE_CRS_DRV2_REG22'/>"
WRITE #1 "        <register address='0xb821724' value='0x" DATA.LONG(A:0x821724) "' name='RPMH_VRM_ENABLE_CRS_DRV2_REG23'/>"
WRITE #1 "        <register address='0xb821824' value='0x" DATA.LONG(A:0x821824) "' name='RPMH_VRM_ENABLE_CRS_DRV2_REG24'/>"
WRITE #1 "        <register address='0xb821924' value='0x" DATA.LONG(A:0x821924) "' name='RPMH_VRM_ENABLE_CRS_DRV2_REG25'/>"
WRITE #1 "        <register address='0xb821a24' value='0x" DATA.LONG(A:0x821a24) "' name='RPMH_VRM_ENABLE_CRS_DRV2_REG26'/>"
WRITE #1 "        <register address='0xb821b24' value='0x" DATA.LONG(A:0x821b24) "' name='RPMH_VRM_ENABLE_CRS_DRV2_REG27'/>"
WRITE #1 "        <register address='0xb821c24' value='0x" DATA.LONG(A:0x821c24) "' name='RPMH_VRM_ENABLE_CRS_DRV2_REG28'/>"
WRITE #1 "        <register address='0xb821d24' value='0x" DATA.LONG(A:0x821d24) "' name='RPMH_VRM_ENABLE_CRS_DRV2_REG29'/>"
WRITE #1 "        <register address='0xb821e24' value='0x" DATA.LONG(A:0x821e24) "' name='RPMH_VRM_ENABLE_CRS_DRV2_REG30'/>"
WRITE #1 "        <register address='0xb821f24' value='0x" DATA.LONG(A:0x821f24) "' name='RPMH_VRM_ENABLE_CRS_DRV2_REG31'/>"
WRITE #1 "        <register address='0xb822024' value='0x" DATA.LONG(A:0x822024) "' name='RPMH_VRM_ENABLE_CRS_DRV2_REG32'/>"
WRITE #1 "        <register address='0xb822124' value='0x" DATA.LONG(A:0x822124) "' name='RPMH_VRM_ENABLE_CRS_DRV2_REG33'/>"
WRITE #1 "        <register address='0xb822224' value='0x" DATA.LONG(A:0x822224) "' name='RPMH_VRM_ENABLE_CRS_DRV2_REG34'/>"
WRITE #1 "        <register address='0xb822324' value='0x" DATA.LONG(A:0x822324) "' name='RPMH_VRM_ENABLE_CRS_DRV2_REG35'/>"
WRITE #1 "        <register address='0xb822424' value='0x" DATA.LONG(A:0x822424) "' name='RPMH_VRM_ENABLE_CRS_DRV2_REG36'/>"
WRITE #1 "        <register address='0xb822524' value='0x" DATA.LONG(A:0x822524) "' name='RPMH_VRM_ENABLE_CRS_DRV2_REG37'/>"
WRITE #1 "        <register address='0xb822624' value='0x" DATA.LONG(A:0x822624) "' name='RPMH_VRM_ENABLE_CRS_DRV2_REG38'/>"
WRITE #1 "        <register address='0xb822724' value='0x" DATA.LONG(A:0x822724) "' name='RPMH_VRM_ENABLE_CRS_DRV2_REG39'/>"
WRITE #1 "        <register address='0xb822824' value='0x" DATA.LONG(A:0x822824) "' name='RPMH_VRM_ENABLE_CRS_DRV2_REG40'/>"
WRITE #1 "        <register address='0xb822924' value='0x" DATA.LONG(A:0x822924) "' name='RPMH_VRM_ENABLE_CRS_DRV2_REG41'/>"
WRITE #1 "        <register address='0xb822a24' value='0x" DATA.LONG(A:0x822a24) "' name='RPMH_VRM_ENABLE_CRS_DRV2_REG42'/>"
WRITE #1 "        <register address='0xb822b24' value='0x" DATA.LONG(A:0x822b24) "' name='RPMH_VRM_ENABLE_CRS_DRV2_REG43'/>"
WRITE #1 "        <register address='0xb822c24' value='0x" DATA.LONG(A:0x822c24) "' name='RPMH_VRM_ENABLE_CRS_DRV2_REG44'/>"
WRITE #1 "        <register address='0xb822d24' value='0x" DATA.LONG(A:0x822d24) "' name='RPMH_VRM_ENABLE_CRS_DRV2_REG45'/>"
WRITE #1 "        <register address='0xb830024' value='0x" DATA.LONG(A:0x830024) "' name='RPMH_VRM_ENABLE_CRS_DRV3_REG0'/>"
WRITE #1 "        <register address='0xb830124' value='0x" DATA.LONG(A:0x830124) "' name='RPMH_VRM_ENABLE_CRS_DRV3_REG1'/>"
WRITE #1 "        <register address='0xb830224' value='0x" DATA.LONG(A:0x830224) "' name='RPMH_VRM_ENABLE_CRS_DRV3_REG2'/>"
WRITE #1 "        <register address='0xb830324' value='0x" DATA.LONG(A:0x830324) "' name='RPMH_VRM_ENABLE_CRS_DRV3_REG3'/>"
WRITE #1 "        <register address='0xb830424' value='0x" DATA.LONG(A:0x830424) "' name='RPMH_VRM_ENABLE_CRS_DRV3_REG4'/>"
WRITE #1 "        <register address='0xb830524' value='0x" DATA.LONG(A:0x830524) "' name='RPMH_VRM_ENABLE_CRS_DRV3_REG5'/>"
WRITE #1 "        <register address='0xb830624' value='0x" DATA.LONG(A:0x830624) "' name='RPMH_VRM_ENABLE_CRS_DRV3_REG6'/>"
WRITE #1 "        <register address='0xb830724' value='0x" DATA.LONG(A:0x830724) "' name='RPMH_VRM_ENABLE_CRS_DRV3_REG7'/>"
WRITE #1 "        <register address='0xb830824' value='0x" DATA.LONG(A:0x830824) "' name='RPMH_VRM_ENABLE_CRS_DRV3_REG8'/>"
WRITE #1 "        <register address='0xb830924' value='0x" DATA.LONG(A:0x830924) "' name='RPMH_VRM_ENABLE_CRS_DRV3_REG9'/>"
WRITE #1 "        <register address='0xb830a24' value='0x" DATA.LONG(A:0x830a24) "' name='RPMH_VRM_ENABLE_CRS_DRV3_REG10'/>"
WRITE #1 "        <register address='0xb830b24' value='0x" DATA.LONG(A:0x830b24) "' name='RPMH_VRM_ENABLE_CRS_DRV3_REG11'/>"
WRITE #1 "        <register address='0xb830c24' value='0x" DATA.LONG(A:0x830c24) "' name='RPMH_VRM_ENABLE_CRS_DRV3_REG12'/>"
WRITE #1 "        <register address='0xb830d24' value='0x" DATA.LONG(A:0x830d24) "' name='RPMH_VRM_ENABLE_CRS_DRV3_REG13'/>"
WRITE #1 "        <register address='0xb830e24' value='0x" DATA.LONG(A:0x830e24) "' name='RPMH_VRM_ENABLE_CRS_DRV3_REG14'/>"
WRITE #1 "        <register address='0xb830f24' value='0x" DATA.LONG(A:0x830f24) "' name='RPMH_VRM_ENABLE_CRS_DRV3_REG15'/>"
WRITE #1 "        <register address='0xb831024' value='0x" DATA.LONG(A:0x831024) "' name='RPMH_VRM_ENABLE_CRS_DRV3_REG16'/>"
WRITE #1 "        <register address='0xb831124' value='0x" DATA.LONG(A:0x831124) "' name='RPMH_VRM_ENABLE_CRS_DRV3_REG17'/>"
WRITE #1 "        <register address='0xb831224' value='0x" DATA.LONG(A:0x831224) "' name='RPMH_VRM_ENABLE_CRS_DRV3_REG18'/>"
WRITE #1 "        <register address='0xb831324' value='0x" DATA.LONG(A:0x831324) "' name='RPMH_VRM_ENABLE_CRS_DRV3_REG19'/>"
WRITE #1 "        <register address='0xb831424' value='0x" DATA.LONG(A:0x831424) "' name='RPMH_VRM_ENABLE_CRS_DRV3_REG20'/>"
WRITE #1 "        <register address='0xb831524' value='0x" DATA.LONG(A:0x831524) "' name='RPMH_VRM_ENABLE_CRS_DRV3_REG21'/>"
WRITE #1 "        <register address='0xb831624' value='0x" DATA.LONG(A:0x831624) "' name='RPMH_VRM_ENABLE_CRS_DRV3_REG22'/>"
WRITE #1 "        <register address='0xb831724' value='0x" DATA.LONG(A:0x831724) "' name='RPMH_VRM_ENABLE_CRS_DRV3_REG23'/>"
WRITE #1 "        <register address='0xb831824' value='0x" DATA.LONG(A:0x831824) "' name='RPMH_VRM_ENABLE_CRS_DRV3_REG24'/>"
WRITE #1 "        <register address='0xb831924' value='0x" DATA.LONG(A:0x831924) "' name='RPMH_VRM_ENABLE_CRS_DRV3_REG25'/>"
WRITE #1 "        <register address='0xb831a24' value='0x" DATA.LONG(A:0x831a24) "' name='RPMH_VRM_ENABLE_CRS_DRV3_REG26'/>"
WRITE #1 "        <register address='0xb831b24' value='0x" DATA.LONG(A:0x831b24) "' name='RPMH_VRM_ENABLE_CRS_DRV3_REG27'/>"
WRITE #1 "        <register address='0xb831c24' value='0x" DATA.LONG(A:0x831c24) "' name='RPMH_VRM_ENABLE_CRS_DRV3_REG28'/>"
WRITE #1 "        <register address='0xb831d24' value='0x" DATA.LONG(A:0x831d24) "' name='RPMH_VRM_ENABLE_CRS_DRV3_REG29'/>"
WRITE #1 "        <register address='0xb831e24' value='0x" DATA.LONG(A:0x831e24) "' name='RPMH_VRM_ENABLE_CRS_DRV3_REG30'/>"
WRITE #1 "        <register address='0xb831f24' value='0x" DATA.LONG(A:0x831f24) "' name='RPMH_VRM_ENABLE_CRS_DRV3_REG31'/>"
WRITE #1 "        <register address='0xb832024' value='0x" DATA.LONG(A:0x832024) "' name='RPMH_VRM_ENABLE_CRS_DRV3_REG32'/>"
WRITE #1 "        <register address='0xb832124' value='0x" DATA.LONG(A:0x832124) "' name='RPMH_VRM_ENABLE_CRS_DRV3_REG33'/>"
WRITE #1 "        <register address='0xb832224' value='0x" DATA.LONG(A:0x832224) "' name='RPMH_VRM_ENABLE_CRS_DRV3_REG34'/>"
WRITE #1 "        <register address='0xb832324' value='0x" DATA.LONG(A:0x832324) "' name='RPMH_VRM_ENABLE_CRS_DRV3_REG35'/>"
WRITE #1 "        <register address='0xb832424' value='0x" DATA.LONG(A:0x832424) "' name='RPMH_VRM_ENABLE_CRS_DRV3_REG36'/>"
WRITE #1 "        <register address='0xb832524' value='0x" DATA.LONG(A:0x832524) "' name='RPMH_VRM_ENABLE_CRS_DRV3_REG37'/>"
WRITE #1 "        <register address='0xb832624' value='0x" DATA.LONG(A:0x832624) "' name='RPMH_VRM_ENABLE_CRS_DRV3_REG38'/>"
WRITE #1 "        <register address='0xb832724' value='0x" DATA.LONG(A:0x832724) "' name='RPMH_VRM_ENABLE_CRS_DRV3_REG39'/>"
WRITE #1 "        <register address='0xb832824' value='0x" DATA.LONG(A:0x832824) "' name='RPMH_VRM_ENABLE_CRS_DRV3_REG40'/>"
WRITE #1 "        <register address='0xb832924' value='0x" DATA.LONG(A:0x832924) "' name='RPMH_VRM_ENABLE_CRS_DRV3_REG41'/>"
WRITE #1 "        <register address='0xb832a24' value='0x" DATA.LONG(A:0x832a24) "' name='RPMH_VRM_ENABLE_CRS_DRV3_REG42'/>"
WRITE #1 "        <register address='0xb832b24' value='0x" DATA.LONG(A:0x832b24) "' name='RPMH_VRM_ENABLE_CRS_DRV3_REG43'/>"
WRITE #1 "        <register address='0xb832c24' value='0x" DATA.LONG(A:0x832c24) "' name='RPMH_VRM_ENABLE_CRS_DRV3_REG44'/>"
WRITE #1 "        <register address='0xb832d24' value='0x" DATA.LONG(A:0x832d24) "' name='RPMH_VRM_ENABLE_CRS_DRV3_REG45'/>"
WRITE #1 "        <register address='0xb840024' value='0x" DATA.LONG(A:0x840024) "' name='RPMH_VRM_ENABLE_CRS_DRV4_REG0'/>"
WRITE #1 "        <register address='0xb840124' value='0x" DATA.LONG(A:0x840124) "' name='RPMH_VRM_ENABLE_CRS_DRV4_REG1'/>"
WRITE #1 "        <register address='0xb840224' value='0x" DATA.LONG(A:0x840224) "' name='RPMH_VRM_ENABLE_CRS_DRV4_REG2'/>"
WRITE #1 "        <register address='0xb840324' value='0x" DATA.LONG(A:0x840324) "' name='RPMH_VRM_ENABLE_CRS_DRV4_REG3'/>"
WRITE #1 "        <register address='0xb840424' value='0x" DATA.LONG(A:0x840424) "' name='RPMH_VRM_ENABLE_CRS_DRV4_REG4'/>"
WRITE #1 "        <register address='0xb840524' value='0x" DATA.LONG(A:0x840524) "' name='RPMH_VRM_ENABLE_CRS_DRV4_REG5'/>"
WRITE #1 "        <register address='0xb840624' value='0x" DATA.LONG(A:0x840624) "' name='RPMH_VRM_ENABLE_CRS_DRV4_REG6'/>"
WRITE #1 "        <register address='0xb840724' value='0x" DATA.LONG(A:0x840724) "' name='RPMH_VRM_ENABLE_CRS_DRV4_REG7'/>"
WRITE #1 "        <register address='0xb840824' value='0x" DATA.LONG(A:0x840824) "' name='RPMH_VRM_ENABLE_CRS_DRV4_REG8'/>"
WRITE #1 "        <register address='0xb840924' value='0x" DATA.LONG(A:0x840924) "' name='RPMH_VRM_ENABLE_CRS_DRV4_REG9'/>"
WRITE #1 "        <register address='0xb840a24' value='0x" DATA.LONG(A:0x840a24) "' name='RPMH_VRM_ENABLE_CRS_DRV4_REG10'/>"
WRITE #1 "        <register address='0xb840b24' value='0x" DATA.LONG(A:0x840b24) "' name='RPMH_VRM_ENABLE_CRS_DRV4_REG11'/>"
WRITE #1 "        <register address='0xb840c24' value='0x" DATA.LONG(A:0x840c24) "' name='RPMH_VRM_ENABLE_CRS_DRV4_REG12'/>"
WRITE #1 "        <register address='0xb840d24' value='0x" DATA.LONG(A:0x840d24) "' name='RPMH_VRM_ENABLE_CRS_DRV4_REG13'/>"
WRITE #1 "        <register address='0xb840e24' value='0x" DATA.LONG(A:0x840e24) "' name='RPMH_VRM_ENABLE_CRS_DRV4_REG14'/>"
WRITE #1 "        <register address='0xb840f24' value='0x" DATA.LONG(A:0x840f24) "' name='RPMH_VRM_ENABLE_CRS_DRV4_REG15'/>"
WRITE #1 "        <register address='0xb841024' value='0x" DATA.LONG(A:0x841024) "' name='RPMH_VRM_ENABLE_CRS_DRV4_REG16'/>"
WRITE #1 "        <register address='0xb841124' value='0x" DATA.LONG(A:0x841124) "' name='RPMH_VRM_ENABLE_CRS_DRV4_REG17'/>"
WRITE #1 "        <register address='0xb841224' value='0x" DATA.LONG(A:0x841224) "' name='RPMH_VRM_ENABLE_CRS_DRV4_REG18'/>"
WRITE #1 "        <register address='0xb841324' value='0x" DATA.LONG(A:0x841324) "' name='RPMH_VRM_ENABLE_CRS_DRV4_REG19'/>"
WRITE #1 "        <register address='0xb841424' value='0x" DATA.LONG(A:0x841424) "' name='RPMH_VRM_ENABLE_CRS_DRV4_REG20'/>"
WRITE #1 "        <register address='0xb841524' value='0x" DATA.LONG(A:0x841524) "' name='RPMH_VRM_ENABLE_CRS_DRV4_REG21'/>"
WRITE #1 "        <register address='0xb841624' value='0x" DATA.LONG(A:0x841624) "' name='RPMH_VRM_ENABLE_CRS_DRV4_REG22'/>"
WRITE #1 "        <register address='0xb841724' value='0x" DATA.LONG(A:0x841724) "' name='RPMH_VRM_ENABLE_CRS_DRV4_REG23'/>"
WRITE #1 "        <register address='0xb841824' value='0x" DATA.LONG(A:0x841824) "' name='RPMH_VRM_ENABLE_CRS_DRV4_REG24'/>"
WRITE #1 "        <register address='0xb841924' value='0x" DATA.LONG(A:0x841924) "' name='RPMH_VRM_ENABLE_CRS_DRV4_REG25'/>"
WRITE #1 "        <register address='0xb841a24' value='0x" DATA.LONG(A:0x841a24) "' name='RPMH_VRM_ENABLE_CRS_DRV4_REG26'/>"
WRITE #1 "        <register address='0xb841b24' value='0x" DATA.LONG(A:0x841b24) "' name='RPMH_VRM_ENABLE_CRS_DRV4_REG27'/>"
WRITE #1 "        <register address='0xb841c24' value='0x" DATA.LONG(A:0x841c24) "' name='RPMH_VRM_ENABLE_CRS_DRV4_REG28'/>"
WRITE #1 "        <register address='0xb841d24' value='0x" DATA.LONG(A:0x841d24) "' name='RPMH_VRM_ENABLE_CRS_DRV4_REG29'/>"
WRITE #1 "        <register address='0xb841e24' value='0x" DATA.LONG(A:0x841e24) "' name='RPMH_VRM_ENABLE_CRS_DRV4_REG30'/>"
WRITE #1 "        <register address='0xb841f24' value='0x" DATA.LONG(A:0x841f24) "' name='RPMH_VRM_ENABLE_CRS_DRV4_REG31'/>"
WRITE #1 "        <register address='0xb842024' value='0x" DATA.LONG(A:0x842024) "' name='RPMH_VRM_ENABLE_CRS_DRV4_REG32'/>"
WRITE #1 "        <register address='0xb842124' value='0x" DATA.LONG(A:0x842124) "' name='RPMH_VRM_ENABLE_CRS_DRV4_REG33'/>"
WRITE #1 "        <register address='0xb842224' value='0x" DATA.LONG(A:0x842224) "' name='RPMH_VRM_ENABLE_CRS_DRV4_REG34'/>"
WRITE #1 "        <register address='0xb842324' value='0x" DATA.LONG(A:0x842324) "' name='RPMH_VRM_ENABLE_CRS_DRV4_REG35'/>"
WRITE #1 "        <register address='0xb842424' value='0x" DATA.LONG(A:0x842424) "' name='RPMH_VRM_ENABLE_CRS_DRV4_REG36'/>"
WRITE #1 "        <register address='0xb842524' value='0x" DATA.LONG(A:0x842524) "' name='RPMH_VRM_ENABLE_CRS_DRV4_REG37'/>"
WRITE #1 "        <register address='0xb842624' value='0x" DATA.LONG(A:0x842624) "' name='RPMH_VRM_ENABLE_CRS_DRV4_REG38'/>"
WRITE #1 "        <register address='0xb842724' value='0x" DATA.LONG(A:0x842724) "' name='RPMH_VRM_ENABLE_CRS_DRV4_REG39'/>"
WRITE #1 "        <register address='0xb842824' value='0x" DATA.LONG(A:0x842824) "' name='RPMH_VRM_ENABLE_CRS_DRV4_REG40'/>"
WRITE #1 "        <register address='0xb842924' value='0x" DATA.LONG(A:0x842924) "' name='RPMH_VRM_ENABLE_CRS_DRV4_REG41'/>"
WRITE #1 "        <register address='0xb842a24' value='0x" DATA.LONG(A:0x842a24) "' name='RPMH_VRM_ENABLE_CRS_DRV4_REG42'/>"
WRITE #1 "        <register address='0xb842b24' value='0x" DATA.LONG(A:0x842b24) "' name='RPMH_VRM_ENABLE_CRS_DRV4_REG43'/>"
WRITE #1 "        <register address='0xb842c24' value='0x" DATA.LONG(A:0x842c24) "' name='RPMH_VRM_ENABLE_CRS_DRV4_REG44'/>"
WRITE #1 "        <register address='0xb842d24' value='0x" DATA.LONG(A:0x842d24) "' name='RPMH_VRM_ENABLE_CRS_DRV4_REG45'/>"
WRITE #1 "        <register address='0xb850024' value='0x" DATA.LONG(A:0x850024) "' name='RPMH_VRM_ENABLE_CRS_DRV5_REG0'/>"
WRITE #1 "        <register address='0xb850124' value='0x" DATA.LONG(A:0x850124) "' name='RPMH_VRM_ENABLE_CRS_DRV5_REG1'/>"
WRITE #1 "        <register address='0xb850224' value='0x" DATA.LONG(A:0x850224) "' name='RPMH_VRM_ENABLE_CRS_DRV5_REG2'/>"
WRITE #1 "        <register address='0xb850324' value='0x" DATA.LONG(A:0x850324) "' name='RPMH_VRM_ENABLE_CRS_DRV5_REG3'/>"
WRITE #1 "        <register address='0xb850424' value='0x" DATA.LONG(A:0x850424) "' name='RPMH_VRM_ENABLE_CRS_DRV5_REG4'/>"
WRITE #1 "        <register address='0xb850524' value='0x" DATA.LONG(A:0x850524) "' name='RPMH_VRM_ENABLE_CRS_DRV5_REG5'/>"
WRITE #1 "        <register address='0xb850624' value='0x" DATA.LONG(A:0x850624) "' name='RPMH_VRM_ENABLE_CRS_DRV5_REG6'/>"
WRITE #1 "        <register address='0xb850724' value='0x" DATA.LONG(A:0x850724) "' name='RPMH_VRM_ENABLE_CRS_DRV5_REG7'/>"
WRITE #1 "        <register address='0xb850824' value='0x" DATA.LONG(A:0x850824) "' name='RPMH_VRM_ENABLE_CRS_DRV5_REG8'/>"
WRITE #1 "        <register address='0xb850924' value='0x" DATA.LONG(A:0x850924) "' name='RPMH_VRM_ENABLE_CRS_DRV5_REG9'/>"
WRITE #1 "        <register address='0xb850a24' value='0x" DATA.LONG(A:0x850a24) "' name='RPMH_VRM_ENABLE_CRS_DRV5_REG10'/>"
WRITE #1 "        <register address='0xb850b24' value='0x" DATA.LONG(A:0x850b24) "' name='RPMH_VRM_ENABLE_CRS_DRV5_REG11'/>"
WRITE #1 "        <register address='0xb850c24' value='0x" DATA.LONG(A:0x850c24) "' name='RPMH_VRM_ENABLE_CRS_DRV5_REG12'/>"
WRITE #1 "        <register address='0xb850d24' value='0x" DATA.LONG(A:0x850d24) "' name='RPMH_VRM_ENABLE_CRS_DRV5_REG13'/>"
WRITE #1 "        <register address='0xb850e24' value='0x" DATA.LONG(A:0x850e24) "' name='RPMH_VRM_ENABLE_CRS_DRV5_REG14'/>"
WRITE #1 "        <register address='0xb850f24' value='0x" DATA.LONG(A:0x850f24) "' name='RPMH_VRM_ENABLE_CRS_DRV5_REG15'/>"
WRITE #1 "        <register address='0xb851024' value='0x" DATA.LONG(A:0x851024) "' name='RPMH_VRM_ENABLE_CRS_DRV5_REG16'/>"
WRITE #1 "        <register address='0xb851124' value='0x" DATA.LONG(A:0x851124) "' name='RPMH_VRM_ENABLE_CRS_DRV5_REG17'/>"
WRITE #1 "        <register address='0xb851224' value='0x" DATA.LONG(A:0x851224) "' name='RPMH_VRM_ENABLE_CRS_DRV5_REG18'/>"
WRITE #1 "        <register address='0xb851324' value='0x" DATA.LONG(A:0x851324) "' name='RPMH_VRM_ENABLE_CRS_DRV5_REG19'/>"
WRITE #1 "        <register address='0xb851424' value='0x" DATA.LONG(A:0x851424) "' name='RPMH_VRM_ENABLE_CRS_DRV5_REG20'/>"
WRITE #1 "        <register address='0xb851524' value='0x" DATA.LONG(A:0x851524) "' name='RPMH_VRM_ENABLE_CRS_DRV5_REG21'/>"
WRITE #1 "        <register address='0xb851624' value='0x" DATA.LONG(A:0x851624) "' name='RPMH_VRM_ENABLE_CRS_DRV5_REG22'/>"
WRITE #1 "        <register address='0xb851724' value='0x" DATA.LONG(A:0x851724) "' name='RPMH_VRM_ENABLE_CRS_DRV5_REG23'/>"
WRITE #1 "        <register address='0xb851824' value='0x" DATA.LONG(A:0x851824) "' name='RPMH_VRM_ENABLE_CRS_DRV5_REG24'/>"
WRITE #1 "        <register address='0xb851924' value='0x" DATA.LONG(A:0x851924) "' name='RPMH_VRM_ENABLE_CRS_DRV5_REG25'/>"
WRITE #1 "        <register address='0xb851a24' value='0x" DATA.LONG(A:0x851a24) "' name='RPMH_VRM_ENABLE_CRS_DRV5_REG26'/>"
WRITE #1 "        <register address='0xb851b24' value='0x" DATA.LONG(A:0x851b24) "' name='RPMH_VRM_ENABLE_CRS_DRV5_REG27'/>"
WRITE #1 "        <register address='0xb851c24' value='0x" DATA.LONG(A:0x851c24) "' name='RPMH_VRM_ENABLE_CRS_DRV5_REG28'/>"
WRITE #1 "        <register address='0xb851d24' value='0x" DATA.LONG(A:0x851d24) "' name='RPMH_VRM_ENABLE_CRS_DRV5_REG29'/>"
WRITE #1 "        <register address='0xb851e24' value='0x" DATA.LONG(A:0x851e24) "' name='RPMH_VRM_ENABLE_CRS_DRV5_REG30'/>"
WRITE #1 "        <register address='0xb851f24' value='0x" DATA.LONG(A:0x851f24) "' name='RPMH_VRM_ENABLE_CRS_DRV5_REG31'/>"
WRITE #1 "        <register address='0xb852024' value='0x" DATA.LONG(A:0x852024) "' name='RPMH_VRM_ENABLE_CRS_DRV5_REG32'/>"
WRITE #1 "        <register address='0xb852124' value='0x" DATA.LONG(A:0x852124) "' name='RPMH_VRM_ENABLE_CRS_DRV5_REG33'/>"
WRITE #1 "        <register address='0xb852224' value='0x" DATA.LONG(A:0x852224) "' name='RPMH_VRM_ENABLE_CRS_DRV5_REG34'/>"
WRITE #1 "        <register address='0xb852324' value='0x" DATA.LONG(A:0x852324) "' name='RPMH_VRM_ENABLE_CRS_DRV5_REG35'/>"
WRITE #1 "        <register address='0xb852424' value='0x" DATA.LONG(A:0x852424) "' name='RPMH_VRM_ENABLE_CRS_DRV5_REG36'/>"
WRITE #1 "        <register address='0xb852524' value='0x" DATA.LONG(A:0x852524) "' name='RPMH_VRM_ENABLE_CRS_DRV5_REG37'/>"
WRITE #1 "        <register address='0xb852624' value='0x" DATA.LONG(A:0x852624) "' name='RPMH_VRM_ENABLE_CRS_DRV5_REG38'/>"
WRITE #1 "        <register address='0xb852724' value='0x" DATA.LONG(A:0x852724) "' name='RPMH_VRM_ENABLE_CRS_DRV5_REG39'/>"
WRITE #1 "        <register address='0xb852824' value='0x" DATA.LONG(A:0x852824) "' name='RPMH_VRM_ENABLE_CRS_DRV5_REG40'/>"
WRITE #1 "        <register address='0xb852924' value='0x" DATA.LONG(A:0x852924) "' name='RPMH_VRM_ENABLE_CRS_DRV5_REG41'/>"
WRITE #1 "        <register address='0xb852a24' value='0x" DATA.LONG(A:0x852a24) "' name='RPMH_VRM_ENABLE_CRS_DRV5_REG42'/>"
WRITE #1 "        <register address='0xb852b24' value='0x" DATA.LONG(A:0x852b24) "' name='RPMH_VRM_ENABLE_CRS_DRV5_REG43'/>"
WRITE #1 "        <register address='0xb852c24' value='0x" DATA.LONG(A:0x852c24) "' name='RPMH_VRM_ENABLE_CRS_DRV5_REG44'/>"
WRITE #1 "        <register address='0xb852d24' value='0x" DATA.LONG(A:0x852d24) "' name='RPMH_VRM_ENABLE_CRS_DRV5_REG45'/>"
WRITE #1 "        <register address='0xb860024' value='0x" DATA.LONG(A:0x860024) "' name='RPMH_VRM_ENABLE_CRS_DRV6_REG0'/>"
WRITE #1 "        <register address='0xb860124' value='0x" DATA.LONG(A:0x860124) "' name='RPMH_VRM_ENABLE_CRS_DRV6_REG1'/>"
WRITE #1 "        <register address='0xb860224' value='0x" DATA.LONG(A:0x860224) "' name='RPMH_VRM_ENABLE_CRS_DRV6_REG2'/>"
WRITE #1 "        <register address='0xb860324' value='0x" DATA.LONG(A:0x860324) "' name='RPMH_VRM_ENABLE_CRS_DRV6_REG3'/>"
WRITE #1 "        <register address='0xb860424' value='0x" DATA.LONG(A:0x860424) "' name='RPMH_VRM_ENABLE_CRS_DRV6_REG4'/>"
WRITE #1 "        <register address='0xb860524' value='0x" DATA.LONG(A:0x860524) "' name='RPMH_VRM_ENABLE_CRS_DRV6_REG5'/>"
WRITE #1 "        <register address='0xb860624' value='0x" DATA.LONG(A:0x860624) "' name='RPMH_VRM_ENABLE_CRS_DRV6_REG6'/>"
WRITE #1 "        <register address='0xb860724' value='0x" DATA.LONG(A:0x860724) "' name='RPMH_VRM_ENABLE_CRS_DRV6_REG7'/>"
WRITE #1 "        <register address='0xb860824' value='0x" DATA.LONG(A:0x860824) "' name='RPMH_VRM_ENABLE_CRS_DRV6_REG8'/>"
WRITE #1 "        <register address='0xb860924' value='0x" DATA.LONG(A:0x860924) "' name='RPMH_VRM_ENABLE_CRS_DRV6_REG9'/>"
WRITE #1 "        <register address='0xb860a24' value='0x" DATA.LONG(A:0x860a24) "' name='RPMH_VRM_ENABLE_CRS_DRV6_REG10'/>"
WRITE #1 "        <register address='0xb860b24' value='0x" DATA.LONG(A:0x860b24) "' name='RPMH_VRM_ENABLE_CRS_DRV6_REG11'/>"
WRITE #1 "        <register address='0xb860c24' value='0x" DATA.LONG(A:0x860c24) "' name='RPMH_VRM_ENABLE_CRS_DRV6_REG12'/>"
WRITE #1 "        <register address='0xb860d24' value='0x" DATA.LONG(A:0x860d24) "' name='RPMH_VRM_ENABLE_CRS_DRV6_REG13'/>"
WRITE #1 "        <register address='0xb860e24' value='0x" DATA.LONG(A:0x860e24) "' name='RPMH_VRM_ENABLE_CRS_DRV6_REG14'/>"
WRITE #1 "        <register address='0xb860f24' value='0x" DATA.LONG(A:0x860f24) "' name='RPMH_VRM_ENABLE_CRS_DRV6_REG15'/>"
WRITE #1 "        <register address='0xb861024' value='0x" DATA.LONG(A:0x861024) "' name='RPMH_VRM_ENABLE_CRS_DRV6_REG16'/>"
WRITE #1 "        <register address='0xb861124' value='0x" DATA.LONG(A:0x861124) "' name='RPMH_VRM_ENABLE_CRS_DRV6_REG17'/>"
WRITE #1 "        <register address='0xb861224' value='0x" DATA.LONG(A:0x861224) "' name='RPMH_VRM_ENABLE_CRS_DRV6_REG18'/>"
WRITE #1 "        <register address='0xb861324' value='0x" DATA.LONG(A:0x861324) "' name='RPMH_VRM_ENABLE_CRS_DRV6_REG19'/>"
WRITE #1 "        <register address='0xb861424' value='0x" DATA.LONG(A:0x861424) "' name='RPMH_VRM_ENABLE_CRS_DRV6_REG20'/>"
WRITE #1 "        <register address='0xb861524' value='0x" DATA.LONG(A:0x861524) "' name='RPMH_VRM_ENABLE_CRS_DRV6_REG21'/>"
WRITE #1 "        <register address='0xb861624' value='0x" DATA.LONG(A:0x861624) "' name='RPMH_VRM_ENABLE_CRS_DRV6_REG22'/>"
WRITE #1 "        <register address='0xb861724' value='0x" DATA.LONG(A:0x861724) "' name='RPMH_VRM_ENABLE_CRS_DRV6_REG23'/>"
WRITE #1 "        <register address='0xb861824' value='0x" DATA.LONG(A:0x861824) "' name='RPMH_VRM_ENABLE_CRS_DRV6_REG24'/>"
WRITE #1 "        <register address='0xb861924' value='0x" DATA.LONG(A:0x861924) "' name='RPMH_VRM_ENABLE_CRS_DRV6_REG25'/>"
WRITE #1 "        <register address='0xb861a24' value='0x" DATA.LONG(A:0x861a24) "' name='RPMH_VRM_ENABLE_CRS_DRV6_REG26'/>"
WRITE #1 "        <register address='0xb861b24' value='0x" DATA.LONG(A:0x861b24) "' name='RPMH_VRM_ENABLE_CRS_DRV6_REG27'/>"
WRITE #1 "        <register address='0xb861c24' value='0x" DATA.LONG(A:0x861c24) "' name='RPMH_VRM_ENABLE_CRS_DRV6_REG28'/>"
WRITE #1 "        <register address='0xb861d24' value='0x" DATA.LONG(A:0x861d24) "' name='RPMH_VRM_ENABLE_CRS_DRV6_REG29'/>"
WRITE #1 "        <register address='0xb861e24' value='0x" DATA.LONG(A:0x861e24) "' name='RPMH_VRM_ENABLE_CRS_DRV6_REG30'/>"
WRITE #1 "        <register address='0xb861f24' value='0x" DATA.LONG(A:0x861f24) "' name='RPMH_VRM_ENABLE_CRS_DRV6_REG31'/>"
WRITE #1 "        <register address='0xb862024' value='0x" DATA.LONG(A:0x862024) "' name='RPMH_VRM_ENABLE_CRS_DRV6_REG32'/>"
WRITE #1 "        <register address='0xb862124' value='0x" DATA.LONG(A:0x862124) "' name='RPMH_VRM_ENABLE_CRS_DRV6_REG33'/>"
WRITE #1 "        <register address='0xb862224' value='0x" DATA.LONG(A:0x862224) "' name='RPMH_VRM_ENABLE_CRS_DRV6_REG34'/>"
WRITE #1 "        <register address='0xb862324' value='0x" DATA.LONG(A:0x862324) "' name='RPMH_VRM_ENABLE_CRS_DRV6_REG35'/>"
WRITE #1 "        <register address='0xb862424' value='0x" DATA.LONG(A:0x862424) "' name='RPMH_VRM_ENABLE_CRS_DRV6_REG36'/>"
WRITE #1 "        <register address='0xb862524' value='0x" DATA.LONG(A:0x862524) "' name='RPMH_VRM_ENABLE_CRS_DRV6_REG37'/>"
WRITE #1 "        <register address='0xb862624' value='0x" DATA.LONG(A:0x862624) "' name='RPMH_VRM_ENABLE_CRS_DRV6_REG38'/>"
WRITE #1 "        <register address='0xb862724' value='0x" DATA.LONG(A:0x862724) "' name='RPMH_VRM_ENABLE_CRS_DRV6_REG39'/>"
WRITE #1 "        <register address='0xb862824' value='0x" DATA.LONG(A:0x862824) "' name='RPMH_VRM_ENABLE_CRS_DRV6_REG40'/>"
WRITE #1 "        <register address='0xb862924' value='0x" DATA.LONG(A:0x862924) "' name='RPMH_VRM_ENABLE_CRS_DRV6_REG41'/>"
WRITE #1 "        <register address='0xb862a24' value='0x" DATA.LONG(A:0x862a24) "' name='RPMH_VRM_ENABLE_CRS_DRV6_REG42'/>"
WRITE #1 "        <register address='0xb862b24' value='0x" DATA.LONG(A:0x862b24) "' name='RPMH_VRM_ENABLE_CRS_DRV6_REG43'/>"
WRITE #1 "        <register address='0xb862c24' value='0x" DATA.LONG(A:0x862c24) "' name='RPMH_VRM_ENABLE_CRS_DRV6_REG44'/>"
WRITE #1 "        <register address='0xb862d24' value='0x" DATA.LONG(A:0x862d24) "' name='RPMH_VRM_ENABLE_CRS_DRV6_REG45'/>"
WRITE #1 "        <register address='0xb870024' value='0x" DATA.LONG(A:0x870024) "' name='RPMH_VRM_ENABLE_CRS_DRV7_REG0'/>"
WRITE #1 "        <register address='0xb870124' value='0x" DATA.LONG(A:0x870124) "' name='RPMH_VRM_ENABLE_CRS_DRV7_REG1'/>"
WRITE #1 "        <register address='0xb870224' value='0x" DATA.LONG(A:0x870224) "' name='RPMH_VRM_ENABLE_CRS_DRV7_REG2'/>"
WRITE #1 "        <register address='0xb870324' value='0x" DATA.LONG(A:0x870324) "' name='RPMH_VRM_ENABLE_CRS_DRV7_REG3'/>"
WRITE #1 "        <register address='0xb870424' value='0x" DATA.LONG(A:0x870424) "' name='RPMH_VRM_ENABLE_CRS_DRV7_REG4'/>"
WRITE #1 "        <register address='0xb870524' value='0x" DATA.LONG(A:0x870524) "' name='RPMH_VRM_ENABLE_CRS_DRV7_REG5'/>"
WRITE #1 "        <register address='0xb870624' value='0x" DATA.LONG(A:0x870624) "' name='RPMH_VRM_ENABLE_CRS_DRV7_REG6'/>"
WRITE #1 "        <register address='0xb870724' value='0x" DATA.LONG(A:0x870724) "' name='RPMH_VRM_ENABLE_CRS_DRV7_REG7'/>"
WRITE #1 "        <register address='0xb870824' value='0x" DATA.LONG(A:0x870824) "' name='RPMH_VRM_ENABLE_CRS_DRV7_REG8'/>"
WRITE #1 "        <register address='0xb870924' value='0x" DATA.LONG(A:0x870924) "' name='RPMH_VRM_ENABLE_CRS_DRV7_REG9'/>"
WRITE #1 "        <register address='0xb870a24' value='0x" DATA.LONG(A:0x870a24) "' name='RPMH_VRM_ENABLE_CRS_DRV7_REG10'/>"
WRITE #1 "        <register address='0xb870b24' value='0x" DATA.LONG(A:0x870b24) "' name='RPMH_VRM_ENABLE_CRS_DRV7_REG11'/>"
WRITE #1 "        <register address='0xb870c24' value='0x" DATA.LONG(A:0x870c24) "' name='RPMH_VRM_ENABLE_CRS_DRV7_REG12'/>"
WRITE #1 "        <register address='0xb870d24' value='0x" DATA.LONG(A:0x870d24) "' name='RPMH_VRM_ENABLE_CRS_DRV7_REG13'/>"
WRITE #1 "        <register address='0xb870e24' value='0x" DATA.LONG(A:0x870e24) "' name='RPMH_VRM_ENABLE_CRS_DRV7_REG14'/>"
WRITE #1 "        <register address='0xb870f24' value='0x" DATA.LONG(A:0x870f24) "' name='RPMH_VRM_ENABLE_CRS_DRV7_REG15'/>"
WRITE #1 "        <register address='0xb871024' value='0x" DATA.LONG(A:0x871024) "' name='RPMH_VRM_ENABLE_CRS_DRV7_REG16'/>"
WRITE #1 "        <register address='0xb871124' value='0x" DATA.LONG(A:0x871124) "' name='RPMH_VRM_ENABLE_CRS_DRV7_REG17'/>"
WRITE #1 "        <register address='0xb871224' value='0x" DATA.LONG(A:0x871224) "' name='RPMH_VRM_ENABLE_CRS_DRV7_REG18'/>"
WRITE #1 "        <register address='0xb871324' value='0x" DATA.LONG(A:0x871324) "' name='RPMH_VRM_ENABLE_CRS_DRV7_REG19'/>"
WRITE #1 "        <register address='0xb871424' value='0x" DATA.LONG(A:0x871424) "' name='RPMH_VRM_ENABLE_CRS_DRV7_REG20'/>"
WRITE #1 "        <register address='0xb871524' value='0x" DATA.LONG(A:0x871524) "' name='RPMH_VRM_ENABLE_CRS_DRV7_REG21'/>"
WRITE #1 "        <register address='0xb871624' value='0x" DATA.LONG(A:0x871624) "' name='RPMH_VRM_ENABLE_CRS_DRV7_REG22'/>"
WRITE #1 "        <register address='0xb871724' value='0x" DATA.LONG(A:0x871724) "' name='RPMH_VRM_ENABLE_CRS_DRV7_REG23'/>"
WRITE #1 "        <register address='0xb871824' value='0x" DATA.LONG(A:0x871824) "' name='RPMH_VRM_ENABLE_CRS_DRV7_REG24'/>"
WRITE #1 "        <register address='0xb871924' value='0x" DATA.LONG(A:0x871924) "' name='RPMH_VRM_ENABLE_CRS_DRV7_REG25'/>"
WRITE #1 "        <register address='0xb871a24' value='0x" DATA.LONG(A:0x871a24) "' name='RPMH_VRM_ENABLE_CRS_DRV7_REG26'/>"
WRITE #1 "        <register address='0xb871b24' value='0x" DATA.LONG(A:0x871b24) "' name='RPMH_VRM_ENABLE_CRS_DRV7_REG27'/>"
WRITE #1 "        <register address='0xb871c24' value='0x" DATA.LONG(A:0x871c24) "' name='RPMH_VRM_ENABLE_CRS_DRV7_REG28'/>"
WRITE #1 "        <register address='0xb871d24' value='0x" DATA.LONG(A:0x871d24) "' name='RPMH_VRM_ENABLE_CRS_DRV7_REG29'/>"
WRITE #1 "        <register address='0xb871e24' value='0x" DATA.LONG(A:0x871e24) "' name='RPMH_VRM_ENABLE_CRS_DRV7_REG30'/>"
WRITE #1 "        <register address='0xb871f24' value='0x" DATA.LONG(A:0x871f24) "' name='RPMH_VRM_ENABLE_CRS_DRV7_REG31'/>"
WRITE #1 "        <register address='0xb872024' value='0x" DATA.LONG(A:0x872024) "' name='RPMH_VRM_ENABLE_CRS_DRV7_REG32'/>"
WRITE #1 "        <register address='0xb872124' value='0x" DATA.LONG(A:0x872124) "' name='RPMH_VRM_ENABLE_CRS_DRV7_REG33'/>"
WRITE #1 "        <register address='0xb872224' value='0x" DATA.LONG(A:0x872224) "' name='RPMH_VRM_ENABLE_CRS_DRV7_REG34'/>"
WRITE #1 "        <register address='0xb872324' value='0x" DATA.LONG(A:0x872324) "' name='RPMH_VRM_ENABLE_CRS_DRV7_REG35'/>"
WRITE #1 "        <register address='0xb872424' value='0x" DATA.LONG(A:0x872424) "' name='RPMH_VRM_ENABLE_CRS_DRV7_REG36'/>"
WRITE #1 "        <register address='0xb872524' value='0x" DATA.LONG(A:0x872524) "' name='RPMH_VRM_ENABLE_CRS_DRV7_REG37'/>"
WRITE #1 "        <register address='0xb872624' value='0x" DATA.LONG(A:0x872624) "' name='RPMH_VRM_ENABLE_CRS_DRV7_REG38'/>"
WRITE #1 "        <register address='0xb872724' value='0x" DATA.LONG(A:0x872724) "' name='RPMH_VRM_ENABLE_CRS_DRV7_REG39'/>"
WRITE #1 "        <register address='0xb872824' value='0x" DATA.LONG(A:0x872824) "' name='RPMH_VRM_ENABLE_CRS_DRV7_REG40'/>"
WRITE #1 "        <register address='0xb872924' value='0x" DATA.LONG(A:0x872924) "' name='RPMH_VRM_ENABLE_CRS_DRV7_REG41'/>"
WRITE #1 "        <register address='0xb872a24' value='0x" DATA.LONG(A:0x872a24) "' name='RPMH_VRM_ENABLE_CRS_DRV7_REG42'/>"
WRITE #1 "        <register address='0xb872b24' value='0x" DATA.LONG(A:0x872b24) "' name='RPMH_VRM_ENABLE_CRS_DRV7_REG43'/>"
WRITE #1 "        <register address='0xb872c24' value='0x" DATA.LONG(A:0x872c24) "' name='RPMH_VRM_ENABLE_CRS_DRV7_REG44'/>"
WRITE #1 "        <register address='0xb872d24' value='0x" DATA.LONG(A:0x872d24) "' name='RPMH_VRM_ENABLE_CRS_DRV7_REG45'/>"
WRITE #1 "        <register address='0xb880024' value='0x" DATA.LONG(A:0x880024) "' name='RPMH_VRM_ENABLE_CRS_DRV8_REG0'/>"
WRITE #1 "        <register address='0xb880124' value='0x" DATA.LONG(A:0x880124) "' name='RPMH_VRM_ENABLE_CRS_DRV8_REG1'/>"
WRITE #1 "        <register address='0xb880224' value='0x" DATA.LONG(A:0x880224) "' name='RPMH_VRM_ENABLE_CRS_DRV8_REG2'/>"
WRITE #1 "        <register address='0xb880324' value='0x" DATA.LONG(A:0x880324) "' name='RPMH_VRM_ENABLE_CRS_DRV8_REG3'/>"
WRITE #1 "        <register address='0xb880424' value='0x" DATA.LONG(A:0x880424) "' name='RPMH_VRM_ENABLE_CRS_DRV8_REG4'/>"
WRITE #1 "        <register address='0xb880524' value='0x" DATA.LONG(A:0x880524) "' name='RPMH_VRM_ENABLE_CRS_DRV8_REG5'/>"
WRITE #1 "        <register address='0xb880624' value='0x" DATA.LONG(A:0x880624) "' name='RPMH_VRM_ENABLE_CRS_DRV8_REG6'/>"
WRITE #1 "        <register address='0xb880724' value='0x" DATA.LONG(A:0x880724) "' name='RPMH_VRM_ENABLE_CRS_DRV8_REG7'/>"
WRITE #1 "        <register address='0xb880824' value='0x" DATA.LONG(A:0x880824) "' name='RPMH_VRM_ENABLE_CRS_DRV8_REG8'/>"
WRITE #1 "        <register address='0xb880924' value='0x" DATA.LONG(A:0x880924) "' name='RPMH_VRM_ENABLE_CRS_DRV8_REG9'/>"
WRITE #1 "        <register address='0xb880a24' value='0x" DATA.LONG(A:0x880a24) "' name='RPMH_VRM_ENABLE_CRS_DRV8_REG10'/>"
WRITE #1 "        <register address='0xb880b24' value='0x" DATA.LONG(A:0x880b24) "' name='RPMH_VRM_ENABLE_CRS_DRV8_REG11'/>"
WRITE #1 "        <register address='0xb880c24' value='0x" DATA.LONG(A:0x880c24) "' name='RPMH_VRM_ENABLE_CRS_DRV8_REG12'/>"
WRITE #1 "        <register address='0xb880d24' value='0x" DATA.LONG(A:0x880d24) "' name='RPMH_VRM_ENABLE_CRS_DRV8_REG13'/>"
WRITE #1 "        <register address='0xb880e24' value='0x" DATA.LONG(A:0x880e24) "' name='RPMH_VRM_ENABLE_CRS_DRV8_REG14'/>"
WRITE #1 "        <register address='0xb880f24' value='0x" DATA.LONG(A:0x880f24) "' name='RPMH_VRM_ENABLE_CRS_DRV8_REG15'/>"
WRITE #1 "        <register address='0xb881024' value='0x" DATA.LONG(A:0x881024) "' name='RPMH_VRM_ENABLE_CRS_DRV8_REG16'/>"
WRITE #1 "        <register address='0xb881124' value='0x" DATA.LONG(A:0x881124) "' name='RPMH_VRM_ENABLE_CRS_DRV8_REG17'/>"
WRITE #1 "        <register address='0xb881224' value='0x" DATA.LONG(A:0x881224) "' name='RPMH_VRM_ENABLE_CRS_DRV8_REG18'/>"
WRITE #1 "        <register address='0xb881324' value='0x" DATA.LONG(A:0x881324) "' name='RPMH_VRM_ENABLE_CRS_DRV8_REG19'/>"
WRITE #1 "        <register address='0xb881424' value='0x" DATA.LONG(A:0x881424) "' name='RPMH_VRM_ENABLE_CRS_DRV8_REG20'/>"
WRITE #1 "        <register address='0xb881524' value='0x" DATA.LONG(A:0x881524) "' name='RPMH_VRM_ENABLE_CRS_DRV8_REG21'/>"
WRITE #1 "        <register address='0xb881624' value='0x" DATA.LONG(A:0x881624) "' name='RPMH_VRM_ENABLE_CRS_DRV8_REG22'/>"
WRITE #1 "        <register address='0xb881724' value='0x" DATA.LONG(A:0x881724) "' name='RPMH_VRM_ENABLE_CRS_DRV8_REG23'/>"
WRITE #1 "        <register address='0xb881824' value='0x" DATA.LONG(A:0x881824) "' name='RPMH_VRM_ENABLE_CRS_DRV8_REG24'/>"
WRITE #1 "        <register address='0xb881924' value='0x" DATA.LONG(A:0x881924) "' name='RPMH_VRM_ENABLE_CRS_DRV8_REG25'/>"
WRITE #1 "        <register address='0xb881a24' value='0x" DATA.LONG(A:0x881a24) "' name='RPMH_VRM_ENABLE_CRS_DRV8_REG26'/>"
WRITE #1 "        <register address='0xb881b24' value='0x" DATA.LONG(A:0x881b24) "' name='RPMH_VRM_ENABLE_CRS_DRV8_REG27'/>"
WRITE #1 "        <register address='0xb881c24' value='0x" DATA.LONG(A:0x881c24) "' name='RPMH_VRM_ENABLE_CRS_DRV8_REG28'/>"
WRITE #1 "        <register address='0xb881d24' value='0x" DATA.LONG(A:0x881d24) "' name='RPMH_VRM_ENABLE_CRS_DRV8_REG29'/>"
WRITE #1 "        <register address='0xb881e24' value='0x" DATA.LONG(A:0x881e24) "' name='RPMH_VRM_ENABLE_CRS_DRV8_REG30'/>"
WRITE #1 "        <register address='0xb881f24' value='0x" DATA.LONG(A:0x881f24) "' name='RPMH_VRM_ENABLE_CRS_DRV8_REG31'/>"
WRITE #1 "        <register address='0xb882024' value='0x" DATA.LONG(A:0x882024) "' name='RPMH_VRM_ENABLE_CRS_DRV8_REG32'/>"
WRITE #1 "        <register address='0xb882124' value='0x" DATA.LONG(A:0x882124) "' name='RPMH_VRM_ENABLE_CRS_DRV8_REG33'/>"
WRITE #1 "        <register address='0xb882224' value='0x" DATA.LONG(A:0x882224) "' name='RPMH_VRM_ENABLE_CRS_DRV8_REG34'/>"
WRITE #1 "        <register address='0xb882324' value='0x" DATA.LONG(A:0x882324) "' name='RPMH_VRM_ENABLE_CRS_DRV8_REG35'/>"
WRITE #1 "        <register address='0xb882424' value='0x" DATA.LONG(A:0x882424) "' name='RPMH_VRM_ENABLE_CRS_DRV8_REG36'/>"
WRITE #1 "        <register address='0xb882524' value='0x" DATA.LONG(A:0x882524) "' name='RPMH_VRM_ENABLE_CRS_DRV8_REG37'/>"
WRITE #1 "        <register address='0xb882624' value='0x" DATA.LONG(A:0x882624) "' name='RPMH_VRM_ENABLE_CRS_DRV8_REG38'/>"
WRITE #1 "        <register address='0xb882724' value='0x" DATA.LONG(A:0x882724) "' name='RPMH_VRM_ENABLE_CRS_DRV8_REG39'/>"
WRITE #1 "        <register address='0xb882824' value='0x" DATA.LONG(A:0x882824) "' name='RPMH_VRM_ENABLE_CRS_DRV8_REG40'/>"
WRITE #1 "        <register address='0xb882924' value='0x" DATA.LONG(A:0x882924) "' name='RPMH_VRM_ENABLE_CRS_DRV8_REG41'/>"
WRITE #1 "        <register address='0xb882a24' value='0x" DATA.LONG(A:0x882a24) "' name='RPMH_VRM_ENABLE_CRS_DRV8_REG42'/>"
WRITE #1 "        <register address='0xb882b24' value='0x" DATA.LONG(A:0x882b24) "' name='RPMH_VRM_ENABLE_CRS_DRV8_REG43'/>"
WRITE #1 "        <register address='0xb882c24' value='0x" DATA.LONG(A:0x882c24) "' name='RPMH_VRM_ENABLE_CRS_DRV8_REG44'/>"
WRITE #1 "        <register address='0xb882d24' value='0x" DATA.LONG(A:0x882d24) "' name='RPMH_VRM_ENABLE_CRS_DRV8_REG45'/>"
WRITE #1 "        <register address='0xb890024' value='0x" DATA.LONG(A:0x890024) "' name='RPMH_VRM_ENABLE_CRS_DRV9_REG0'/>"
WRITE #1 "        <register address='0xb890124' value='0x" DATA.LONG(A:0x890124) "' name='RPMH_VRM_ENABLE_CRS_DRV9_REG1'/>"
WRITE #1 "        <register address='0xb890224' value='0x" DATA.LONG(A:0x890224) "' name='RPMH_VRM_ENABLE_CRS_DRV9_REG2'/>"
WRITE #1 "        <register address='0xb890324' value='0x" DATA.LONG(A:0x890324) "' name='RPMH_VRM_ENABLE_CRS_DRV9_REG3'/>"
WRITE #1 "        <register address='0xb890424' value='0x" DATA.LONG(A:0x890424) "' name='RPMH_VRM_ENABLE_CRS_DRV9_REG4'/>"
WRITE #1 "        <register address='0xb890524' value='0x" DATA.LONG(A:0x890524) "' name='RPMH_VRM_ENABLE_CRS_DRV9_REG5'/>"
WRITE #1 "        <register address='0xb890624' value='0x" DATA.LONG(A:0x890624) "' name='RPMH_VRM_ENABLE_CRS_DRV9_REG6'/>"
WRITE #1 "        <register address='0xb890724' value='0x" DATA.LONG(A:0x890724) "' name='RPMH_VRM_ENABLE_CRS_DRV9_REG7'/>"
WRITE #1 "        <register address='0xb890824' value='0x" DATA.LONG(A:0x890824) "' name='RPMH_VRM_ENABLE_CRS_DRV9_REG8'/>"
WRITE #1 "        <register address='0xb890924' value='0x" DATA.LONG(A:0x890924) "' name='RPMH_VRM_ENABLE_CRS_DRV9_REG9'/>"
WRITE #1 "        <register address='0xb890a24' value='0x" DATA.LONG(A:0x890a24) "' name='RPMH_VRM_ENABLE_CRS_DRV9_REG10'/>"
WRITE #1 "        <register address='0xb890b24' value='0x" DATA.LONG(A:0x890b24) "' name='RPMH_VRM_ENABLE_CRS_DRV9_REG11'/>"
WRITE #1 "        <register address='0xb890c24' value='0x" DATA.LONG(A:0x890c24) "' name='RPMH_VRM_ENABLE_CRS_DRV9_REG12'/>"
WRITE #1 "        <register address='0xb890d24' value='0x" DATA.LONG(A:0x890d24) "' name='RPMH_VRM_ENABLE_CRS_DRV9_REG13'/>"
WRITE #1 "        <register address='0xb890e24' value='0x" DATA.LONG(A:0x890e24) "' name='RPMH_VRM_ENABLE_CRS_DRV9_REG14'/>"
WRITE #1 "        <register address='0xb890f24' value='0x" DATA.LONG(A:0x890f24) "' name='RPMH_VRM_ENABLE_CRS_DRV9_REG15'/>"
WRITE #1 "        <register address='0xb891024' value='0x" DATA.LONG(A:0x891024) "' name='RPMH_VRM_ENABLE_CRS_DRV9_REG16'/>"
WRITE #1 "        <register address='0xb891124' value='0x" DATA.LONG(A:0x891124) "' name='RPMH_VRM_ENABLE_CRS_DRV9_REG17'/>"
WRITE #1 "        <register address='0xb891224' value='0x" DATA.LONG(A:0x891224) "' name='RPMH_VRM_ENABLE_CRS_DRV9_REG18'/>"
WRITE #1 "        <register address='0xb891324' value='0x" DATA.LONG(A:0x891324) "' name='RPMH_VRM_ENABLE_CRS_DRV9_REG19'/>"
WRITE #1 "        <register address='0xb891424' value='0x" DATA.LONG(A:0x891424) "' name='RPMH_VRM_ENABLE_CRS_DRV9_REG20'/>"
WRITE #1 "        <register address='0xb891524' value='0x" DATA.LONG(A:0x891524) "' name='RPMH_VRM_ENABLE_CRS_DRV9_REG21'/>"
WRITE #1 "        <register address='0xb891624' value='0x" DATA.LONG(A:0x891624) "' name='RPMH_VRM_ENABLE_CRS_DRV9_REG22'/>"
WRITE #1 "        <register address='0xb891724' value='0x" DATA.LONG(A:0x891724) "' name='RPMH_VRM_ENABLE_CRS_DRV9_REG23'/>"
WRITE #1 "        <register address='0xb891824' value='0x" DATA.LONG(A:0x891824) "' name='RPMH_VRM_ENABLE_CRS_DRV9_REG24'/>"
WRITE #1 "        <register address='0xb891924' value='0x" DATA.LONG(A:0x891924) "' name='RPMH_VRM_ENABLE_CRS_DRV9_REG25'/>"
WRITE #1 "        <register address='0xb891a24' value='0x" DATA.LONG(A:0x891a24) "' name='RPMH_VRM_ENABLE_CRS_DRV9_REG26'/>"
WRITE #1 "        <register address='0xb891b24' value='0x" DATA.LONG(A:0x891b24) "' name='RPMH_VRM_ENABLE_CRS_DRV9_REG27'/>"
WRITE #1 "        <register address='0xb891c24' value='0x" DATA.LONG(A:0x891c24) "' name='RPMH_VRM_ENABLE_CRS_DRV9_REG28'/>"
WRITE #1 "        <register address='0xb891d24' value='0x" DATA.LONG(A:0x891d24) "' name='RPMH_VRM_ENABLE_CRS_DRV9_REG29'/>"
WRITE #1 "        <register address='0xb891e24' value='0x" DATA.LONG(A:0x891e24) "' name='RPMH_VRM_ENABLE_CRS_DRV9_REG30'/>"
WRITE #1 "        <register address='0xb891f24' value='0x" DATA.LONG(A:0x891f24) "' name='RPMH_VRM_ENABLE_CRS_DRV9_REG31'/>"
WRITE #1 "        <register address='0xb892024' value='0x" DATA.LONG(A:0x892024) "' name='RPMH_VRM_ENABLE_CRS_DRV9_REG32'/>"
WRITE #1 "        <register address='0xb892124' value='0x" DATA.LONG(A:0x892124) "' name='RPMH_VRM_ENABLE_CRS_DRV9_REG33'/>"
WRITE #1 "        <register address='0xb892224' value='0x" DATA.LONG(A:0x892224) "' name='RPMH_VRM_ENABLE_CRS_DRV9_REG34'/>"
WRITE #1 "        <register address='0xb892324' value='0x" DATA.LONG(A:0x892324) "' name='RPMH_VRM_ENABLE_CRS_DRV9_REG35'/>"
WRITE #1 "        <register address='0xb892424' value='0x" DATA.LONG(A:0x892424) "' name='RPMH_VRM_ENABLE_CRS_DRV9_REG36'/>"
WRITE #1 "        <register address='0xb892524' value='0x" DATA.LONG(A:0x892524) "' name='RPMH_VRM_ENABLE_CRS_DRV9_REG37'/>"
WRITE #1 "        <register address='0xb892624' value='0x" DATA.LONG(A:0x892624) "' name='RPMH_VRM_ENABLE_CRS_DRV9_REG38'/>"
WRITE #1 "        <register address='0xb892724' value='0x" DATA.LONG(A:0x892724) "' name='RPMH_VRM_ENABLE_CRS_DRV9_REG39'/>"
WRITE #1 "        <register address='0xb892824' value='0x" DATA.LONG(A:0x892824) "' name='RPMH_VRM_ENABLE_CRS_DRV9_REG40'/>"
WRITE #1 "        <register address='0xb892924' value='0x" DATA.LONG(A:0x892924) "' name='RPMH_VRM_ENABLE_CRS_DRV9_REG41'/>"
WRITE #1 "        <register address='0xb892a24' value='0x" DATA.LONG(A:0x892a24) "' name='RPMH_VRM_ENABLE_CRS_DRV9_REG42'/>"
WRITE #1 "        <register address='0xb892b24' value='0x" DATA.LONG(A:0x892b24) "' name='RPMH_VRM_ENABLE_CRS_DRV9_REG43'/>"
WRITE #1 "        <register address='0xb892c24' value='0x" DATA.LONG(A:0x892c24) "' name='RPMH_VRM_ENABLE_CRS_DRV9_REG44'/>"
WRITE #1 "        <register address='0xb892d24' value='0x" DATA.LONG(A:0x892d24) "' name='RPMH_VRM_ENABLE_CRS_DRV9_REG45'/>"
WRITE #1 "        <register address='0xb8a0024' value='0x" DATA.LONG(A:0x8a0024) "' name='RPMH_VRM_ENABLE_CRS_DRV10_REG0'/>"
WRITE #1 "        <register address='0xb8a0124' value='0x" DATA.LONG(A:0x8a0124) "' name='RPMH_VRM_ENABLE_CRS_DRV10_REG1'/>"
WRITE #1 "        <register address='0xb8a0224' value='0x" DATA.LONG(A:0x8a0224) "' name='RPMH_VRM_ENABLE_CRS_DRV10_REG2'/>"
WRITE #1 "        <register address='0xb8a0324' value='0x" DATA.LONG(A:0x8a0324) "' name='RPMH_VRM_ENABLE_CRS_DRV10_REG3'/>"
WRITE #1 "        <register address='0xb8a0424' value='0x" DATA.LONG(A:0x8a0424) "' name='RPMH_VRM_ENABLE_CRS_DRV10_REG4'/>"
WRITE #1 "        <register address='0xb8a0524' value='0x" DATA.LONG(A:0x8a0524) "' name='RPMH_VRM_ENABLE_CRS_DRV10_REG5'/>"
WRITE #1 "        <register address='0xb8a0624' value='0x" DATA.LONG(A:0x8a0624) "' name='RPMH_VRM_ENABLE_CRS_DRV10_REG6'/>"
WRITE #1 "        <register address='0xb8a0724' value='0x" DATA.LONG(A:0x8a0724) "' name='RPMH_VRM_ENABLE_CRS_DRV10_REG7'/>"
WRITE #1 "        <register address='0xb8a0824' value='0x" DATA.LONG(A:0x8a0824) "' name='RPMH_VRM_ENABLE_CRS_DRV10_REG8'/>"
WRITE #1 "        <register address='0xb8a0924' value='0x" DATA.LONG(A:0x8a0924) "' name='RPMH_VRM_ENABLE_CRS_DRV10_REG9'/>"
WRITE #1 "        <register address='0xb8a0a24' value='0x" DATA.LONG(A:0x8a0a24) "' name='RPMH_VRM_ENABLE_CRS_DRV10_REG10'/>"
WRITE #1 "        <register address='0xb8a0b24' value='0x" DATA.LONG(A:0x8a0b24) "' name='RPMH_VRM_ENABLE_CRS_DRV10_REG11'/>"
WRITE #1 "        <register address='0xb8a0c24' value='0x" DATA.LONG(A:0x8a0c24) "' name='RPMH_VRM_ENABLE_CRS_DRV10_REG12'/>"
WRITE #1 "        <register address='0xb8a0d24' value='0x" DATA.LONG(A:0x8a0d24) "' name='RPMH_VRM_ENABLE_CRS_DRV10_REG13'/>"
WRITE #1 "        <register address='0xb8a0e24' value='0x" DATA.LONG(A:0x8a0e24) "' name='RPMH_VRM_ENABLE_CRS_DRV10_REG14'/>"
WRITE #1 "        <register address='0xb8a0f24' value='0x" DATA.LONG(A:0x8a0f24) "' name='RPMH_VRM_ENABLE_CRS_DRV10_REG15'/>"
WRITE #1 "        <register address='0xb8a1024' value='0x" DATA.LONG(A:0x8a1024) "' name='RPMH_VRM_ENABLE_CRS_DRV10_REG16'/>"
WRITE #1 "        <register address='0xb8a1124' value='0x" DATA.LONG(A:0x8a1124) "' name='RPMH_VRM_ENABLE_CRS_DRV10_REG17'/>"
WRITE #1 "        <register address='0xb8a1224' value='0x" DATA.LONG(A:0x8a1224) "' name='RPMH_VRM_ENABLE_CRS_DRV10_REG18'/>"
WRITE #1 "        <register address='0xb8a1324' value='0x" DATA.LONG(A:0x8a1324) "' name='RPMH_VRM_ENABLE_CRS_DRV10_REG19'/>"
WRITE #1 "        <register address='0xb8a1424' value='0x" DATA.LONG(A:0x8a1424) "' name='RPMH_VRM_ENABLE_CRS_DRV10_REG20'/>"
WRITE #1 "        <register address='0xb8a1524' value='0x" DATA.LONG(A:0x8a1524) "' name='RPMH_VRM_ENABLE_CRS_DRV10_REG21'/>"
WRITE #1 "        <register address='0xb8a1624' value='0x" DATA.LONG(A:0x8a1624) "' name='RPMH_VRM_ENABLE_CRS_DRV10_REG22'/>"
WRITE #1 "        <register address='0xb8a1724' value='0x" DATA.LONG(A:0x8a1724) "' name='RPMH_VRM_ENABLE_CRS_DRV10_REG23'/>"
WRITE #1 "        <register address='0xb8a1824' value='0x" DATA.LONG(A:0x8a1824) "' name='RPMH_VRM_ENABLE_CRS_DRV10_REG24'/>"
WRITE #1 "        <register address='0xb8a1924' value='0x" DATA.LONG(A:0x8a1924) "' name='RPMH_VRM_ENABLE_CRS_DRV10_REG25'/>"
WRITE #1 "        <register address='0xb8a1a24' value='0x" DATA.LONG(A:0x8a1a24) "' name='RPMH_VRM_ENABLE_CRS_DRV10_REG26'/>"
WRITE #1 "        <register address='0xb8a1b24' value='0x" DATA.LONG(A:0x8a1b24) "' name='RPMH_VRM_ENABLE_CRS_DRV10_REG27'/>"
WRITE #1 "        <register address='0xb8a1c24' value='0x" DATA.LONG(A:0x8a1c24) "' name='RPMH_VRM_ENABLE_CRS_DRV10_REG28'/>"
WRITE #1 "        <register address='0xb8a1d24' value='0x" DATA.LONG(A:0x8a1d24) "' name='RPMH_VRM_ENABLE_CRS_DRV10_REG29'/>"
WRITE #1 "        <register address='0xb8a1e24' value='0x" DATA.LONG(A:0x8a1e24) "' name='RPMH_VRM_ENABLE_CRS_DRV10_REG30'/>"
WRITE #1 "        <register address='0xb8a1f24' value='0x" DATA.LONG(A:0x8a1f24) "' name='RPMH_VRM_ENABLE_CRS_DRV10_REG31'/>"
WRITE #1 "        <register address='0xb8a2024' value='0x" DATA.LONG(A:0x8a2024) "' name='RPMH_VRM_ENABLE_CRS_DRV10_REG32'/>"
WRITE #1 "        <register address='0xb8a2124' value='0x" DATA.LONG(A:0x8a2124) "' name='RPMH_VRM_ENABLE_CRS_DRV10_REG33'/>"
WRITE #1 "        <register address='0xb8a2224' value='0x" DATA.LONG(A:0x8a2224) "' name='RPMH_VRM_ENABLE_CRS_DRV10_REG34'/>"
WRITE #1 "        <register address='0xb8a2324' value='0x" DATA.LONG(A:0x8a2324) "' name='RPMH_VRM_ENABLE_CRS_DRV10_REG35'/>"
WRITE #1 "        <register address='0xb8a2424' value='0x" DATA.LONG(A:0x8a2424) "' name='RPMH_VRM_ENABLE_CRS_DRV10_REG36'/>"
WRITE #1 "        <register address='0xb8a2524' value='0x" DATA.LONG(A:0x8a2524) "' name='RPMH_VRM_ENABLE_CRS_DRV10_REG37'/>"
WRITE #1 "        <register address='0xb8a2624' value='0x" DATA.LONG(A:0x8a2624) "' name='RPMH_VRM_ENABLE_CRS_DRV10_REG38'/>"
WRITE #1 "        <register address='0xb8a2724' value='0x" DATA.LONG(A:0x8a2724) "' name='RPMH_VRM_ENABLE_CRS_DRV10_REG39'/>"
WRITE #1 "        <register address='0xb8a2824' value='0x" DATA.LONG(A:0x8a2824) "' name='RPMH_VRM_ENABLE_CRS_DRV10_REG40'/>"
WRITE #1 "        <register address='0xb8a2924' value='0x" DATA.LONG(A:0x8a2924) "' name='RPMH_VRM_ENABLE_CRS_DRV10_REG41'/>"
WRITE #1 "        <register address='0xb8a2a24' value='0x" DATA.LONG(A:0x8a2a24) "' name='RPMH_VRM_ENABLE_CRS_DRV10_REG42'/>"
WRITE #1 "        <register address='0xb8a2b24' value='0x" DATA.LONG(A:0x8a2b24) "' name='RPMH_VRM_ENABLE_CRS_DRV10_REG43'/>"
WRITE #1 "        <register address='0xb8a2c24' value='0x" DATA.LONG(A:0x8a2c24) "' name='RPMH_VRM_ENABLE_CRS_DRV10_REG44'/>"
WRITE #1 "        <register address='0xb8a2d24' value='0x" DATA.LONG(A:0x8a2d24) "' name='RPMH_VRM_ENABLE_CRS_DRV10_REG45'/>"
WRITE #1 "        <register address='0xb8b0024' value='0x" DATA.LONG(A:0x8b0024) "' name='RPMH_VRM_ENABLE_CRS_DRV11_REG0'/>"
WRITE #1 "        <register address='0xb8b0124' value='0x" DATA.LONG(A:0x8b0124) "' name='RPMH_VRM_ENABLE_CRS_DRV11_REG1'/>"
WRITE #1 "        <register address='0xb8b0224' value='0x" DATA.LONG(A:0x8b0224) "' name='RPMH_VRM_ENABLE_CRS_DRV11_REG2'/>"
WRITE #1 "        <register address='0xb8b0324' value='0x" DATA.LONG(A:0x8b0324) "' name='RPMH_VRM_ENABLE_CRS_DRV11_REG3'/>"
WRITE #1 "        <register address='0xb8b0424' value='0x" DATA.LONG(A:0x8b0424) "' name='RPMH_VRM_ENABLE_CRS_DRV11_REG4'/>"
WRITE #1 "        <register address='0xb8b0524' value='0x" DATA.LONG(A:0x8b0524) "' name='RPMH_VRM_ENABLE_CRS_DRV11_REG5'/>"
WRITE #1 "        <register address='0xb8b0624' value='0x" DATA.LONG(A:0x8b0624) "' name='RPMH_VRM_ENABLE_CRS_DRV11_REG6'/>"
WRITE #1 "        <register address='0xb8b0724' value='0x" DATA.LONG(A:0x8b0724) "' name='RPMH_VRM_ENABLE_CRS_DRV11_REG7'/>"
WRITE #1 "        <register address='0xb8b0824' value='0x" DATA.LONG(A:0x8b0824) "' name='RPMH_VRM_ENABLE_CRS_DRV11_REG8'/>"
WRITE #1 "        <register address='0xb8b0924' value='0x" DATA.LONG(A:0x8b0924) "' name='RPMH_VRM_ENABLE_CRS_DRV11_REG9'/>"
WRITE #1 "        <register address='0xb8b0a24' value='0x" DATA.LONG(A:0x8b0a24) "' name='RPMH_VRM_ENABLE_CRS_DRV11_REG10'/>"
WRITE #1 "        <register address='0xb8b0b24' value='0x" DATA.LONG(A:0x8b0b24) "' name='RPMH_VRM_ENABLE_CRS_DRV11_REG11'/>"
WRITE #1 "        <register address='0xb8b0c24' value='0x" DATA.LONG(A:0x8b0c24) "' name='RPMH_VRM_ENABLE_CRS_DRV11_REG12'/>"
WRITE #1 "        <register address='0xb8b0d24' value='0x" DATA.LONG(A:0x8b0d24) "' name='RPMH_VRM_ENABLE_CRS_DRV11_REG13'/>"
WRITE #1 "        <register address='0xb8b0e24' value='0x" DATA.LONG(A:0x8b0e24) "' name='RPMH_VRM_ENABLE_CRS_DRV11_REG14'/>"
WRITE #1 "        <register address='0xb8b0f24' value='0x" DATA.LONG(A:0x8b0f24) "' name='RPMH_VRM_ENABLE_CRS_DRV11_REG15'/>"
WRITE #1 "        <register address='0xb8b1024' value='0x" DATA.LONG(A:0x8b1024) "' name='RPMH_VRM_ENABLE_CRS_DRV11_REG16'/>"
WRITE #1 "        <register address='0xb8b1124' value='0x" DATA.LONG(A:0x8b1124) "' name='RPMH_VRM_ENABLE_CRS_DRV11_REG17'/>"
WRITE #1 "        <register address='0xb8b1224' value='0x" DATA.LONG(A:0x8b1224) "' name='RPMH_VRM_ENABLE_CRS_DRV11_REG18'/>"
WRITE #1 "        <register address='0xb8b1324' value='0x" DATA.LONG(A:0x8b1324) "' name='RPMH_VRM_ENABLE_CRS_DRV11_REG19'/>"
WRITE #1 "        <register address='0xb8b1424' value='0x" DATA.LONG(A:0x8b1424) "' name='RPMH_VRM_ENABLE_CRS_DRV11_REG20'/>"
WRITE #1 "        <register address='0xb8b1524' value='0x" DATA.LONG(A:0x8b1524) "' name='RPMH_VRM_ENABLE_CRS_DRV11_REG21'/>"
WRITE #1 "        <register address='0xb8b1624' value='0x" DATA.LONG(A:0x8b1624) "' name='RPMH_VRM_ENABLE_CRS_DRV11_REG22'/>"
WRITE #1 "        <register address='0xb8b1724' value='0x" DATA.LONG(A:0x8b1724) "' name='RPMH_VRM_ENABLE_CRS_DRV11_REG23'/>"
WRITE #1 "        <register address='0xb8b1824' value='0x" DATA.LONG(A:0x8b1824) "' name='RPMH_VRM_ENABLE_CRS_DRV11_REG24'/>"
WRITE #1 "        <register address='0xb8b1924' value='0x" DATA.LONG(A:0x8b1924) "' name='RPMH_VRM_ENABLE_CRS_DRV11_REG25'/>"
WRITE #1 "        <register address='0xb8b1a24' value='0x" DATA.LONG(A:0x8b1a24) "' name='RPMH_VRM_ENABLE_CRS_DRV11_REG26'/>"
WRITE #1 "        <register address='0xb8b1b24' value='0x" DATA.LONG(A:0x8b1b24) "' name='RPMH_VRM_ENABLE_CRS_DRV11_REG27'/>"
WRITE #1 "        <register address='0xb8b1c24' value='0x" DATA.LONG(A:0x8b1c24) "' name='RPMH_VRM_ENABLE_CRS_DRV11_REG28'/>"
WRITE #1 "        <register address='0xb8b1d24' value='0x" DATA.LONG(A:0x8b1d24) "' name='RPMH_VRM_ENABLE_CRS_DRV11_REG29'/>"
WRITE #1 "        <register address='0xb8b1e24' value='0x" DATA.LONG(A:0x8b1e24) "' name='RPMH_VRM_ENABLE_CRS_DRV11_REG30'/>"
WRITE #1 "        <register address='0xb8b1f24' value='0x" DATA.LONG(A:0x8b1f24) "' name='RPMH_VRM_ENABLE_CRS_DRV11_REG31'/>"
WRITE #1 "        <register address='0xb8b2024' value='0x" DATA.LONG(A:0x8b2024) "' name='RPMH_VRM_ENABLE_CRS_DRV11_REG32'/>"
WRITE #1 "        <register address='0xb8b2124' value='0x" DATA.LONG(A:0x8b2124) "' name='RPMH_VRM_ENABLE_CRS_DRV11_REG33'/>"
WRITE #1 "        <register address='0xb8b2224' value='0x" DATA.LONG(A:0x8b2224) "' name='RPMH_VRM_ENABLE_CRS_DRV11_REG34'/>"
WRITE #1 "        <register address='0xb8b2324' value='0x" DATA.LONG(A:0x8b2324) "' name='RPMH_VRM_ENABLE_CRS_DRV11_REG35'/>"
WRITE #1 "        <register address='0xb8b2424' value='0x" DATA.LONG(A:0x8b2424) "' name='RPMH_VRM_ENABLE_CRS_DRV11_REG36'/>"
WRITE #1 "        <register address='0xb8b2524' value='0x" DATA.LONG(A:0x8b2524) "' name='RPMH_VRM_ENABLE_CRS_DRV11_REG37'/>"
WRITE #1 "        <register address='0xb8b2624' value='0x" DATA.LONG(A:0x8b2624) "' name='RPMH_VRM_ENABLE_CRS_DRV11_REG38'/>"
WRITE #1 "        <register address='0xb8b2724' value='0x" DATA.LONG(A:0x8b2724) "' name='RPMH_VRM_ENABLE_CRS_DRV11_REG39'/>"
WRITE #1 "        <register address='0xb8b2824' value='0x" DATA.LONG(A:0x8b2824) "' name='RPMH_VRM_ENABLE_CRS_DRV11_REG40'/>"
WRITE #1 "        <register address='0xb8b2924' value='0x" DATA.LONG(A:0x8b2924) "' name='RPMH_VRM_ENABLE_CRS_DRV11_REG41'/>"
WRITE #1 "        <register address='0xb8b2a24' value='0x" DATA.LONG(A:0x8b2a24) "' name='RPMH_VRM_ENABLE_CRS_DRV11_REG42'/>"
WRITE #1 "        <register address='0xb8b2b24' value='0x" DATA.LONG(A:0x8b2b24) "' name='RPMH_VRM_ENABLE_CRS_DRV11_REG43'/>"
WRITE #1 "        <register address='0xb8b2c24' value='0x" DATA.LONG(A:0x8b2c24) "' name='RPMH_VRM_ENABLE_CRS_DRV11_REG44'/>"
WRITE #1 "        <register address='0xb8b2d24' value='0x" DATA.LONG(A:0x8b2d24) "' name='RPMH_VRM_ENABLE_CRS_DRV11_REG45'/>"
WRITE #1 "        <register address='0xb800028' value='0x" DATA.LONG(A:0x800028) "' name='RPMH_VRM_MODE_CRS_DRV0_REG0'/>"
WRITE #1 "        <register address='0xb800128' value='0x" DATA.LONG(A:0x800128) "' name='RPMH_VRM_MODE_CRS_DRV0_REG1'/>"
WRITE #1 "        <register address='0xb800228' value='0x" DATA.LONG(A:0x800228) "' name='RPMH_VRM_MODE_CRS_DRV0_REG2'/>"
WRITE #1 "        <register address='0xb800328' value='0x" DATA.LONG(A:0x800328) "' name='RPMH_VRM_MODE_CRS_DRV0_REG3'/>"
WRITE #1 "        <register address='0xb800428' value='0x" DATA.LONG(A:0x800428) "' name='RPMH_VRM_MODE_CRS_DRV0_REG4'/>"
WRITE #1 "        <register address='0xb800528' value='0x" DATA.LONG(A:0x800528) "' name='RPMH_VRM_MODE_CRS_DRV0_REG5'/>"
WRITE #1 "        <register address='0xb800628' value='0x" DATA.LONG(A:0x800628) "' name='RPMH_VRM_MODE_CRS_DRV0_REG6'/>"
WRITE #1 "        <register address='0xb800728' value='0x" DATA.LONG(A:0x800728) "' name='RPMH_VRM_MODE_CRS_DRV0_REG7'/>"
WRITE #1 "        <register address='0xb800828' value='0x" DATA.LONG(A:0x800828) "' name='RPMH_VRM_MODE_CRS_DRV0_REG8'/>"
WRITE #1 "        <register address='0xb800928' value='0x" DATA.LONG(A:0x800928) "' name='RPMH_VRM_MODE_CRS_DRV0_REG9'/>"
WRITE #1 "        <register address='0xb800a28' value='0x" DATA.LONG(A:0x800a28) "' name='RPMH_VRM_MODE_CRS_DRV0_REG10'/>"
WRITE #1 "        <register address='0xb800b28' value='0x" DATA.LONG(A:0x800b28) "' name='RPMH_VRM_MODE_CRS_DRV0_REG11'/>"
WRITE #1 "        <register address='0xb800c28' value='0x" DATA.LONG(A:0x800c28) "' name='RPMH_VRM_MODE_CRS_DRV0_REG12'/>"
WRITE #1 "        <register address='0xb800d28' value='0x" DATA.LONG(A:0x800d28) "' name='RPMH_VRM_MODE_CRS_DRV0_REG13'/>"
WRITE #1 "        <register address='0xb800e28' value='0x" DATA.LONG(A:0x800e28) "' name='RPMH_VRM_MODE_CRS_DRV0_REG14'/>"
WRITE #1 "        <register address='0xb800f28' value='0x" DATA.LONG(A:0x800f28) "' name='RPMH_VRM_MODE_CRS_DRV0_REG15'/>"
WRITE #1 "        <register address='0xb801028' value='0x" DATA.LONG(A:0x801028) "' name='RPMH_VRM_MODE_CRS_DRV0_REG16'/>"
WRITE #1 "        <register address='0xb801128' value='0x" DATA.LONG(A:0x801128) "' name='RPMH_VRM_MODE_CRS_DRV0_REG17'/>"
WRITE #1 "        <register address='0xb801228' value='0x" DATA.LONG(A:0x801228) "' name='RPMH_VRM_MODE_CRS_DRV0_REG18'/>"
WRITE #1 "        <register address='0xb801328' value='0x" DATA.LONG(A:0x801328) "' name='RPMH_VRM_MODE_CRS_DRV0_REG19'/>"
WRITE #1 "        <register address='0xb801428' value='0x" DATA.LONG(A:0x801428) "' name='RPMH_VRM_MODE_CRS_DRV0_REG20'/>"
WRITE #1 "        <register address='0xb801528' value='0x" DATA.LONG(A:0x801528) "' name='RPMH_VRM_MODE_CRS_DRV0_REG21'/>"
WRITE #1 "        <register address='0xb801628' value='0x" DATA.LONG(A:0x801628) "' name='RPMH_VRM_MODE_CRS_DRV0_REG22'/>"
WRITE #1 "        <register address='0xb801728' value='0x" DATA.LONG(A:0x801728) "' name='RPMH_VRM_MODE_CRS_DRV0_REG23'/>"
WRITE #1 "        <register address='0xb801828' value='0x" DATA.LONG(A:0x801828) "' name='RPMH_VRM_MODE_CRS_DRV0_REG24'/>"
WRITE #1 "        <register address='0xb801928' value='0x" DATA.LONG(A:0x801928) "' name='RPMH_VRM_MODE_CRS_DRV0_REG25'/>"
WRITE #1 "        <register address='0xb801a28' value='0x" DATA.LONG(A:0x801a28) "' name='RPMH_VRM_MODE_CRS_DRV0_REG26'/>"
WRITE #1 "        <register address='0xb801b28' value='0x" DATA.LONG(A:0x801b28) "' name='RPMH_VRM_MODE_CRS_DRV0_REG27'/>"
WRITE #1 "        <register address='0xb801c28' value='0x" DATA.LONG(A:0x801c28) "' name='RPMH_VRM_MODE_CRS_DRV0_REG28'/>"
WRITE #1 "        <register address='0xb801d28' value='0x" DATA.LONG(A:0x801d28) "' name='RPMH_VRM_MODE_CRS_DRV0_REG29'/>"
WRITE #1 "        <register address='0xb801e28' value='0x" DATA.LONG(A:0x801e28) "' name='RPMH_VRM_MODE_CRS_DRV0_REG30'/>"
WRITE #1 "        <register address='0xb801f28' value='0x" DATA.LONG(A:0x801f28) "' name='RPMH_VRM_MODE_CRS_DRV0_REG31'/>"
WRITE #1 "        <register address='0xb802028' value='0x" DATA.LONG(A:0x802028) "' name='RPMH_VRM_MODE_CRS_DRV0_REG32'/>"
WRITE #1 "        <register address='0xb802128' value='0x" DATA.LONG(A:0x802128) "' name='RPMH_VRM_MODE_CRS_DRV0_REG33'/>"
WRITE #1 "        <register address='0xb802228' value='0x" DATA.LONG(A:0x802228) "' name='RPMH_VRM_MODE_CRS_DRV0_REG34'/>"
WRITE #1 "        <register address='0xb802328' value='0x" DATA.LONG(A:0x802328) "' name='RPMH_VRM_MODE_CRS_DRV0_REG35'/>"
WRITE #1 "        <register address='0xb802428' value='0x" DATA.LONG(A:0x802428) "' name='RPMH_VRM_MODE_CRS_DRV0_REG36'/>"
WRITE #1 "        <register address='0xb802528' value='0x" DATA.LONG(A:0x802528) "' name='RPMH_VRM_MODE_CRS_DRV0_REG37'/>"
WRITE #1 "        <register address='0xb802628' value='0x" DATA.LONG(A:0x802628) "' name='RPMH_VRM_MODE_CRS_DRV0_REG38'/>"
WRITE #1 "        <register address='0xb802728' value='0x" DATA.LONG(A:0x802728) "' name='RPMH_VRM_MODE_CRS_DRV0_REG39'/>"
WRITE #1 "        <register address='0xb802828' value='0x" DATA.LONG(A:0x802828) "' name='RPMH_VRM_MODE_CRS_DRV0_REG40'/>"
WRITE #1 "        <register address='0xb802928' value='0x" DATA.LONG(A:0x802928) "' name='RPMH_VRM_MODE_CRS_DRV0_REG41'/>"
WRITE #1 "        <register address='0xb802a28' value='0x" DATA.LONG(A:0x802a28) "' name='RPMH_VRM_MODE_CRS_DRV0_REG42'/>"
WRITE #1 "        <register address='0xb802b28' value='0x" DATA.LONG(A:0x802b28) "' name='RPMH_VRM_MODE_CRS_DRV0_REG43'/>"
WRITE #1 "        <register address='0xb802c28' value='0x" DATA.LONG(A:0x802c28) "' name='RPMH_VRM_MODE_CRS_DRV0_REG44'/>"
WRITE #1 "        <register address='0xb802d28' value='0x" DATA.LONG(A:0x802d28) "' name='RPMH_VRM_MODE_CRS_DRV0_REG45'/>"
WRITE #1 "        <register address='0xb810028' value='0x" DATA.LONG(A:0x810028) "' name='RPMH_VRM_MODE_CRS_DRV1_REG0'/>"
WRITE #1 "        <register address='0xb810128' value='0x" DATA.LONG(A:0x810128) "' name='RPMH_VRM_MODE_CRS_DRV1_REG1'/>"
WRITE #1 "        <register address='0xb810228' value='0x" DATA.LONG(A:0x810228) "' name='RPMH_VRM_MODE_CRS_DRV1_REG2'/>"
WRITE #1 "        <register address='0xb810328' value='0x" DATA.LONG(A:0x810328) "' name='RPMH_VRM_MODE_CRS_DRV1_REG3'/>"
WRITE #1 "        <register address='0xb810428' value='0x" DATA.LONG(A:0x810428) "' name='RPMH_VRM_MODE_CRS_DRV1_REG4'/>"
WRITE #1 "        <register address='0xb810528' value='0x" DATA.LONG(A:0x810528) "' name='RPMH_VRM_MODE_CRS_DRV1_REG5'/>"
WRITE #1 "        <register address='0xb810628' value='0x" DATA.LONG(A:0x810628) "' name='RPMH_VRM_MODE_CRS_DRV1_REG6'/>"
WRITE #1 "        <register address='0xb810728' value='0x" DATA.LONG(A:0x810728) "' name='RPMH_VRM_MODE_CRS_DRV1_REG7'/>"
WRITE #1 "        <register address='0xb810828' value='0x" DATA.LONG(A:0x810828) "' name='RPMH_VRM_MODE_CRS_DRV1_REG8'/>"
WRITE #1 "        <register address='0xb810928' value='0x" DATA.LONG(A:0x810928) "' name='RPMH_VRM_MODE_CRS_DRV1_REG9'/>"
WRITE #1 "        <register address='0xb810a28' value='0x" DATA.LONG(A:0x810a28) "' name='RPMH_VRM_MODE_CRS_DRV1_REG10'/>"
WRITE #1 "        <register address='0xb810b28' value='0x" DATA.LONG(A:0x810b28) "' name='RPMH_VRM_MODE_CRS_DRV1_REG11'/>"
WRITE #1 "        <register address='0xb810c28' value='0x" DATA.LONG(A:0x810c28) "' name='RPMH_VRM_MODE_CRS_DRV1_REG12'/>"
WRITE #1 "        <register address='0xb810d28' value='0x" DATA.LONG(A:0x810d28) "' name='RPMH_VRM_MODE_CRS_DRV1_REG13'/>"
WRITE #1 "        <register address='0xb810e28' value='0x" DATA.LONG(A:0x810e28) "' name='RPMH_VRM_MODE_CRS_DRV1_REG14'/>"
WRITE #1 "        <register address='0xb810f28' value='0x" DATA.LONG(A:0x810f28) "' name='RPMH_VRM_MODE_CRS_DRV1_REG15'/>"
WRITE #1 "        <register address='0xb811028' value='0x" DATA.LONG(A:0x811028) "' name='RPMH_VRM_MODE_CRS_DRV1_REG16'/>"
WRITE #1 "        <register address='0xb811128' value='0x" DATA.LONG(A:0x811128) "' name='RPMH_VRM_MODE_CRS_DRV1_REG17'/>"
WRITE #1 "        <register address='0xb811228' value='0x" DATA.LONG(A:0x811228) "' name='RPMH_VRM_MODE_CRS_DRV1_REG18'/>"
WRITE #1 "        <register address='0xb811328' value='0x" DATA.LONG(A:0x811328) "' name='RPMH_VRM_MODE_CRS_DRV1_REG19'/>"
WRITE #1 "        <register address='0xb811428' value='0x" DATA.LONG(A:0x811428) "' name='RPMH_VRM_MODE_CRS_DRV1_REG20'/>"
WRITE #1 "        <register address='0xb811528' value='0x" DATA.LONG(A:0x811528) "' name='RPMH_VRM_MODE_CRS_DRV1_REG21'/>"
WRITE #1 "        <register address='0xb811628' value='0x" DATA.LONG(A:0x811628) "' name='RPMH_VRM_MODE_CRS_DRV1_REG22'/>"
WRITE #1 "        <register address='0xb811728' value='0x" DATA.LONG(A:0x811728) "' name='RPMH_VRM_MODE_CRS_DRV1_REG23'/>"
WRITE #1 "        <register address='0xb811828' value='0x" DATA.LONG(A:0x811828) "' name='RPMH_VRM_MODE_CRS_DRV1_REG24'/>"
WRITE #1 "        <register address='0xb811928' value='0x" DATA.LONG(A:0x811928) "' name='RPMH_VRM_MODE_CRS_DRV1_REG25'/>"
WRITE #1 "        <register address='0xb811a28' value='0x" DATA.LONG(A:0x811a28) "' name='RPMH_VRM_MODE_CRS_DRV1_REG26'/>"
WRITE #1 "        <register address='0xb811b28' value='0x" DATA.LONG(A:0x811b28) "' name='RPMH_VRM_MODE_CRS_DRV1_REG27'/>"
WRITE #1 "        <register address='0xb811c28' value='0x" DATA.LONG(A:0x811c28) "' name='RPMH_VRM_MODE_CRS_DRV1_REG28'/>"
WRITE #1 "        <register address='0xb811d28' value='0x" DATA.LONG(A:0x811d28) "' name='RPMH_VRM_MODE_CRS_DRV1_REG29'/>"
WRITE #1 "        <register address='0xb811e28' value='0x" DATA.LONG(A:0x811e28) "' name='RPMH_VRM_MODE_CRS_DRV1_REG30'/>"
WRITE #1 "        <register address='0xb811f28' value='0x" DATA.LONG(A:0x811f28) "' name='RPMH_VRM_MODE_CRS_DRV1_REG31'/>"
WRITE #1 "        <register address='0xb812028' value='0x" DATA.LONG(A:0x812028) "' name='RPMH_VRM_MODE_CRS_DRV1_REG32'/>"
WRITE #1 "        <register address='0xb812128' value='0x" DATA.LONG(A:0x812128) "' name='RPMH_VRM_MODE_CRS_DRV1_REG33'/>"
WRITE #1 "        <register address='0xb812228' value='0x" DATA.LONG(A:0x812228) "' name='RPMH_VRM_MODE_CRS_DRV1_REG34'/>"
WRITE #1 "        <register address='0xb812328' value='0x" DATA.LONG(A:0x812328) "' name='RPMH_VRM_MODE_CRS_DRV1_REG35'/>"
WRITE #1 "        <register address='0xb812428' value='0x" DATA.LONG(A:0x812428) "' name='RPMH_VRM_MODE_CRS_DRV1_REG36'/>"
WRITE #1 "        <register address='0xb812528' value='0x" DATA.LONG(A:0x812528) "' name='RPMH_VRM_MODE_CRS_DRV1_REG37'/>"
WRITE #1 "        <register address='0xb812628' value='0x" DATA.LONG(A:0x812628) "' name='RPMH_VRM_MODE_CRS_DRV1_REG38'/>"
WRITE #1 "        <register address='0xb812728' value='0x" DATA.LONG(A:0x812728) "' name='RPMH_VRM_MODE_CRS_DRV1_REG39'/>"
WRITE #1 "        <register address='0xb812828' value='0x" DATA.LONG(A:0x812828) "' name='RPMH_VRM_MODE_CRS_DRV1_REG40'/>"
WRITE #1 "        <register address='0xb812928' value='0x" DATA.LONG(A:0x812928) "' name='RPMH_VRM_MODE_CRS_DRV1_REG41'/>"
WRITE #1 "        <register address='0xb812a28' value='0x" DATA.LONG(A:0x812a28) "' name='RPMH_VRM_MODE_CRS_DRV1_REG42'/>"
WRITE #1 "        <register address='0xb812b28' value='0x" DATA.LONG(A:0x812b28) "' name='RPMH_VRM_MODE_CRS_DRV1_REG43'/>"
WRITE #1 "        <register address='0xb812c28' value='0x" DATA.LONG(A:0x812c28) "' name='RPMH_VRM_MODE_CRS_DRV1_REG44'/>"
WRITE #1 "        <register address='0xb812d28' value='0x" DATA.LONG(A:0x812d28) "' name='RPMH_VRM_MODE_CRS_DRV1_REG45'/>"
WRITE #1 "        <register address='0xb820028' value='0x" DATA.LONG(A:0x820028) "' name='RPMH_VRM_MODE_CRS_DRV2_REG0'/>"
WRITE #1 "        <register address='0xb820128' value='0x" DATA.LONG(A:0x820128) "' name='RPMH_VRM_MODE_CRS_DRV2_REG1'/>"
WRITE #1 "        <register address='0xb820228' value='0x" DATA.LONG(A:0x820228) "' name='RPMH_VRM_MODE_CRS_DRV2_REG2'/>"
WRITE #1 "        <register address='0xb820328' value='0x" DATA.LONG(A:0x820328) "' name='RPMH_VRM_MODE_CRS_DRV2_REG3'/>"
WRITE #1 "        <register address='0xb820428' value='0x" DATA.LONG(A:0x820428) "' name='RPMH_VRM_MODE_CRS_DRV2_REG4'/>"
WRITE #1 "        <register address='0xb820528' value='0x" DATA.LONG(A:0x820528) "' name='RPMH_VRM_MODE_CRS_DRV2_REG5'/>"
WRITE #1 "        <register address='0xb820628' value='0x" DATA.LONG(A:0x820628) "' name='RPMH_VRM_MODE_CRS_DRV2_REG6'/>"
WRITE #1 "        <register address='0xb820728' value='0x" DATA.LONG(A:0x820728) "' name='RPMH_VRM_MODE_CRS_DRV2_REG7'/>"
WRITE #1 "        <register address='0xb820828' value='0x" DATA.LONG(A:0x820828) "' name='RPMH_VRM_MODE_CRS_DRV2_REG8'/>"
WRITE #1 "        <register address='0xb820928' value='0x" DATA.LONG(A:0x820928) "' name='RPMH_VRM_MODE_CRS_DRV2_REG9'/>"
WRITE #1 "        <register address='0xb820a28' value='0x" DATA.LONG(A:0x820a28) "' name='RPMH_VRM_MODE_CRS_DRV2_REG10'/>"
WRITE #1 "        <register address='0xb820b28' value='0x" DATA.LONG(A:0x820b28) "' name='RPMH_VRM_MODE_CRS_DRV2_REG11'/>"
WRITE #1 "        <register address='0xb820c28' value='0x" DATA.LONG(A:0x820c28) "' name='RPMH_VRM_MODE_CRS_DRV2_REG12'/>"
WRITE #1 "        <register address='0xb820d28' value='0x" DATA.LONG(A:0x820d28) "' name='RPMH_VRM_MODE_CRS_DRV2_REG13'/>"
WRITE #1 "        <register address='0xb820e28' value='0x" DATA.LONG(A:0x820e28) "' name='RPMH_VRM_MODE_CRS_DRV2_REG14'/>"
WRITE #1 "        <register address='0xb820f28' value='0x" DATA.LONG(A:0x820f28) "' name='RPMH_VRM_MODE_CRS_DRV2_REG15'/>"
WRITE #1 "        <register address='0xb821028' value='0x" DATA.LONG(A:0x821028) "' name='RPMH_VRM_MODE_CRS_DRV2_REG16'/>"
WRITE #1 "        <register address='0xb821128' value='0x" DATA.LONG(A:0x821128) "' name='RPMH_VRM_MODE_CRS_DRV2_REG17'/>"
WRITE #1 "        <register address='0xb821228' value='0x" DATA.LONG(A:0x821228) "' name='RPMH_VRM_MODE_CRS_DRV2_REG18'/>"
WRITE #1 "        <register address='0xb821328' value='0x" DATA.LONG(A:0x821328) "' name='RPMH_VRM_MODE_CRS_DRV2_REG19'/>"
WRITE #1 "        <register address='0xb821428' value='0x" DATA.LONG(A:0x821428) "' name='RPMH_VRM_MODE_CRS_DRV2_REG20'/>"
WRITE #1 "        <register address='0xb821528' value='0x" DATA.LONG(A:0x821528) "' name='RPMH_VRM_MODE_CRS_DRV2_REG21'/>"
WRITE #1 "        <register address='0xb821628' value='0x" DATA.LONG(A:0x821628) "' name='RPMH_VRM_MODE_CRS_DRV2_REG22'/>"
WRITE #1 "        <register address='0xb821728' value='0x" DATA.LONG(A:0x821728) "' name='RPMH_VRM_MODE_CRS_DRV2_REG23'/>"
WRITE #1 "        <register address='0xb821828' value='0x" DATA.LONG(A:0x821828) "' name='RPMH_VRM_MODE_CRS_DRV2_REG24'/>"
WRITE #1 "        <register address='0xb821928' value='0x" DATA.LONG(A:0x821928) "' name='RPMH_VRM_MODE_CRS_DRV2_REG25'/>"
WRITE #1 "        <register address='0xb821a28' value='0x" DATA.LONG(A:0x821a28) "' name='RPMH_VRM_MODE_CRS_DRV2_REG26'/>"
WRITE #1 "        <register address='0xb821b28' value='0x" DATA.LONG(A:0x821b28) "' name='RPMH_VRM_MODE_CRS_DRV2_REG27'/>"
WRITE #1 "        <register address='0xb821c28' value='0x" DATA.LONG(A:0x821c28) "' name='RPMH_VRM_MODE_CRS_DRV2_REG28'/>"
WRITE #1 "        <register address='0xb821d28' value='0x" DATA.LONG(A:0x821d28) "' name='RPMH_VRM_MODE_CRS_DRV2_REG29'/>"
WRITE #1 "        <register address='0xb821e28' value='0x" DATA.LONG(A:0x821e28) "' name='RPMH_VRM_MODE_CRS_DRV2_REG30'/>"
WRITE #1 "        <register address='0xb821f28' value='0x" DATA.LONG(A:0x821f28) "' name='RPMH_VRM_MODE_CRS_DRV2_REG31'/>"
WRITE #1 "        <register address='0xb822028' value='0x" DATA.LONG(A:0x822028) "' name='RPMH_VRM_MODE_CRS_DRV2_REG32'/>"
WRITE #1 "        <register address='0xb822128' value='0x" DATA.LONG(A:0x822128) "' name='RPMH_VRM_MODE_CRS_DRV2_REG33'/>"
WRITE #1 "        <register address='0xb822228' value='0x" DATA.LONG(A:0x822228) "' name='RPMH_VRM_MODE_CRS_DRV2_REG34'/>"
WRITE #1 "        <register address='0xb822328' value='0x" DATA.LONG(A:0x822328) "' name='RPMH_VRM_MODE_CRS_DRV2_REG35'/>"
WRITE #1 "        <register address='0xb822428' value='0x" DATA.LONG(A:0x822428) "' name='RPMH_VRM_MODE_CRS_DRV2_REG36'/>"
WRITE #1 "        <register address='0xb822528' value='0x" DATA.LONG(A:0x822528) "' name='RPMH_VRM_MODE_CRS_DRV2_REG37'/>"
WRITE #1 "        <register address='0xb822628' value='0x" DATA.LONG(A:0x822628) "' name='RPMH_VRM_MODE_CRS_DRV2_REG38'/>"
WRITE #1 "        <register address='0xb822728' value='0x" DATA.LONG(A:0x822728) "' name='RPMH_VRM_MODE_CRS_DRV2_REG39'/>"
WRITE #1 "        <register address='0xb822828' value='0x" DATA.LONG(A:0x822828) "' name='RPMH_VRM_MODE_CRS_DRV2_REG40'/>"
WRITE #1 "        <register address='0xb822928' value='0x" DATA.LONG(A:0x822928) "' name='RPMH_VRM_MODE_CRS_DRV2_REG41'/>"
WRITE #1 "        <register address='0xb822a28' value='0x" DATA.LONG(A:0x822a28) "' name='RPMH_VRM_MODE_CRS_DRV2_REG42'/>"
WRITE #1 "        <register address='0xb822b28' value='0x" DATA.LONG(A:0x822b28) "' name='RPMH_VRM_MODE_CRS_DRV2_REG43'/>"
WRITE #1 "        <register address='0xb822c28' value='0x" DATA.LONG(A:0x822c28) "' name='RPMH_VRM_MODE_CRS_DRV2_REG44'/>"
WRITE #1 "        <register address='0xb822d28' value='0x" DATA.LONG(A:0x822d28) "' name='RPMH_VRM_MODE_CRS_DRV2_REG45'/>"
WRITE #1 "        <register address='0xb830028' value='0x" DATA.LONG(A:0x830028) "' name='RPMH_VRM_MODE_CRS_DRV3_REG0'/>"
WRITE #1 "        <register address='0xb830128' value='0x" DATA.LONG(A:0x830128) "' name='RPMH_VRM_MODE_CRS_DRV3_REG1'/>"
WRITE #1 "        <register address='0xb830228' value='0x" DATA.LONG(A:0x830228) "' name='RPMH_VRM_MODE_CRS_DRV3_REG2'/>"
WRITE #1 "        <register address='0xb830328' value='0x" DATA.LONG(A:0x830328) "' name='RPMH_VRM_MODE_CRS_DRV3_REG3'/>"
WRITE #1 "        <register address='0xb830428' value='0x" DATA.LONG(A:0x830428) "' name='RPMH_VRM_MODE_CRS_DRV3_REG4'/>"
WRITE #1 "        <register address='0xb830528' value='0x" DATA.LONG(A:0x830528) "' name='RPMH_VRM_MODE_CRS_DRV3_REG5'/>"
WRITE #1 "        <register address='0xb830628' value='0x" DATA.LONG(A:0x830628) "' name='RPMH_VRM_MODE_CRS_DRV3_REG6'/>"
WRITE #1 "        <register address='0xb830728' value='0x" DATA.LONG(A:0x830728) "' name='RPMH_VRM_MODE_CRS_DRV3_REG7'/>"
WRITE #1 "        <register address='0xb830828' value='0x" DATA.LONG(A:0x830828) "' name='RPMH_VRM_MODE_CRS_DRV3_REG8'/>"
WRITE #1 "        <register address='0xb830928' value='0x" DATA.LONG(A:0x830928) "' name='RPMH_VRM_MODE_CRS_DRV3_REG9'/>"
WRITE #1 "        <register address='0xb830a28' value='0x" DATA.LONG(A:0x830a28) "' name='RPMH_VRM_MODE_CRS_DRV3_REG10'/>"
WRITE #1 "        <register address='0xb830b28' value='0x" DATA.LONG(A:0x830b28) "' name='RPMH_VRM_MODE_CRS_DRV3_REG11'/>"
WRITE #1 "        <register address='0xb830c28' value='0x" DATA.LONG(A:0x830c28) "' name='RPMH_VRM_MODE_CRS_DRV3_REG12'/>"
WRITE #1 "        <register address='0xb830d28' value='0x" DATA.LONG(A:0x830d28) "' name='RPMH_VRM_MODE_CRS_DRV3_REG13'/>"
WRITE #1 "        <register address='0xb830e28' value='0x" DATA.LONG(A:0x830e28) "' name='RPMH_VRM_MODE_CRS_DRV3_REG14'/>"
WRITE #1 "        <register address='0xb830f28' value='0x" DATA.LONG(A:0x830f28) "' name='RPMH_VRM_MODE_CRS_DRV3_REG15'/>"
WRITE #1 "        <register address='0xb831028' value='0x" DATA.LONG(A:0x831028) "' name='RPMH_VRM_MODE_CRS_DRV3_REG16'/>"
WRITE #1 "        <register address='0xb831128' value='0x" DATA.LONG(A:0x831128) "' name='RPMH_VRM_MODE_CRS_DRV3_REG17'/>"
WRITE #1 "        <register address='0xb831228' value='0x" DATA.LONG(A:0x831228) "' name='RPMH_VRM_MODE_CRS_DRV3_REG18'/>"
WRITE #1 "        <register address='0xb831328' value='0x" DATA.LONG(A:0x831328) "' name='RPMH_VRM_MODE_CRS_DRV3_REG19'/>"
WRITE #1 "        <register address='0xb831428' value='0x" DATA.LONG(A:0x831428) "' name='RPMH_VRM_MODE_CRS_DRV3_REG20'/>"
WRITE #1 "        <register address='0xb831528' value='0x" DATA.LONG(A:0x831528) "' name='RPMH_VRM_MODE_CRS_DRV3_REG21'/>"
WRITE #1 "        <register address='0xb831628' value='0x" DATA.LONG(A:0x831628) "' name='RPMH_VRM_MODE_CRS_DRV3_REG22'/>"
WRITE #1 "        <register address='0xb831728' value='0x" DATA.LONG(A:0x831728) "' name='RPMH_VRM_MODE_CRS_DRV3_REG23'/>"
WRITE #1 "        <register address='0xb831828' value='0x" DATA.LONG(A:0x831828) "' name='RPMH_VRM_MODE_CRS_DRV3_REG24'/>"
WRITE #1 "        <register address='0xb831928' value='0x" DATA.LONG(A:0x831928) "' name='RPMH_VRM_MODE_CRS_DRV3_REG25'/>"
WRITE #1 "        <register address='0xb831a28' value='0x" DATA.LONG(A:0x831a28) "' name='RPMH_VRM_MODE_CRS_DRV3_REG26'/>"
WRITE #1 "        <register address='0xb831b28' value='0x" DATA.LONG(A:0x831b28) "' name='RPMH_VRM_MODE_CRS_DRV3_REG27'/>"
WRITE #1 "        <register address='0xb831c28' value='0x" DATA.LONG(A:0x831c28) "' name='RPMH_VRM_MODE_CRS_DRV3_REG28'/>"
WRITE #1 "        <register address='0xb831d28' value='0x" DATA.LONG(A:0x831d28) "' name='RPMH_VRM_MODE_CRS_DRV3_REG29'/>"
WRITE #1 "        <register address='0xb831e28' value='0x" DATA.LONG(A:0x831e28) "' name='RPMH_VRM_MODE_CRS_DRV3_REG30'/>"
WRITE #1 "        <register address='0xb831f28' value='0x" DATA.LONG(A:0x831f28) "' name='RPMH_VRM_MODE_CRS_DRV3_REG31'/>"
WRITE #1 "        <register address='0xb832028' value='0x" DATA.LONG(A:0x832028) "' name='RPMH_VRM_MODE_CRS_DRV3_REG32'/>"
WRITE #1 "        <register address='0xb832128' value='0x" DATA.LONG(A:0x832128) "' name='RPMH_VRM_MODE_CRS_DRV3_REG33'/>"
WRITE #1 "        <register address='0xb832228' value='0x" DATA.LONG(A:0x832228) "' name='RPMH_VRM_MODE_CRS_DRV3_REG34'/>"
WRITE #1 "        <register address='0xb832328' value='0x" DATA.LONG(A:0x832328) "' name='RPMH_VRM_MODE_CRS_DRV3_REG35'/>"
WRITE #1 "        <register address='0xb832428' value='0x" DATA.LONG(A:0x832428) "' name='RPMH_VRM_MODE_CRS_DRV3_REG36'/>"
WRITE #1 "        <register address='0xb832528' value='0x" DATA.LONG(A:0x832528) "' name='RPMH_VRM_MODE_CRS_DRV3_REG37'/>"
WRITE #1 "        <register address='0xb832628' value='0x" DATA.LONG(A:0x832628) "' name='RPMH_VRM_MODE_CRS_DRV3_REG38'/>"
WRITE #1 "        <register address='0xb832728' value='0x" DATA.LONG(A:0x832728) "' name='RPMH_VRM_MODE_CRS_DRV3_REG39'/>"
WRITE #1 "        <register address='0xb832828' value='0x" DATA.LONG(A:0x832828) "' name='RPMH_VRM_MODE_CRS_DRV3_REG40'/>"
WRITE #1 "        <register address='0xb832928' value='0x" DATA.LONG(A:0x832928) "' name='RPMH_VRM_MODE_CRS_DRV3_REG41'/>"
WRITE #1 "        <register address='0xb832a28' value='0x" DATA.LONG(A:0x832a28) "' name='RPMH_VRM_MODE_CRS_DRV3_REG42'/>"
WRITE #1 "        <register address='0xb832b28' value='0x" DATA.LONG(A:0x832b28) "' name='RPMH_VRM_MODE_CRS_DRV3_REG43'/>"
WRITE #1 "        <register address='0xb832c28' value='0x" DATA.LONG(A:0x832c28) "' name='RPMH_VRM_MODE_CRS_DRV3_REG44'/>"
WRITE #1 "        <register address='0xb832d28' value='0x" DATA.LONG(A:0x832d28) "' name='RPMH_VRM_MODE_CRS_DRV3_REG45'/>"
WRITE #1 "        <register address='0xb840028' value='0x" DATA.LONG(A:0x840028) "' name='RPMH_VRM_MODE_CRS_DRV4_REG0'/>"
WRITE #1 "        <register address='0xb840128' value='0x" DATA.LONG(A:0x840128) "' name='RPMH_VRM_MODE_CRS_DRV4_REG1'/>"
WRITE #1 "        <register address='0xb840228' value='0x" DATA.LONG(A:0x840228) "' name='RPMH_VRM_MODE_CRS_DRV4_REG2'/>"
WRITE #1 "        <register address='0xb840328' value='0x" DATA.LONG(A:0x840328) "' name='RPMH_VRM_MODE_CRS_DRV4_REG3'/>"
WRITE #1 "        <register address='0xb840428' value='0x" DATA.LONG(A:0x840428) "' name='RPMH_VRM_MODE_CRS_DRV4_REG4'/>"
WRITE #1 "        <register address='0xb840528' value='0x" DATA.LONG(A:0x840528) "' name='RPMH_VRM_MODE_CRS_DRV4_REG5'/>"
WRITE #1 "        <register address='0xb840628' value='0x" DATA.LONG(A:0x840628) "' name='RPMH_VRM_MODE_CRS_DRV4_REG6'/>"
WRITE #1 "        <register address='0xb840728' value='0x" DATA.LONG(A:0x840728) "' name='RPMH_VRM_MODE_CRS_DRV4_REG7'/>"
WRITE #1 "        <register address='0xb840828' value='0x" DATA.LONG(A:0x840828) "' name='RPMH_VRM_MODE_CRS_DRV4_REG8'/>"
WRITE #1 "        <register address='0xb840928' value='0x" DATA.LONG(A:0x840928) "' name='RPMH_VRM_MODE_CRS_DRV4_REG9'/>"
WRITE #1 "        <register address='0xb840a28' value='0x" DATA.LONG(A:0x840a28) "' name='RPMH_VRM_MODE_CRS_DRV4_REG10'/>"
WRITE #1 "        <register address='0xb840b28' value='0x" DATA.LONG(A:0x840b28) "' name='RPMH_VRM_MODE_CRS_DRV4_REG11'/>"
WRITE #1 "        <register address='0xb840c28' value='0x" DATA.LONG(A:0x840c28) "' name='RPMH_VRM_MODE_CRS_DRV4_REG12'/>"
WRITE #1 "        <register address='0xb840d28' value='0x" DATA.LONG(A:0x840d28) "' name='RPMH_VRM_MODE_CRS_DRV4_REG13'/>"
WRITE #1 "        <register address='0xb840e28' value='0x" DATA.LONG(A:0x840e28) "' name='RPMH_VRM_MODE_CRS_DRV4_REG14'/>"
WRITE #1 "        <register address='0xb840f28' value='0x" DATA.LONG(A:0x840f28) "' name='RPMH_VRM_MODE_CRS_DRV4_REG15'/>"
WRITE #1 "        <register address='0xb841028' value='0x" DATA.LONG(A:0x841028) "' name='RPMH_VRM_MODE_CRS_DRV4_REG16'/>"
WRITE #1 "        <register address='0xb841128' value='0x" DATA.LONG(A:0x841128) "' name='RPMH_VRM_MODE_CRS_DRV4_REG17'/>"
WRITE #1 "        <register address='0xb841228' value='0x" DATA.LONG(A:0x841228) "' name='RPMH_VRM_MODE_CRS_DRV4_REG18'/>"
WRITE #1 "        <register address='0xb841328' value='0x" DATA.LONG(A:0x841328) "' name='RPMH_VRM_MODE_CRS_DRV4_REG19'/>"
WRITE #1 "        <register address='0xb841428' value='0x" DATA.LONG(A:0x841428) "' name='RPMH_VRM_MODE_CRS_DRV4_REG20'/>"
WRITE #1 "        <register address='0xb841528' value='0x" DATA.LONG(A:0x841528) "' name='RPMH_VRM_MODE_CRS_DRV4_REG21'/>"
WRITE #1 "        <register address='0xb841628' value='0x" DATA.LONG(A:0x841628) "' name='RPMH_VRM_MODE_CRS_DRV4_REG22'/>"
WRITE #1 "        <register address='0xb841728' value='0x" DATA.LONG(A:0x841728) "' name='RPMH_VRM_MODE_CRS_DRV4_REG23'/>"
WRITE #1 "        <register address='0xb841828' value='0x" DATA.LONG(A:0x841828) "' name='RPMH_VRM_MODE_CRS_DRV4_REG24'/>"
WRITE #1 "        <register address='0xb841928' value='0x" DATA.LONG(A:0x841928) "' name='RPMH_VRM_MODE_CRS_DRV4_REG25'/>"
WRITE #1 "        <register address='0xb841a28' value='0x" DATA.LONG(A:0x841a28) "' name='RPMH_VRM_MODE_CRS_DRV4_REG26'/>"
WRITE #1 "        <register address='0xb841b28' value='0x" DATA.LONG(A:0x841b28) "' name='RPMH_VRM_MODE_CRS_DRV4_REG27'/>"
WRITE #1 "        <register address='0xb841c28' value='0x" DATA.LONG(A:0x841c28) "' name='RPMH_VRM_MODE_CRS_DRV4_REG28'/>"
WRITE #1 "        <register address='0xb841d28' value='0x" DATA.LONG(A:0x841d28) "' name='RPMH_VRM_MODE_CRS_DRV4_REG29'/>"
WRITE #1 "        <register address='0xb841e28' value='0x" DATA.LONG(A:0x841e28) "' name='RPMH_VRM_MODE_CRS_DRV4_REG30'/>"
WRITE #1 "        <register address='0xb841f28' value='0x" DATA.LONG(A:0x841f28) "' name='RPMH_VRM_MODE_CRS_DRV4_REG31'/>"
WRITE #1 "        <register address='0xb842028' value='0x" DATA.LONG(A:0x842028) "' name='RPMH_VRM_MODE_CRS_DRV4_REG32'/>"
WRITE #1 "        <register address='0xb842128' value='0x" DATA.LONG(A:0x842128) "' name='RPMH_VRM_MODE_CRS_DRV4_REG33'/>"
WRITE #1 "        <register address='0xb842228' value='0x" DATA.LONG(A:0x842228) "' name='RPMH_VRM_MODE_CRS_DRV4_REG34'/>"
WRITE #1 "        <register address='0xb842328' value='0x" DATA.LONG(A:0x842328) "' name='RPMH_VRM_MODE_CRS_DRV4_REG35'/>"
WRITE #1 "        <register address='0xb842428' value='0x" DATA.LONG(A:0x842428) "' name='RPMH_VRM_MODE_CRS_DRV4_REG36'/>"
WRITE #1 "        <register address='0xb842528' value='0x" DATA.LONG(A:0x842528) "' name='RPMH_VRM_MODE_CRS_DRV4_REG37'/>"
WRITE #1 "        <register address='0xb842628' value='0x" DATA.LONG(A:0x842628) "' name='RPMH_VRM_MODE_CRS_DRV4_REG38'/>"
WRITE #1 "        <register address='0xb842728' value='0x" DATA.LONG(A:0x842728) "' name='RPMH_VRM_MODE_CRS_DRV4_REG39'/>"
WRITE #1 "        <register address='0xb842828' value='0x" DATA.LONG(A:0x842828) "' name='RPMH_VRM_MODE_CRS_DRV4_REG40'/>"
WRITE #1 "        <register address='0xb842928' value='0x" DATA.LONG(A:0x842928) "' name='RPMH_VRM_MODE_CRS_DRV4_REG41'/>"
WRITE #1 "        <register address='0xb842a28' value='0x" DATA.LONG(A:0x842a28) "' name='RPMH_VRM_MODE_CRS_DRV4_REG42'/>"
WRITE #1 "        <register address='0xb842b28' value='0x" DATA.LONG(A:0x842b28) "' name='RPMH_VRM_MODE_CRS_DRV4_REG43'/>"
WRITE #1 "        <register address='0xb842c28' value='0x" DATA.LONG(A:0x842c28) "' name='RPMH_VRM_MODE_CRS_DRV4_REG44'/>"
WRITE #1 "        <register address='0xb842d28' value='0x" DATA.LONG(A:0x842d28) "' name='RPMH_VRM_MODE_CRS_DRV4_REG45'/>"
WRITE #1 "        <register address='0xb850028' value='0x" DATA.LONG(A:0x850028) "' name='RPMH_VRM_MODE_CRS_DRV5_REG0'/>"
WRITE #1 "        <register address='0xb850128' value='0x" DATA.LONG(A:0x850128) "' name='RPMH_VRM_MODE_CRS_DRV5_REG1'/>"
WRITE #1 "        <register address='0xb850228' value='0x" DATA.LONG(A:0x850228) "' name='RPMH_VRM_MODE_CRS_DRV5_REG2'/>"
WRITE #1 "        <register address='0xb850328' value='0x" DATA.LONG(A:0x850328) "' name='RPMH_VRM_MODE_CRS_DRV5_REG3'/>"
WRITE #1 "        <register address='0xb850428' value='0x" DATA.LONG(A:0x850428) "' name='RPMH_VRM_MODE_CRS_DRV5_REG4'/>"
WRITE #1 "        <register address='0xb850528' value='0x" DATA.LONG(A:0x850528) "' name='RPMH_VRM_MODE_CRS_DRV5_REG5'/>"
WRITE #1 "        <register address='0xb850628' value='0x" DATA.LONG(A:0x850628) "' name='RPMH_VRM_MODE_CRS_DRV5_REG6'/>"
WRITE #1 "        <register address='0xb850728' value='0x" DATA.LONG(A:0x850728) "' name='RPMH_VRM_MODE_CRS_DRV5_REG7'/>"
WRITE #1 "        <register address='0xb850828' value='0x" DATA.LONG(A:0x850828) "' name='RPMH_VRM_MODE_CRS_DRV5_REG8'/>"
WRITE #1 "        <register address='0xb850928' value='0x" DATA.LONG(A:0x850928) "' name='RPMH_VRM_MODE_CRS_DRV5_REG9'/>"
WRITE #1 "        <register address='0xb850a28' value='0x" DATA.LONG(A:0x850a28) "' name='RPMH_VRM_MODE_CRS_DRV5_REG10'/>"
WRITE #1 "        <register address='0xb850b28' value='0x" DATA.LONG(A:0x850b28) "' name='RPMH_VRM_MODE_CRS_DRV5_REG11'/>"
WRITE #1 "        <register address='0xb850c28' value='0x" DATA.LONG(A:0x850c28) "' name='RPMH_VRM_MODE_CRS_DRV5_REG12'/>"
WRITE #1 "        <register address='0xb850d28' value='0x" DATA.LONG(A:0x850d28) "' name='RPMH_VRM_MODE_CRS_DRV5_REG13'/>"
WRITE #1 "        <register address='0xb850e28' value='0x" DATA.LONG(A:0x850e28) "' name='RPMH_VRM_MODE_CRS_DRV5_REG14'/>"
WRITE #1 "        <register address='0xb850f28' value='0x" DATA.LONG(A:0x850f28) "' name='RPMH_VRM_MODE_CRS_DRV5_REG15'/>"
WRITE #1 "        <register address='0xb851028' value='0x" DATA.LONG(A:0x851028) "' name='RPMH_VRM_MODE_CRS_DRV5_REG16'/>"
WRITE #1 "        <register address='0xb851128' value='0x" DATA.LONG(A:0x851128) "' name='RPMH_VRM_MODE_CRS_DRV5_REG17'/>"
WRITE #1 "        <register address='0xb851228' value='0x" DATA.LONG(A:0x851228) "' name='RPMH_VRM_MODE_CRS_DRV5_REG18'/>"
WRITE #1 "        <register address='0xb851328' value='0x" DATA.LONG(A:0x851328) "' name='RPMH_VRM_MODE_CRS_DRV5_REG19'/>"
WRITE #1 "        <register address='0xb851428' value='0x" DATA.LONG(A:0x851428) "' name='RPMH_VRM_MODE_CRS_DRV5_REG20'/>"
WRITE #1 "        <register address='0xb851528' value='0x" DATA.LONG(A:0x851528) "' name='RPMH_VRM_MODE_CRS_DRV5_REG21'/>"
WRITE #1 "        <register address='0xb851628' value='0x" DATA.LONG(A:0x851628) "' name='RPMH_VRM_MODE_CRS_DRV5_REG22'/>"
WRITE #1 "        <register address='0xb851728' value='0x" DATA.LONG(A:0x851728) "' name='RPMH_VRM_MODE_CRS_DRV5_REG23'/>"
WRITE #1 "        <register address='0xb851828' value='0x" DATA.LONG(A:0x851828) "' name='RPMH_VRM_MODE_CRS_DRV5_REG24'/>"
WRITE #1 "        <register address='0xb851928' value='0x" DATA.LONG(A:0x851928) "' name='RPMH_VRM_MODE_CRS_DRV5_REG25'/>"
WRITE #1 "        <register address='0xb851a28' value='0x" DATA.LONG(A:0x851a28) "' name='RPMH_VRM_MODE_CRS_DRV5_REG26'/>"
WRITE #1 "        <register address='0xb851b28' value='0x" DATA.LONG(A:0x851b28) "' name='RPMH_VRM_MODE_CRS_DRV5_REG27'/>"
WRITE #1 "        <register address='0xb851c28' value='0x" DATA.LONG(A:0x851c28) "' name='RPMH_VRM_MODE_CRS_DRV5_REG28'/>"
WRITE #1 "        <register address='0xb851d28' value='0x" DATA.LONG(A:0x851d28) "' name='RPMH_VRM_MODE_CRS_DRV5_REG29'/>"
WRITE #1 "        <register address='0xb851e28' value='0x" DATA.LONG(A:0x851e28) "' name='RPMH_VRM_MODE_CRS_DRV5_REG30'/>"
WRITE #1 "        <register address='0xb851f28' value='0x" DATA.LONG(A:0x851f28) "' name='RPMH_VRM_MODE_CRS_DRV5_REG31'/>"
WRITE #1 "        <register address='0xb852028' value='0x" DATA.LONG(A:0x852028) "' name='RPMH_VRM_MODE_CRS_DRV5_REG32'/>"
WRITE #1 "        <register address='0xb852128' value='0x" DATA.LONG(A:0x852128) "' name='RPMH_VRM_MODE_CRS_DRV5_REG33'/>"
WRITE #1 "        <register address='0xb852228' value='0x" DATA.LONG(A:0x852228) "' name='RPMH_VRM_MODE_CRS_DRV5_REG34'/>"
WRITE #1 "        <register address='0xb852328' value='0x" DATA.LONG(A:0x852328) "' name='RPMH_VRM_MODE_CRS_DRV5_REG35'/>"
WRITE #1 "        <register address='0xb852428' value='0x" DATA.LONG(A:0x852428) "' name='RPMH_VRM_MODE_CRS_DRV5_REG36'/>"
WRITE #1 "        <register address='0xb852528' value='0x" DATA.LONG(A:0x852528) "' name='RPMH_VRM_MODE_CRS_DRV5_REG37'/>"
WRITE #1 "        <register address='0xb852628' value='0x" DATA.LONG(A:0x852628) "' name='RPMH_VRM_MODE_CRS_DRV5_REG38'/>"
WRITE #1 "        <register address='0xb852728' value='0x" DATA.LONG(A:0x852728) "' name='RPMH_VRM_MODE_CRS_DRV5_REG39'/>"
WRITE #1 "        <register address='0xb852828' value='0x" DATA.LONG(A:0x852828) "' name='RPMH_VRM_MODE_CRS_DRV5_REG40'/>"
WRITE #1 "        <register address='0xb852928' value='0x" DATA.LONG(A:0x852928) "' name='RPMH_VRM_MODE_CRS_DRV5_REG41'/>"
WRITE #1 "        <register address='0xb852a28' value='0x" DATA.LONG(A:0x852a28) "' name='RPMH_VRM_MODE_CRS_DRV5_REG42'/>"
WRITE #1 "        <register address='0xb852b28' value='0x" DATA.LONG(A:0x852b28) "' name='RPMH_VRM_MODE_CRS_DRV5_REG43'/>"
WRITE #1 "        <register address='0xb852c28' value='0x" DATA.LONG(A:0x852c28) "' name='RPMH_VRM_MODE_CRS_DRV5_REG44'/>"
WRITE #1 "        <register address='0xb852d28' value='0x" DATA.LONG(A:0x852d28) "' name='RPMH_VRM_MODE_CRS_DRV5_REG45'/>"
WRITE #1 "        <register address='0xb860028' value='0x" DATA.LONG(A:0x860028) "' name='RPMH_VRM_MODE_CRS_DRV6_REG0'/>"
WRITE #1 "        <register address='0xb860128' value='0x" DATA.LONG(A:0x860128) "' name='RPMH_VRM_MODE_CRS_DRV6_REG1'/>"
WRITE #1 "        <register address='0xb860228' value='0x" DATA.LONG(A:0x860228) "' name='RPMH_VRM_MODE_CRS_DRV6_REG2'/>"
WRITE #1 "        <register address='0xb860328' value='0x" DATA.LONG(A:0x860328) "' name='RPMH_VRM_MODE_CRS_DRV6_REG3'/>"
WRITE #1 "        <register address='0xb860428' value='0x" DATA.LONG(A:0x860428) "' name='RPMH_VRM_MODE_CRS_DRV6_REG4'/>"
WRITE #1 "        <register address='0xb860528' value='0x" DATA.LONG(A:0x860528) "' name='RPMH_VRM_MODE_CRS_DRV6_REG5'/>"
WRITE #1 "        <register address='0xb860628' value='0x" DATA.LONG(A:0x860628) "' name='RPMH_VRM_MODE_CRS_DRV6_REG6'/>"
WRITE #1 "        <register address='0xb860728' value='0x" DATA.LONG(A:0x860728) "' name='RPMH_VRM_MODE_CRS_DRV6_REG7'/>"
WRITE #1 "        <register address='0xb860828' value='0x" DATA.LONG(A:0x860828) "' name='RPMH_VRM_MODE_CRS_DRV6_REG8'/>"
WRITE #1 "        <register address='0xb860928' value='0x" DATA.LONG(A:0x860928) "' name='RPMH_VRM_MODE_CRS_DRV6_REG9'/>"
WRITE #1 "        <register address='0xb860a28' value='0x" DATA.LONG(A:0x860a28) "' name='RPMH_VRM_MODE_CRS_DRV6_REG10'/>"
WRITE #1 "        <register address='0xb860b28' value='0x" DATA.LONG(A:0x860b28) "' name='RPMH_VRM_MODE_CRS_DRV6_REG11'/>"
WRITE #1 "        <register address='0xb860c28' value='0x" DATA.LONG(A:0x860c28) "' name='RPMH_VRM_MODE_CRS_DRV6_REG12'/>"
WRITE #1 "        <register address='0xb860d28' value='0x" DATA.LONG(A:0x860d28) "' name='RPMH_VRM_MODE_CRS_DRV6_REG13'/>"
WRITE #1 "        <register address='0xb860e28' value='0x" DATA.LONG(A:0x860e28) "' name='RPMH_VRM_MODE_CRS_DRV6_REG14'/>"
WRITE #1 "        <register address='0xb860f28' value='0x" DATA.LONG(A:0x860f28) "' name='RPMH_VRM_MODE_CRS_DRV6_REG15'/>"
WRITE #1 "        <register address='0xb861028' value='0x" DATA.LONG(A:0x861028) "' name='RPMH_VRM_MODE_CRS_DRV6_REG16'/>"
WRITE #1 "        <register address='0xb861128' value='0x" DATA.LONG(A:0x861128) "' name='RPMH_VRM_MODE_CRS_DRV6_REG17'/>"
WRITE #1 "        <register address='0xb861228' value='0x" DATA.LONG(A:0x861228) "' name='RPMH_VRM_MODE_CRS_DRV6_REG18'/>"
WRITE #1 "        <register address='0xb861328' value='0x" DATA.LONG(A:0x861328) "' name='RPMH_VRM_MODE_CRS_DRV6_REG19'/>"
WRITE #1 "        <register address='0xb861428' value='0x" DATA.LONG(A:0x861428) "' name='RPMH_VRM_MODE_CRS_DRV6_REG20'/>"
WRITE #1 "        <register address='0xb861528' value='0x" DATA.LONG(A:0x861528) "' name='RPMH_VRM_MODE_CRS_DRV6_REG21'/>"
WRITE #1 "        <register address='0xb861628' value='0x" DATA.LONG(A:0x861628) "' name='RPMH_VRM_MODE_CRS_DRV6_REG22'/>"
WRITE #1 "        <register address='0xb861728' value='0x" DATA.LONG(A:0x861728) "' name='RPMH_VRM_MODE_CRS_DRV6_REG23'/>"
WRITE #1 "        <register address='0xb861828' value='0x" DATA.LONG(A:0x861828) "' name='RPMH_VRM_MODE_CRS_DRV6_REG24'/>"
WRITE #1 "        <register address='0xb861928' value='0x" DATA.LONG(A:0x861928) "' name='RPMH_VRM_MODE_CRS_DRV6_REG25'/>"
WRITE #1 "        <register address='0xb861a28' value='0x" DATA.LONG(A:0x861a28) "' name='RPMH_VRM_MODE_CRS_DRV6_REG26'/>"
WRITE #1 "        <register address='0xb861b28' value='0x" DATA.LONG(A:0x861b28) "' name='RPMH_VRM_MODE_CRS_DRV6_REG27'/>"
WRITE #1 "        <register address='0xb861c28' value='0x" DATA.LONG(A:0x861c28) "' name='RPMH_VRM_MODE_CRS_DRV6_REG28'/>"
WRITE #1 "        <register address='0xb861d28' value='0x" DATA.LONG(A:0x861d28) "' name='RPMH_VRM_MODE_CRS_DRV6_REG29'/>"
WRITE #1 "        <register address='0xb861e28' value='0x" DATA.LONG(A:0x861e28) "' name='RPMH_VRM_MODE_CRS_DRV6_REG30'/>"
WRITE #1 "        <register address='0xb861f28' value='0x" DATA.LONG(A:0x861f28) "' name='RPMH_VRM_MODE_CRS_DRV6_REG31'/>"
WRITE #1 "        <register address='0xb862028' value='0x" DATA.LONG(A:0x862028) "' name='RPMH_VRM_MODE_CRS_DRV6_REG32'/>"
WRITE #1 "        <register address='0xb862128' value='0x" DATA.LONG(A:0x862128) "' name='RPMH_VRM_MODE_CRS_DRV6_REG33'/>"
WRITE #1 "        <register address='0xb862228' value='0x" DATA.LONG(A:0x862228) "' name='RPMH_VRM_MODE_CRS_DRV6_REG34'/>"
WRITE #1 "        <register address='0xb862328' value='0x" DATA.LONG(A:0x862328) "' name='RPMH_VRM_MODE_CRS_DRV6_REG35'/>"
WRITE #1 "        <register address='0xb862428' value='0x" DATA.LONG(A:0x862428) "' name='RPMH_VRM_MODE_CRS_DRV6_REG36'/>"
WRITE #1 "        <register address='0xb862528' value='0x" DATA.LONG(A:0x862528) "' name='RPMH_VRM_MODE_CRS_DRV6_REG37'/>"
WRITE #1 "        <register address='0xb862628' value='0x" DATA.LONG(A:0x862628) "' name='RPMH_VRM_MODE_CRS_DRV6_REG38'/>"
WRITE #1 "        <register address='0xb862728' value='0x" DATA.LONG(A:0x862728) "' name='RPMH_VRM_MODE_CRS_DRV6_REG39'/>"
WRITE #1 "        <register address='0xb862828' value='0x" DATA.LONG(A:0x862828) "' name='RPMH_VRM_MODE_CRS_DRV6_REG40'/>"
WRITE #1 "        <register address='0xb862928' value='0x" DATA.LONG(A:0x862928) "' name='RPMH_VRM_MODE_CRS_DRV6_REG41'/>"
WRITE #1 "        <register address='0xb862a28' value='0x" DATA.LONG(A:0x862a28) "' name='RPMH_VRM_MODE_CRS_DRV6_REG42'/>"
WRITE #1 "        <register address='0xb862b28' value='0x" DATA.LONG(A:0x862b28) "' name='RPMH_VRM_MODE_CRS_DRV6_REG43'/>"
WRITE #1 "        <register address='0xb862c28' value='0x" DATA.LONG(A:0x862c28) "' name='RPMH_VRM_MODE_CRS_DRV6_REG44'/>"
WRITE #1 "        <register address='0xb862d28' value='0x" DATA.LONG(A:0x862d28) "' name='RPMH_VRM_MODE_CRS_DRV6_REG45'/>"
WRITE #1 "        <register address='0xb870028' value='0x" DATA.LONG(A:0x870028) "' name='RPMH_VRM_MODE_CRS_DRV7_REG0'/>"
WRITE #1 "        <register address='0xb870128' value='0x" DATA.LONG(A:0x870128) "' name='RPMH_VRM_MODE_CRS_DRV7_REG1'/>"
WRITE #1 "        <register address='0xb870228' value='0x" DATA.LONG(A:0x870228) "' name='RPMH_VRM_MODE_CRS_DRV7_REG2'/>"
WRITE #1 "        <register address='0xb870328' value='0x" DATA.LONG(A:0x870328) "' name='RPMH_VRM_MODE_CRS_DRV7_REG3'/>"
WRITE #1 "        <register address='0xb870428' value='0x" DATA.LONG(A:0x870428) "' name='RPMH_VRM_MODE_CRS_DRV7_REG4'/>"
WRITE #1 "        <register address='0xb870528' value='0x" DATA.LONG(A:0x870528) "' name='RPMH_VRM_MODE_CRS_DRV7_REG5'/>"
WRITE #1 "        <register address='0xb870628' value='0x" DATA.LONG(A:0x870628) "' name='RPMH_VRM_MODE_CRS_DRV7_REG6'/>"
WRITE #1 "        <register address='0xb870728' value='0x" DATA.LONG(A:0x870728) "' name='RPMH_VRM_MODE_CRS_DRV7_REG7'/>"
WRITE #1 "        <register address='0xb870828' value='0x" DATA.LONG(A:0x870828) "' name='RPMH_VRM_MODE_CRS_DRV7_REG8'/>"
WRITE #1 "        <register address='0xb870928' value='0x" DATA.LONG(A:0x870928) "' name='RPMH_VRM_MODE_CRS_DRV7_REG9'/>"
WRITE #1 "        <register address='0xb870a28' value='0x" DATA.LONG(A:0x870a28) "' name='RPMH_VRM_MODE_CRS_DRV7_REG10'/>"
WRITE #1 "        <register address='0xb870b28' value='0x" DATA.LONG(A:0x870b28) "' name='RPMH_VRM_MODE_CRS_DRV7_REG11'/>"
WRITE #1 "        <register address='0xb870c28' value='0x" DATA.LONG(A:0x870c28) "' name='RPMH_VRM_MODE_CRS_DRV7_REG12'/>"
WRITE #1 "        <register address='0xb870d28' value='0x" DATA.LONG(A:0x870d28) "' name='RPMH_VRM_MODE_CRS_DRV7_REG13'/>"
WRITE #1 "        <register address='0xb870e28' value='0x" DATA.LONG(A:0x870e28) "' name='RPMH_VRM_MODE_CRS_DRV7_REG14'/>"
WRITE #1 "        <register address='0xb870f28' value='0x" DATA.LONG(A:0x870f28) "' name='RPMH_VRM_MODE_CRS_DRV7_REG15'/>"
WRITE #1 "        <register address='0xb871028' value='0x" DATA.LONG(A:0x871028) "' name='RPMH_VRM_MODE_CRS_DRV7_REG16'/>"
WRITE #1 "        <register address='0xb871128' value='0x" DATA.LONG(A:0x871128) "' name='RPMH_VRM_MODE_CRS_DRV7_REG17'/>"
WRITE #1 "        <register address='0xb871228' value='0x" DATA.LONG(A:0x871228) "' name='RPMH_VRM_MODE_CRS_DRV7_REG18'/>"
WRITE #1 "        <register address='0xb871328' value='0x" DATA.LONG(A:0x871328) "' name='RPMH_VRM_MODE_CRS_DRV7_REG19'/>"
WRITE #1 "        <register address='0xb871428' value='0x" DATA.LONG(A:0x871428) "' name='RPMH_VRM_MODE_CRS_DRV7_REG20'/>"
WRITE #1 "        <register address='0xb871528' value='0x" DATA.LONG(A:0x871528) "' name='RPMH_VRM_MODE_CRS_DRV7_REG21'/>"
WRITE #1 "        <register address='0xb871628' value='0x" DATA.LONG(A:0x871628) "' name='RPMH_VRM_MODE_CRS_DRV7_REG22'/>"
WRITE #1 "        <register address='0xb871728' value='0x" DATA.LONG(A:0x871728) "' name='RPMH_VRM_MODE_CRS_DRV7_REG23'/>"
WRITE #1 "        <register address='0xb871828' value='0x" DATA.LONG(A:0x871828) "' name='RPMH_VRM_MODE_CRS_DRV7_REG24'/>"
WRITE #1 "        <register address='0xb871928' value='0x" DATA.LONG(A:0x871928) "' name='RPMH_VRM_MODE_CRS_DRV7_REG25'/>"
WRITE #1 "        <register address='0xb871a28' value='0x" DATA.LONG(A:0x871a28) "' name='RPMH_VRM_MODE_CRS_DRV7_REG26'/>"
WRITE #1 "        <register address='0xb871b28' value='0x" DATA.LONG(A:0x871b28) "' name='RPMH_VRM_MODE_CRS_DRV7_REG27'/>"
WRITE #1 "        <register address='0xb871c28' value='0x" DATA.LONG(A:0x871c28) "' name='RPMH_VRM_MODE_CRS_DRV7_REG28'/>"
WRITE #1 "        <register address='0xb871d28' value='0x" DATA.LONG(A:0x871d28) "' name='RPMH_VRM_MODE_CRS_DRV7_REG29'/>"
WRITE #1 "        <register address='0xb871e28' value='0x" DATA.LONG(A:0x871e28) "' name='RPMH_VRM_MODE_CRS_DRV7_REG30'/>"
WRITE #1 "        <register address='0xb871f28' value='0x" DATA.LONG(A:0x871f28) "' name='RPMH_VRM_MODE_CRS_DRV7_REG31'/>"
WRITE #1 "        <register address='0xb872028' value='0x" DATA.LONG(A:0x872028) "' name='RPMH_VRM_MODE_CRS_DRV7_REG32'/>"
WRITE #1 "        <register address='0xb872128' value='0x" DATA.LONG(A:0x872128) "' name='RPMH_VRM_MODE_CRS_DRV7_REG33'/>"
WRITE #1 "        <register address='0xb872228' value='0x" DATA.LONG(A:0x872228) "' name='RPMH_VRM_MODE_CRS_DRV7_REG34'/>"
WRITE #1 "        <register address='0xb872328' value='0x" DATA.LONG(A:0x872328) "' name='RPMH_VRM_MODE_CRS_DRV7_REG35'/>"
WRITE #1 "        <register address='0xb872428' value='0x" DATA.LONG(A:0x872428) "' name='RPMH_VRM_MODE_CRS_DRV7_REG36'/>"
WRITE #1 "        <register address='0xb872528' value='0x" DATA.LONG(A:0x872528) "' name='RPMH_VRM_MODE_CRS_DRV7_REG37'/>"
WRITE #1 "        <register address='0xb872628' value='0x" DATA.LONG(A:0x872628) "' name='RPMH_VRM_MODE_CRS_DRV7_REG38'/>"
WRITE #1 "        <register address='0xb872728' value='0x" DATA.LONG(A:0x872728) "' name='RPMH_VRM_MODE_CRS_DRV7_REG39'/>"
WRITE #1 "        <register address='0xb872828' value='0x" DATA.LONG(A:0x872828) "' name='RPMH_VRM_MODE_CRS_DRV7_REG40'/>"
WRITE #1 "        <register address='0xb872928' value='0x" DATA.LONG(A:0x872928) "' name='RPMH_VRM_MODE_CRS_DRV7_REG41'/>"
WRITE #1 "        <register address='0xb872a28' value='0x" DATA.LONG(A:0x872a28) "' name='RPMH_VRM_MODE_CRS_DRV7_REG42'/>"
WRITE #1 "        <register address='0xb872b28' value='0x" DATA.LONG(A:0x872b28) "' name='RPMH_VRM_MODE_CRS_DRV7_REG43'/>"
WRITE #1 "        <register address='0xb872c28' value='0x" DATA.LONG(A:0x872c28) "' name='RPMH_VRM_MODE_CRS_DRV7_REG44'/>"
WRITE #1 "        <register address='0xb872d28' value='0x" DATA.LONG(A:0x872d28) "' name='RPMH_VRM_MODE_CRS_DRV7_REG45'/>"
WRITE #1 "        <register address='0xb880028' value='0x" DATA.LONG(A:0x880028) "' name='RPMH_VRM_MODE_CRS_DRV8_REG0'/>"
WRITE #1 "        <register address='0xb880128' value='0x" DATA.LONG(A:0x880128) "' name='RPMH_VRM_MODE_CRS_DRV8_REG1'/>"
WRITE #1 "        <register address='0xb880228' value='0x" DATA.LONG(A:0x880228) "' name='RPMH_VRM_MODE_CRS_DRV8_REG2'/>"
WRITE #1 "        <register address='0xb880328' value='0x" DATA.LONG(A:0x880328) "' name='RPMH_VRM_MODE_CRS_DRV8_REG3'/>"
WRITE #1 "        <register address='0xb880428' value='0x" DATA.LONG(A:0x880428) "' name='RPMH_VRM_MODE_CRS_DRV8_REG4'/>"
WRITE #1 "        <register address='0xb880528' value='0x" DATA.LONG(A:0x880528) "' name='RPMH_VRM_MODE_CRS_DRV8_REG5'/>"
WRITE #1 "        <register address='0xb880628' value='0x" DATA.LONG(A:0x880628) "' name='RPMH_VRM_MODE_CRS_DRV8_REG6'/>"
WRITE #1 "        <register address='0xb880728' value='0x" DATA.LONG(A:0x880728) "' name='RPMH_VRM_MODE_CRS_DRV8_REG7'/>"
WRITE #1 "        <register address='0xb880828' value='0x" DATA.LONG(A:0x880828) "' name='RPMH_VRM_MODE_CRS_DRV8_REG8'/>"
WRITE #1 "        <register address='0xb880928' value='0x" DATA.LONG(A:0x880928) "' name='RPMH_VRM_MODE_CRS_DRV8_REG9'/>"
WRITE #1 "        <register address='0xb880a28' value='0x" DATA.LONG(A:0x880a28) "' name='RPMH_VRM_MODE_CRS_DRV8_REG10'/>"
WRITE #1 "        <register address='0xb880b28' value='0x" DATA.LONG(A:0x880b28) "' name='RPMH_VRM_MODE_CRS_DRV8_REG11'/>"
WRITE #1 "        <register address='0xb880c28' value='0x" DATA.LONG(A:0x880c28) "' name='RPMH_VRM_MODE_CRS_DRV8_REG12'/>"
WRITE #1 "        <register address='0xb880d28' value='0x" DATA.LONG(A:0x880d28) "' name='RPMH_VRM_MODE_CRS_DRV8_REG13'/>"
WRITE #1 "        <register address='0xb880e28' value='0x" DATA.LONG(A:0x880e28) "' name='RPMH_VRM_MODE_CRS_DRV8_REG14'/>"
WRITE #1 "        <register address='0xb880f28' value='0x" DATA.LONG(A:0x880f28) "' name='RPMH_VRM_MODE_CRS_DRV8_REG15'/>"
WRITE #1 "        <register address='0xb881028' value='0x" DATA.LONG(A:0x881028) "' name='RPMH_VRM_MODE_CRS_DRV8_REG16'/>"
WRITE #1 "        <register address='0xb881128' value='0x" DATA.LONG(A:0x881128) "' name='RPMH_VRM_MODE_CRS_DRV8_REG17'/>"
WRITE #1 "        <register address='0xb881228' value='0x" DATA.LONG(A:0x881228) "' name='RPMH_VRM_MODE_CRS_DRV8_REG18'/>"
WRITE #1 "        <register address='0xb881328' value='0x" DATA.LONG(A:0x881328) "' name='RPMH_VRM_MODE_CRS_DRV8_REG19'/>"
WRITE #1 "        <register address='0xb881428' value='0x" DATA.LONG(A:0x881428) "' name='RPMH_VRM_MODE_CRS_DRV8_REG20'/>"
WRITE #1 "        <register address='0xb881528' value='0x" DATA.LONG(A:0x881528) "' name='RPMH_VRM_MODE_CRS_DRV8_REG21'/>"
WRITE #1 "        <register address='0xb881628' value='0x" DATA.LONG(A:0x881628) "' name='RPMH_VRM_MODE_CRS_DRV8_REG22'/>"
WRITE #1 "        <register address='0xb881728' value='0x" DATA.LONG(A:0x881728) "' name='RPMH_VRM_MODE_CRS_DRV8_REG23'/>"
WRITE #1 "        <register address='0xb881828' value='0x" DATA.LONG(A:0x881828) "' name='RPMH_VRM_MODE_CRS_DRV8_REG24'/>"
WRITE #1 "        <register address='0xb881928' value='0x" DATA.LONG(A:0x881928) "' name='RPMH_VRM_MODE_CRS_DRV8_REG25'/>"
WRITE #1 "        <register address='0xb881a28' value='0x" DATA.LONG(A:0x881a28) "' name='RPMH_VRM_MODE_CRS_DRV8_REG26'/>"
WRITE #1 "        <register address='0xb881b28' value='0x" DATA.LONG(A:0x881b28) "' name='RPMH_VRM_MODE_CRS_DRV8_REG27'/>"
WRITE #1 "        <register address='0xb881c28' value='0x" DATA.LONG(A:0x881c28) "' name='RPMH_VRM_MODE_CRS_DRV8_REG28'/>"
WRITE #1 "        <register address='0xb881d28' value='0x" DATA.LONG(A:0x881d28) "' name='RPMH_VRM_MODE_CRS_DRV8_REG29'/>"
WRITE #1 "        <register address='0xb881e28' value='0x" DATA.LONG(A:0x881e28) "' name='RPMH_VRM_MODE_CRS_DRV8_REG30'/>"
WRITE #1 "        <register address='0xb881f28' value='0x" DATA.LONG(A:0x881f28) "' name='RPMH_VRM_MODE_CRS_DRV8_REG31'/>"
WRITE #1 "        <register address='0xb882028' value='0x" DATA.LONG(A:0x882028) "' name='RPMH_VRM_MODE_CRS_DRV8_REG32'/>"
WRITE #1 "        <register address='0xb882128' value='0x" DATA.LONG(A:0x882128) "' name='RPMH_VRM_MODE_CRS_DRV8_REG33'/>"
WRITE #1 "        <register address='0xb882228' value='0x" DATA.LONG(A:0x882228) "' name='RPMH_VRM_MODE_CRS_DRV8_REG34'/>"
WRITE #1 "        <register address='0xb882328' value='0x" DATA.LONG(A:0x882328) "' name='RPMH_VRM_MODE_CRS_DRV8_REG35'/>"
WRITE #1 "        <register address='0xb882428' value='0x" DATA.LONG(A:0x882428) "' name='RPMH_VRM_MODE_CRS_DRV8_REG36'/>"
WRITE #1 "        <register address='0xb882528' value='0x" DATA.LONG(A:0x882528) "' name='RPMH_VRM_MODE_CRS_DRV8_REG37'/>"
WRITE #1 "        <register address='0xb882628' value='0x" DATA.LONG(A:0x882628) "' name='RPMH_VRM_MODE_CRS_DRV8_REG38'/>"
WRITE #1 "        <register address='0xb882728' value='0x" DATA.LONG(A:0x882728) "' name='RPMH_VRM_MODE_CRS_DRV8_REG39'/>"
WRITE #1 "        <register address='0xb882828' value='0x" DATA.LONG(A:0x882828) "' name='RPMH_VRM_MODE_CRS_DRV8_REG40'/>"
WRITE #1 "        <register address='0xb882928' value='0x" DATA.LONG(A:0x882928) "' name='RPMH_VRM_MODE_CRS_DRV8_REG41'/>"
WRITE #1 "        <register address='0xb882a28' value='0x" DATA.LONG(A:0x882a28) "' name='RPMH_VRM_MODE_CRS_DRV8_REG42'/>"
WRITE #1 "        <register address='0xb882b28' value='0x" DATA.LONG(A:0x882b28) "' name='RPMH_VRM_MODE_CRS_DRV8_REG43'/>"
WRITE #1 "        <register address='0xb882c28' value='0x" DATA.LONG(A:0x882c28) "' name='RPMH_VRM_MODE_CRS_DRV8_REG44'/>"
WRITE #1 "        <register address='0xb882d28' value='0x" DATA.LONG(A:0x882d28) "' name='RPMH_VRM_MODE_CRS_DRV8_REG45'/>"
WRITE #1 "        <register address='0xb890028' value='0x" DATA.LONG(A:0x890028) "' name='RPMH_VRM_MODE_CRS_DRV9_REG0'/>"
WRITE #1 "        <register address='0xb890128' value='0x" DATA.LONG(A:0x890128) "' name='RPMH_VRM_MODE_CRS_DRV9_REG1'/>"
WRITE #1 "        <register address='0xb890228' value='0x" DATA.LONG(A:0x890228) "' name='RPMH_VRM_MODE_CRS_DRV9_REG2'/>"
WRITE #1 "        <register address='0xb890328' value='0x" DATA.LONG(A:0x890328) "' name='RPMH_VRM_MODE_CRS_DRV9_REG3'/>"
WRITE #1 "        <register address='0xb890428' value='0x" DATA.LONG(A:0x890428) "' name='RPMH_VRM_MODE_CRS_DRV9_REG4'/>"
WRITE #1 "        <register address='0xb890528' value='0x" DATA.LONG(A:0x890528) "' name='RPMH_VRM_MODE_CRS_DRV9_REG5'/>"
WRITE #1 "        <register address='0xb890628' value='0x" DATA.LONG(A:0x890628) "' name='RPMH_VRM_MODE_CRS_DRV9_REG6'/>"
WRITE #1 "        <register address='0xb890728' value='0x" DATA.LONG(A:0x890728) "' name='RPMH_VRM_MODE_CRS_DRV9_REG7'/>"
WRITE #1 "        <register address='0xb890828' value='0x" DATA.LONG(A:0x890828) "' name='RPMH_VRM_MODE_CRS_DRV9_REG8'/>"
WRITE #1 "        <register address='0xb890928' value='0x" DATA.LONG(A:0x890928) "' name='RPMH_VRM_MODE_CRS_DRV9_REG9'/>"
WRITE #1 "        <register address='0xb890a28' value='0x" DATA.LONG(A:0x890a28) "' name='RPMH_VRM_MODE_CRS_DRV9_REG10'/>"
WRITE #1 "        <register address='0xb890b28' value='0x" DATA.LONG(A:0x890b28) "' name='RPMH_VRM_MODE_CRS_DRV9_REG11'/>"
WRITE #1 "        <register address='0xb890c28' value='0x" DATA.LONG(A:0x890c28) "' name='RPMH_VRM_MODE_CRS_DRV9_REG12'/>"
WRITE #1 "        <register address='0xb890d28' value='0x" DATA.LONG(A:0x890d28) "' name='RPMH_VRM_MODE_CRS_DRV9_REG13'/>"
WRITE #1 "        <register address='0xb890e28' value='0x" DATA.LONG(A:0x890e28) "' name='RPMH_VRM_MODE_CRS_DRV9_REG14'/>"
WRITE #1 "        <register address='0xb890f28' value='0x" DATA.LONG(A:0x890f28) "' name='RPMH_VRM_MODE_CRS_DRV9_REG15'/>"
WRITE #1 "        <register address='0xb891028' value='0x" DATA.LONG(A:0x891028) "' name='RPMH_VRM_MODE_CRS_DRV9_REG16'/>"
WRITE #1 "        <register address='0xb891128' value='0x" DATA.LONG(A:0x891128) "' name='RPMH_VRM_MODE_CRS_DRV9_REG17'/>"
WRITE #1 "        <register address='0xb891228' value='0x" DATA.LONG(A:0x891228) "' name='RPMH_VRM_MODE_CRS_DRV9_REG18'/>"
WRITE #1 "        <register address='0xb891328' value='0x" DATA.LONG(A:0x891328) "' name='RPMH_VRM_MODE_CRS_DRV9_REG19'/>"
WRITE #1 "        <register address='0xb891428' value='0x" DATA.LONG(A:0x891428) "' name='RPMH_VRM_MODE_CRS_DRV9_REG20'/>"
WRITE #1 "        <register address='0xb891528' value='0x" DATA.LONG(A:0x891528) "' name='RPMH_VRM_MODE_CRS_DRV9_REG21'/>"
WRITE #1 "        <register address='0xb891628' value='0x" DATA.LONG(A:0x891628) "' name='RPMH_VRM_MODE_CRS_DRV9_REG22'/>"
WRITE #1 "        <register address='0xb891728' value='0x" DATA.LONG(A:0x891728) "' name='RPMH_VRM_MODE_CRS_DRV9_REG23'/>"
WRITE #1 "        <register address='0xb891828' value='0x" DATA.LONG(A:0x891828) "' name='RPMH_VRM_MODE_CRS_DRV9_REG24'/>"
WRITE #1 "        <register address='0xb891928' value='0x" DATA.LONG(A:0x891928) "' name='RPMH_VRM_MODE_CRS_DRV9_REG25'/>"
WRITE #1 "        <register address='0xb891a28' value='0x" DATA.LONG(A:0x891a28) "' name='RPMH_VRM_MODE_CRS_DRV9_REG26'/>"
WRITE #1 "        <register address='0xb891b28' value='0x" DATA.LONG(A:0x891b28) "' name='RPMH_VRM_MODE_CRS_DRV9_REG27'/>"
WRITE #1 "        <register address='0xb891c28' value='0x" DATA.LONG(A:0x891c28) "' name='RPMH_VRM_MODE_CRS_DRV9_REG28'/>"
WRITE #1 "        <register address='0xb891d28' value='0x" DATA.LONG(A:0x891d28) "' name='RPMH_VRM_MODE_CRS_DRV9_REG29'/>"
WRITE #1 "        <register address='0xb891e28' value='0x" DATA.LONG(A:0x891e28) "' name='RPMH_VRM_MODE_CRS_DRV9_REG30'/>"
WRITE #1 "        <register address='0xb891f28' value='0x" DATA.LONG(A:0x891f28) "' name='RPMH_VRM_MODE_CRS_DRV9_REG31'/>"
WRITE #1 "        <register address='0xb892028' value='0x" DATA.LONG(A:0x892028) "' name='RPMH_VRM_MODE_CRS_DRV9_REG32'/>"
WRITE #1 "        <register address='0xb892128' value='0x" DATA.LONG(A:0x892128) "' name='RPMH_VRM_MODE_CRS_DRV9_REG33'/>"
WRITE #1 "        <register address='0xb892228' value='0x" DATA.LONG(A:0x892228) "' name='RPMH_VRM_MODE_CRS_DRV9_REG34'/>"
WRITE #1 "        <register address='0xb892328' value='0x" DATA.LONG(A:0x892328) "' name='RPMH_VRM_MODE_CRS_DRV9_REG35'/>"
WRITE #1 "        <register address='0xb892428' value='0x" DATA.LONG(A:0x892428) "' name='RPMH_VRM_MODE_CRS_DRV9_REG36'/>"
WRITE #1 "        <register address='0xb892528' value='0x" DATA.LONG(A:0x892528) "' name='RPMH_VRM_MODE_CRS_DRV9_REG37'/>"
WRITE #1 "        <register address='0xb892628' value='0x" DATA.LONG(A:0x892628) "' name='RPMH_VRM_MODE_CRS_DRV9_REG38'/>"
WRITE #1 "        <register address='0xb892728' value='0x" DATA.LONG(A:0x892728) "' name='RPMH_VRM_MODE_CRS_DRV9_REG39'/>"
WRITE #1 "        <register address='0xb892828' value='0x" DATA.LONG(A:0x892828) "' name='RPMH_VRM_MODE_CRS_DRV9_REG40'/>"
WRITE #1 "        <register address='0xb892928' value='0x" DATA.LONG(A:0x892928) "' name='RPMH_VRM_MODE_CRS_DRV9_REG41'/>"
WRITE #1 "        <register address='0xb892a28' value='0x" DATA.LONG(A:0x892a28) "' name='RPMH_VRM_MODE_CRS_DRV9_REG42'/>"
WRITE #1 "        <register address='0xb892b28' value='0x" DATA.LONG(A:0x892b28) "' name='RPMH_VRM_MODE_CRS_DRV9_REG43'/>"
WRITE #1 "        <register address='0xb892c28' value='0x" DATA.LONG(A:0x892c28) "' name='RPMH_VRM_MODE_CRS_DRV9_REG44'/>"
WRITE #1 "        <register address='0xb892d28' value='0x" DATA.LONG(A:0x892d28) "' name='RPMH_VRM_MODE_CRS_DRV9_REG45'/>"
WRITE #1 "        <register address='0xb8a0028' value='0x" DATA.LONG(A:0x8a0028) "' name='RPMH_VRM_MODE_CRS_DRV10_REG0'/>"
WRITE #1 "        <register address='0xb8a0128' value='0x" DATA.LONG(A:0x8a0128) "' name='RPMH_VRM_MODE_CRS_DRV10_REG1'/>"
WRITE #1 "        <register address='0xb8a0228' value='0x" DATA.LONG(A:0x8a0228) "' name='RPMH_VRM_MODE_CRS_DRV10_REG2'/>"
WRITE #1 "        <register address='0xb8a0328' value='0x" DATA.LONG(A:0x8a0328) "' name='RPMH_VRM_MODE_CRS_DRV10_REG3'/>"
WRITE #1 "        <register address='0xb8a0428' value='0x" DATA.LONG(A:0x8a0428) "' name='RPMH_VRM_MODE_CRS_DRV10_REG4'/>"
WRITE #1 "        <register address='0xb8a0528' value='0x" DATA.LONG(A:0x8a0528) "' name='RPMH_VRM_MODE_CRS_DRV10_REG5'/>"
WRITE #1 "        <register address='0xb8a0628' value='0x" DATA.LONG(A:0x8a0628) "' name='RPMH_VRM_MODE_CRS_DRV10_REG6'/>"
WRITE #1 "        <register address='0xb8a0728' value='0x" DATA.LONG(A:0x8a0728) "' name='RPMH_VRM_MODE_CRS_DRV10_REG7'/>"
WRITE #1 "        <register address='0xb8a0828' value='0x" DATA.LONG(A:0x8a0828) "' name='RPMH_VRM_MODE_CRS_DRV10_REG8'/>"
WRITE #1 "        <register address='0xb8a0928' value='0x" DATA.LONG(A:0x8a0928) "' name='RPMH_VRM_MODE_CRS_DRV10_REG9'/>"
WRITE #1 "        <register address='0xb8a0a28' value='0x" DATA.LONG(A:0x8a0a28) "' name='RPMH_VRM_MODE_CRS_DRV10_REG10'/>"
WRITE #1 "        <register address='0xb8a0b28' value='0x" DATA.LONG(A:0x8a0b28) "' name='RPMH_VRM_MODE_CRS_DRV10_REG11'/>"
WRITE #1 "        <register address='0xb8a0c28' value='0x" DATA.LONG(A:0x8a0c28) "' name='RPMH_VRM_MODE_CRS_DRV10_REG12'/>"
WRITE #1 "        <register address='0xb8a0d28' value='0x" DATA.LONG(A:0x8a0d28) "' name='RPMH_VRM_MODE_CRS_DRV10_REG13'/>"
WRITE #1 "        <register address='0xb8a0e28' value='0x" DATA.LONG(A:0x8a0e28) "' name='RPMH_VRM_MODE_CRS_DRV10_REG14'/>"
WRITE #1 "        <register address='0xb8a0f28' value='0x" DATA.LONG(A:0x8a0f28) "' name='RPMH_VRM_MODE_CRS_DRV10_REG15'/>"
WRITE #1 "        <register address='0xb8a1028' value='0x" DATA.LONG(A:0x8a1028) "' name='RPMH_VRM_MODE_CRS_DRV10_REG16'/>"
WRITE #1 "        <register address='0xb8a1128' value='0x" DATA.LONG(A:0x8a1128) "' name='RPMH_VRM_MODE_CRS_DRV10_REG17'/>"
WRITE #1 "        <register address='0xb8a1228' value='0x" DATA.LONG(A:0x8a1228) "' name='RPMH_VRM_MODE_CRS_DRV10_REG18'/>"
WRITE #1 "        <register address='0xb8a1328' value='0x" DATA.LONG(A:0x8a1328) "' name='RPMH_VRM_MODE_CRS_DRV10_REG19'/>"
WRITE #1 "        <register address='0xb8a1428' value='0x" DATA.LONG(A:0x8a1428) "' name='RPMH_VRM_MODE_CRS_DRV10_REG20'/>"
WRITE #1 "        <register address='0xb8a1528' value='0x" DATA.LONG(A:0x8a1528) "' name='RPMH_VRM_MODE_CRS_DRV10_REG21'/>"
WRITE #1 "        <register address='0xb8a1628' value='0x" DATA.LONG(A:0x8a1628) "' name='RPMH_VRM_MODE_CRS_DRV10_REG22'/>"
WRITE #1 "        <register address='0xb8a1728' value='0x" DATA.LONG(A:0x8a1728) "' name='RPMH_VRM_MODE_CRS_DRV10_REG23'/>"
WRITE #1 "        <register address='0xb8a1828' value='0x" DATA.LONG(A:0x8a1828) "' name='RPMH_VRM_MODE_CRS_DRV10_REG24'/>"
WRITE #1 "        <register address='0xb8a1928' value='0x" DATA.LONG(A:0x8a1928) "' name='RPMH_VRM_MODE_CRS_DRV10_REG25'/>"
WRITE #1 "        <register address='0xb8a1a28' value='0x" DATA.LONG(A:0x8a1a28) "' name='RPMH_VRM_MODE_CRS_DRV10_REG26'/>"
WRITE #1 "        <register address='0xb8a1b28' value='0x" DATA.LONG(A:0x8a1b28) "' name='RPMH_VRM_MODE_CRS_DRV10_REG27'/>"
WRITE #1 "        <register address='0xb8a1c28' value='0x" DATA.LONG(A:0x8a1c28) "' name='RPMH_VRM_MODE_CRS_DRV10_REG28'/>"
WRITE #1 "        <register address='0xb8a1d28' value='0x" DATA.LONG(A:0x8a1d28) "' name='RPMH_VRM_MODE_CRS_DRV10_REG29'/>"
WRITE #1 "        <register address='0xb8a1e28' value='0x" DATA.LONG(A:0x8a1e28) "' name='RPMH_VRM_MODE_CRS_DRV10_REG30'/>"
WRITE #1 "        <register address='0xb8a1f28' value='0x" DATA.LONG(A:0x8a1f28) "' name='RPMH_VRM_MODE_CRS_DRV10_REG31'/>"
WRITE #1 "        <register address='0xb8a2028' value='0x" DATA.LONG(A:0x8a2028) "' name='RPMH_VRM_MODE_CRS_DRV10_REG32'/>"
WRITE #1 "        <register address='0xb8a2128' value='0x" DATA.LONG(A:0x8a2128) "' name='RPMH_VRM_MODE_CRS_DRV10_REG33'/>"
WRITE #1 "        <register address='0xb8a2228' value='0x" DATA.LONG(A:0x8a2228) "' name='RPMH_VRM_MODE_CRS_DRV10_REG34'/>"
WRITE #1 "        <register address='0xb8a2328' value='0x" DATA.LONG(A:0x8a2328) "' name='RPMH_VRM_MODE_CRS_DRV10_REG35'/>"
WRITE #1 "        <register address='0xb8a2428' value='0x" DATA.LONG(A:0x8a2428) "' name='RPMH_VRM_MODE_CRS_DRV10_REG36'/>"
WRITE #1 "        <register address='0xb8a2528' value='0x" DATA.LONG(A:0x8a2528) "' name='RPMH_VRM_MODE_CRS_DRV10_REG37'/>"
WRITE #1 "        <register address='0xb8a2628' value='0x" DATA.LONG(A:0x8a2628) "' name='RPMH_VRM_MODE_CRS_DRV10_REG38'/>"
WRITE #1 "        <register address='0xb8a2728' value='0x" DATA.LONG(A:0x8a2728) "' name='RPMH_VRM_MODE_CRS_DRV10_REG39'/>"
WRITE #1 "        <register address='0xb8a2828' value='0x" DATA.LONG(A:0x8a2828) "' name='RPMH_VRM_MODE_CRS_DRV10_REG40'/>"
WRITE #1 "        <register address='0xb8a2928' value='0x" DATA.LONG(A:0x8a2928) "' name='RPMH_VRM_MODE_CRS_DRV10_REG41'/>"
WRITE #1 "        <register address='0xb8a2a28' value='0x" DATA.LONG(A:0x8a2a28) "' name='RPMH_VRM_MODE_CRS_DRV10_REG42'/>"
WRITE #1 "        <register address='0xb8a2b28' value='0x" DATA.LONG(A:0x8a2b28) "' name='RPMH_VRM_MODE_CRS_DRV10_REG43'/>"
WRITE #1 "        <register address='0xb8a2c28' value='0x" DATA.LONG(A:0x8a2c28) "' name='RPMH_VRM_MODE_CRS_DRV10_REG44'/>"
WRITE #1 "        <register address='0xb8a2d28' value='0x" DATA.LONG(A:0x8a2d28) "' name='RPMH_VRM_MODE_CRS_DRV10_REG45'/>"
WRITE #1 "        <register address='0xb8b0028' value='0x" DATA.LONG(A:0x8b0028) "' name='RPMH_VRM_MODE_CRS_DRV11_REG0'/>"
WRITE #1 "        <register address='0xb8b0128' value='0x" DATA.LONG(A:0x8b0128) "' name='RPMH_VRM_MODE_CRS_DRV11_REG1'/>"
WRITE #1 "        <register address='0xb8b0228' value='0x" DATA.LONG(A:0x8b0228) "' name='RPMH_VRM_MODE_CRS_DRV11_REG2'/>"
WRITE #1 "        <register address='0xb8b0328' value='0x" DATA.LONG(A:0x8b0328) "' name='RPMH_VRM_MODE_CRS_DRV11_REG3'/>"
WRITE #1 "        <register address='0xb8b0428' value='0x" DATA.LONG(A:0x8b0428) "' name='RPMH_VRM_MODE_CRS_DRV11_REG4'/>"
WRITE #1 "        <register address='0xb8b0528' value='0x" DATA.LONG(A:0x8b0528) "' name='RPMH_VRM_MODE_CRS_DRV11_REG5'/>"
WRITE #1 "        <register address='0xb8b0628' value='0x" DATA.LONG(A:0x8b0628) "' name='RPMH_VRM_MODE_CRS_DRV11_REG6'/>"
WRITE #1 "        <register address='0xb8b0728' value='0x" DATA.LONG(A:0x8b0728) "' name='RPMH_VRM_MODE_CRS_DRV11_REG7'/>"
WRITE #1 "        <register address='0xb8b0828' value='0x" DATA.LONG(A:0x8b0828) "' name='RPMH_VRM_MODE_CRS_DRV11_REG8'/>"
WRITE #1 "        <register address='0xb8b0928' value='0x" DATA.LONG(A:0x8b0928) "' name='RPMH_VRM_MODE_CRS_DRV11_REG9'/>"
WRITE #1 "        <register address='0xb8b0a28' value='0x" DATA.LONG(A:0x8b0a28) "' name='RPMH_VRM_MODE_CRS_DRV11_REG10'/>"
WRITE #1 "        <register address='0xb8b0b28' value='0x" DATA.LONG(A:0x8b0b28) "' name='RPMH_VRM_MODE_CRS_DRV11_REG11'/>"
WRITE #1 "        <register address='0xb8b0c28' value='0x" DATA.LONG(A:0x8b0c28) "' name='RPMH_VRM_MODE_CRS_DRV11_REG12'/>"
WRITE #1 "        <register address='0xb8b0d28' value='0x" DATA.LONG(A:0x8b0d28) "' name='RPMH_VRM_MODE_CRS_DRV11_REG13'/>"
WRITE #1 "        <register address='0xb8b0e28' value='0x" DATA.LONG(A:0x8b0e28) "' name='RPMH_VRM_MODE_CRS_DRV11_REG14'/>"
WRITE #1 "        <register address='0xb8b0f28' value='0x" DATA.LONG(A:0x8b0f28) "' name='RPMH_VRM_MODE_CRS_DRV11_REG15'/>"
WRITE #1 "        <register address='0xb8b1028' value='0x" DATA.LONG(A:0x8b1028) "' name='RPMH_VRM_MODE_CRS_DRV11_REG16'/>"
WRITE #1 "        <register address='0xb8b1128' value='0x" DATA.LONG(A:0x8b1128) "' name='RPMH_VRM_MODE_CRS_DRV11_REG17'/>"
WRITE #1 "        <register address='0xb8b1228' value='0x" DATA.LONG(A:0x8b1228) "' name='RPMH_VRM_MODE_CRS_DRV11_REG18'/>"
WRITE #1 "        <register address='0xb8b1328' value='0x" DATA.LONG(A:0x8b1328) "' name='RPMH_VRM_MODE_CRS_DRV11_REG19'/>"
WRITE #1 "        <register address='0xb8b1428' value='0x" DATA.LONG(A:0x8b1428) "' name='RPMH_VRM_MODE_CRS_DRV11_REG20'/>"
WRITE #1 "        <register address='0xb8b1528' value='0x" DATA.LONG(A:0x8b1528) "' name='RPMH_VRM_MODE_CRS_DRV11_REG21'/>"
WRITE #1 "        <register address='0xb8b1628' value='0x" DATA.LONG(A:0x8b1628) "' name='RPMH_VRM_MODE_CRS_DRV11_REG22'/>"
WRITE #1 "        <register address='0xb8b1728' value='0x" DATA.LONG(A:0x8b1728) "' name='RPMH_VRM_MODE_CRS_DRV11_REG23'/>"
WRITE #1 "        <register address='0xb8b1828' value='0x" DATA.LONG(A:0x8b1828) "' name='RPMH_VRM_MODE_CRS_DRV11_REG24'/>"
WRITE #1 "        <register address='0xb8b1928' value='0x" DATA.LONG(A:0x8b1928) "' name='RPMH_VRM_MODE_CRS_DRV11_REG25'/>"
WRITE #1 "        <register address='0xb8b1a28' value='0x" DATA.LONG(A:0x8b1a28) "' name='RPMH_VRM_MODE_CRS_DRV11_REG26'/>"
WRITE #1 "        <register address='0xb8b1b28' value='0x" DATA.LONG(A:0x8b1b28) "' name='RPMH_VRM_MODE_CRS_DRV11_REG27'/>"
WRITE #1 "        <register address='0xb8b1c28' value='0x" DATA.LONG(A:0x8b1c28) "' name='RPMH_VRM_MODE_CRS_DRV11_REG28'/>"
WRITE #1 "        <register address='0xb8b1d28' value='0x" DATA.LONG(A:0x8b1d28) "' name='RPMH_VRM_MODE_CRS_DRV11_REG29'/>"
WRITE #1 "        <register address='0xb8b1e28' value='0x" DATA.LONG(A:0x8b1e28) "' name='RPMH_VRM_MODE_CRS_DRV11_REG30'/>"
WRITE #1 "        <register address='0xb8b1f28' value='0x" DATA.LONG(A:0x8b1f28) "' name='RPMH_VRM_MODE_CRS_DRV11_REG31'/>"
WRITE #1 "        <register address='0xb8b2028' value='0x" DATA.LONG(A:0x8b2028) "' name='RPMH_VRM_MODE_CRS_DRV11_REG32'/>"
WRITE #1 "        <register address='0xb8b2128' value='0x" DATA.LONG(A:0x8b2128) "' name='RPMH_VRM_MODE_CRS_DRV11_REG33'/>"
WRITE #1 "        <register address='0xb8b2228' value='0x" DATA.LONG(A:0x8b2228) "' name='RPMH_VRM_MODE_CRS_DRV11_REG34'/>"
WRITE #1 "        <register address='0xb8b2328' value='0x" DATA.LONG(A:0x8b2328) "' name='RPMH_VRM_MODE_CRS_DRV11_REG35'/>"
WRITE #1 "        <register address='0xb8b2428' value='0x" DATA.LONG(A:0x8b2428) "' name='RPMH_VRM_MODE_CRS_DRV11_REG36'/>"
WRITE #1 "        <register address='0xb8b2528' value='0x" DATA.LONG(A:0x8b2528) "' name='RPMH_VRM_MODE_CRS_DRV11_REG37'/>"
WRITE #1 "        <register address='0xb8b2628' value='0x" DATA.LONG(A:0x8b2628) "' name='RPMH_VRM_MODE_CRS_DRV11_REG38'/>"
WRITE #1 "        <register address='0xb8b2728' value='0x" DATA.LONG(A:0x8b2728) "' name='RPMH_VRM_MODE_CRS_DRV11_REG39'/>"
WRITE #1 "        <register address='0xb8b2828' value='0x" DATA.LONG(A:0x8b2828) "' name='RPMH_VRM_MODE_CRS_DRV11_REG40'/>"
WRITE #1 "        <register address='0xb8b2928' value='0x" DATA.LONG(A:0x8b2928) "' name='RPMH_VRM_MODE_CRS_DRV11_REG41'/>"
WRITE #1 "        <register address='0xb8b2a28' value='0x" DATA.LONG(A:0x8b2a28) "' name='RPMH_VRM_MODE_CRS_DRV11_REG42'/>"
WRITE #1 "        <register address='0xb8b2b28' value='0x" DATA.LONG(A:0x8b2b28) "' name='RPMH_VRM_MODE_CRS_DRV11_REG43'/>"
WRITE #1 "        <register address='0xb8b2c28' value='0x" DATA.LONG(A:0x8b2c28) "' name='RPMH_VRM_MODE_CRS_DRV11_REG44'/>"
WRITE #1 "        <register address='0xb8b2d28' value='0x" DATA.LONG(A:0x8b2d28) "' name='RPMH_VRM_MODE_CRS_DRV11_REG45'/>"
WRITE #1 "        <register address='0xb802e24' value='0x" DATA.LONG(A:0x802e24) "' name='RPMH_VRM_ENABLE_CRS_DRV0_XOB0'/>"
WRITE #1 "        <register address='0xb802f24' value='0x" DATA.LONG(A:0x802f24) "' name='RPMH_VRM_ENABLE_CRS_DRV0_XOB1'/>"
WRITE #1 "        <register address='0xb803024' value='0x" DATA.LONG(A:0x803024) "' name='RPMH_VRM_ENABLE_CRS_DRV0_XOB2'/>"
WRITE #1 "        <register address='0xb803124' value='0x" DATA.LONG(A:0x803124) "' name='RPMH_VRM_ENABLE_CRS_DRV0_XOB3'/>"
WRITE #1 "        <register address='0xb803224' value='0x" DATA.LONG(A:0x803224) "' name='RPMH_VRM_ENABLE_CRS_DRV0_XOB4'/>"
WRITE #1 "        <register address='0xb803324' value='0x" DATA.LONG(A:0x803324) "' name='RPMH_VRM_ENABLE_CRS_DRV0_XOB5'/>"
WRITE #1 "        <register address='0xb803424' value='0x" DATA.LONG(A:0x803424) "' name='RPMH_VRM_ENABLE_CRS_DRV0_XOB6'/>"
WRITE #1 "        <register address='0xb803524' value='0x" DATA.LONG(A:0x803524) "' name='RPMH_VRM_ENABLE_CRS_DRV0_XOB7'/>"
WRITE #1 "        <register address='0xb803624' value='0x" DATA.LONG(A:0x803624) "' name='RPMH_VRM_ENABLE_CRS_DRV0_XOB8'/>"
WRITE #1 "        <register address='0xb803724' value='0x" DATA.LONG(A:0x803724) "' name='RPMH_VRM_ENABLE_CRS_DRV0_XOB9'/>"
WRITE #1 "        <register address='0xb803824' value='0x" DATA.LONG(A:0x803824) "' name='RPMH_VRM_ENABLE_CRS_DRV0_XOB10'/>"
WRITE #1 "        <register address='0xb803924' value='0x" DATA.LONG(A:0x803924) "' name='RPMH_VRM_ENABLE_CRS_DRV0_XOB11'/>"
WRITE #1 "        <register address='0xb803a24' value='0x" DATA.LONG(A:0x803a24) "' name='RPMH_VRM_ENABLE_CRS_DRV0_XOB12'/>"
WRITE #1 "        <register address='0xb803b24' value='0x" DATA.LONG(A:0x803b24) "' name='RPMH_VRM_ENABLE_CRS_DRV0_XOB13'/>"
WRITE #1 "        <register address='0xb803c24' value='0x" DATA.LONG(A:0x803c24) "' name='RPMH_VRM_ENABLE_CRS_DRV0_XOB14'/>"
WRITE #1 "        <register address='0xb803d24' value='0x" DATA.LONG(A:0x803d24) "' name='RPMH_VRM_ENABLE_CRS_DRV0_XOB15'/>"
WRITE #1 "        <register address='0xb812e24' value='0x" DATA.LONG(A:0x812e24) "' name='RPMH_VRM_ENABLE_CRS_DRV1_XOB0'/>"
WRITE #1 "        <register address='0xb812f24' value='0x" DATA.LONG(A:0x812f24) "' name='RPMH_VRM_ENABLE_CRS_DRV1_XOB1'/>"
WRITE #1 "        <register address='0xb813024' value='0x" DATA.LONG(A:0x813024) "' name='RPMH_VRM_ENABLE_CRS_DRV1_XOB2'/>"
WRITE #1 "        <register address='0xb813124' value='0x" DATA.LONG(A:0x813124) "' name='RPMH_VRM_ENABLE_CRS_DRV1_XOB3'/>"
WRITE #1 "        <register address='0xb813224' value='0x" DATA.LONG(A:0x813224) "' name='RPMH_VRM_ENABLE_CRS_DRV1_XOB4'/>"
WRITE #1 "        <register address='0xb813324' value='0x" DATA.LONG(A:0x813324) "' name='RPMH_VRM_ENABLE_CRS_DRV1_XOB5'/>"
WRITE #1 "        <register address='0xb813424' value='0x" DATA.LONG(A:0x813424) "' name='RPMH_VRM_ENABLE_CRS_DRV1_XOB6'/>"
WRITE #1 "        <register address='0xb813524' value='0x" DATA.LONG(A:0x813524) "' name='RPMH_VRM_ENABLE_CRS_DRV1_XOB7'/>"
WRITE #1 "        <register address='0xb813624' value='0x" DATA.LONG(A:0x813624) "' name='RPMH_VRM_ENABLE_CRS_DRV1_XOB8'/>"
WRITE #1 "        <register address='0xb813724' value='0x" DATA.LONG(A:0x813724) "' name='RPMH_VRM_ENABLE_CRS_DRV1_XOB9'/>"
WRITE #1 "        <register address='0xb813824' value='0x" DATA.LONG(A:0x813824) "' name='RPMH_VRM_ENABLE_CRS_DRV1_XOB10'/>"
WRITE #1 "        <register address='0xb813924' value='0x" DATA.LONG(A:0x813924) "' name='RPMH_VRM_ENABLE_CRS_DRV1_XOB11'/>"
WRITE #1 "        <register address='0xb813a24' value='0x" DATA.LONG(A:0x813a24) "' name='RPMH_VRM_ENABLE_CRS_DRV1_XOB12'/>"
WRITE #1 "        <register address='0xb813b24' value='0x" DATA.LONG(A:0x813b24) "' name='RPMH_VRM_ENABLE_CRS_DRV1_XOB13'/>"
WRITE #1 "        <register address='0xb813c24' value='0x" DATA.LONG(A:0x813c24) "' name='RPMH_VRM_ENABLE_CRS_DRV1_XOB14'/>"
WRITE #1 "        <register address='0xb813d24' value='0x" DATA.LONG(A:0x813d24) "' name='RPMH_VRM_ENABLE_CRS_DRV1_XOB15'/>"
WRITE #1 "        <register address='0xb822e24' value='0x" DATA.LONG(A:0x822e24) "' name='RPMH_VRM_ENABLE_CRS_DRV2_XOB0'/>"
WRITE #1 "        <register address='0xb822f24' value='0x" DATA.LONG(A:0x822f24) "' name='RPMH_VRM_ENABLE_CRS_DRV2_XOB1'/>"
WRITE #1 "        <register address='0xb823024' value='0x" DATA.LONG(A:0x823024) "' name='RPMH_VRM_ENABLE_CRS_DRV2_XOB2'/>"
WRITE #1 "        <register address='0xb823124' value='0x" DATA.LONG(A:0x823124) "' name='RPMH_VRM_ENABLE_CRS_DRV2_XOB3'/>"
WRITE #1 "        <register address='0xb823224' value='0x" DATA.LONG(A:0x823224) "' name='RPMH_VRM_ENABLE_CRS_DRV2_XOB4'/>"
WRITE #1 "        <register address='0xb823324' value='0x" DATA.LONG(A:0x823324) "' name='RPMH_VRM_ENABLE_CRS_DRV2_XOB5'/>"
WRITE #1 "        <register address='0xb823424' value='0x" DATA.LONG(A:0x823424) "' name='RPMH_VRM_ENABLE_CRS_DRV2_XOB6'/>"
WRITE #1 "        <register address='0xb823524' value='0x" DATA.LONG(A:0x823524) "' name='RPMH_VRM_ENABLE_CRS_DRV2_XOB7'/>"
WRITE #1 "        <register address='0xb823624' value='0x" DATA.LONG(A:0x823624) "' name='RPMH_VRM_ENABLE_CRS_DRV2_XOB8'/>"
WRITE #1 "        <register address='0xb823724' value='0x" DATA.LONG(A:0x823724) "' name='RPMH_VRM_ENABLE_CRS_DRV2_XOB9'/>"
WRITE #1 "        <register address='0xb823824' value='0x" DATA.LONG(A:0x823824) "' name='RPMH_VRM_ENABLE_CRS_DRV2_XOB10'/>"
WRITE #1 "        <register address='0xb823924' value='0x" DATA.LONG(A:0x823924) "' name='RPMH_VRM_ENABLE_CRS_DRV2_XOB11'/>"
WRITE #1 "        <register address='0xb823a24' value='0x" DATA.LONG(A:0x823a24) "' name='RPMH_VRM_ENABLE_CRS_DRV2_XOB12'/>"
WRITE #1 "        <register address='0xb823b24' value='0x" DATA.LONG(A:0x823b24) "' name='RPMH_VRM_ENABLE_CRS_DRV2_XOB13'/>"
WRITE #1 "        <register address='0xb823c24' value='0x" DATA.LONG(A:0x823c24) "' name='RPMH_VRM_ENABLE_CRS_DRV2_XOB14'/>"
WRITE #1 "        <register address='0xb823d24' value='0x" DATA.LONG(A:0x823d24) "' name='RPMH_VRM_ENABLE_CRS_DRV2_XOB15'/>"
WRITE #1 "        <register address='0xb832e24' value='0x" DATA.LONG(A:0x832e24) "' name='RPMH_VRM_ENABLE_CRS_DRV3_XOB0'/>"
WRITE #1 "        <register address='0xb832f24' value='0x" DATA.LONG(A:0x832f24) "' name='RPMH_VRM_ENABLE_CRS_DRV3_XOB1'/>"
WRITE #1 "        <register address='0xb833024' value='0x" DATA.LONG(A:0x833024) "' name='RPMH_VRM_ENABLE_CRS_DRV3_XOB2'/>"
WRITE #1 "        <register address='0xb833124' value='0x" DATA.LONG(A:0x833124) "' name='RPMH_VRM_ENABLE_CRS_DRV3_XOB3'/>"
WRITE #1 "        <register address='0xb833224' value='0x" DATA.LONG(A:0x833224) "' name='RPMH_VRM_ENABLE_CRS_DRV3_XOB4'/>"
WRITE #1 "        <register address='0xb833324' value='0x" DATA.LONG(A:0x833324) "' name='RPMH_VRM_ENABLE_CRS_DRV3_XOB5'/>"
WRITE #1 "        <register address='0xb833424' value='0x" DATA.LONG(A:0x833424) "' name='RPMH_VRM_ENABLE_CRS_DRV3_XOB6'/>"
WRITE #1 "        <register address='0xb833524' value='0x" DATA.LONG(A:0x833524) "' name='RPMH_VRM_ENABLE_CRS_DRV3_XOB7'/>"
WRITE #1 "        <register address='0xb833624' value='0x" DATA.LONG(A:0x833624) "' name='RPMH_VRM_ENABLE_CRS_DRV3_XOB8'/>"
WRITE #1 "        <register address='0xb833724' value='0x" DATA.LONG(A:0x833724) "' name='RPMH_VRM_ENABLE_CRS_DRV3_XOB9'/>"
WRITE #1 "        <register address='0xb833824' value='0x" DATA.LONG(A:0x833824) "' name='RPMH_VRM_ENABLE_CRS_DRV3_XOB10'/>"
WRITE #1 "        <register address='0xb833924' value='0x" DATA.LONG(A:0x833924) "' name='RPMH_VRM_ENABLE_CRS_DRV3_XOB11'/>"
WRITE #1 "        <register address='0xb833a24' value='0x" DATA.LONG(A:0x833a24) "' name='RPMH_VRM_ENABLE_CRS_DRV3_XOB12'/>"
WRITE #1 "        <register address='0xb833b24' value='0x" DATA.LONG(A:0x833b24) "' name='RPMH_VRM_ENABLE_CRS_DRV3_XOB13'/>"
WRITE #1 "        <register address='0xb833c24' value='0x" DATA.LONG(A:0x833c24) "' name='RPMH_VRM_ENABLE_CRS_DRV3_XOB14'/>"
WRITE #1 "        <register address='0xb833d24' value='0x" DATA.LONG(A:0x833d24) "' name='RPMH_VRM_ENABLE_CRS_DRV3_XOB15'/>"
WRITE #1 "        <register address='0xb842e24' value='0x" DATA.LONG(A:0x842e24) "' name='RPMH_VRM_ENABLE_CRS_DRV4_XOB0'/>"
WRITE #1 "        <register address='0xb842f24' value='0x" DATA.LONG(A:0x842f24) "' name='RPMH_VRM_ENABLE_CRS_DRV4_XOB1'/>"
WRITE #1 "        <register address='0xb843024' value='0x" DATA.LONG(A:0x843024) "' name='RPMH_VRM_ENABLE_CRS_DRV4_XOB2'/>"
WRITE #1 "        <register address='0xb843124' value='0x" DATA.LONG(A:0x843124) "' name='RPMH_VRM_ENABLE_CRS_DRV4_XOB3'/>"
WRITE #1 "        <register address='0xb843224' value='0x" DATA.LONG(A:0x843224) "' name='RPMH_VRM_ENABLE_CRS_DRV4_XOB4'/>"
WRITE #1 "        <register address='0xb843324' value='0x" DATA.LONG(A:0x843324) "' name='RPMH_VRM_ENABLE_CRS_DRV4_XOB5'/>"
WRITE #1 "        <register address='0xb843424' value='0x" DATA.LONG(A:0x843424) "' name='RPMH_VRM_ENABLE_CRS_DRV4_XOB6'/>"
WRITE #1 "        <register address='0xb843524' value='0x" DATA.LONG(A:0x843524) "' name='RPMH_VRM_ENABLE_CRS_DRV4_XOB7'/>"
WRITE #1 "        <register address='0xb843624' value='0x" DATA.LONG(A:0x843624) "' name='RPMH_VRM_ENABLE_CRS_DRV4_XOB8'/>"
WRITE #1 "        <register address='0xb843724' value='0x" DATA.LONG(A:0x843724) "' name='RPMH_VRM_ENABLE_CRS_DRV4_XOB9'/>"
WRITE #1 "        <register address='0xb843824' value='0x" DATA.LONG(A:0x843824) "' name='RPMH_VRM_ENABLE_CRS_DRV4_XOB10'/>"
WRITE #1 "        <register address='0xb843924' value='0x" DATA.LONG(A:0x843924) "' name='RPMH_VRM_ENABLE_CRS_DRV4_XOB11'/>"
WRITE #1 "        <register address='0xb843a24' value='0x" DATA.LONG(A:0x843a24) "' name='RPMH_VRM_ENABLE_CRS_DRV4_XOB12'/>"
WRITE #1 "        <register address='0xb843b24' value='0x" DATA.LONG(A:0x843b24) "' name='RPMH_VRM_ENABLE_CRS_DRV4_XOB13'/>"
WRITE #1 "        <register address='0xb843c24' value='0x" DATA.LONG(A:0x843c24) "' name='RPMH_VRM_ENABLE_CRS_DRV4_XOB14'/>"
WRITE #1 "        <register address='0xb843d24' value='0x" DATA.LONG(A:0x843d24) "' name='RPMH_VRM_ENABLE_CRS_DRV4_XOB15'/>"
WRITE #1 "        <register address='0xb852e24' value='0x" DATA.LONG(A:0x852e24) "' name='RPMH_VRM_ENABLE_CRS_DRV5_XOB0'/>"
WRITE #1 "        <register address='0xb852f24' value='0x" DATA.LONG(A:0x852f24) "' name='RPMH_VRM_ENABLE_CRS_DRV5_XOB1'/>"
WRITE #1 "        <register address='0xb853024' value='0x" DATA.LONG(A:0x853024) "' name='RPMH_VRM_ENABLE_CRS_DRV5_XOB2'/>"
WRITE #1 "        <register address='0xb853124' value='0x" DATA.LONG(A:0x853124) "' name='RPMH_VRM_ENABLE_CRS_DRV5_XOB3'/>"
WRITE #1 "        <register address='0xb853224' value='0x" DATA.LONG(A:0x853224) "' name='RPMH_VRM_ENABLE_CRS_DRV5_XOB4'/>"
WRITE #1 "        <register address='0xb853324' value='0x" DATA.LONG(A:0x853324) "' name='RPMH_VRM_ENABLE_CRS_DRV5_XOB5'/>"
WRITE #1 "        <register address='0xb853424' value='0x" DATA.LONG(A:0x853424) "' name='RPMH_VRM_ENABLE_CRS_DRV5_XOB6'/>"
WRITE #1 "        <register address='0xb853524' value='0x" DATA.LONG(A:0x853524) "' name='RPMH_VRM_ENABLE_CRS_DRV5_XOB7'/>"
WRITE #1 "        <register address='0xb853624' value='0x" DATA.LONG(A:0x853624) "' name='RPMH_VRM_ENABLE_CRS_DRV5_XOB8'/>"
WRITE #1 "        <register address='0xb853724' value='0x" DATA.LONG(A:0x853724) "' name='RPMH_VRM_ENABLE_CRS_DRV5_XOB9'/>"
WRITE #1 "        <register address='0xb853824' value='0x" DATA.LONG(A:0x853824) "' name='RPMH_VRM_ENABLE_CRS_DRV5_XOB10'/>"
WRITE #1 "        <register address='0xb853924' value='0x" DATA.LONG(A:0x853924) "' name='RPMH_VRM_ENABLE_CRS_DRV5_XOB11'/>"
WRITE #1 "        <register address='0xb853a24' value='0x" DATA.LONG(A:0x853a24) "' name='RPMH_VRM_ENABLE_CRS_DRV5_XOB12'/>"
WRITE #1 "        <register address='0xb853b24' value='0x" DATA.LONG(A:0x853b24) "' name='RPMH_VRM_ENABLE_CRS_DRV5_XOB13'/>"
WRITE #1 "        <register address='0xb853c24' value='0x" DATA.LONG(A:0x853c24) "' name='RPMH_VRM_ENABLE_CRS_DRV5_XOB14'/>"
WRITE #1 "        <register address='0xb853d24' value='0x" DATA.LONG(A:0x853d24) "' name='RPMH_VRM_ENABLE_CRS_DRV5_XOB15'/>"
WRITE #1 "        <register address='0xb862e24' value='0x" DATA.LONG(A:0x862e24) "' name='RPMH_VRM_ENABLE_CRS_DRV6_XOB0'/>"
WRITE #1 "        <register address='0xb862f24' value='0x" DATA.LONG(A:0x862f24) "' name='RPMH_VRM_ENABLE_CRS_DRV6_XOB1'/>"
WRITE #1 "        <register address='0xb863024' value='0x" DATA.LONG(A:0x863024) "' name='RPMH_VRM_ENABLE_CRS_DRV6_XOB2'/>"
WRITE #1 "        <register address='0xb863124' value='0x" DATA.LONG(A:0x863124) "' name='RPMH_VRM_ENABLE_CRS_DRV6_XOB3'/>"
WRITE #1 "        <register address='0xb863224' value='0x" DATA.LONG(A:0x863224) "' name='RPMH_VRM_ENABLE_CRS_DRV6_XOB4'/>"
WRITE #1 "        <register address='0xb863324' value='0x" DATA.LONG(A:0x863324) "' name='RPMH_VRM_ENABLE_CRS_DRV6_XOB5'/>"
WRITE #1 "        <register address='0xb863424' value='0x" DATA.LONG(A:0x863424) "' name='RPMH_VRM_ENABLE_CRS_DRV6_XOB6'/>"
WRITE #1 "        <register address='0xb863524' value='0x" DATA.LONG(A:0x863524) "' name='RPMH_VRM_ENABLE_CRS_DRV6_XOB7'/>"
WRITE #1 "        <register address='0xb863624' value='0x" DATA.LONG(A:0x863624) "' name='RPMH_VRM_ENABLE_CRS_DRV6_XOB8'/>"
WRITE #1 "        <register address='0xb863724' value='0x" DATA.LONG(A:0x863724) "' name='RPMH_VRM_ENABLE_CRS_DRV6_XOB9'/>"
WRITE #1 "        <register address='0xb863824' value='0x" DATA.LONG(A:0x863824) "' name='RPMH_VRM_ENABLE_CRS_DRV6_XOB10'/>"
WRITE #1 "        <register address='0xb863924' value='0x" DATA.LONG(A:0x863924) "' name='RPMH_VRM_ENABLE_CRS_DRV6_XOB11'/>"
WRITE #1 "        <register address='0xb863a24' value='0x" DATA.LONG(A:0x863a24) "' name='RPMH_VRM_ENABLE_CRS_DRV6_XOB12'/>"
WRITE #1 "        <register address='0xb863b24' value='0x" DATA.LONG(A:0x863b24) "' name='RPMH_VRM_ENABLE_CRS_DRV6_XOB13'/>"
WRITE #1 "        <register address='0xb863c24' value='0x" DATA.LONG(A:0x863c24) "' name='RPMH_VRM_ENABLE_CRS_DRV6_XOB14'/>"
WRITE #1 "        <register address='0xb863d24' value='0x" DATA.LONG(A:0x863d24) "' name='RPMH_VRM_ENABLE_CRS_DRV6_XOB15'/>"
WRITE #1 "        <register address='0xb872e24' value='0x" DATA.LONG(A:0x872e24) "' name='RPMH_VRM_ENABLE_CRS_DRV7_XOB0'/>"
WRITE #1 "        <register address='0xb872f24' value='0x" DATA.LONG(A:0x872f24) "' name='RPMH_VRM_ENABLE_CRS_DRV7_XOB1'/>"
WRITE #1 "        <register address='0xb873024' value='0x" DATA.LONG(A:0x873024) "' name='RPMH_VRM_ENABLE_CRS_DRV7_XOB2'/>"
WRITE #1 "        <register address='0xb873124' value='0x" DATA.LONG(A:0x873124) "' name='RPMH_VRM_ENABLE_CRS_DRV7_XOB3'/>"
WRITE #1 "        <register address='0xb873224' value='0x" DATA.LONG(A:0x873224) "' name='RPMH_VRM_ENABLE_CRS_DRV7_XOB4'/>"
WRITE #1 "        <register address='0xb873324' value='0x" DATA.LONG(A:0x873324) "' name='RPMH_VRM_ENABLE_CRS_DRV7_XOB5'/>"
WRITE #1 "        <register address='0xb873424' value='0x" DATA.LONG(A:0x873424) "' name='RPMH_VRM_ENABLE_CRS_DRV7_XOB6'/>"
WRITE #1 "        <register address='0xb873524' value='0x" DATA.LONG(A:0x873524) "' name='RPMH_VRM_ENABLE_CRS_DRV7_XOB7'/>"
WRITE #1 "        <register address='0xb873624' value='0x" DATA.LONG(A:0x873624) "' name='RPMH_VRM_ENABLE_CRS_DRV7_XOB8'/>"
WRITE #1 "        <register address='0xb873724' value='0x" DATA.LONG(A:0x873724) "' name='RPMH_VRM_ENABLE_CRS_DRV7_XOB9'/>"
WRITE #1 "        <register address='0xb873824' value='0x" DATA.LONG(A:0x873824) "' name='RPMH_VRM_ENABLE_CRS_DRV7_XOB10'/>"
WRITE #1 "        <register address='0xb873924' value='0x" DATA.LONG(A:0x873924) "' name='RPMH_VRM_ENABLE_CRS_DRV7_XOB11'/>"
WRITE #1 "        <register address='0xb873a24' value='0x" DATA.LONG(A:0x873a24) "' name='RPMH_VRM_ENABLE_CRS_DRV7_XOB12'/>"
WRITE #1 "        <register address='0xb873b24' value='0x" DATA.LONG(A:0x873b24) "' name='RPMH_VRM_ENABLE_CRS_DRV7_XOB13'/>"
WRITE #1 "        <register address='0xb873c24' value='0x" DATA.LONG(A:0x873c24) "' name='RPMH_VRM_ENABLE_CRS_DRV7_XOB14'/>"
WRITE #1 "        <register address='0xb873d24' value='0x" DATA.LONG(A:0x873d24) "' name='RPMH_VRM_ENABLE_CRS_DRV7_XOB15'/>"
WRITE #1 "        <register address='0xb882e24' value='0x" DATA.LONG(A:0x882e24) "' name='RPMH_VRM_ENABLE_CRS_DRV8_XOB0'/>"
WRITE #1 "        <register address='0xb882f24' value='0x" DATA.LONG(A:0x882f24) "' name='RPMH_VRM_ENABLE_CRS_DRV8_XOB1'/>"
WRITE #1 "        <register address='0xb883024' value='0x" DATA.LONG(A:0x883024) "' name='RPMH_VRM_ENABLE_CRS_DRV8_XOB2'/>"
WRITE #1 "        <register address='0xb883124' value='0x" DATA.LONG(A:0x883124) "' name='RPMH_VRM_ENABLE_CRS_DRV8_XOB3'/>"
WRITE #1 "        <register address='0xb883224' value='0x" DATA.LONG(A:0x883224) "' name='RPMH_VRM_ENABLE_CRS_DRV8_XOB4'/>"
WRITE #1 "        <register address='0xb883324' value='0x" DATA.LONG(A:0x883324) "' name='RPMH_VRM_ENABLE_CRS_DRV8_XOB5'/>"
WRITE #1 "        <register address='0xb883424' value='0x" DATA.LONG(A:0x883424) "' name='RPMH_VRM_ENABLE_CRS_DRV8_XOB6'/>"
WRITE #1 "        <register address='0xb883524' value='0x" DATA.LONG(A:0x883524) "' name='RPMH_VRM_ENABLE_CRS_DRV8_XOB7'/>"
WRITE #1 "        <register address='0xb883624' value='0x" DATA.LONG(A:0x883624) "' name='RPMH_VRM_ENABLE_CRS_DRV8_XOB8'/>"
WRITE #1 "        <register address='0xb883724' value='0x" DATA.LONG(A:0x883724) "' name='RPMH_VRM_ENABLE_CRS_DRV8_XOB9'/>"
WRITE #1 "        <register address='0xb883824' value='0x" DATA.LONG(A:0x883824) "' name='RPMH_VRM_ENABLE_CRS_DRV8_XOB10'/>"
WRITE #1 "        <register address='0xb883924' value='0x" DATA.LONG(A:0x883924) "' name='RPMH_VRM_ENABLE_CRS_DRV8_XOB11'/>"
WRITE #1 "        <register address='0xb883a24' value='0x" DATA.LONG(A:0x883a24) "' name='RPMH_VRM_ENABLE_CRS_DRV8_XOB12'/>"
WRITE #1 "        <register address='0xb883b24' value='0x" DATA.LONG(A:0x883b24) "' name='RPMH_VRM_ENABLE_CRS_DRV8_XOB13'/>"
WRITE #1 "        <register address='0xb883c24' value='0x" DATA.LONG(A:0x883c24) "' name='RPMH_VRM_ENABLE_CRS_DRV8_XOB14'/>"
WRITE #1 "        <register address='0xb883d24' value='0x" DATA.LONG(A:0x883d24) "' name='RPMH_VRM_ENABLE_CRS_DRV8_XOB15'/>"
WRITE #1 "        <register address='0xb892e24' value='0x" DATA.LONG(A:0x892e24) "' name='RPMH_VRM_ENABLE_CRS_DRV9_XOB0'/>"
WRITE #1 "        <register address='0xb892f24' value='0x" DATA.LONG(A:0x892f24) "' name='RPMH_VRM_ENABLE_CRS_DRV9_XOB1'/>"
WRITE #1 "        <register address='0xb893024' value='0x" DATA.LONG(A:0x893024) "' name='RPMH_VRM_ENABLE_CRS_DRV9_XOB2'/>"
WRITE #1 "        <register address='0xb893124' value='0x" DATA.LONG(A:0x893124) "' name='RPMH_VRM_ENABLE_CRS_DRV9_XOB3'/>"
WRITE #1 "        <register address='0xb893224' value='0x" DATA.LONG(A:0x893224) "' name='RPMH_VRM_ENABLE_CRS_DRV9_XOB4'/>"
WRITE #1 "        <register address='0xb893324' value='0x" DATA.LONG(A:0x893324) "' name='RPMH_VRM_ENABLE_CRS_DRV9_XOB5'/>"
WRITE #1 "        <register address='0xb893424' value='0x" DATA.LONG(A:0x893424) "' name='RPMH_VRM_ENABLE_CRS_DRV9_XOB6'/>"
WRITE #1 "        <register address='0xb893524' value='0x" DATA.LONG(A:0x893524) "' name='RPMH_VRM_ENABLE_CRS_DRV9_XOB7'/>"
WRITE #1 "        <register address='0xb893624' value='0x" DATA.LONG(A:0x893624) "' name='RPMH_VRM_ENABLE_CRS_DRV9_XOB8'/>"
WRITE #1 "        <register address='0xb893724' value='0x" DATA.LONG(A:0x893724) "' name='RPMH_VRM_ENABLE_CRS_DRV9_XOB9'/>"
WRITE #1 "        <register address='0xb893824' value='0x" DATA.LONG(A:0x893824) "' name='RPMH_VRM_ENABLE_CRS_DRV9_XOB10'/>"
WRITE #1 "        <register address='0xb893924' value='0x" DATA.LONG(A:0x893924) "' name='RPMH_VRM_ENABLE_CRS_DRV9_XOB11'/>"
WRITE #1 "        <register address='0xb893a24' value='0x" DATA.LONG(A:0x893a24) "' name='RPMH_VRM_ENABLE_CRS_DRV9_XOB12'/>"
WRITE #1 "        <register address='0xb893b24' value='0x" DATA.LONG(A:0x893b24) "' name='RPMH_VRM_ENABLE_CRS_DRV9_XOB13'/>"
WRITE #1 "        <register address='0xb893c24' value='0x" DATA.LONG(A:0x893c24) "' name='RPMH_VRM_ENABLE_CRS_DRV9_XOB14'/>"
WRITE #1 "        <register address='0xb893d24' value='0x" DATA.LONG(A:0x893d24) "' name='RPMH_VRM_ENABLE_CRS_DRV9_XOB15'/>"
WRITE #1 "        <register address='0xb8a2e24' value='0x" DATA.LONG(A:0x8a2e24) "' name='RPMH_VRM_ENABLE_CRS_DRV10_XOB0'/>"
WRITE #1 "        <register address='0xb8a2f24' value='0x" DATA.LONG(A:0x8a2f24) "' name='RPMH_VRM_ENABLE_CRS_DRV10_XOB1'/>"
WRITE #1 "        <register address='0xb8a3024' value='0x" DATA.LONG(A:0x8a3024) "' name='RPMH_VRM_ENABLE_CRS_DRV10_XOB2'/>"
WRITE #1 "        <register address='0xb8a3124' value='0x" DATA.LONG(A:0x8a3124) "' name='RPMH_VRM_ENABLE_CRS_DRV10_XOB3'/>"
WRITE #1 "        <register address='0xb8a3224' value='0x" DATA.LONG(A:0x8a3224) "' name='RPMH_VRM_ENABLE_CRS_DRV10_XOB4'/>"
WRITE #1 "        <register address='0xb8a3324' value='0x" DATA.LONG(A:0x8a3324) "' name='RPMH_VRM_ENABLE_CRS_DRV10_XOB5'/>"
WRITE #1 "        <register address='0xb8a3424' value='0x" DATA.LONG(A:0x8a3424) "' name='RPMH_VRM_ENABLE_CRS_DRV10_XOB6'/>"
WRITE #1 "        <register address='0xb8a3524' value='0x" DATA.LONG(A:0x8a3524) "' name='RPMH_VRM_ENABLE_CRS_DRV10_XOB7'/>"
WRITE #1 "        <register address='0xb8a3624' value='0x" DATA.LONG(A:0x8a3624) "' name='RPMH_VRM_ENABLE_CRS_DRV10_XOB8'/>"
WRITE #1 "        <register address='0xb8a3724' value='0x" DATA.LONG(A:0x8a3724) "' name='RPMH_VRM_ENABLE_CRS_DRV10_XOB9'/>"
WRITE #1 "        <register address='0xb8a3824' value='0x" DATA.LONG(A:0x8a3824) "' name='RPMH_VRM_ENABLE_CRS_DRV10_XOB10'/>"
WRITE #1 "        <register address='0xb8a3924' value='0x" DATA.LONG(A:0x8a3924) "' name='RPMH_VRM_ENABLE_CRS_DRV10_XOB11'/>"
WRITE #1 "        <register address='0xb8a3a24' value='0x" DATA.LONG(A:0x8a3a24) "' name='RPMH_VRM_ENABLE_CRS_DRV10_XOB12'/>"
WRITE #1 "        <register address='0xb8a3b24' value='0x" DATA.LONG(A:0x8a3b24) "' name='RPMH_VRM_ENABLE_CRS_DRV10_XOB13'/>"
WRITE #1 "        <register address='0xb8a3c24' value='0x" DATA.LONG(A:0x8a3c24) "' name='RPMH_VRM_ENABLE_CRS_DRV10_XOB14'/>"
WRITE #1 "        <register address='0xb8a3d24' value='0x" DATA.LONG(A:0x8a3d24) "' name='RPMH_VRM_ENABLE_CRS_DRV10_XOB15'/>"
WRITE #1 "        <register address='0xb8b2e24' value='0x" DATA.LONG(A:0x8b2e24) "' name='RPMH_VRM_ENABLE_CRS_DRV11_XOB0'/>"
WRITE #1 "        <register address='0xb8b2f24' value='0x" DATA.LONG(A:0x8b2f24) "' name='RPMH_VRM_ENABLE_CRS_DRV11_XOB1'/>"
WRITE #1 "        <register address='0xb8b3024' value='0x" DATA.LONG(A:0x8b3024) "' name='RPMH_VRM_ENABLE_CRS_DRV11_XOB2'/>"
WRITE #1 "        <register address='0xb8b3124' value='0x" DATA.LONG(A:0x8b3124) "' name='RPMH_VRM_ENABLE_CRS_DRV11_XOB3'/>"
WRITE #1 "        <register address='0xb8b3224' value='0x" DATA.LONG(A:0x8b3224) "' name='RPMH_VRM_ENABLE_CRS_DRV11_XOB4'/>"
WRITE #1 "        <register address='0xb8b3324' value='0x" DATA.LONG(A:0x8b3324) "' name='RPMH_VRM_ENABLE_CRS_DRV11_XOB5'/>"
WRITE #1 "        <register address='0xb8b3424' value='0x" DATA.LONG(A:0x8b3424) "' name='RPMH_VRM_ENABLE_CRS_DRV11_XOB6'/>"
WRITE #1 "        <register address='0xb8b3524' value='0x" DATA.LONG(A:0x8b3524) "' name='RPMH_VRM_ENABLE_CRS_DRV11_XOB7'/>"
WRITE #1 "        <register address='0xb8b3624' value='0x" DATA.LONG(A:0x8b3624) "' name='RPMH_VRM_ENABLE_CRS_DRV11_XOB8'/>"
WRITE #1 "        <register address='0xb8b3724' value='0x" DATA.LONG(A:0x8b3724) "' name='RPMH_VRM_ENABLE_CRS_DRV11_XOB9'/>"
WRITE #1 "        <register address='0xb8b3824' value='0x" DATA.LONG(A:0x8b3824) "' name='RPMH_VRM_ENABLE_CRS_DRV11_XOB10'/>"
WRITE #1 "        <register address='0xb8b3924' value='0x" DATA.LONG(A:0x8b3924) "' name='RPMH_VRM_ENABLE_CRS_DRV11_XOB11'/>"
WRITE #1 "        <register address='0xb8b3a24' value='0x" DATA.LONG(A:0x8b3a24) "' name='RPMH_VRM_ENABLE_CRS_DRV11_XOB12'/>"
WRITE #1 "        <register address='0xb8b3b24' value='0x" DATA.LONG(A:0x8b3b24) "' name='RPMH_VRM_ENABLE_CRS_DRV11_XOB13'/>"
WRITE #1 "        <register address='0xb8b3c24' value='0x" DATA.LONG(A:0x8b3c24) "' name='RPMH_VRM_ENABLE_CRS_DRV11_XOB14'/>"
WRITE #1 "        <register address='0xb8b3d24' value='0x" DATA.LONG(A:0x8b3d24) "' name='RPMH_VRM_ENABLE_CRS_DRV11_XOB15'/>"
WRITE #1 "        <register address='0xb803e24' value='0x" DATA.LONG(A:0x803e24) "' name='RPMH_VRM_ENABLE_CRS_DRV0_XO0'/>"
WRITE #1 "        <register address='0xb813e24' value='0x" DATA.LONG(A:0x813e24) "' name='RPMH_VRM_ENABLE_CRS_DRV1_XO0'/>"
WRITE #1 "        <register address='0xb823e24' value='0x" DATA.LONG(A:0x823e24) "' name='RPMH_VRM_ENABLE_CRS_DRV2_XO0'/>"
WRITE #1 "        <register address='0xb833e24' value='0x" DATA.LONG(A:0x833e24) "' name='RPMH_VRM_ENABLE_CRS_DRV3_XO0'/>"
WRITE #1 "        <register address='0xb843e24' value='0x" DATA.LONG(A:0x843e24) "' name='RPMH_VRM_ENABLE_CRS_DRV4_XO0'/>"
WRITE #1 "        <register address='0xb853e24' value='0x" DATA.LONG(A:0x853e24) "' name='RPMH_VRM_ENABLE_CRS_DRV5_XO0'/>"
WRITE #1 "        <register address='0xb863e24' value='0x" DATA.LONG(A:0x863e24) "' name='RPMH_VRM_ENABLE_CRS_DRV6_XO0'/>"
WRITE #1 "        <register address='0xb873e24' value='0x" DATA.LONG(A:0x873e24) "' name='RPMH_VRM_ENABLE_CRS_DRV7_XO0'/>"
WRITE #1 "        <register address='0xb883e24' value='0x" DATA.LONG(A:0x883e24) "' name='RPMH_VRM_ENABLE_CRS_DRV8_XO0'/>"
WRITE #1 "        <register address='0xb893e24' value='0x" DATA.LONG(A:0x893e24) "' name='RPMH_VRM_ENABLE_CRS_DRV9_XO0'/>"
WRITE #1 "        <register address='0xb8a3e24' value='0x" DATA.LONG(A:0x8a3e24) "' name='RPMH_VRM_ENABLE_CRS_DRV10_XO0'/>"
WRITE #1 "        <register address='0xb8b3e24' value='0x" DATA.LONG(A:0x8b3e24) "' name='RPMH_VRM_ENABLE_CRS_DRV11_XO0'/>"
WRITE #1 "        <register address='0xb9e0000' value='0x" DATA.LONG(A:0x9e0000) "' name='RPMH_VRM_VOLTAGE_CRS_CSR_REG0'/>"
WRITE #1 "        <register address='0xb9e0100' value='0x" DATA.LONG(A:0x9e0100) "' name='RPMH_VRM_VOLTAGE_CRS_CSR_REG1'/>"
WRITE #1 "        <register address='0xb9e0200' value='0x" DATA.LONG(A:0x9e0200) "' name='RPMH_VRM_VOLTAGE_CRS_CSR_REG2'/>"
WRITE #1 "        <register address='0xb9e0300' value='0x" DATA.LONG(A:0x9e0300) "' name='RPMH_VRM_VOLTAGE_CRS_CSR_REG3'/>"
WRITE #1 "        <register address='0xb9e0400' value='0x" DATA.LONG(A:0x9e0400) "' name='RPMH_VRM_VOLTAGE_CRS_CSR_REG4'/>"
WRITE #1 "        <register address='0xb9e0500' value='0x" DATA.LONG(A:0x9e0500) "' name='RPMH_VRM_VOLTAGE_CRS_CSR_REG5'/>"
WRITE #1 "        <register address='0xb9e0600' value='0x" DATA.LONG(A:0x9e0600) "' name='RPMH_VRM_VOLTAGE_CRS_CSR_REG6'/>"
WRITE #1 "        <register address='0xb9e0700' value='0x" DATA.LONG(A:0x9e0700) "' name='RPMH_VRM_VOLTAGE_CRS_CSR_REG7'/>"
WRITE #1 "        <register address='0xb9e0800' value='0x" DATA.LONG(A:0x9e0800) "' name='RPMH_VRM_VOLTAGE_CRS_CSR_REG8'/>"
WRITE #1 "        <register address='0xb9e0900' value='0x" DATA.LONG(A:0x9e0900) "' name='RPMH_VRM_VOLTAGE_CRS_CSR_REG9'/>"
WRITE #1 "        <register address='0xb9e0a00' value='0x" DATA.LONG(A:0x9e0a00) "' name='RPMH_VRM_VOLTAGE_CRS_CSR_REG10'/>"
WRITE #1 "        <register address='0xb9e0b00' value='0x" DATA.LONG(A:0x9e0b00) "' name='RPMH_VRM_VOLTAGE_CRS_CSR_REG11'/>"
WRITE #1 "        <register address='0xb9e0c00' value='0x" DATA.LONG(A:0x9e0c00) "' name='RPMH_VRM_VOLTAGE_CRS_CSR_REG12'/>"
WRITE #1 "        <register address='0xb9e0d00' value='0x" DATA.LONG(A:0x9e0d00) "' name='RPMH_VRM_VOLTAGE_CRS_CSR_REG13'/>"
WRITE #1 "        <register address='0xb9e0e00' value='0x" DATA.LONG(A:0x9e0e00) "' name='RPMH_VRM_VOLTAGE_CRS_CSR_REG14'/>"
WRITE #1 "        <register address='0xb9e0f00' value='0x" DATA.LONG(A:0x9e0f00) "' name='RPMH_VRM_VOLTAGE_CRS_CSR_REG15'/>"
WRITE #1 "        <register address='0xb9e1000' value='0x" DATA.LONG(A:0x9e1000) "' name='RPMH_VRM_VOLTAGE_CRS_CSR_REG16'/>"
WRITE #1 "        <register address='0xb9e1100' value='0x" DATA.LONG(A:0x9e1100) "' name='RPMH_VRM_VOLTAGE_CRS_CSR_REG17'/>"
WRITE #1 "        <register address='0xb9e1200' value='0x" DATA.LONG(A:0x9e1200) "' name='RPMH_VRM_VOLTAGE_CRS_CSR_REG18'/>"
WRITE #1 "        <register address='0xb9e1300' value='0x" DATA.LONG(A:0x9e1300) "' name='RPMH_VRM_VOLTAGE_CRS_CSR_REG19'/>"
WRITE #1 "        <register address='0xb9e1400' value='0x" DATA.LONG(A:0x9e1400) "' name='RPMH_VRM_VOLTAGE_CRS_CSR_REG20'/>"
WRITE #1 "        <register address='0xb9e1500' value='0x" DATA.LONG(A:0x9e1500) "' name='RPMH_VRM_VOLTAGE_CRS_CSR_REG21'/>"
WRITE #1 "        <register address='0xb9e1600' value='0x" DATA.LONG(A:0x9e1600) "' name='RPMH_VRM_VOLTAGE_CRS_CSR_REG22'/>"
WRITE #1 "        <register address='0xb9e1700' value='0x" DATA.LONG(A:0x9e1700) "' name='RPMH_VRM_VOLTAGE_CRS_CSR_REG23'/>"
WRITE #1 "        <register address='0xb9e1800' value='0x" DATA.LONG(A:0x9e1800) "' name='RPMH_VRM_VOLTAGE_CRS_CSR_REG24'/>"
WRITE #1 "        <register address='0xb9e1900' value='0x" DATA.LONG(A:0x9e1900) "' name='RPMH_VRM_VOLTAGE_CRS_CSR_REG25'/>"
WRITE #1 "        <register address='0xb9e1a00' value='0x" DATA.LONG(A:0x9e1a00) "' name='RPMH_VRM_VOLTAGE_CRS_CSR_REG26'/>"
WRITE #1 "        <register address='0xb9e1b00' value='0x" DATA.LONG(A:0x9e1b00) "' name='RPMH_VRM_VOLTAGE_CRS_CSR_REG27'/>"
WRITE #1 "        <register address='0xb9e1c00' value='0x" DATA.LONG(A:0x9e1c00) "' name='RPMH_VRM_VOLTAGE_CRS_CSR_REG28'/>"
WRITE #1 "        <register address='0xb9e1d00' value='0x" DATA.LONG(A:0x9e1d00) "' name='RPMH_VRM_VOLTAGE_CRS_CSR_REG29'/>"
WRITE #1 "        <register address='0xb9e1e00' value='0x" DATA.LONG(A:0x9e1e00) "' name='RPMH_VRM_VOLTAGE_CRS_CSR_REG30'/>"
WRITE #1 "        <register address='0xb9e1f00' value='0x" DATA.LONG(A:0x9e1f00) "' name='RPMH_VRM_VOLTAGE_CRS_CSR_REG31'/>"
WRITE #1 "        <register address='0xb9e2000' value='0x" DATA.LONG(A:0x9e2000) "' name='RPMH_VRM_VOLTAGE_CRS_CSR_REG32'/>"
WRITE #1 "        <register address='0xb9e2100' value='0x" DATA.LONG(A:0x9e2100) "' name='RPMH_VRM_VOLTAGE_CRS_CSR_REG33'/>"
WRITE #1 "        <register address='0xb9e2200' value='0x" DATA.LONG(A:0x9e2200) "' name='RPMH_VRM_VOLTAGE_CRS_CSR_REG34'/>"
WRITE #1 "        <register address='0xb9e2300' value='0x" DATA.LONG(A:0x9e2300) "' name='RPMH_VRM_VOLTAGE_CRS_CSR_REG35'/>"
WRITE #1 "        <register address='0xb9e2400' value='0x" DATA.LONG(A:0x9e2400) "' name='RPMH_VRM_VOLTAGE_CRS_CSR_REG36'/>"
WRITE #1 "        <register address='0xb9e2500' value='0x" DATA.LONG(A:0x9e2500) "' name='RPMH_VRM_VOLTAGE_CRS_CSR_REG37'/>"
WRITE #1 "        <register address='0xb9e2600' value='0x" DATA.LONG(A:0x9e2600) "' name='RPMH_VRM_VOLTAGE_CRS_CSR_REG38'/>"
WRITE #1 "        <register address='0xb9e2700' value='0x" DATA.LONG(A:0x9e2700) "' name='RPMH_VRM_VOLTAGE_CRS_CSR_REG39'/>"
WRITE #1 "        <register address='0xb9e2800' value='0x" DATA.LONG(A:0x9e2800) "' name='RPMH_VRM_VOLTAGE_CRS_CSR_REG40'/>"
WRITE #1 "        <register address='0xb9e2900' value='0x" DATA.LONG(A:0x9e2900) "' name='RPMH_VRM_VOLTAGE_CRS_CSR_REG41'/>"
WRITE #1 "        <register address='0xb9e2a00' value='0x" DATA.LONG(A:0x9e2a00) "' name='RPMH_VRM_VOLTAGE_CRS_CSR_REG42'/>"
WRITE #1 "        <register address='0xb9e2b00' value='0x" DATA.LONG(A:0x9e2b00) "' name='RPMH_VRM_VOLTAGE_CRS_CSR_REG43'/>"
WRITE #1 "        <register address='0xb9e2c00' value='0x" DATA.LONG(A:0x9e2c00) "' name='RPMH_VRM_VOLTAGE_CRS_CSR_REG44'/>"
WRITE #1 "        <register address='0xb9e2d00' value='0x" DATA.LONG(A:0x9e2d00) "' name='RPMH_VRM_VOLTAGE_CRS_CSR_REG45'/>"
WRITE #1 "        <register address='0xb9e0004' value='0x" DATA.LONG(A:0x9e0004) "' name='RPMH_VRM_ENABLE_CRS_CSR_REG0'/>"
WRITE #1 "        <register address='0xb9e0104' value='0x" DATA.LONG(A:0x9e0104) "' name='RPMH_VRM_ENABLE_CRS_CSR_REG1'/>"
WRITE #1 "        <register address='0xb9e0204' value='0x" DATA.LONG(A:0x9e0204) "' name='RPMH_VRM_ENABLE_CRS_CSR_REG2'/>"
WRITE #1 "        <register address='0xb9e0304' value='0x" DATA.LONG(A:0x9e0304) "' name='RPMH_VRM_ENABLE_CRS_CSR_REG3'/>"
WRITE #1 "        <register address='0xb9e0404' value='0x" DATA.LONG(A:0x9e0404) "' name='RPMH_VRM_ENABLE_CRS_CSR_REG4'/>"
WRITE #1 "        <register address='0xb9e0504' value='0x" DATA.LONG(A:0x9e0504) "' name='RPMH_VRM_ENABLE_CRS_CSR_REG5'/>"
WRITE #1 "        <register address='0xb9e0604' value='0x" DATA.LONG(A:0x9e0604) "' name='RPMH_VRM_ENABLE_CRS_CSR_REG6'/>"
WRITE #1 "        <register address='0xb9e0704' value='0x" DATA.LONG(A:0x9e0704) "' name='RPMH_VRM_ENABLE_CRS_CSR_REG7'/>"
WRITE #1 "        <register address='0xb9e0804' value='0x" DATA.LONG(A:0x9e0804) "' name='RPMH_VRM_ENABLE_CRS_CSR_REG8'/>"
WRITE #1 "        <register address='0xb9e0904' value='0x" DATA.LONG(A:0x9e0904) "' name='RPMH_VRM_ENABLE_CRS_CSR_REG9'/>"
WRITE #1 "        <register address='0xb9e0a04' value='0x" DATA.LONG(A:0x9e0a04) "' name='RPMH_VRM_ENABLE_CRS_CSR_REG10'/>"
WRITE #1 "        <register address='0xb9e0b04' value='0x" DATA.LONG(A:0x9e0b04) "' name='RPMH_VRM_ENABLE_CRS_CSR_REG11'/>"
WRITE #1 "        <register address='0xb9e0c04' value='0x" DATA.LONG(A:0x9e0c04) "' name='RPMH_VRM_ENABLE_CRS_CSR_REG12'/>"
WRITE #1 "        <register address='0xb9e0d04' value='0x" DATA.LONG(A:0x9e0d04) "' name='RPMH_VRM_ENABLE_CRS_CSR_REG13'/>"
WRITE #1 "        <register address='0xb9e0e04' value='0x" DATA.LONG(A:0x9e0e04) "' name='RPMH_VRM_ENABLE_CRS_CSR_REG14'/>"
WRITE #1 "        <register address='0xb9e0f04' value='0x" DATA.LONG(A:0x9e0f04) "' name='RPMH_VRM_ENABLE_CRS_CSR_REG15'/>"
WRITE #1 "        <register address='0xb9e1004' value='0x" DATA.LONG(A:0x9e1004) "' name='RPMH_VRM_ENABLE_CRS_CSR_REG16'/>"
WRITE #1 "        <register address='0xb9e1104' value='0x" DATA.LONG(A:0x9e1104) "' name='RPMH_VRM_ENABLE_CRS_CSR_REG17'/>"
WRITE #1 "        <register address='0xb9e1204' value='0x" DATA.LONG(A:0x9e1204) "' name='RPMH_VRM_ENABLE_CRS_CSR_REG18'/>"
WRITE #1 "        <register address='0xb9e1304' value='0x" DATA.LONG(A:0x9e1304) "' name='RPMH_VRM_ENABLE_CRS_CSR_REG19'/>"
WRITE #1 "        <register address='0xb9e1404' value='0x" DATA.LONG(A:0x9e1404) "' name='RPMH_VRM_ENABLE_CRS_CSR_REG20'/>"
WRITE #1 "        <register address='0xb9e1504' value='0x" DATA.LONG(A:0x9e1504) "' name='RPMH_VRM_ENABLE_CRS_CSR_REG21'/>"
WRITE #1 "        <register address='0xb9e1604' value='0x" DATA.LONG(A:0x9e1604) "' name='RPMH_VRM_ENABLE_CRS_CSR_REG22'/>"
WRITE #1 "        <register address='0xb9e1704' value='0x" DATA.LONG(A:0x9e1704) "' name='RPMH_VRM_ENABLE_CRS_CSR_REG23'/>"
WRITE #1 "        <register address='0xb9e1804' value='0x" DATA.LONG(A:0x9e1804) "' name='RPMH_VRM_ENABLE_CRS_CSR_REG24'/>"
WRITE #1 "        <register address='0xb9e1904' value='0x" DATA.LONG(A:0x9e1904) "' name='RPMH_VRM_ENABLE_CRS_CSR_REG25'/>"
WRITE #1 "        <register address='0xb9e1a04' value='0x" DATA.LONG(A:0x9e1a04) "' name='RPMH_VRM_ENABLE_CRS_CSR_REG26'/>"
WRITE #1 "        <register address='0xb9e1b04' value='0x" DATA.LONG(A:0x9e1b04) "' name='RPMH_VRM_ENABLE_CRS_CSR_REG27'/>"
WRITE #1 "        <register address='0xb9e1c04' value='0x" DATA.LONG(A:0x9e1c04) "' name='RPMH_VRM_ENABLE_CRS_CSR_REG28'/>"
WRITE #1 "        <register address='0xb9e1d04' value='0x" DATA.LONG(A:0x9e1d04) "' name='RPMH_VRM_ENABLE_CRS_CSR_REG29'/>"
WRITE #1 "        <register address='0xb9e1e04' value='0x" DATA.LONG(A:0x9e1e04) "' name='RPMH_VRM_ENABLE_CRS_CSR_REG30'/>"
WRITE #1 "        <register address='0xb9e1f04' value='0x" DATA.LONG(A:0x9e1f04) "' name='RPMH_VRM_ENABLE_CRS_CSR_REG31'/>"
WRITE #1 "        <register address='0xb9e2004' value='0x" DATA.LONG(A:0x9e2004) "' name='RPMH_VRM_ENABLE_CRS_CSR_REG32'/>"
WRITE #1 "        <register address='0xb9e2104' value='0x" DATA.LONG(A:0x9e2104) "' name='RPMH_VRM_ENABLE_CRS_CSR_REG33'/>"
WRITE #1 "        <register address='0xb9e2204' value='0x" DATA.LONG(A:0x9e2204) "' name='RPMH_VRM_ENABLE_CRS_CSR_REG34'/>"
WRITE #1 "        <register address='0xb9e2304' value='0x" DATA.LONG(A:0x9e2304) "' name='RPMH_VRM_ENABLE_CRS_CSR_REG35'/>"
WRITE #1 "        <register address='0xb9e2404' value='0x" DATA.LONG(A:0x9e2404) "' name='RPMH_VRM_ENABLE_CRS_CSR_REG36'/>"
WRITE #1 "        <register address='0xb9e2504' value='0x" DATA.LONG(A:0x9e2504) "' name='RPMH_VRM_ENABLE_CRS_CSR_REG37'/>"
WRITE #1 "        <register address='0xb9e2604' value='0x" DATA.LONG(A:0x9e2604) "' name='RPMH_VRM_ENABLE_CRS_CSR_REG38'/>"
WRITE #1 "        <register address='0xb9e2704' value='0x" DATA.LONG(A:0x9e2704) "' name='RPMH_VRM_ENABLE_CRS_CSR_REG39'/>"
WRITE #1 "        <register address='0xb9e2804' value='0x" DATA.LONG(A:0x9e2804) "' name='RPMH_VRM_ENABLE_CRS_CSR_REG40'/>"
WRITE #1 "        <register address='0xb9e2904' value='0x" DATA.LONG(A:0x9e2904) "' name='RPMH_VRM_ENABLE_CRS_CSR_REG41'/>"
WRITE #1 "        <register address='0xb9e2a04' value='0x" DATA.LONG(A:0x9e2a04) "' name='RPMH_VRM_ENABLE_CRS_CSR_REG42'/>"
WRITE #1 "        <register address='0xb9e2b04' value='0x" DATA.LONG(A:0x9e2b04) "' name='RPMH_VRM_ENABLE_CRS_CSR_REG43'/>"
WRITE #1 "        <register address='0xb9e2c04' value='0x" DATA.LONG(A:0x9e2c04) "' name='RPMH_VRM_ENABLE_CRS_CSR_REG44'/>"
WRITE #1 "        <register address='0xb9e2d04' value='0x" DATA.LONG(A:0x9e2d04) "' name='RPMH_VRM_ENABLE_CRS_CSR_REG45'/>"
WRITE #1 "        <register address='0xb9e0008' value='0x" DATA.LONG(A:0x9e0008) "' name='RPMH_VRM_MODE_CRS_CSR_REG0'/>"
WRITE #1 "        <register address='0xb9e0108' value='0x" DATA.LONG(A:0x9e0108) "' name='RPMH_VRM_MODE_CRS_CSR_REG1'/>"
WRITE #1 "        <register address='0xb9e0208' value='0x" DATA.LONG(A:0x9e0208) "' name='RPMH_VRM_MODE_CRS_CSR_REG2'/>"
WRITE #1 "        <register address='0xb9e0308' value='0x" DATA.LONG(A:0x9e0308) "' name='RPMH_VRM_MODE_CRS_CSR_REG3'/>"
WRITE #1 "        <register address='0xb9e0408' value='0x" DATA.LONG(A:0x9e0408) "' name='RPMH_VRM_MODE_CRS_CSR_REG4'/>"
WRITE #1 "        <register address='0xb9e0508' value='0x" DATA.LONG(A:0x9e0508) "' name='RPMH_VRM_MODE_CRS_CSR_REG5'/>"
WRITE #1 "        <register address='0xb9e0608' value='0x" DATA.LONG(A:0x9e0608) "' name='RPMH_VRM_MODE_CRS_CSR_REG6'/>"
WRITE #1 "        <register address='0xb9e0708' value='0x" DATA.LONG(A:0x9e0708) "' name='RPMH_VRM_MODE_CRS_CSR_REG7'/>"
WRITE #1 "        <register address='0xb9e0808' value='0x" DATA.LONG(A:0x9e0808) "' name='RPMH_VRM_MODE_CRS_CSR_REG8'/>"
WRITE #1 "        <register address='0xb9e0908' value='0x" DATA.LONG(A:0x9e0908) "' name='RPMH_VRM_MODE_CRS_CSR_REG9'/>"
WRITE #1 "        <register address='0xb9e0a08' value='0x" DATA.LONG(A:0x9e0a08) "' name='RPMH_VRM_MODE_CRS_CSR_REG10'/>"
WRITE #1 "        <register address='0xb9e0b08' value='0x" DATA.LONG(A:0x9e0b08) "' name='RPMH_VRM_MODE_CRS_CSR_REG11'/>"
WRITE #1 "        <register address='0xb9e0c08' value='0x" DATA.LONG(A:0x9e0c08) "' name='RPMH_VRM_MODE_CRS_CSR_REG12'/>"
WRITE #1 "        <register address='0xb9e0d08' value='0x" DATA.LONG(A:0x9e0d08) "' name='RPMH_VRM_MODE_CRS_CSR_REG13'/>"
WRITE #1 "        <register address='0xb9e0e08' value='0x" DATA.LONG(A:0x9e0e08) "' name='RPMH_VRM_MODE_CRS_CSR_REG14'/>"
WRITE #1 "        <register address='0xb9e0f08' value='0x" DATA.LONG(A:0x9e0f08) "' name='RPMH_VRM_MODE_CRS_CSR_REG15'/>"
WRITE #1 "        <register address='0xb9e1008' value='0x" DATA.LONG(A:0x9e1008) "' name='RPMH_VRM_MODE_CRS_CSR_REG16'/>"
WRITE #1 "        <register address='0xb9e1108' value='0x" DATA.LONG(A:0x9e1108) "' name='RPMH_VRM_MODE_CRS_CSR_REG17'/>"
WRITE #1 "        <register address='0xb9e1208' value='0x" DATA.LONG(A:0x9e1208) "' name='RPMH_VRM_MODE_CRS_CSR_REG18'/>"
WRITE #1 "        <register address='0xb9e1308' value='0x" DATA.LONG(A:0x9e1308) "' name='RPMH_VRM_MODE_CRS_CSR_REG19'/>"
WRITE #1 "        <register address='0xb9e1408' value='0x" DATA.LONG(A:0x9e1408) "' name='RPMH_VRM_MODE_CRS_CSR_REG20'/>"
WRITE #1 "        <register address='0xb9e1508' value='0x" DATA.LONG(A:0x9e1508) "' name='RPMH_VRM_MODE_CRS_CSR_REG21'/>"
WRITE #1 "        <register address='0xb9e1608' value='0x" DATA.LONG(A:0x9e1608) "' name='RPMH_VRM_MODE_CRS_CSR_REG22'/>"
WRITE #1 "        <register address='0xb9e1708' value='0x" DATA.LONG(A:0x9e1708) "' name='RPMH_VRM_MODE_CRS_CSR_REG23'/>"
WRITE #1 "        <register address='0xb9e1808' value='0x" DATA.LONG(A:0x9e1808) "' name='RPMH_VRM_MODE_CRS_CSR_REG24'/>"
WRITE #1 "        <register address='0xb9e1908' value='0x" DATA.LONG(A:0x9e1908) "' name='RPMH_VRM_MODE_CRS_CSR_REG25'/>"
WRITE #1 "        <register address='0xb9e1a08' value='0x" DATA.LONG(A:0x9e1a08) "' name='RPMH_VRM_MODE_CRS_CSR_REG26'/>"
WRITE #1 "        <register address='0xb9e1b08' value='0x" DATA.LONG(A:0x9e1b08) "' name='RPMH_VRM_MODE_CRS_CSR_REG27'/>"
WRITE #1 "        <register address='0xb9e1c08' value='0x" DATA.LONG(A:0x9e1c08) "' name='RPMH_VRM_MODE_CRS_CSR_REG28'/>"
WRITE #1 "        <register address='0xb9e1d08' value='0x" DATA.LONG(A:0x9e1d08) "' name='RPMH_VRM_MODE_CRS_CSR_REG29'/>"
WRITE #1 "        <register address='0xb9e1e08' value='0x" DATA.LONG(A:0x9e1e08) "' name='RPMH_VRM_MODE_CRS_CSR_REG30'/>"
WRITE #1 "        <register address='0xb9e1f08' value='0x" DATA.LONG(A:0x9e1f08) "' name='RPMH_VRM_MODE_CRS_CSR_REG31'/>"
WRITE #1 "        <register address='0xb9e2008' value='0x" DATA.LONG(A:0x9e2008) "' name='RPMH_VRM_MODE_CRS_CSR_REG32'/>"
WRITE #1 "        <register address='0xb9e2108' value='0x" DATA.LONG(A:0x9e2108) "' name='RPMH_VRM_MODE_CRS_CSR_REG33'/>"
WRITE #1 "        <register address='0xb9e2208' value='0x" DATA.LONG(A:0x9e2208) "' name='RPMH_VRM_MODE_CRS_CSR_REG34'/>"
WRITE #1 "        <register address='0xb9e2308' value='0x" DATA.LONG(A:0x9e2308) "' name='RPMH_VRM_MODE_CRS_CSR_REG35'/>"
WRITE #1 "        <register address='0xb9e2408' value='0x" DATA.LONG(A:0x9e2408) "' name='RPMH_VRM_MODE_CRS_CSR_REG36'/>"
WRITE #1 "        <register address='0xb9e2508' value='0x" DATA.LONG(A:0x9e2508) "' name='RPMH_VRM_MODE_CRS_CSR_REG37'/>"
WRITE #1 "        <register address='0xb9e2608' value='0x" DATA.LONG(A:0x9e2608) "' name='RPMH_VRM_MODE_CRS_CSR_REG38'/>"
WRITE #1 "        <register address='0xb9e2708' value='0x" DATA.LONG(A:0x9e2708) "' name='RPMH_VRM_MODE_CRS_CSR_REG39'/>"
WRITE #1 "        <register address='0xb9e2808' value='0x" DATA.LONG(A:0x9e2808) "' name='RPMH_VRM_MODE_CRS_CSR_REG40'/>"
WRITE #1 "        <register address='0xb9e2908' value='0x" DATA.LONG(A:0x9e2908) "' name='RPMH_VRM_MODE_CRS_CSR_REG41'/>"
WRITE #1 "        <register address='0xb9e2a08' value='0x" DATA.LONG(A:0x9e2a08) "' name='RPMH_VRM_MODE_CRS_CSR_REG42'/>"
WRITE #1 "        <register address='0xb9e2b08' value='0x" DATA.LONG(A:0x9e2b08) "' name='RPMH_VRM_MODE_CRS_CSR_REG43'/>"
WRITE #1 "        <register address='0xb9e2c08' value='0x" DATA.LONG(A:0x9e2c08) "' name='RPMH_VRM_MODE_CRS_CSR_REG44'/>"
WRITE #1 "        <register address='0xb9e2d08' value='0x" DATA.LONG(A:0x9e2d08) "' name='RPMH_VRM_MODE_CRS_CSR_REG45'/>"
WRITE #1 "        <register address='0xb9e2e04' value='0x" DATA.LONG(A:0x9e2e04) "' name='RPMH_VRM_ENABLE_CRS_CSR_XOB0'/>"
WRITE #1 "        <register address='0xb9e2f04' value='0x" DATA.LONG(A:0x9e2f04) "' name='RPMH_VRM_ENABLE_CRS_CSR_XOB1'/>"
WRITE #1 "        <register address='0xb9e3004' value='0x" DATA.LONG(A:0x9e3004) "' name='RPMH_VRM_ENABLE_CRS_CSR_XOB2'/>"
WRITE #1 "        <register address='0xb9e3104' value='0x" DATA.LONG(A:0x9e3104) "' name='RPMH_VRM_ENABLE_CRS_CSR_XOB3'/>"
WRITE #1 "        <register address='0xb9e3204' value='0x" DATA.LONG(A:0x9e3204) "' name='RPMH_VRM_ENABLE_CRS_CSR_XOB4'/>"
WRITE #1 "        <register address='0xb9e3304' value='0x" DATA.LONG(A:0x9e3304) "' name='RPMH_VRM_ENABLE_CRS_CSR_XOB5'/>"
WRITE #1 "        <register address='0xb9e3404' value='0x" DATA.LONG(A:0x9e3404) "' name='RPMH_VRM_ENABLE_CRS_CSR_XOB6'/>"
WRITE #1 "        <register address='0xb9e3504' value='0x" DATA.LONG(A:0x9e3504) "' name='RPMH_VRM_ENABLE_CRS_CSR_XOB7'/>"
WRITE #1 "        <register address='0xb9e3604' value='0x" DATA.LONG(A:0x9e3604) "' name='RPMH_VRM_ENABLE_CRS_CSR_XOB8'/>"
WRITE #1 "        <register address='0xb9e3704' value='0x" DATA.LONG(A:0x9e3704) "' name='RPMH_VRM_ENABLE_CRS_CSR_XOB9'/>"
WRITE #1 "        <register address='0xb9e3804' value='0x" DATA.LONG(A:0x9e3804) "' name='RPMH_VRM_ENABLE_CRS_CSR_XOB10'/>"
WRITE #1 "        <register address='0xb9e3904' value='0x" DATA.LONG(A:0x9e3904) "' name='RPMH_VRM_ENABLE_CRS_CSR_XOB11'/>"
WRITE #1 "        <register address='0xb9e3a04' value='0x" DATA.LONG(A:0x9e3a04) "' name='RPMH_VRM_ENABLE_CRS_CSR_XOB12'/>"
WRITE #1 "        <register address='0xb9e3b04' value='0x" DATA.LONG(A:0x9e3b04) "' name='RPMH_VRM_ENABLE_CRS_CSR_XOB13'/>"
WRITE #1 "        <register address='0xb9e3c04' value='0x" DATA.LONG(A:0x9e3c04) "' name='RPMH_VRM_ENABLE_CRS_CSR_XOB14'/>"
WRITE #1 "        <register address='0xb9e3d04' value='0x" DATA.LONG(A:0x9e3d04) "' name='RPMH_VRM_ENABLE_CRS_CSR_XOB15'/>"
WRITE #1 "        <register address='0xb9e3e04' value='0x" DATA.LONG(A:0x9e3e04) "' name='RPMH_VRM_ENABLE_CRS_CSR_XO0'/>"
WRITE #1 "        <register address='0xb9e0020' value='0x" DATA.LONG(A:0x9e0020) "' name='RPMH_VRM_VOLTAGE_WRS_CSR_REG0'/>"
WRITE #1 "        <register address='0xb9e0120' value='0x" DATA.LONG(A:0x9e0120) "' name='RPMH_VRM_VOLTAGE_WRS_CSR_REG1'/>"
WRITE #1 "        <register address='0xb9e0220' value='0x" DATA.LONG(A:0x9e0220) "' name='RPMH_VRM_VOLTAGE_WRS_CSR_REG2'/>"
WRITE #1 "        <register address='0xb9e0320' value='0x" DATA.LONG(A:0x9e0320) "' name='RPMH_VRM_VOLTAGE_WRS_CSR_REG3'/>"
WRITE #1 "        <register address='0xb9e0420' value='0x" DATA.LONG(A:0x9e0420) "' name='RPMH_VRM_VOLTAGE_WRS_CSR_REG4'/>"
WRITE #1 "        <register address='0xb9e0520' value='0x" DATA.LONG(A:0x9e0520) "' name='RPMH_VRM_VOLTAGE_WRS_CSR_REG5'/>"
WRITE #1 "        <register address='0xb9e0620' value='0x" DATA.LONG(A:0x9e0620) "' name='RPMH_VRM_VOLTAGE_WRS_CSR_REG6'/>"
WRITE #1 "        <register address='0xb9e0720' value='0x" DATA.LONG(A:0x9e0720) "' name='RPMH_VRM_VOLTAGE_WRS_CSR_REG7'/>"
WRITE #1 "        <register address='0xb9e0820' value='0x" DATA.LONG(A:0x9e0820) "' name='RPMH_VRM_VOLTAGE_WRS_CSR_REG8'/>"
WRITE #1 "        <register address='0xb9e0920' value='0x" DATA.LONG(A:0x9e0920) "' name='RPMH_VRM_VOLTAGE_WRS_CSR_REG9'/>"
WRITE #1 "        <register address='0xb9e0a20' value='0x" DATA.LONG(A:0x9e0a20) "' name='RPMH_VRM_VOLTAGE_WRS_CSR_REG10'/>"
WRITE #1 "        <register address='0xb9e0b20' value='0x" DATA.LONG(A:0x9e0b20) "' name='RPMH_VRM_VOLTAGE_WRS_CSR_REG11'/>"
WRITE #1 "        <register address='0xb9e0c20' value='0x" DATA.LONG(A:0x9e0c20) "' name='RPMH_VRM_VOLTAGE_WRS_CSR_REG12'/>"
WRITE #1 "        <register address='0xb9e0d20' value='0x" DATA.LONG(A:0x9e0d20) "' name='RPMH_VRM_VOLTAGE_WRS_CSR_REG13'/>"
WRITE #1 "        <register address='0xb9e0e20' value='0x" DATA.LONG(A:0x9e0e20) "' name='RPMH_VRM_VOLTAGE_WRS_CSR_REG14'/>"
WRITE #1 "        <register address='0xb9e0f20' value='0x" DATA.LONG(A:0x9e0f20) "' name='RPMH_VRM_VOLTAGE_WRS_CSR_REG15'/>"
WRITE #1 "        <register address='0xb9e1020' value='0x" DATA.LONG(A:0x9e1020) "' name='RPMH_VRM_VOLTAGE_WRS_CSR_REG16'/>"
WRITE #1 "        <register address='0xb9e1120' value='0x" DATA.LONG(A:0x9e1120) "' name='RPMH_VRM_VOLTAGE_WRS_CSR_REG17'/>"
WRITE #1 "        <register address='0xb9e1220' value='0x" DATA.LONG(A:0x9e1220) "' name='RPMH_VRM_VOLTAGE_WRS_CSR_REG18'/>"
WRITE #1 "        <register address='0xb9e1320' value='0x" DATA.LONG(A:0x9e1320) "' name='RPMH_VRM_VOLTAGE_WRS_CSR_REG19'/>"
WRITE #1 "        <register address='0xb9e1420' value='0x" DATA.LONG(A:0x9e1420) "' name='RPMH_VRM_VOLTAGE_WRS_CSR_REG20'/>"
WRITE #1 "        <register address='0xb9e1520' value='0x" DATA.LONG(A:0x9e1520) "' name='RPMH_VRM_VOLTAGE_WRS_CSR_REG21'/>"
WRITE #1 "        <register address='0xb9e1620' value='0x" DATA.LONG(A:0x9e1620) "' name='RPMH_VRM_VOLTAGE_WRS_CSR_REG22'/>"
WRITE #1 "        <register address='0xb9e1720' value='0x" DATA.LONG(A:0x9e1720) "' name='RPMH_VRM_VOLTAGE_WRS_CSR_REG23'/>"
WRITE #1 "        <register address='0xb9e1820' value='0x" DATA.LONG(A:0x9e1820) "' name='RPMH_VRM_VOLTAGE_WRS_CSR_REG24'/>"
WRITE #1 "        <register address='0xb9e1920' value='0x" DATA.LONG(A:0x9e1920) "' name='RPMH_VRM_VOLTAGE_WRS_CSR_REG25'/>"
WRITE #1 "        <register address='0xb9e1a20' value='0x" DATA.LONG(A:0x9e1a20) "' name='RPMH_VRM_VOLTAGE_WRS_CSR_REG26'/>"
WRITE #1 "        <register address='0xb9e1b20' value='0x" DATA.LONG(A:0x9e1b20) "' name='RPMH_VRM_VOLTAGE_WRS_CSR_REG27'/>"
WRITE #1 "        <register address='0xb9e1c20' value='0x" DATA.LONG(A:0x9e1c20) "' name='RPMH_VRM_VOLTAGE_WRS_CSR_REG28'/>"
WRITE #1 "        <register address='0xb9e1d20' value='0x" DATA.LONG(A:0x9e1d20) "' name='RPMH_VRM_VOLTAGE_WRS_CSR_REG29'/>"
WRITE #1 "        <register address='0xb9e1e20' value='0x" DATA.LONG(A:0x9e1e20) "' name='RPMH_VRM_VOLTAGE_WRS_CSR_REG30'/>"
WRITE #1 "        <register address='0xb9e1f20' value='0x" DATA.LONG(A:0x9e1f20) "' name='RPMH_VRM_VOLTAGE_WRS_CSR_REG31'/>"
WRITE #1 "        <register address='0xb9e2020' value='0x" DATA.LONG(A:0x9e2020) "' name='RPMH_VRM_VOLTAGE_WRS_CSR_REG32'/>"
WRITE #1 "        <register address='0xb9e2120' value='0x" DATA.LONG(A:0x9e2120) "' name='RPMH_VRM_VOLTAGE_WRS_CSR_REG33'/>"
WRITE #1 "        <register address='0xb9e2220' value='0x" DATA.LONG(A:0x9e2220) "' name='RPMH_VRM_VOLTAGE_WRS_CSR_REG34'/>"
WRITE #1 "        <register address='0xb9e2320' value='0x" DATA.LONG(A:0x9e2320) "' name='RPMH_VRM_VOLTAGE_WRS_CSR_REG35'/>"
WRITE #1 "        <register address='0xb9e2420' value='0x" DATA.LONG(A:0x9e2420) "' name='RPMH_VRM_VOLTAGE_WRS_CSR_REG36'/>"
WRITE #1 "        <register address='0xb9e2520' value='0x" DATA.LONG(A:0x9e2520) "' name='RPMH_VRM_VOLTAGE_WRS_CSR_REG37'/>"
WRITE #1 "        <register address='0xb9e2620' value='0x" DATA.LONG(A:0x9e2620) "' name='RPMH_VRM_VOLTAGE_WRS_CSR_REG38'/>"
WRITE #1 "        <register address='0xb9e2720' value='0x" DATA.LONG(A:0x9e2720) "' name='RPMH_VRM_VOLTAGE_WRS_CSR_REG39'/>"
WRITE #1 "        <register address='0xb9e2820' value='0x" DATA.LONG(A:0x9e2820) "' name='RPMH_VRM_VOLTAGE_WRS_CSR_REG40'/>"
WRITE #1 "        <register address='0xb9e2920' value='0x" DATA.LONG(A:0x9e2920) "' name='RPMH_VRM_VOLTAGE_WRS_CSR_REG41'/>"
WRITE #1 "        <register address='0xb9e2a20' value='0x" DATA.LONG(A:0x9e2a20) "' name='RPMH_VRM_VOLTAGE_WRS_CSR_REG42'/>"
WRITE #1 "        <register address='0xb9e2b20' value='0x" DATA.LONG(A:0x9e2b20) "' name='RPMH_VRM_VOLTAGE_WRS_CSR_REG43'/>"
WRITE #1 "        <register address='0xb9e2c20' value='0x" DATA.LONG(A:0x9e2c20) "' name='RPMH_VRM_VOLTAGE_WRS_CSR_REG44'/>"
WRITE #1 "        <register address='0xb9e2d20' value='0x" DATA.LONG(A:0x9e2d20) "' name='RPMH_VRM_VOLTAGE_WRS_CSR_REG45'/>"
WRITE #1 "        <register address='0xb9e0024' value='0x" DATA.LONG(A:0x9e0024) "' name='RPMH_VRM_ENABLE_WRS_CSR_REG0'/>"
WRITE #1 "        <register address='0xb9e0124' value='0x" DATA.LONG(A:0x9e0124) "' name='RPMH_VRM_ENABLE_WRS_CSR_REG1'/>"
WRITE #1 "        <register address='0xb9e0224' value='0x" DATA.LONG(A:0x9e0224) "' name='RPMH_VRM_ENABLE_WRS_CSR_REG2'/>"
WRITE #1 "        <register address='0xb9e0324' value='0x" DATA.LONG(A:0x9e0324) "' name='RPMH_VRM_ENABLE_WRS_CSR_REG3'/>"
WRITE #1 "        <register address='0xb9e0424' value='0x" DATA.LONG(A:0x9e0424) "' name='RPMH_VRM_ENABLE_WRS_CSR_REG4'/>"
WRITE #1 "        <register address='0xb9e0524' value='0x" DATA.LONG(A:0x9e0524) "' name='RPMH_VRM_ENABLE_WRS_CSR_REG5'/>"
WRITE #1 "        <register address='0xb9e0624' value='0x" DATA.LONG(A:0x9e0624) "' name='RPMH_VRM_ENABLE_WRS_CSR_REG6'/>"
WRITE #1 "        <register address='0xb9e0724' value='0x" DATA.LONG(A:0x9e0724) "' name='RPMH_VRM_ENABLE_WRS_CSR_REG7'/>"
WRITE #1 "        <register address='0xb9e0824' value='0x" DATA.LONG(A:0x9e0824) "' name='RPMH_VRM_ENABLE_WRS_CSR_REG8'/>"
WRITE #1 "        <register address='0xb9e0924' value='0x" DATA.LONG(A:0x9e0924) "' name='RPMH_VRM_ENABLE_WRS_CSR_REG9'/>"
WRITE #1 "        <register address='0xb9e0a24' value='0x" DATA.LONG(A:0x9e0a24) "' name='RPMH_VRM_ENABLE_WRS_CSR_REG10'/>"
WRITE #1 "        <register address='0xb9e0b24' value='0x" DATA.LONG(A:0x9e0b24) "' name='RPMH_VRM_ENABLE_WRS_CSR_REG11'/>"
WRITE #1 "        <register address='0xb9e0c24' value='0x" DATA.LONG(A:0x9e0c24) "' name='RPMH_VRM_ENABLE_WRS_CSR_REG12'/>"
WRITE #1 "        <register address='0xb9e0d24' value='0x" DATA.LONG(A:0x9e0d24) "' name='RPMH_VRM_ENABLE_WRS_CSR_REG13'/>"
WRITE #1 "        <register address='0xb9e0e24' value='0x" DATA.LONG(A:0x9e0e24) "' name='RPMH_VRM_ENABLE_WRS_CSR_REG14'/>"
WRITE #1 "        <register address='0xb9e0f24' value='0x" DATA.LONG(A:0x9e0f24) "' name='RPMH_VRM_ENABLE_WRS_CSR_REG15'/>"
WRITE #1 "        <register address='0xb9e1024' value='0x" DATA.LONG(A:0x9e1024) "' name='RPMH_VRM_ENABLE_WRS_CSR_REG16'/>"
WRITE #1 "        <register address='0xb9e1124' value='0x" DATA.LONG(A:0x9e1124) "' name='RPMH_VRM_ENABLE_WRS_CSR_REG17'/>"
WRITE #1 "        <register address='0xb9e1224' value='0x" DATA.LONG(A:0x9e1224) "' name='RPMH_VRM_ENABLE_WRS_CSR_REG18'/>"
WRITE #1 "        <register address='0xb9e1324' value='0x" DATA.LONG(A:0x9e1324) "' name='RPMH_VRM_ENABLE_WRS_CSR_REG19'/>"
WRITE #1 "        <register address='0xb9e1424' value='0x" DATA.LONG(A:0x9e1424) "' name='RPMH_VRM_ENABLE_WRS_CSR_REG20'/>"
WRITE #1 "        <register address='0xb9e1524' value='0x" DATA.LONG(A:0x9e1524) "' name='RPMH_VRM_ENABLE_WRS_CSR_REG21'/>"
WRITE #1 "        <register address='0xb9e1624' value='0x" DATA.LONG(A:0x9e1624) "' name='RPMH_VRM_ENABLE_WRS_CSR_REG22'/>"
WRITE #1 "        <register address='0xb9e1724' value='0x" DATA.LONG(A:0x9e1724) "' name='RPMH_VRM_ENABLE_WRS_CSR_REG23'/>"
WRITE #1 "        <register address='0xb9e1824' value='0x" DATA.LONG(A:0x9e1824) "' name='RPMH_VRM_ENABLE_WRS_CSR_REG24'/>"
WRITE #1 "        <register address='0xb9e1924' value='0x" DATA.LONG(A:0x9e1924) "' name='RPMH_VRM_ENABLE_WRS_CSR_REG25'/>"
WRITE #1 "        <register address='0xb9e1a24' value='0x" DATA.LONG(A:0x9e1a24) "' name='RPMH_VRM_ENABLE_WRS_CSR_REG26'/>"
WRITE #1 "        <register address='0xb9e1b24' value='0x" DATA.LONG(A:0x9e1b24) "' name='RPMH_VRM_ENABLE_WRS_CSR_REG27'/>"
WRITE #1 "        <register address='0xb9e1c24' value='0x" DATA.LONG(A:0x9e1c24) "' name='RPMH_VRM_ENABLE_WRS_CSR_REG28'/>"
WRITE #1 "        <register address='0xb9e1d24' value='0x" DATA.LONG(A:0x9e1d24) "' name='RPMH_VRM_ENABLE_WRS_CSR_REG29'/>"
WRITE #1 "        <register address='0xb9e1e24' value='0x" DATA.LONG(A:0x9e1e24) "' name='RPMH_VRM_ENABLE_WRS_CSR_REG30'/>"
WRITE #1 "        <register address='0xb9e1f24' value='0x" DATA.LONG(A:0x9e1f24) "' name='RPMH_VRM_ENABLE_WRS_CSR_REG31'/>"
WRITE #1 "        <register address='0xb9e2024' value='0x" DATA.LONG(A:0x9e2024) "' name='RPMH_VRM_ENABLE_WRS_CSR_REG32'/>"
WRITE #1 "        <register address='0xb9e2124' value='0x" DATA.LONG(A:0x9e2124) "' name='RPMH_VRM_ENABLE_WRS_CSR_REG33'/>"
WRITE #1 "        <register address='0xb9e2224' value='0x" DATA.LONG(A:0x9e2224) "' name='RPMH_VRM_ENABLE_WRS_CSR_REG34'/>"
WRITE #1 "        <register address='0xb9e2324' value='0x" DATA.LONG(A:0x9e2324) "' name='RPMH_VRM_ENABLE_WRS_CSR_REG35'/>"
WRITE #1 "        <register address='0xb9e2424' value='0x" DATA.LONG(A:0x9e2424) "' name='RPMH_VRM_ENABLE_WRS_CSR_REG36'/>"
WRITE #1 "        <register address='0xb9e2524' value='0x" DATA.LONG(A:0x9e2524) "' name='RPMH_VRM_ENABLE_WRS_CSR_REG37'/>"
WRITE #1 "        <register address='0xb9e2624' value='0x" DATA.LONG(A:0x9e2624) "' name='RPMH_VRM_ENABLE_WRS_CSR_REG38'/>"
WRITE #1 "        <register address='0xb9e2724' value='0x" DATA.LONG(A:0x9e2724) "' name='RPMH_VRM_ENABLE_WRS_CSR_REG39'/>"
WRITE #1 "        <register address='0xb9e2824' value='0x" DATA.LONG(A:0x9e2824) "' name='RPMH_VRM_ENABLE_WRS_CSR_REG40'/>"
WRITE #1 "        <register address='0xb9e2924' value='0x" DATA.LONG(A:0x9e2924) "' name='RPMH_VRM_ENABLE_WRS_CSR_REG41'/>"
WRITE #1 "        <register address='0xb9e2a24' value='0x" DATA.LONG(A:0x9e2a24) "' name='RPMH_VRM_ENABLE_WRS_CSR_REG42'/>"
WRITE #1 "        <register address='0xb9e2b24' value='0x" DATA.LONG(A:0x9e2b24) "' name='RPMH_VRM_ENABLE_WRS_CSR_REG43'/>"
WRITE #1 "        <register address='0xb9e2c24' value='0x" DATA.LONG(A:0x9e2c24) "' name='RPMH_VRM_ENABLE_WRS_CSR_REG44'/>"
WRITE #1 "        <register address='0xb9e2d24' value='0x" DATA.LONG(A:0x9e2d24) "' name='RPMH_VRM_ENABLE_WRS_CSR_REG45'/>"
WRITE #1 "        <register address='0xb9e0028' value='0x" DATA.LONG(A:0x9e0028) "' name='RPMH_VRM_MODE_WRS_CSR_REG0'/>"
WRITE #1 "        <register address='0xb9e0128' value='0x" DATA.LONG(A:0x9e0128) "' name='RPMH_VRM_MODE_WRS_CSR_REG1'/>"
WRITE #1 "        <register address='0xb9e0228' value='0x" DATA.LONG(A:0x9e0228) "' name='RPMH_VRM_MODE_WRS_CSR_REG2'/>"
WRITE #1 "        <register address='0xb9e0328' value='0x" DATA.LONG(A:0x9e0328) "' name='RPMH_VRM_MODE_WRS_CSR_REG3'/>"
WRITE #1 "        <register address='0xb9e0428' value='0x" DATA.LONG(A:0x9e0428) "' name='RPMH_VRM_MODE_WRS_CSR_REG4'/>"
WRITE #1 "        <register address='0xb9e0528' value='0x" DATA.LONG(A:0x9e0528) "' name='RPMH_VRM_MODE_WRS_CSR_REG5'/>"
WRITE #1 "        <register address='0xb9e0628' value='0x" DATA.LONG(A:0x9e0628) "' name='RPMH_VRM_MODE_WRS_CSR_REG6'/>"
WRITE #1 "        <register address='0xb9e0728' value='0x" DATA.LONG(A:0x9e0728) "' name='RPMH_VRM_MODE_WRS_CSR_REG7'/>"
WRITE #1 "        <register address='0xb9e0828' value='0x" DATA.LONG(A:0x9e0828) "' name='RPMH_VRM_MODE_WRS_CSR_REG8'/>"
WRITE #1 "        <register address='0xb9e0928' value='0x" DATA.LONG(A:0x9e0928) "' name='RPMH_VRM_MODE_WRS_CSR_REG9'/>"
WRITE #1 "        <register address='0xb9e0a28' value='0x" DATA.LONG(A:0x9e0a28) "' name='RPMH_VRM_MODE_WRS_CSR_REG10'/>"
WRITE #1 "        <register address='0xb9e0b28' value='0x" DATA.LONG(A:0x9e0b28) "' name='RPMH_VRM_MODE_WRS_CSR_REG11'/>"
WRITE #1 "        <register address='0xb9e0c28' value='0x" DATA.LONG(A:0x9e0c28) "' name='RPMH_VRM_MODE_WRS_CSR_REG12'/>"
WRITE #1 "        <register address='0xb9e0d28' value='0x" DATA.LONG(A:0x9e0d28) "' name='RPMH_VRM_MODE_WRS_CSR_REG13'/>"
WRITE #1 "        <register address='0xb9e0e28' value='0x" DATA.LONG(A:0x9e0e28) "' name='RPMH_VRM_MODE_WRS_CSR_REG14'/>"
WRITE #1 "        <register address='0xb9e0f28' value='0x" DATA.LONG(A:0x9e0f28) "' name='RPMH_VRM_MODE_WRS_CSR_REG15'/>"
WRITE #1 "        <register address='0xb9e1028' value='0x" DATA.LONG(A:0x9e1028) "' name='RPMH_VRM_MODE_WRS_CSR_REG16'/>"
WRITE #1 "        <register address='0xb9e1128' value='0x" DATA.LONG(A:0x9e1128) "' name='RPMH_VRM_MODE_WRS_CSR_REG17'/>"
WRITE #1 "        <register address='0xb9e1228' value='0x" DATA.LONG(A:0x9e1228) "' name='RPMH_VRM_MODE_WRS_CSR_REG18'/>"
WRITE #1 "        <register address='0xb9e1328' value='0x" DATA.LONG(A:0x9e1328) "' name='RPMH_VRM_MODE_WRS_CSR_REG19'/>"
WRITE #1 "        <register address='0xb9e1428' value='0x" DATA.LONG(A:0x9e1428) "' name='RPMH_VRM_MODE_WRS_CSR_REG20'/>"
WRITE #1 "        <register address='0xb9e1528' value='0x" DATA.LONG(A:0x9e1528) "' name='RPMH_VRM_MODE_WRS_CSR_REG21'/>"
WRITE #1 "        <register address='0xb9e1628' value='0x" DATA.LONG(A:0x9e1628) "' name='RPMH_VRM_MODE_WRS_CSR_REG22'/>"
WRITE #1 "        <register address='0xb9e1728' value='0x" DATA.LONG(A:0x9e1728) "' name='RPMH_VRM_MODE_WRS_CSR_REG23'/>"
WRITE #1 "        <register address='0xb9e1828' value='0x" DATA.LONG(A:0x9e1828) "' name='RPMH_VRM_MODE_WRS_CSR_REG24'/>"
WRITE #1 "        <register address='0xb9e1928' value='0x" DATA.LONG(A:0x9e1928) "' name='RPMH_VRM_MODE_WRS_CSR_REG25'/>"
WRITE #1 "        <register address='0xb9e1a28' value='0x" DATA.LONG(A:0x9e1a28) "' name='RPMH_VRM_MODE_WRS_CSR_REG26'/>"
WRITE #1 "        <register address='0xb9e1b28' value='0x" DATA.LONG(A:0x9e1b28) "' name='RPMH_VRM_MODE_WRS_CSR_REG27'/>"
WRITE #1 "        <register address='0xb9e1c28' value='0x" DATA.LONG(A:0x9e1c28) "' name='RPMH_VRM_MODE_WRS_CSR_REG28'/>"
WRITE #1 "        <register address='0xb9e1d28' value='0x" DATA.LONG(A:0x9e1d28) "' name='RPMH_VRM_MODE_WRS_CSR_REG29'/>"
WRITE #1 "        <register address='0xb9e1e28' value='0x" DATA.LONG(A:0x9e1e28) "' name='RPMH_VRM_MODE_WRS_CSR_REG30'/>"
WRITE #1 "        <register address='0xb9e1f28' value='0x" DATA.LONG(A:0x9e1f28) "' name='RPMH_VRM_MODE_WRS_CSR_REG31'/>"
WRITE #1 "        <register address='0xb9e2028' value='0x" DATA.LONG(A:0x9e2028) "' name='RPMH_VRM_MODE_WRS_CSR_REG32'/>"
WRITE #1 "        <register address='0xb9e2128' value='0x" DATA.LONG(A:0x9e2128) "' name='RPMH_VRM_MODE_WRS_CSR_REG33'/>"
WRITE #1 "        <register address='0xb9e2228' value='0x" DATA.LONG(A:0x9e2228) "' name='RPMH_VRM_MODE_WRS_CSR_REG34'/>"
WRITE #1 "        <register address='0xb9e2328' value='0x" DATA.LONG(A:0x9e2328) "' name='RPMH_VRM_MODE_WRS_CSR_REG35'/>"
WRITE #1 "        <register address='0xb9e2428' value='0x" DATA.LONG(A:0x9e2428) "' name='RPMH_VRM_MODE_WRS_CSR_REG36'/>"
WRITE #1 "        <register address='0xb9e2528' value='0x" DATA.LONG(A:0x9e2528) "' name='RPMH_VRM_MODE_WRS_CSR_REG37'/>"
WRITE #1 "        <register address='0xb9e2628' value='0x" DATA.LONG(A:0x9e2628) "' name='RPMH_VRM_MODE_WRS_CSR_REG38'/>"
WRITE #1 "        <register address='0xb9e2728' value='0x" DATA.LONG(A:0x9e2728) "' name='RPMH_VRM_MODE_WRS_CSR_REG39'/>"
WRITE #1 "        <register address='0xb9e2828' value='0x" DATA.LONG(A:0x9e2828) "' name='RPMH_VRM_MODE_WRS_CSR_REG40'/>"
WRITE #1 "        <register address='0xb9e2928' value='0x" DATA.LONG(A:0x9e2928) "' name='RPMH_VRM_MODE_WRS_CSR_REG41'/>"
WRITE #1 "        <register address='0xb9e2a28' value='0x" DATA.LONG(A:0x9e2a28) "' name='RPMH_VRM_MODE_WRS_CSR_REG42'/>"
WRITE #1 "        <register address='0xb9e2b28' value='0x" DATA.LONG(A:0x9e2b28) "' name='RPMH_VRM_MODE_WRS_CSR_REG43'/>"
WRITE #1 "        <register address='0xb9e2c28' value='0x" DATA.LONG(A:0x9e2c28) "' name='RPMH_VRM_MODE_WRS_CSR_REG44'/>"
WRITE #1 "        <register address='0xb9e2d28' value='0x" DATA.LONG(A:0x9e2d28) "' name='RPMH_VRM_MODE_WRS_CSR_REG45'/>"
WRITE #1 "        <register address='0xb9e2e24' value='0x" DATA.LONG(A:0x9e2e24) "' name='RPMH_VRM_ENABLE_WRS_CSR_XOB0'/>"
WRITE #1 "        <register address='0xb9e2f24' value='0x" DATA.LONG(A:0x9e2f24) "' name='RPMH_VRM_ENABLE_WRS_CSR_XOB1'/>"
WRITE #1 "        <register address='0xb9e3024' value='0x" DATA.LONG(A:0x9e3024) "' name='RPMH_VRM_ENABLE_WRS_CSR_XOB2'/>"
WRITE #1 "        <register address='0xb9e3124' value='0x" DATA.LONG(A:0x9e3124) "' name='RPMH_VRM_ENABLE_WRS_CSR_XOB3'/>"
WRITE #1 "        <register address='0xb9e3224' value='0x" DATA.LONG(A:0x9e3224) "' name='RPMH_VRM_ENABLE_WRS_CSR_XOB4'/>"
WRITE #1 "        <register address='0xb9e3324' value='0x" DATA.LONG(A:0x9e3324) "' name='RPMH_VRM_ENABLE_WRS_CSR_XOB5'/>"
WRITE #1 "        <register address='0xb9e3424' value='0x" DATA.LONG(A:0x9e3424) "' name='RPMH_VRM_ENABLE_WRS_CSR_XOB6'/>"
WRITE #1 "        <register address='0xb9e3524' value='0x" DATA.LONG(A:0x9e3524) "' name='RPMH_VRM_ENABLE_WRS_CSR_XOB7'/>"
WRITE #1 "        <register address='0xb9e3624' value='0x" DATA.LONG(A:0x9e3624) "' name='RPMH_VRM_ENABLE_WRS_CSR_XOB8'/>"
WRITE #1 "        <register address='0xb9e3724' value='0x" DATA.LONG(A:0x9e3724) "' name='RPMH_VRM_ENABLE_WRS_CSR_XOB9'/>"
WRITE #1 "        <register address='0xb9e3824' value='0x" DATA.LONG(A:0x9e3824) "' name='RPMH_VRM_ENABLE_WRS_CSR_XOB10'/>"
WRITE #1 "        <register address='0xb9e3924' value='0x" DATA.LONG(A:0x9e3924) "' name='RPMH_VRM_ENABLE_WRS_CSR_XOB11'/>"
WRITE #1 "        <register address='0xb9e3a24' value='0x" DATA.LONG(A:0x9e3a24) "' name='RPMH_VRM_ENABLE_WRS_CSR_XOB12'/>"
WRITE #1 "        <register address='0xb9e3b24' value='0x" DATA.LONG(A:0x9e3b24) "' name='RPMH_VRM_ENABLE_WRS_CSR_XOB13'/>"
WRITE #1 "        <register address='0xb9e3c24' value='0x" DATA.LONG(A:0x9e3c24) "' name='RPMH_VRM_ENABLE_WRS_CSR_XOB14'/>"
WRITE #1 "        <register address='0xb9e3d24' value='0x" DATA.LONG(A:0x9e3d24) "' name='RPMH_VRM_ENABLE_WRS_CSR_XOB15'/>"
WRITE #1 "        <register address='0xb9e3e24' value='0x" DATA.LONG(A:0x9e3e24) "' name='RPMH_VRM_ENABLE_WRS_CSR_XO0'/>"
WRITE #1 "        <register address='0xb9e0040' value='0x" DATA.LONG(A:0x9e0040) "' name='RPMH_VRM_VOLTAGE_DRS_CSR_REG0'/>"
WRITE #1 "        <register address='0xb9e0140' value='0x" DATA.LONG(A:0x9e0140) "' name='RPMH_VRM_VOLTAGE_DRS_CSR_REG1'/>"
WRITE #1 "        <register address='0xb9e0240' value='0x" DATA.LONG(A:0x9e0240) "' name='RPMH_VRM_VOLTAGE_DRS_CSR_REG2'/>"
WRITE #1 "        <register address='0xb9e0340' value='0x" DATA.LONG(A:0x9e0340) "' name='RPMH_VRM_VOLTAGE_DRS_CSR_REG3'/>"
WRITE #1 "        <register address='0xb9e0440' value='0x" DATA.LONG(A:0x9e0440) "' name='RPMH_VRM_VOLTAGE_DRS_CSR_REG4'/>"
WRITE #1 "        <register address='0xb9e0540' value='0x" DATA.LONG(A:0x9e0540) "' name='RPMH_VRM_VOLTAGE_DRS_CSR_REG5'/>"
WRITE #1 "        <register address='0xb9e0640' value='0x" DATA.LONG(A:0x9e0640) "' name='RPMH_VRM_VOLTAGE_DRS_CSR_REG6'/>"
WRITE #1 "        <register address='0xb9e0740' value='0x" DATA.LONG(A:0x9e0740) "' name='RPMH_VRM_VOLTAGE_DRS_CSR_REG7'/>"
WRITE #1 "        <register address='0xb9e0840' value='0x" DATA.LONG(A:0x9e0840) "' name='RPMH_VRM_VOLTAGE_DRS_CSR_REG8'/>"
WRITE #1 "        <register address='0xb9e0940' value='0x" DATA.LONG(A:0x9e0940) "' name='RPMH_VRM_VOLTAGE_DRS_CSR_REG9'/>"
WRITE #1 "        <register address='0xb9e0a40' value='0x" DATA.LONG(A:0x9e0a40) "' name='RPMH_VRM_VOLTAGE_DRS_CSR_REG10'/>"
WRITE #1 "        <register address='0xb9e0b40' value='0x" DATA.LONG(A:0x9e0b40) "' name='RPMH_VRM_VOLTAGE_DRS_CSR_REG11'/>"
WRITE #1 "        <register address='0xb9e0c40' value='0x" DATA.LONG(A:0x9e0c40) "' name='RPMH_VRM_VOLTAGE_DRS_CSR_REG12'/>"
WRITE #1 "        <register address='0xb9e0d40' value='0x" DATA.LONG(A:0x9e0d40) "' name='RPMH_VRM_VOLTAGE_DRS_CSR_REG13'/>"
WRITE #1 "        <register address='0xb9e0e40' value='0x" DATA.LONG(A:0x9e0e40) "' name='RPMH_VRM_VOLTAGE_DRS_CSR_REG14'/>"
WRITE #1 "        <register address='0xb9e0f40' value='0x" DATA.LONG(A:0x9e0f40) "' name='RPMH_VRM_VOLTAGE_DRS_CSR_REG15'/>"
WRITE #1 "        <register address='0xb9e1040' value='0x" DATA.LONG(A:0x9e1040) "' name='RPMH_VRM_VOLTAGE_DRS_CSR_REG16'/>"
WRITE #1 "        <register address='0xb9e1140' value='0x" DATA.LONG(A:0x9e1140) "' name='RPMH_VRM_VOLTAGE_DRS_CSR_REG17'/>"
WRITE #1 "        <register address='0xb9e1240' value='0x" DATA.LONG(A:0x9e1240) "' name='RPMH_VRM_VOLTAGE_DRS_CSR_REG18'/>"
WRITE #1 "        <register address='0xb9e1340' value='0x" DATA.LONG(A:0x9e1340) "' name='RPMH_VRM_VOLTAGE_DRS_CSR_REG19'/>"
WRITE #1 "        <register address='0xb9e1440' value='0x" DATA.LONG(A:0x9e1440) "' name='RPMH_VRM_VOLTAGE_DRS_CSR_REG20'/>"
WRITE #1 "        <register address='0xb9e1540' value='0x" DATA.LONG(A:0x9e1540) "' name='RPMH_VRM_VOLTAGE_DRS_CSR_REG21'/>"
WRITE #1 "        <register address='0xb9e1640' value='0x" DATA.LONG(A:0x9e1640) "' name='RPMH_VRM_VOLTAGE_DRS_CSR_REG22'/>"
WRITE #1 "        <register address='0xb9e1740' value='0x" DATA.LONG(A:0x9e1740) "' name='RPMH_VRM_VOLTAGE_DRS_CSR_REG23'/>"
WRITE #1 "        <register address='0xb9e1840' value='0x" DATA.LONG(A:0x9e1840) "' name='RPMH_VRM_VOLTAGE_DRS_CSR_REG24'/>"
WRITE #1 "        <register address='0xb9e1940' value='0x" DATA.LONG(A:0x9e1940) "' name='RPMH_VRM_VOLTAGE_DRS_CSR_REG25'/>"
WRITE #1 "        <register address='0xb9e1a40' value='0x" DATA.LONG(A:0x9e1a40) "' name='RPMH_VRM_VOLTAGE_DRS_CSR_REG26'/>"
WRITE #1 "        <register address='0xb9e1b40' value='0x" DATA.LONG(A:0x9e1b40) "' name='RPMH_VRM_VOLTAGE_DRS_CSR_REG27'/>"
WRITE #1 "        <register address='0xb9e1c40' value='0x" DATA.LONG(A:0x9e1c40) "' name='RPMH_VRM_VOLTAGE_DRS_CSR_REG28'/>"
WRITE #1 "        <register address='0xb9e1d40' value='0x" DATA.LONG(A:0x9e1d40) "' name='RPMH_VRM_VOLTAGE_DRS_CSR_REG29'/>"
WRITE #1 "        <register address='0xb9e1e40' value='0x" DATA.LONG(A:0x9e1e40) "' name='RPMH_VRM_VOLTAGE_DRS_CSR_REG30'/>"
WRITE #1 "        <register address='0xb9e1f40' value='0x" DATA.LONG(A:0x9e1f40) "' name='RPMH_VRM_VOLTAGE_DRS_CSR_REG31'/>"
WRITE #1 "        <register address='0xb9e2040' value='0x" DATA.LONG(A:0x9e2040) "' name='RPMH_VRM_VOLTAGE_DRS_CSR_REG32'/>"
WRITE #1 "        <register address='0xb9e2140' value='0x" DATA.LONG(A:0x9e2140) "' name='RPMH_VRM_VOLTAGE_DRS_CSR_REG33'/>"
WRITE #1 "        <register address='0xb9e2240' value='0x" DATA.LONG(A:0x9e2240) "' name='RPMH_VRM_VOLTAGE_DRS_CSR_REG34'/>"
WRITE #1 "        <register address='0xb9e2340' value='0x" DATA.LONG(A:0x9e2340) "' name='RPMH_VRM_VOLTAGE_DRS_CSR_REG35'/>"
WRITE #1 "        <register address='0xb9e2440' value='0x" DATA.LONG(A:0x9e2440) "' name='RPMH_VRM_VOLTAGE_DRS_CSR_REG36'/>"
WRITE #1 "        <register address='0xb9e2540' value='0x" DATA.LONG(A:0x9e2540) "' name='RPMH_VRM_VOLTAGE_DRS_CSR_REG37'/>"
WRITE #1 "        <register address='0xb9e2640' value='0x" DATA.LONG(A:0x9e2640) "' name='RPMH_VRM_VOLTAGE_DRS_CSR_REG38'/>"
WRITE #1 "        <register address='0xb9e2740' value='0x" DATA.LONG(A:0x9e2740) "' name='RPMH_VRM_VOLTAGE_DRS_CSR_REG39'/>"
WRITE #1 "        <register address='0xb9e2840' value='0x" DATA.LONG(A:0x9e2840) "' name='RPMH_VRM_VOLTAGE_DRS_CSR_REG40'/>"
WRITE #1 "        <register address='0xb9e2940' value='0x" DATA.LONG(A:0x9e2940) "' name='RPMH_VRM_VOLTAGE_DRS_CSR_REG41'/>"
WRITE #1 "        <register address='0xb9e2a40' value='0x" DATA.LONG(A:0x9e2a40) "' name='RPMH_VRM_VOLTAGE_DRS_CSR_REG42'/>"
WRITE #1 "        <register address='0xb9e2b40' value='0x" DATA.LONG(A:0x9e2b40) "' name='RPMH_VRM_VOLTAGE_DRS_CSR_REG43'/>"
WRITE #1 "        <register address='0xb9e2c40' value='0x" DATA.LONG(A:0x9e2c40) "' name='RPMH_VRM_VOLTAGE_DRS_CSR_REG44'/>"
WRITE #1 "        <register address='0xb9e2d40' value='0x" DATA.LONG(A:0x9e2d40) "' name='RPMH_VRM_VOLTAGE_DRS_CSR_REG45'/>"
WRITE #1 "        <register address='0xb9e0044' value='0x" DATA.LONG(A:0x9e0044) "' name='RPMH_VRM_ENABLE_DRS_CSR_REG0'/>"
WRITE #1 "        <register address='0xb9e0144' value='0x" DATA.LONG(A:0x9e0144) "' name='RPMH_VRM_ENABLE_DRS_CSR_REG1'/>"
WRITE #1 "        <register address='0xb9e0244' value='0x" DATA.LONG(A:0x9e0244) "' name='RPMH_VRM_ENABLE_DRS_CSR_REG2'/>"
WRITE #1 "        <register address='0xb9e0344' value='0x" DATA.LONG(A:0x9e0344) "' name='RPMH_VRM_ENABLE_DRS_CSR_REG3'/>"
WRITE #1 "        <register address='0xb9e0444' value='0x" DATA.LONG(A:0x9e0444) "' name='RPMH_VRM_ENABLE_DRS_CSR_REG4'/>"
WRITE #1 "        <register address='0xb9e0544' value='0x" DATA.LONG(A:0x9e0544) "' name='RPMH_VRM_ENABLE_DRS_CSR_REG5'/>"
WRITE #1 "        <register address='0xb9e0644' value='0x" DATA.LONG(A:0x9e0644) "' name='RPMH_VRM_ENABLE_DRS_CSR_REG6'/>"
WRITE #1 "        <register address='0xb9e0744' value='0x" DATA.LONG(A:0x9e0744) "' name='RPMH_VRM_ENABLE_DRS_CSR_REG7'/>"
WRITE #1 "        <register address='0xb9e0844' value='0x" DATA.LONG(A:0x9e0844) "' name='RPMH_VRM_ENABLE_DRS_CSR_REG8'/>"
WRITE #1 "        <register address='0xb9e0944' value='0x" DATA.LONG(A:0x9e0944) "' name='RPMH_VRM_ENABLE_DRS_CSR_REG9'/>"
WRITE #1 "        <register address='0xb9e0a44' value='0x" DATA.LONG(A:0x9e0a44) "' name='RPMH_VRM_ENABLE_DRS_CSR_REG10'/>"
WRITE #1 "        <register address='0xb9e0b44' value='0x" DATA.LONG(A:0x9e0b44) "' name='RPMH_VRM_ENABLE_DRS_CSR_REG11'/>"
WRITE #1 "        <register address='0xb9e0c44' value='0x" DATA.LONG(A:0x9e0c44) "' name='RPMH_VRM_ENABLE_DRS_CSR_REG12'/>"
WRITE #1 "        <register address='0xb9e0d44' value='0x" DATA.LONG(A:0x9e0d44) "' name='RPMH_VRM_ENABLE_DRS_CSR_REG13'/>"
WRITE #1 "        <register address='0xb9e0e44' value='0x" DATA.LONG(A:0x9e0e44) "' name='RPMH_VRM_ENABLE_DRS_CSR_REG14'/>"
WRITE #1 "        <register address='0xb9e0f44' value='0x" DATA.LONG(A:0x9e0f44) "' name='RPMH_VRM_ENABLE_DRS_CSR_REG15'/>"
WRITE #1 "        <register address='0xb9e1044' value='0x" DATA.LONG(A:0x9e1044) "' name='RPMH_VRM_ENABLE_DRS_CSR_REG16'/>"
WRITE #1 "        <register address='0xb9e1144' value='0x" DATA.LONG(A:0x9e1144) "' name='RPMH_VRM_ENABLE_DRS_CSR_REG17'/>"
WRITE #1 "        <register address='0xb9e1244' value='0x" DATA.LONG(A:0x9e1244) "' name='RPMH_VRM_ENABLE_DRS_CSR_REG18'/>"
WRITE #1 "        <register address='0xb9e1344' value='0x" DATA.LONG(A:0x9e1344) "' name='RPMH_VRM_ENABLE_DRS_CSR_REG19'/>"
WRITE #1 "        <register address='0xb9e1444' value='0x" DATA.LONG(A:0x9e1444) "' name='RPMH_VRM_ENABLE_DRS_CSR_REG20'/>"
WRITE #1 "        <register address='0xb9e1544' value='0x" DATA.LONG(A:0x9e1544) "' name='RPMH_VRM_ENABLE_DRS_CSR_REG21'/>"
WRITE #1 "        <register address='0xb9e1644' value='0x" DATA.LONG(A:0x9e1644) "' name='RPMH_VRM_ENABLE_DRS_CSR_REG22'/>"
WRITE #1 "        <register address='0xb9e1744' value='0x" DATA.LONG(A:0x9e1744) "' name='RPMH_VRM_ENABLE_DRS_CSR_REG23'/>"
WRITE #1 "        <register address='0xb9e1844' value='0x" DATA.LONG(A:0x9e1844) "' name='RPMH_VRM_ENABLE_DRS_CSR_REG24'/>"
WRITE #1 "        <register address='0xb9e1944' value='0x" DATA.LONG(A:0x9e1944) "' name='RPMH_VRM_ENABLE_DRS_CSR_REG25'/>"
WRITE #1 "        <register address='0xb9e1a44' value='0x" DATA.LONG(A:0x9e1a44) "' name='RPMH_VRM_ENABLE_DRS_CSR_REG26'/>"
WRITE #1 "        <register address='0xb9e1b44' value='0x" DATA.LONG(A:0x9e1b44) "' name='RPMH_VRM_ENABLE_DRS_CSR_REG27'/>"
WRITE #1 "        <register address='0xb9e1c44' value='0x" DATA.LONG(A:0x9e1c44) "' name='RPMH_VRM_ENABLE_DRS_CSR_REG28'/>"
WRITE #1 "        <register address='0xb9e1d44' value='0x" DATA.LONG(A:0x9e1d44) "' name='RPMH_VRM_ENABLE_DRS_CSR_REG29'/>"
WRITE #1 "        <register address='0xb9e1e44' value='0x" DATA.LONG(A:0x9e1e44) "' name='RPMH_VRM_ENABLE_DRS_CSR_REG30'/>"
WRITE #1 "        <register address='0xb9e1f44' value='0x" DATA.LONG(A:0x9e1f44) "' name='RPMH_VRM_ENABLE_DRS_CSR_REG31'/>"
WRITE #1 "        <register address='0xb9e2044' value='0x" DATA.LONG(A:0x9e2044) "' name='RPMH_VRM_ENABLE_DRS_CSR_REG32'/>"
WRITE #1 "        <register address='0xb9e2144' value='0x" DATA.LONG(A:0x9e2144) "' name='RPMH_VRM_ENABLE_DRS_CSR_REG33'/>"
WRITE #1 "        <register address='0xb9e2244' value='0x" DATA.LONG(A:0x9e2244) "' name='RPMH_VRM_ENABLE_DRS_CSR_REG34'/>"
WRITE #1 "        <register address='0xb9e2344' value='0x" DATA.LONG(A:0x9e2344) "' name='RPMH_VRM_ENABLE_DRS_CSR_REG35'/>"
WRITE #1 "        <register address='0xb9e2444' value='0x" DATA.LONG(A:0x9e2444) "' name='RPMH_VRM_ENABLE_DRS_CSR_REG36'/>"
WRITE #1 "        <register address='0xb9e2544' value='0x" DATA.LONG(A:0x9e2544) "' name='RPMH_VRM_ENABLE_DRS_CSR_REG37'/>"
WRITE #1 "        <register address='0xb9e2644' value='0x" DATA.LONG(A:0x9e2644) "' name='RPMH_VRM_ENABLE_DRS_CSR_REG38'/>"
WRITE #1 "        <register address='0xb9e2744' value='0x" DATA.LONG(A:0x9e2744) "' name='RPMH_VRM_ENABLE_DRS_CSR_REG39'/>"
WRITE #1 "        <register address='0xb9e2844' value='0x" DATA.LONG(A:0x9e2844) "' name='RPMH_VRM_ENABLE_DRS_CSR_REG40'/>"
WRITE #1 "        <register address='0xb9e2944' value='0x" DATA.LONG(A:0x9e2944) "' name='RPMH_VRM_ENABLE_DRS_CSR_REG41'/>"
WRITE #1 "        <register address='0xb9e2a44' value='0x" DATA.LONG(A:0x9e2a44) "' name='RPMH_VRM_ENABLE_DRS_CSR_REG42'/>"
WRITE #1 "        <register address='0xb9e2b44' value='0x" DATA.LONG(A:0x9e2b44) "' name='RPMH_VRM_ENABLE_DRS_CSR_REG43'/>"
WRITE #1 "        <register address='0xb9e2c44' value='0x" DATA.LONG(A:0x9e2c44) "' name='RPMH_VRM_ENABLE_DRS_CSR_REG44'/>"
WRITE #1 "        <register address='0xb9e2d44' value='0x" DATA.LONG(A:0x9e2d44) "' name='RPMH_VRM_ENABLE_DRS_CSR_REG45'/>"
WRITE #1 "        <register address='0xb9e0048' value='0x" DATA.LONG(A:0x9e0048) "' name='RPMH_VRM_MODE_DRS_CSR_REG0'/>"
WRITE #1 "        <register address='0xb9e0148' value='0x" DATA.LONG(A:0x9e0148) "' name='RPMH_VRM_MODE_DRS_CSR_REG1'/>"
WRITE #1 "        <register address='0xb9e0248' value='0x" DATA.LONG(A:0x9e0248) "' name='RPMH_VRM_MODE_DRS_CSR_REG2'/>"
WRITE #1 "        <register address='0xb9e0348' value='0x" DATA.LONG(A:0x9e0348) "' name='RPMH_VRM_MODE_DRS_CSR_REG3'/>"
WRITE #1 "        <register address='0xb9e0448' value='0x" DATA.LONG(A:0x9e0448) "' name='RPMH_VRM_MODE_DRS_CSR_REG4'/>"
WRITE #1 "        <register address='0xb9e0548' value='0x" DATA.LONG(A:0x9e0548) "' name='RPMH_VRM_MODE_DRS_CSR_REG5'/>"
WRITE #1 "        <register address='0xb9e0648' value='0x" DATA.LONG(A:0x9e0648) "' name='RPMH_VRM_MODE_DRS_CSR_REG6'/>"
WRITE #1 "        <register address='0xb9e0748' value='0x" DATA.LONG(A:0x9e0748) "' name='RPMH_VRM_MODE_DRS_CSR_REG7'/>"
WRITE #1 "        <register address='0xb9e0848' value='0x" DATA.LONG(A:0x9e0848) "' name='RPMH_VRM_MODE_DRS_CSR_REG8'/>"
WRITE #1 "        <register address='0xb9e0948' value='0x" DATA.LONG(A:0x9e0948) "' name='RPMH_VRM_MODE_DRS_CSR_REG9'/>"
WRITE #1 "        <register address='0xb9e0a48' value='0x" DATA.LONG(A:0x9e0a48) "' name='RPMH_VRM_MODE_DRS_CSR_REG10'/>"
WRITE #1 "        <register address='0xb9e0b48' value='0x" DATA.LONG(A:0x9e0b48) "' name='RPMH_VRM_MODE_DRS_CSR_REG11'/>"
WRITE #1 "        <register address='0xb9e0c48' value='0x" DATA.LONG(A:0x9e0c48) "' name='RPMH_VRM_MODE_DRS_CSR_REG12'/>"
WRITE #1 "        <register address='0xb9e0d48' value='0x" DATA.LONG(A:0x9e0d48) "' name='RPMH_VRM_MODE_DRS_CSR_REG13'/>"
WRITE #1 "        <register address='0xb9e0e48' value='0x" DATA.LONG(A:0x9e0e48) "' name='RPMH_VRM_MODE_DRS_CSR_REG14'/>"
WRITE #1 "        <register address='0xb9e0f48' value='0x" DATA.LONG(A:0x9e0f48) "' name='RPMH_VRM_MODE_DRS_CSR_REG15'/>"
WRITE #1 "        <register address='0xb9e1048' value='0x" DATA.LONG(A:0x9e1048) "' name='RPMH_VRM_MODE_DRS_CSR_REG16'/>"
WRITE #1 "        <register address='0xb9e1148' value='0x" DATA.LONG(A:0x9e1148) "' name='RPMH_VRM_MODE_DRS_CSR_REG17'/>"
WRITE #1 "        <register address='0xb9e1248' value='0x" DATA.LONG(A:0x9e1248) "' name='RPMH_VRM_MODE_DRS_CSR_REG18'/>"
WRITE #1 "        <register address='0xb9e1348' value='0x" DATA.LONG(A:0x9e1348) "' name='RPMH_VRM_MODE_DRS_CSR_REG19'/>"
WRITE #1 "        <register address='0xb9e1448' value='0x" DATA.LONG(A:0x9e1448) "' name='RPMH_VRM_MODE_DRS_CSR_REG20'/>"
WRITE #1 "        <register address='0xb9e1548' value='0x" DATA.LONG(A:0x9e1548) "' name='RPMH_VRM_MODE_DRS_CSR_REG21'/>"
WRITE #1 "        <register address='0xb9e1648' value='0x" DATA.LONG(A:0x9e1648) "' name='RPMH_VRM_MODE_DRS_CSR_REG22'/>"
WRITE #1 "        <register address='0xb9e1748' value='0x" DATA.LONG(A:0x9e1748) "' name='RPMH_VRM_MODE_DRS_CSR_REG23'/>"
WRITE #1 "        <register address='0xb9e1848' value='0x" DATA.LONG(A:0x9e1848) "' name='RPMH_VRM_MODE_DRS_CSR_REG24'/>"
WRITE #1 "        <register address='0xb9e1948' value='0x" DATA.LONG(A:0x9e1948) "' name='RPMH_VRM_MODE_DRS_CSR_REG25'/>"
WRITE #1 "        <register address='0xb9e1a48' value='0x" DATA.LONG(A:0x9e1a48) "' name='RPMH_VRM_MODE_DRS_CSR_REG26'/>"
WRITE #1 "        <register address='0xb9e1b48' value='0x" DATA.LONG(A:0x9e1b48) "' name='RPMH_VRM_MODE_DRS_CSR_REG27'/>"
WRITE #1 "        <register address='0xb9e1c48' value='0x" DATA.LONG(A:0x9e1c48) "' name='RPMH_VRM_MODE_DRS_CSR_REG28'/>"
WRITE #1 "        <register address='0xb9e1d48' value='0x" DATA.LONG(A:0x9e1d48) "' name='RPMH_VRM_MODE_DRS_CSR_REG29'/>"
WRITE #1 "        <register address='0xb9e1e48' value='0x" DATA.LONG(A:0x9e1e48) "' name='RPMH_VRM_MODE_DRS_CSR_REG30'/>"
WRITE #1 "        <register address='0xb9e1f48' value='0x" DATA.LONG(A:0x9e1f48) "' name='RPMH_VRM_MODE_DRS_CSR_REG31'/>"
WRITE #1 "        <register address='0xb9e2048' value='0x" DATA.LONG(A:0x9e2048) "' name='RPMH_VRM_MODE_DRS_CSR_REG32'/>"
WRITE #1 "        <register address='0xb9e2148' value='0x" DATA.LONG(A:0x9e2148) "' name='RPMH_VRM_MODE_DRS_CSR_REG33'/>"
WRITE #1 "        <register address='0xb9e2248' value='0x" DATA.LONG(A:0x9e2248) "' name='RPMH_VRM_MODE_DRS_CSR_REG34'/>"
WRITE #1 "        <register address='0xb9e2348' value='0x" DATA.LONG(A:0x9e2348) "' name='RPMH_VRM_MODE_DRS_CSR_REG35'/>"
WRITE #1 "        <register address='0xb9e2448' value='0x" DATA.LONG(A:0x9e2448) "' name='RPMH_VRM_MODE_DRS_CSR_REG36'/>"
WRITE #1 "        <register address='0xb9e2548' value='0x" DATA.LONG(A:0x9e2548) "' name='RPMH_VRM_MODE_DRS_CSR_REG37'/>"
WRITE #1 "        <register address='0xb9e2648' value='0x" DATA.LONG(A:0x9e2648) "' name='RPMH_VRM_MODE_DRS_CSR_REG38'/>"
WRITE #1 "        <register address='0xb9e2748' value='0x" DATA.LONG(A:0x9e2748) "' name='RPMH_VRM_MODE_DRS_CSR_REG39'/>"
WRITE #1 "        <register address='0xb9e2848' value='0x" DATA.LONG(A:0x9e2848) "' name='RPMH_VRM_MODE_DRS_CSR_REG40'/>"
WRITE #1 "        <register address='0xb9e2948' value='0x" DATA.LONG(A:0x9e2948) "' name='RPMH_VRM_MODE_DRS_CSR_REG41'/>"
WRITE #1 "        <register address='0xb9e2a48' value='0x" DATA.LONG(A:0x9e2a48) "' name='RPMH_VRM_MODE_DRS_CSR_REG42'/>"
WRITE #1 "        <register address='0xb9e2b48' value='0x" DATA.LONG(A:0x9e2b48) "' name='RPMH_VRM_MODE_DRS_CSR_REG43'/>"
WRITE #1 "        <register address='0xb9e2c48' value='0x" DATA.LONG(A:0x9e2c48) "' name='RPMH_VRM_MODE_DRS_CSR_REG44'/>"
WRITE #1 "        <register address='0xb9e2d48' value='0x" DATA.LONG(A:0x9e2d48) "' name='RPMH_VRM_MODE_DRS_CSR_REG45'/>"
WRITE #1 "        <register address='0xb9e2e44' value='0x" DATA.LONG(A:0x9e2e44) "' name='RPMH_VRM_ENABLE_DRS_CSR_XOB0'/>"
WRITE #1 "        <register address='0xb9e2f44' value='0x" DATA.LONG(A:0x9e2f44) "' name='RPMH_VRM_ENABLE_DRS_CSR_XOB1'/>"
WRITE #1 "        <register address='0xb9e3044' value='0x" DATA.LONG(A:0x9e3044) "' name='RPMH_VRM_ENABLE_DRS_CSR_XOB2'/>"
WRITE #1 "        <register address='0xb9e3144' value='0x" DATA.LONG(A:0x9e3144) "' name='RPMH_VRM_ENABLE_DRS_CSR_XOB3'/>"
WRITE #1 "        <register address='0xb9e3244' value='0x" DATA.LONG(A:0x9e3244) "' name='RPMH_VRM_ENABLE_DRS_CSR_XOB4'/>"
WRITE #1 "        <register address='0xb9e3344' value='0x" DATA.LONG(A:0x9e3344) "' name='RPMH_VRM_ENABLE_DRS_CSR_XOB5'/>"
WRITE #1 "        <register address='0xb9e3444' value='0x" DATA.LONG(A:0x9e3444) "' name='RPMH_VRM_ENABLE_DRS_CSR_XOB6'/>"
WRITE #1 "        <register address='0xb9e3544' value='0x" DATA.LONG(A:0x9e3544) "' name='RPMH_VRM_ENABLE_DRS_CSR_XOB7'/>"
WRITE #1 "        <register address='0xb9e3644' value='0x" DATA.LONG(A:0x9e3644) "' name='RPMH_VRM_ENABLE_DRS_CSR_XOB8'/>"
WRITE #1 "        <register address='0xb9e3744' value='0x" DATA.LONG(A:0x9e3744) "' name='RPMH_VRM_ENABLE_DRS_CSR_XOB9'/>"
WRITE #1 "        <register address='0xb9e3844' value='0x" DATA.LONG(A:0x9e3844) "' name='RPMH_VRM_ENABLE_DRS_CSR_XOB10'/>"
WRITE #1 "        <register address='0xb9e3944' value='0x" DATA.LONG(A:0x9e3944) "' name='RPMH_VRM_ENABLE_DRS_CSR_XOB11'/>"
WRITE #1 "        <register address='0xb9e3a44' value='0x" DATA.LONG(A:0x9e3a44) "' name='RPMH_VRM_ENABLE_DRS_CSR_XOB12'/>"
WRITE #1 "        <register address='0xb9e3b44' value='0x" DATA.LONG(A:0x9e3b44) "' name='RPMH_VRM_ENABLE_DRS_CSR_XOB13'/>"
WRITE #1 "        <register address='0xb9e3c44' value='0x" DATA.LONG(A:0x9e3c44) "' name='RPMH_VRM_ENABLE_DRS_CSR_XOB14'/>"
WRITE #1 "        <register address='0xb9e3d44' value='0x" DATA.LONG(A:0x9e3d44) "' name='RPMH_VRM_ENABLE_DRS_CSR_XOB15'/>"
WRITE #1 "        <register address='0xb9e3e44' value='0x" DATA.LONG(A:0x9e3e44) "' name='RPMH_VRM_ENABLE_DRS_CSR_XO0'/>"
WRITE #1 "        <register address='0xb9e0060' value='0x" DATA.LONG(A:0x9e0060) "' name='RPMH_VRM_VOLTAGE_ARS_CSR_REG0'/>"
WRITE #1 "        <register address='0xb9e0160' value='0x" DATA.LONG(A:0x9e0160) "' name='RPMH_VRM_VOLTAGE_ARS_CSR_REG1'/>"
WRITE #1 "        <register address='0xb9e0260' value='0x" DATA.LONG(A:0x9e0260) "' name='RPMH_VRM_VOLTAGE_ARS_CSR_REG2'/>"
WRITE #1 "        <register address='0xb9e0360' value='0x" DATA.LONG(A:0x9e0360) "' name='RPMH_VRM_VOLTAGE_ARS_CSR_REG3'/>"
WRITE #1 "        <register address='0xb9e0460' value='0x" DATA.LONG(A:0x9e0460) "' name='RPMH_VRM_VOLTAGE_ARS_CSR_REG4'/>"
WRITE #1 "        <register address='0xb9e0560' value='0x" DATA.LONG(A:0x9e0560) "' name='RPMH_VRM_VOLTAGE_ARS_CSR_REG5'/>"
WRITE #1 "        <register address='0xb9e0660' value='0x" DATA.LONG(A:0x9e0660) "' name='RPMH_VRM_VOLTAGE_ARS_CSR_REG6'/>"
WRITE #1 "        <register address='0xb9e0760' value='0x" DATA.LONG(A:0x9e0760) "' name='RPMH_VRM_VOLTAGE_ARS_CSR_REG7'/>"
WRITE #1 "        <register address='0xb9e0860' value='0x" DATA.LONG(A:0x9e0860) "' name='RPMH_VRM_VOLTAGE_ARS_CSR_REG8'/>"
WRITE #1 "        <register address='0xb9e0960' value='0x" DATA.LONG(A:0x9e0960) "' name='RPMH_VRM_VOLTAGE_ARS_CSR_REG9'/>"
WRITE #1 "        <register address='0xb9e0a60' value='0x" DATA.LONG(A:0x9e0a60) "' name='RPMH_VRM_VOLTAGE_ARS_CSR_REG10'/>"
WRITE #1 "        <register address='0xb9e0b60' value='0x" DATA.LONG(A:0x9e0b60) "' name='RPMH_VRM_VOLTAGE_ARS_CSR_REG11'/>"
WRITE #1 "        <register address='0xb9e0c60' value='0x" DATA.LONG(A:0x9e0c60) "' name='RPMH_VRM_VOLTAGE_ARS_CSR_REG12'/>"
WRITE #1 "        <register address='0xb9e0d60' value='0x" DATA.LONG(A:0x9e0d60) "' name='RPMH_VRM_VOLTAGE_ARS_CSR_REG13'/>"
WRITE #1 "        <register address='0xb9e0e60' value='0x" DATA.LONG(A:0x9e0e60) "' name='RPMH_VRM_VOLTAGE_ARS_CSR_REG14'/>"
WRITE #1 "        <register address='0xb9e0f60' value='0x" DATA.LONG(A:0x9e0f60) "' name='RPMH_VRM_VOLTAGE_ARS_CSR_REG15'/>"
WRITE #1 "        <register address='0xb9e1060' value='0x" DATA.LONG(A:0x9e1060) "' name='RPMH_VRM_VOLTAGE_ARS_CSR_REG16'/>"
WRITE #1 "        <register address='0xb9e1160' value='0x" DATA.LONG(A:0x9e1160) "' name='RPMH_VRM_VOLTAGE_ARS_CSR_REG17'/>"
WRITE #1 "        <register address='0xb9e1260' value='0x" DATA.LONG(A:0x9e1260) "' name='RPMH_VRM_VOLTAGE_ARS_CSR_REG18'/>"
WRITE #1 "        <register address='0xb9e1360' value='0x" DATA.LONG(A:0x9e1360) "' name='RPMH_VRM_VOLTAGE_ARS_CSR_REG19'/>"
WRITE #1 "        <register address='0xb9e1460' value='0x" DATA.LONG(A:0x9e1460) "' name='RPMH_VRM_VOLTAGE_ARS_CSR_REG20'/>"
WRITE #1 "        <register address='0xb9e1560' value='0x" DATA.LONG(A:0x9e1560) "' name='RPMH_VRM_VOLTAGE_ARS_CSR_REG21'/>"
WRITE #1 "        <register address='0xb9e1660' value='0x" DATA.LONG(A:0x9e1660) "' name='RPMH_VRM_VOLTAGE_ARS_CSR_REG22'/>"
WRITE #1 "        <register address='0xb9e1760' value='0x" DATA.LONG(A:0x9e1760) "' name='RPMH_VRM_VOLTAGE_ARS_CSR_REG23'/>"
WRITE #1 "        <register address='0xb9e1860' value='0x" DATA.LONG(A:0x9e1860) "' name='RPMH_VRM_VOLTAGE_ARS_CSR_REG24'/>"
WRITE #1 "        <register address='0xb9e1960' value='0x" DATA.LONG(A:0x9e1960) "' name='RPMH_VRM_VOLTAGE_ARS_CSR_REG25'/>"
WRITE #1 "        <register address='0xb9e1a60' value='0x" DATA.LONG(A:0x9e1a60) "' name='RPMH_VRM_VOLTAGE_ARS_CSR_REG26'/>"
WRITE #1 "        <register address='0xb9e1b60' value='0x" DATA.LONG(A:0x9e1b60) "' name='RPMH_VRM_VOLTAGE_ARS_CSR_REG27'/>"
WRITE #1 "        <register address='0xb9e1c60' value='0x" DATA.LONG(A:0x9e1c60) "' name='RPMH_VRM_VOLTAGE_ARS_CSR_REG28'/>"
WRITE #1 "        <register address='0xb9e1d60' value='0x" DATA.LONG(A:0x9e1d60) "' name='RPMH_VRM_VOLTAGE_ARS_CSR_REG29'/>"
WRITE #1 "        <register address='0xb9e1e60' value='0x" DATA.LONG(A:0x9e1e60) "' name='RPMH_VRM_VOLTAGE_ARS_CSR_REG30'/>"
WRITE #1 "        <register address='0xb9e1f60' value='0x" DATA.LONG(A:0x9e1f60) "' name='RPMH_VRM_VOLTAGE_ARS_CSR_REG31'/>"
WRITE #1 "        <register address='0xb9e2060' value='0x" DATA.LONG(A:0x9e2060) "' name='RPMH_VRM_VOLTAGE_ARS_CSR_REG32'/>"
WRITE #1 "        <register address='0xb9e2160' value='0x" DATA.LONG(A:0x9e2160) "' name='RPMH_VRM_VOLTAGE_ARS_CSR_REG33'/>"
WRITE #1 "        <register address='0xb9e2260' value='0x" DATA.LONG(A:0x9e2260) "' name='RPMH_VRM_VOLTAGE_ARS_CSR_REG34'/>"
WRITE #1 "        <register address='0xb9e2360' value='0x" DATA.LONG(A:0x9e2360) "' name='RPMH_VRM_VOLTAGE_ARS_CSR_REG35'/>"
WRITE #1 "        <register address='0xb9e2460' value='0x" DATA.LONG(A:0x9e2460) "' name='RPMH_VRM_VOLTAGE_ARS_CSR_REG36'/>"
WRITE #1 "        <register address='0xb9e2560' value='0x" DATA.LONG(A:0x9e2560) "' name='RPMH_VRM_VOLTAGE_ARS_CSR_REG37'/>"
WRITE #1 "        <register address='0xb9e2660' value='0x" DATA.LONG(A:0x9e2660) "' name='RPMH_VRM_VOLTAGE_ARS_CSR_REG38'/>"
WRITE #1 "        <register address='0xb9e2760' value='0x" DATA.LONG(A:0x9e2760) "' name='RPMH_VRM_VOLTAGE_ARS_CSR_REG39'/>"
WRITE #1 "        <register address='0xb9e2860' value='0x" DATA.LONG(A:0x9e2860) "' name='RPMH_VRM_VOLTAGE_ARS_CSR_REG40'/>"
WRITE #1 "        <register address='0xb9e2960' value='0x" DATA.LONG(A:0x9e2960) "' name='RPMH_VRM_VOLTAGE_ARS_CSR_REG41'/>"
WRITE #1 "        <register address='0xb9e2a60' value='0x" DATA.LONG(A:0x9e2a60) "' name='RPMH_VRM_VOLTAGE_ARS_CSR_REG42'/>"
WRITE #1 "        <register address='0xb9e2b60' value='0x" DATA.LONG(A:0x9e2b60) "' name='RPMH_VRM_VOLTAGE_ARS_CSR_REG43'/>"
WRITE #1 "        <register address='0xb9e2c60' value='0x" DATA.LONG(A:0x9e2c60) "' name='RPMH_VRM_VOLTAGE_ARS_CSR_REG44'/>"
WRITE #1 "        <register address='0xb9e2d60' value='0x" DATA.LONG(A:0x9e2d60) "' name='RPMH_VRM_VOLTAGE_ARS_CSR_REG45'/>"
WRITE #1 "        <register address='0xb9e0064' value='0x" DATA.LONG(A:0x9e0064) "' name='RPMH_VRM_ENABLE_ARS_CSR_REG0'/>"
WRITE #1 "        <register address='0xb9e0164' value='0x" DATA.LONG(A:0x9e0164) "' name='RPMH_VRM_ENABLE_ARS_CSR_REG1'/>"
WRITE #1 "        <register address='0xb9e0264' value='0x" DATA.LONG(A:0x9e0264) "' name='RPMH_VRM_ENABLE_ARS_CSR_REG2'/>"
WRITE #1 "        <register address='0xb9e0364' value='0x" DATA.LONG(A:0x9e0364) "' name='RPMH_VRM_ENABLE_ARS_CSR_REG3'/>"
WRITE #1 "        <register address='0xb9e0464' value='0x" DATA.LONG(A:0x9e0464) "' name='RPMH_VRM_ENABLE_ARS_CSR_REG4'/>"
WRITE #1 "        <register address='0xb9e0564' value='0x" DATA.LONG(A:0x9e0564) "' name='RPMH_VRM_ENABLE_ARS_CSR_REG5'/>"
WRITE #1 "        <register address='0xb9e0664' value='0x" DATA.LONG(A:0x9e0664) "' name='RPMH_VRM_ENABLE_ARS_CSR_REG6'/>"
WRITE #1 "        <register address='0xb9e0764' value='0x" DATA.LONG(A:0x9e0764) "' name='RPMH_VRM_ENABLE_ARS_CSR_REG7'/>"
WRITE #1 "        <register address='0xb9e0864' value='0x" DATA.LONG(A:0x9e0864) "' name='RPMH_VRM_ENABLE_ARS_CSR_REG8'/>"
WRITE #1 "        <register address='0xb9e0964' value='0x" DATA.LONG(A:0x9e0964) "' name='RPMH_VRM_ENABLE_ARS_CSR_REG9'/>"
WRITE #1 "        <register address='0xb9e0a64' value='0x" DATA.LONG(A:0x9e0a64) "' name='RPMH_VRM_ENABLE_ARS_CSR_REG10'/>"
WRITE #1 "        <register address='0xb9e0b64' value='0x" DATA.LONG(A:0x9e0b64) "' name='RPMH_VRM_ENABLE_ARS_CSR_REG11'/>"
WRITE #1 "        <register address='0xb9e0c64' value='0x" DATA.LONG(A:0x9e0c64) "' name='RPMH_VRM_ENABLE_ARS_CSR_REG12'/>"
WRITE #1 "        <register address='0xb9e0d64' value='0x" DATA.LONG(A:0x9e0d64) "' name='RPMH_VRM_ENABLE_ARS_CSR_REG13'/>"
WRITE #1 "        <register address='0xb9e0e64' value='0x" DATA.LONG(A:0x9e0e64) "' name='RPMH_VRM_ENABLE_ARS_CSR_REG14'/>"
WRITE #1 "        <register address='0xb9e0f64' value='0x" DATA.LONG(A:0x9e0f64) "' name='RPMH_VRM_ENABLE_ARS_CSR_REG15'/>"
WRITE #1 "        <register address='0xb9e1064' value='0x" DATA.LONG(A:0x9e1064) "' name='RPMH_VRM_ENABLE_ARS_CSR_REG16'/>"
WRITE #1 "        <register address='0xb9e1164' value='0x" DATA.LONG(A:0x9e1164) "' name='RPMH_VRM_ENABLE_ARS_CSR_REG17'/>"
WRITE #1 "        <register address='0xb9e1264' value='0x" DATA.LONG(A:0x9e1264) "' name='RPMH_VRM_ENABLE_ARS_CSR_REG18'/>"
WRITE #1 "        <register address='0xb9e1364' value='0x" DATA.LONG(A:0x9e1364) "' name='RPMH_VRM_ENABLE_ARS_CSR_REG19'/>"
WRITE #1 "        <register address='0xb9e1464' value='0x" DATA.LONG(A:0x9e1464) "' name='RPMH_VRM_ENABLE_ARS_CSR_REG20'/>"
WRITE #1 "        <register address='0xb9e1564' value='0x" DATA.LONG(A:0x9e1564) "' name='RPMH_VRM_ENABLE_ARS_CSR_REG21'/>"
WRITE #1 "        <register address='0xb9e1664' value='0x" DATA.LONG(A:0x9e1664) "' name='RPMH_VRM_ENABLE_ARS_CSR_REG22'/>"
WRITE #1 "        <register address='0xb9e1764' value='0x" DATA.LONG(A:0x9e1764) "' name='RPMH_VRM_ENABLE_ARS_CSR_REG23'/>"
WRITE #1 "        <register address='0xb9e1864' value='0x" DATA.LONG(A:0x9e1864) "' name='RPMH_VRM_ENABLE_ARS_CSR_REG24'/>"
WRITE #1 "        <register address='0xb9e1964' value='0x" DATA.LONG(A:0x9e1964) "' name='RPMH_VRM_ENABLE_ARS_CSR_REG25'/>"
WRITE #1 "        <register address='0xb9e1a64' value='0x" DATA.LONG(A:0x9e1a64) "' name='RPMH_VRM_ENABLE_ARS_CSR_REG26'/>"
WRITE #1 "        <register address='0xb9e1b64' value='0x" DATA.LONG(A:0x9e1b64) "' name='RPMH_VRM_ENABLE_ARS_CSR_REG27'/>"
WRITE #1 "        <register address='0xb9e1c64' value='0x" DATA.LONG(A:0x9e1c64) "' name='RPMH_VRM_ENABLE_ARS_CSR_REG28'/>"
WRITE #1 "        <register address='0xb9e1d64' value='0x" DATA.LONG(A:0x9e1d64) "' name='RPMH_VRM_ENABLE_ARS_CSR_REG29'/>"
WRITE #1 "        <register address='0xb9e1e64' value='0x" DATA.LONG(A:0x9e1e64) "' name='RPMH_VRM_ENABLE_ARS_CSR_REG30'/>"
WRITE #1 "        <register address='0xb9e1f64' value='0x" DATA.LONG(A:0x9e1f64) "' name='RPMH_VRM_ENABLE_ARS_CSR_REG31'/>"
WRITE #1 "        <register address='0xb9e2064' value='0x" DATA.LONG(A:0x9e2064) "' name='RPMH_VRM_ENABLE_ARS_CSR_REG32'/>"
WRITE #1 "        <register address='0xb9e2164' value='0x" DATA.LONG(A:0x9e2164) "' name='RPMH_VRM_ENABLE_ARS_CSR_REG33'/>"
WRITE #1 "        <register address='0xb9e2264' value='0x" DATA.LONG(A:0x9e2264) "' name='RPMH_VRM_ENABLE_ARS_CSR_REG34'/>"
WRITE #1 "        <register address='0xb9e2364' value='0x" DATA.LONG(A:0x9e2364) "' name='RPMH_VRM_ENABLE_ARS_CSR_REG35'/>"
WRITE #1 "        <register address='0xb9e2464' value='0x" DATA.LONG(A:0x9e2464) "' name='RPMH_VRM_ENABLE_ARS_CSR_REG36'/>"
WRITE #1 "        <register address='0xb9e2564' value='0x" DATA.LONG(A:0x9e2564) "' name='RPMH_VRM_ENABLE_ARS_CSR_REG37'/>"
WRITE #1 "        <register address='0xb9e2664' value='0x" DATA.LONG(A:0x9e2664) "' name='RPMH_VRM_ENABLE_ARS_CSR_REG38'/>"
WRITE #1 "        <register address='0xb9e2764' value='0x" DATA.LONG(A:0x9e2764) "' name='RPMH_VRM_ENABLE_ARS_CSR_REG39'/>"
WRITE #1 "        <register address='0xb9e2864' value='0x" DATA.LONG(A:0x9e2864) "' name='RPMH_VRM_ENABLE_ARS_CSR_REG40'/>"
WRITE #1 "        <register address='0xb9e2964' value='0x" DATA.LONG(A:0x9e2964) "' name='RPMH_VRM_ENABLE_ARS_CSR_REG41'/>"
WRITE #1 "        <register address='0xb9e2a64' value='0x" DATA.LONG(A:0x9e2a64) "' name='RPMH_VRM_ENABLE_ARS_CSR_REG42'/>"
WRITE #1 "        <register address='0xb9e2b64' value='0x" DATA.LONG(A:0x9e2b64) "' name='RPMH_VRM_ENABLE_ARS_CSR_REG43'/>"
WRITE #1 "        <register address='0xb9e2c64' value='0x" DATA.LONG(A:0x9e2c64) "' name='RPMH_VRM_ENABLE_ARS_CSR_REG44'/>"
WRITE #1 "        <register address='0xb9e2d64' value='0x" DATA.LONG(A:0x9e2d64) "' name='RPMH_VRM_ENABLE_ARS_CSR_REG45'/>"
WRITE #1 "        <register address='0xb9e0068' value='0x" DATA.LONG(A:0x9e0068) "' name='RPMH_VRM_MODE_ARS_CSR_REG0'/>"
WRITE #1 "        <register address='0xb9e0168' value='0x" DATA.LONG(A:0x9e0168) "' name='RPMH_VRM_MODE_ARS_CSR_REG1'/>"
WRITE #1 "        <register address='0xb9e0268' value='0x" DATA.LONG(A:0x9e0268) "' name='RPMH_VRM_MODE_ARS_CSR_REG2'/>"
WRITE #1 "        <register address='0xb9e0368' value='0x" DATA.LONG(A:0x9e0368) "' name='RPMH_VRM_MODE_ARS_CSR_REG3'/>"
WRITE #1 "        <register address='0xb9e0468' value='0x" DATA.LONG(A:0x9e0468) "' name='RPMH_VRM_MODE_ARS_CSR_REG4'/>"
WRITE #1 "        <register address='0xb9e0568' value='0x" DATA.LONG(A:0x9e0568) "' name='RPMH_VRM_MODE_ARS_CSR_REG5'/>"
WRITE #1 "        <register address='0xb9e0668' value='0x" DATA.LONG(A:0x9e0668) "' name='RPMH_VRM_MODE_ARS_CSR_REG6'/>"
WRITE #1 "        <register address='0xb9e0768' value='0x" DATA.LONG(A:0x9e0768) "' name='RPMH_VRM_MODE_ARS_CSR_REG7'/>"
WRITE #1 "        <register address='0xb9e0868' value='0x" DATA.LONG(A:0x9e0868) "' name='RPMH_VRM_MODE_ARS_CSR_REG8'/>"
WRITE #1 "        <register address='0xb9e0968' value='0x" DATA.LONG(A:0x9e0968) "' name='RPMH_VRM_MODE_ARS_CSR_REG9'/>"
WRITE #1 "        <register address='0xb9e0a68' value='0x" DATA.LONG(A:0x9e0a68) "' name='RPMH_VRM_MODE_ARS_CSR_REG10'/>"
WRITE #1 "        <register address='0xb9e0b68' value='0x" DATA.LONG(A:0x9e0b68) "' name='RPMH_VRM_MODE_ARS_CSR_REG11'/>"
WRITE #1 "        <register address='0xb9e0c68' value='0x" DATA.LONG(A:0x9e0c68) "' name='RPMH_VRM_MODE_ARS_CSR_REG12'/>"
WRITE #1 "        <register address='0xb9e0d68' value='0x" DATA.LONG(A:0x9e0d68) "' name='RPMH_VRM_MODE_ARS_CSR_REG13'/>"
WRITE #1 "        <register address='0xb9e0e68' value='0x" DATA.LONG(A:0x9e0e68) "' name='RPMH_VRM_MODE_ARS_CSR_REG14'/>"
WRITE #1 "        <register address='0xb9e0f68' value='0x" DATA.LONG(A:0x9e0f68) "' name='RPMH_VRM_MODE_ARS_CSR_REG15'/>"
WRITE #1 "        <register address='0xb9e1068' value='0x" DATA.LONG(A:0x9e1068) "' name='RPMH_VRM_MODE_ARS_CSR_REG16'/>"
WRITE #1 "        <register address='0xb9e1168' value='0x" DATA.LONG(A:0x9e1168) "' name='RPMH_VRM_MODE_ARS_CSR_REG17'/>"
WRITE #1 "        <register address='0xb9e1268' value='0x" DATA.LONG(A:0x9e1268) "' name='RPMH_VRM_MODE_ARS_CSR_REG18'/>"
WRITE #1 "        <register address='0xb9e1368' value='0x" DATA.LONG(A:0x9e1368) "' name='RPMH_VRM_MODE_ARS_CSR_REG19'/>"
WRITE #1 "        <register address='0xb9e1468' value='0x" DATA.LONG(A:0x9e1468) "' name='RPMH_VRM_MODE_ARS_CSR_REG20'/>"
WRITE #1 "        <register address='0xb9e1568' value='0x" DATA.LONG(A:0x9e1568) "' name='RPMH_VRM_MODE_ARS_CSR_REG21'/>"
WRITE #1 "        <register address='0xb9e1668' value='0x" DATA.LONG(A:0x9e1668) "' name='RPMH_VRM_MODE_ARS_CSR_REG22'/>"
WRITE #1 "        <register address='0xb9e1768' value='0x" DATA.LONG(A:0x9e1768) "' name='RPMH_VRM_MODE_ARS_CSR_REG23'/>"
WRITE #1 "        <register address='0xb9e1868' value='0x" DATA.LONG(A:0x9e1868) "' name='RPMH_VRM_MODE_ARS_CSR_REG24'/>"
WRITE #1 "        <register address='0xb9e1968' value='0x" DATA.LONG(A:0x9e1968) "' name='RPMH_VRM_MODE_ARS_CSR_REG25'/>"
WRITE #1 "        <register address='0xb9e1a68' value='0x" DATA.LONG(A:0x9e1a68) "' name='RPMH_VRM_MODE_ARS_CSR_REG26'/>"
WRITE #1 "        <register address='0xb9e1b68' value='0x" DATA.LONG(A:0x9e1b68) "' name='RPMH_VRM_MODE_ARS_CSR_REG27'/>"
WRITE #1 "        <register address='0xb9e1c68' value='0x" DATA.LONG(A:0x9e1c68) "' name='RPMH_VRM_MODE_ARS_CSR_REG28'/>"
WRITE #1 "        <register address='0xb9e1d68' value='0x" DATA.LONG(A:0x9e1d68) "' name='RPMH_VRM_MODE_ARS_CSR_REG29'/>"
WRITE #1 "        <register address='0xb9e1e68' value='0x" DATA.LONG(A:0x9e1e68) "' name='RPMH_VRM_MODE_ARS_CSR_REG30'/>"
WRITE #1 "        <register address='0xb9e1f68' value='0x" DATA.LONG(A:0x9e1f68) "' name='RPMH_VRM_MODE_ARS_CSR_REG31'/>"
WRITE #1 "        <register address='0xb9e2068' value='0x" DATA.LONG(A:0x9e2068) "' name='RPMH_VRM_MODE_ARS_CSR_REG32'/>"
WRITE #1 "        <register address='0xb9e2168' value='0x" DATA.LONG(A:0x9e2168) "' name='RPMH_VRM_MODE_ARS_CSR_REG33'/>"
WRITE #1 "        <register address='0xb9e2268' value='0x" DATA.LONG(A:0x9e2268) "' name='RPMH_VRM_MODE_ARS_CSR_REG34'/>"
WRITE #1 "        <register address='0xb9e2368' value='0x" DATA.LONG(A:0x9e2368) "' name='RPMH_VRM_MODE_ARS_CSR_REG35'/>"
WRITE #1 "        <register address='0xb9e2468' value='0x" DATA.LONG(A:0x9e2468) "' name='RPMH_VRM_MODE_ARS_CSR_REG36'/>"
WRITE #1 "        <register address='0xb9e2568' value='0x" DATA.LONG(A:0x9e2568) "' name='RPMH_VRM_MODE_ARS_CSR_REG37'/>"
WRITE #1 "        <register address='0xb9e2668' value='0x" DATA.LONG(A:0x9e2668) "' name='RPMH_VRM_MODE_ARS_CSR_REG38'/>"
WRITE #1 "        <register address='0xb9e2768' value='0x" DATA.LONG(A:0x9e2768) "' name='RPMH_VRM_MODE_ARS_CSR_REG39'/>"
WRITE #1 "        <register address='0xb9e2868' value='0x" DATA.LONG(A:0x9e2868) "' name='RPMH_VRM_MODE_ARS_CSR_REG40'/>"
WRITE #1 "        <register address='0xb9e2968' value='0x" DATA.LONG(A:0x9e2968) "' name='RPMH_VRM_MODE_ARS_CSR_REG41'/>"
WRITE #1 "        <register address='0xb9e2a68' value='0x" DATA.LONG(A:0x9e2a68) "' name='RPMH_VRM_MODE_ARS_CSR_REG42'/>"
WRITE #1 "        <register address='0xb9e2b68' value='0x" DATA.LONG(A:0x9e2b68) "' name='RPMH_VRM_MODE_ARS_CSR_REG43'/>"
WRITE #1 "        <register address='0xb9e2c68' value='0x" DATA.LONG(A:0x9e2c68) "' name='RPMH_VRM_MODE_ARS_CSR_REG44'/>"
WRITE #1 "        <register address='0xb9e2d68' value='0x" DATA.LONG(A:0x9e2d68) "' name='RPMH_VRM_MODE_ARS_CSR_REG45'/>"
WRITE #1 "        <register address='0xb9e2e64' value='0x" DATA.LONG(A:0x9e2e64) "' name='RPMH_VRM_ENABLE_ARS_CSR_XOB0'/>"
WRITE #1 "        <register address='0xb9e2f64' value='0x" DATA.LONG(A:0x9e2f64) "' name='RPMH_VRM_ENABLE_ARS_CSR_XOB1'/>"
WRITE #1 "        <register address='0xb9e3064' value='0x" DATA.LONG(A:0x9e3064) "' name='RPMH_VRM_ENABLE_ARS_CSR_XOB2'/>"
WRITE #1 "        <register address='0xb9e3164' value='0x" DATA.LONG(A:0x9e3164) "' name='RPMH_VRM_ENABLE_ARS_CSR_XOB3'/>"
WRITE #1 "        <register address='0xb9e3264' value='0x" DATA.LONG(A:0x9e3264) "' name='RPMH_VRM_ENABLE_ARS_CSR_XOB4'/>"
WRITE #1 "        <register address='0xb9e3364' value='0x" DATA.LONG(A:0x9e3364) "' name='RPMH_VRM_ENABLE_ARS_CSR_XOB5'/>"
WRITE #1 "        <register address='0xb9e3464' value='0x" DATA.LONG(A:0x9e3464) "' name='RPMH_VRM_ENABLE_ARS_CSR_XOB6'/>"
WRITE #1 "        <register address='0xb9e3564' value='0x" DATA.LONG(A:0x9e3564) "' name='RPMH_VRM_ENABLE_ARS_CSR_XOB7'/>"
WRITE #1 "        <register address='0xb9e3664' value='0x" DATA.LONG(A:0x9e3664) "' name='RPMH_VRM_ENABLE_ARS_CSR_XOB8'/>"
WRITE #1 "        <register address='0xb9e3764' value='0x" DATA.LONG(A:0x9e3764) "' name='RPMH_VRM_ENABLE_ARS_CSR_XOB9'/>"
WRITE #1 "        <register address='0xb9e3864' value='0x" DATA.LONG(A:0x9e3864) "' name='RPMH_VRM_ENABLE_ARS_CSR_XOB10'/>"
WRITE #1 "        <register address='0xb9e3964' value='0x" DATA.LONG(A:0x9e3964) "' name='RPMH_VRM_ENABLE_ARS_CSR_XOB11'/>"
WRITE #1 "        <register address='0xb9e3a64' value='0x" DATA.LONG(A:0x9e3a64) "' name='RPMH_VRM_ENABLE_ARS_CSR_XOB12'/>"
WRITE #1 "        <register address='0xb9e3b64' value='0x" DATA.LONG(A:0x9e3b64) "' name='RPMH_VRM_ENABLE_ARS_CSR_XOB13'/>"
WRITE #1 "        <register address='0xb9e3c64' value='0x" DATA.LONG(A:0x9e3c64) "' name='RPMH_VRM_ENABLE_ARS_CSR_XOB14'/>"
WRITE #1 "        <register address='0xb9e3d64' value='0x" DATA.LONG(A:0x9e3d64) "' name='RPMH_VRM_ENABLE_ARS_CSR_XOB15'/>"
WRITE #1 "        <register address='0xb9e3e64' value='0x" DATA.LONG(A:0x9e3e64) "' name='RPMH_VRM_ENABLE_ARS_CSR_XO0'/>"
WRITE #1 "        <register address='0xb9e0080' value='0x" DATA.LONG(A:0x9e0080) "' name='RPMH_VRM_TYPE_CSR_REG0'/>"
WRITE #1 "        <register address='0xb9e0180' value='0x" DATA.LONG(A:0x9e0180) "' name='RPMH_VRM_TYPE_CSR_REG1'/>"
WRITE #1 "        <register address='0xb9e0280' value='0x" DATA.LONG(A:0x9e0280) "' name='RPMH_VRM_TYPE_CSR_REG2'/>"
WRITE #1 "        <register address='0xb9e0380' value='0x" DATA.LONG(A:0x9e0380) "' name='RPMH_VRM_TYPE_CSR_REG3'/>"
WRITE #1 "        <register address='0xb9e0480' value='0x" DATA.LONG(A:0x9e0480) "' name='RPMH_VRM_TYPE_CSR_REG4'/>"
WRITE #1 "        <register address='0xb9e0580' value='0x" DATA.LONG(A:0x9e0580) "' name='RPMH_VRM_TYPE_CSR_REG5'/>"
WRITE #1 "        <register address='0xb9e0680' value='0x" DATA.LONG(A:0x9e0680) "' name='RPMH_VRM_TYPE_CSR_REG6'/>"
WRITE #1 "        <register address='0xb9e0780' value='0x" DATA.LONG(A:0x9e0780) "' name='RPMH_VRM_TYPE_CSR_REG7'/>"
WRITE #1 "        <register address='0xb9e0880' value='0x" DATA.LONG(A:0x9e0880) "' name='RPMH_VRM_TYPE_CSR_REG8'/>"
WRITE #1 "        <register address='0xb9e0980' value='0x" DATA.LONG(A:0x9e0980) "' name='RPMH_VRM_TYPE_CSR_REG9'/>"
WRITE #1 "        <register address='0xb9e0a80' value='0x" DATA.LONG(A:0x9e0a80) "' name='RPMH_VRM_TYPE_CSR_REG10'/>"
WRITE #1 "        <register address='0xb9e0b80' value='0x" DATA.LONG(A:0x9e0b80) "' name='RPMH_VRM_TYPE_CSR_REG11'/>"
WRITE #1 "        <register address='0xb9e0c80' value='0x" DATA.LONG(A:0x9e0c80) "' name='RPMH_VRM_TYPE_CSR_REG12'/>"
WRITE #1 "        <register address='0xb9e0d80' value='0x" DATA.LONG(A:0x9e0d80) "' name='RPMH_VRM_TYPE_CSR_REG13'/>"
WRITE #1 "        <register address='0xb9e0e80' value='0x" DATA.LONG(A:0x9e0e80) "' name='RPMH_VRM_TYPE_CSR_REG14'/>"
WRITE #1 "        <register address='0xb9e0f80' value='0x" DATA.LONG(A:0x9e0f80) "' name='RPMH_VRM_TYPE_CSR_REG15'/>"
WRITE #1 "        <register address='0xb9e1080' value='0x" DATA.LONG(A:0x9e1080) "' name='RPMH_VRM_TYPE_CSR_REG16'/>"
WRITE #1 "        <register address='0xb9e1180' value='0x" DATA.LONG(A:0x9e1180) "' name='RPMH_VRM_TYPE_CSR_REG17'/>"
WRITE #1 "        <register address='0xb9e1280' value='0x" DATA.LONG(A:0x9e1280) "' name='RPMH_VRM_TYPE_CSR_REG18'/>"
WRITE #1 "        <register address='0xb9e1380' value='0x" DATA.LONG(A:0x9e1380) "' name='RPMH_VRM_TYPE_CSR_REG19'/>"
WRITE #1 "        <register address='0xb9e1480' value='0x" DATA.LONG(A:0x9e1480) "' name='RPMH_VRM_TYPE_CSR_REG20'/>"
WRITE #1 "        <register address='0xb9e1580' value='0x" DATA.LONG(A:0x9e1580) "' name='RPMH_VRM_TYPE_CSR_REG21'/>"
WRITE #1 "        <register address='0xb9e1680' value='0x" DATA.LONG(A:0x9e1680) "' name='RPMH_VRM_TYPE_CSR_REG22'/>"
WRITE #1 "        <register address='0xb9e1780' value='0x" DATA.LONG(A:0x9e1780) "' name='RPMH_VRM_TYPE_CSR_REG23'/>"
WRITE #1 "        <register address='0xb9e1880' value='0x" DATA.LONG(A:0x9e1880) "' name='RPMH_VRM_TYPE_CSR_REG24'/>"
WRITE #1 "        <register address='0xb9e1980' value='0x" DATA.LONG(A:0x9e1980) "' name='RPMH_VRM_TYPE_CSR_REG25'/>"
WRITE #1 "        <register address='0xb9e1a80' value='0x" DATA.LONG(A:0x9e1a80) "' name='RPMH_VRM_TYPE_CSR_REG26'/>"
WRITE #1 "        <register address='0xb9e1b80' value='0x" DATA.LONG(A:0x9e1b80) "' name='RPMH_VRM_TYPE_CSR_REG27'/>"
WRITE #1 "        <register address='0xb9e1c80' value='0x" DATA.LONG(A:0x9e1c80) "' name='RPMH_VRM_TYPE_CSR_REG28'/>"
WRITE #1 "        <register address='0xb9e1d80' value='0x" DATA.LONG(A:0x9e1d80) "' name='RPMH_VRM_TYPE_CSR_REG29'/>"
WRITE #1 "        <register address='0xb9e1e80' value='0x" DATA.LONG(A:0x9e1e80) "' name='RPMH_VRM_TYPE_CSR_REG30'/>"
WRITE #1 "        <register address='0xb9e1f80' value='0x" DATA.LONG(A:0x9e1f80) "' name='RPMH_VRM_TYPE_CSR_REG31'/>"
WRITE #1 "        <register address='0xb9e2080' value='0x" DATA.LONG(A:0x9e2080) "' name='RPMH_VRM_TYPE_CSR_REG32'/>"
WRITE #1 "        <register address='0xb9e2180' value='0x" DATA.LONG(A:0x9e2180) "' name='RPMH_VRM_TYPE_CSR_REG33'/>"
WRITE #1 "        <register address='0xb9e2280' value='0x" DATA.LONG(A:0x9e2280) "' name='RPMH_VRM_TYPE_CSR_REG34'/>"
WRITE #1 "        <register address='0xb9e2380' value='0x" DATA.LONG(A:0x9e2380) "' name='RPMH_VRM_TYPE_CSR_REG35'/>"
WRITE #1 "        <register address='0xb9e2480' value='0x" DATA.LONG(A:0x9e2480) "' name='RPMH_VRM_TYPE_CSR_REG36'/>"
WRITE #1 "        <register address='0xb9e2580' value='0x" DATA.LONG(A:0x9e2580) "' name='RPMH_VRM_TYPE_CSR_REG37'/>"
WRITE #1 "        <register address='0xb9e2680' value='0x" DATA.LONG(A:0x9e2680) "' name='RPMH_VRM_TYPE_CSR_REG38'/>"
WRITE #1 "        <register address='0xb9e2780' value='0x" DATA.LONG(A:0x9e2780) "' name='RPMH_VRM_TYPE_CSR_REG39'/>"
WRITE #1 "        <register address='0xb9e2880' value='0x" DATA.LONG(A:0x9e2880) "' name='RPMH_VRM_TYPE_CSR_REG40'/>"
WRITE #1 "        <register address='0xb9e2980' value='0x" DATA.LONG(A:0x9e2980) "' name='RPMH_VRM_TYPE_CSR_REG41'/>"
WRITE #1 "        <register address='0xb9e2a80' value='0x" DATA.LONG(A:0x9e2a80) "' name='RPMH_VRM_TYPE_CSR_REG42'/>"
WRITE #1 "        <register address='0xb9e2b80' value='0x" DATA.LONG(A:0x9e2b80) "' name='RPMH_VRM_TYPE_CSR_REG43'/>"
WRITE #1 "        <register address='0xb9e2c80' value='0x" DATA.LONG(A:0x9e2c80) "' name='RPMH_VRM_TYPE_CSR_REG44'/>"
WRITE #1 "        <register address='0xb9e2d80' value='0x" DATA.LONG(A:0x9e2d80) "' name='RPMH_VRM_TYPE_CSR_REG45'/>"
WRITE #1 "        <register address='0xb9e0084' value='0x" DATA.LONG(A:0x9e0084) "' name='RPMH_VRM_BASE_ADDR_CSR_REG0'/>"
WRITE #1 "        <register address='0xb9e0184' value='0x" DATA.LONG(A:0x9e0184) "' name='RPMH_VRM_BASE_ADDR_CSR_REG1'/>"
WRITE #1 "        <register address='0xb9e0284' value='0x" DATA.LONG(A:0x9e0284) "' name='RPMH_VRM_BASE_ADDR_CSR_REG2'/>"
WRITE #1 "        <register address='0xb9e0384' value='0x" DATA.LONG(A:0x9e0384) "' name='RPMH_VRM_BASE_ADDR_CSR_REG3'/>"
WRITE #1 "        <register address='0xb9e0484' value='0x" DATA.LONG(A:0x9e0484) "' name='RPMH_VRM_BASE_ADDR_CSR_REG4'/>"
WRITE #1 "        <register address='0xb9e0584' value='0x" DATA.LONG(A:0x9e0584) "' name='RPMH_VRM_BASE_ADDR_CSR_REG5'/>"
WRITE #1 "        <register address='0xb9e0684' value='0x" DATA.LONG(A:0x9e0684) "' name='RPMH_VRM_BASE_ADDR_CSR_REG6'/>"
WRITE #1 "        <register address='0xb9e0784' value='0x" DATA.LONG(A:0x9e0784) "' name='RPMH_VRM_BASE_ADDR_CSR_REG7'/>"
WRITE #1 "        <register address='0xb9e0884' value='0x" DATA.LONG(A:0x9e0884) "' name='RPMH_VRM_BASE_ADDR_CSR_REG8'/>"
WRITE #1 "        <register address='0xb9e0984' value='0x" DATA.LONG(A:0x9e0984) "' name='RPMH_VRM_BASE_ADDR_CSR_REG9'/>"
WRITE #1 "        <register address='0xb9e0a84' value='0x" DATA.LONG(A:0x9e0a84) "' name='RPMH_VRM_BASE_ADDR_CSR_REG10'/>"
WRITE #1 "        <register address='0xb9e0b84' value='0x" DATA.LONG(A:0x9e0b84) "' name='RPMH_VRM_BASE_ADDR_CSR_REG11'/>"
WRITE #1 "        <register address='0xb9e0c84' value='0x" DATA.LONG(A:0x9e0c84) "' name='RPMH_VRM_BASE_ADDR_CSR_REG12'/>"
WRITE #1 "        <register address='0xb9e0d84' value='0x" DATA.LONG(A:0x9e0d84) "' name='RPMH_VRM_BASE_ADDR_CSR_REG13'/>"
WRITE #1 "        <register address='0xb9e0e84' value='0x" DATA.LONG(A:0x9e0e84) "' name='RPMH_VRM_BASE_ADDR_CSR_REG14'/>"
WRITE #1 "        <register address='0xb9e0f84' value='0x" DATA.LONG(A:0x9e0f84) "' name='RPMH_VRM_BASE_ADDR_CSR_REG15'/>"
WRITE #1 "        <register address='0xb9e1084' value='0x" DATA.LONG(A:0x9e1084) "' name='RPMH_VRM_BASE_ADDR_CSR_REG16'/>"
WRITE #1 "        <register address='0xb9e1184' value='0x" DATA.LONG(A:0x9e1184) "' name='RPMH_VRM_BASE_ADDR_CSR_REG17'/>"
WRITE #1 "        <register address='0xb9e1284' value='0x" DATA.LONG(A:0x9e1284) "' name='RPMH_VRM_BASE_ADDR_CSR_REG18'/>"
WRITE #1 "        <register address='0xb9e1384' value='0x" DATA.LONG(A:0x9e1384) "' name='RPMH_VRM_BASE_ADDR_CSR_REG19'/>"
WRITE #1 "        <register address='0xb9e1484' value='0x" DATA.LONG(A:0x9e1484) "' name='RPMH_VRM_BASE_ADDR_CSR_REG20'/>"
WRITE #1 "        <register address='0xb9e1584' value='0x" DATA.LONG(A:0x9e1584) "' name='RPMH_VRM_BASE_ADDR_CSR_REG21'/>"
WRITE #1 "        <register address='0xb9e1684' value='0x" DATA.LONG(A:0x9e1684) "' name='RPMH_VRM_BASE_ADDR_CSR_REG22'/>"
WRITE #1 "        <register address='0xb9e1784' value='0x" DATA.LONG(A:0x9e1784) "' name='RPMH_VRM_BASE_ADDR_CSR_REG23'/>"
WRITE #1 "        <register address='0xb9e1884' value='0x" DATA.LONG(A:0x9e1884) "' name='RPMH_VRM_BASE_ADDR_CSR_REG24'/>"
WRITE #1 "        <register address='0xb9e1984' value='0x" DATA.LONG(A:0x9e1984) "' name='RPMH_VRM_BASE_ADDR_CSR_REG25'/>"
WRITE #1 "        <register address='0xb9e1a84' value='0x" DATA.LONG(A:0x9e1a84) "' name='RPMH_VRM_BASE_ADDR_CSR_REG26'/>"
WRITE #1 "        <register address='0xb9e1b84' value='0x" DATA.LONG(A:0x9e1b84) "' name='RPMH_VRM_BASE_ADDR_CSR_REG27'/>"
WRITE #1 "        <register address='0xb9e1c84' value='0x" DATA.LONG(A:0x9e1c84) "' name='RPMH_VRM_BASE_ADDR_CSR_REG28'/>"
WRITE #1 "        <register address='0xb9e1d84' value='0x" DATA.LONG(A:0x9e1d84) "' name='RPMH_VRM_BASE_ADDR_CSR_REG29'/>"
WRITE #1 "        <register address='0xb9e1e84' value='0x" DATA.LONG(A:0x9e1e84) "' name='RPMH_VRM_BASE_ADDR_CSR_REG30'/>"
WRITE #1 "        <register address='0xb9e1f84' value='0x" DATA.LONG(A:0x9e1f84) "' name='RPMH_VRM_BASE_ADDR_CSR_REG31'/>"
WRITE #1 "        <register address='0xb9e2084' value='0x" DATA.LONG(A:0x9e2084) "' name='RPMH_VRM_BASE_ADDR_CSR_REG32'/>"
WRITE #1 "        <register address='0xb9e2184' value='0x" DATA.LONG(A:0x9e2184) "' name='RPMH_VRM_BASE_ADDR_CSR_REG33'/>"
WRITE #1 "        <register address='0xb9e2284' value='0x" DATA.LONG(A:0x9e2284) "' name='RPMH_VRM_BASE_ADDR_CSR_REG34'/>"
WRITE #1 "        <register address='0xb9e2384' value='0x" DATA.LONG(A:0x9e2384) "' name='RPMH_VRM_BASE_ADDR_CSR_REG35'/>"
WRITE #1 "        <register address='0xb9e2484' value='0x" DATA.LONG(A:0x9e2484) "' name='RPMH_VRM_BASE_ADDR_CSR_REG36'/>"
WRITE #1 "        <register address='0xb9e2584' value='0x" DATA.LONG(A:0x9e2584) "' name='RPMH_VRM_BASE_ADDR_CSR_REG37'/>"
WRITE #1 "        <register address='0xb9e2684' value='0x" DATA.LONG(A:0x9e2684) "' name='RPMH_VRM_BASE_ADDR_CSR_REG38'/>"
WRITE #1 "        <register address='0xb9e2784' value='0x" DATA.LONG(A:0x9e2784) "' name='RPMH_VRM_BASE_ADDR_CSR_REG39'/>"
WRITE #1 "        <register address='0xb9e2884' value='0x" DATA.LONG(A:0x9e2884) "' name='RPMH_VRM_BASE_ADDR_CSR_REG40'/>"
WRITE #1 "        <register address='0xb9e2984' value='0x" DATA.LONG(A:0x9e2984) "' name='RPMH_VRM_BASE_ADDR_CSR_REG41'/>"
WRITE #1 "        <register address='0xb9e2a84' value='0x" DATA.LONG(A:0x9e2a84) "' name='RPMH_VRM_BASE_ADDR_CSR_REG42'/>"
WRITE #1 "        <register address='0xb9e2b84' value='0x" DATA.LONG(A:0x9e2b84) "' name='RPMH_VRM_BASE_ADDR_CSR_REG43'/>"
WRITE #1 "        <register address='0xb9e2c84' value='0x" DATA.LONG(A:0x9e2c84) "' name='RPMH_VRM_BASE_ADDR_CSR_REG44'/>"
WRITE #1 "        <register address='0xb9e2d84' value='0x" DATA.LONG(A:0x9e2d84) "' name='RPMH_VRM_BASE_ADDR_CSR_REG45'/>"
WRITE #1 "        <register address='0xb9e0088' value='0x" DATA.LONG(A:0x9e0088) "' name='RPMH_VRM_MAX_VOLTAGE_CSR_REG0'/>"
WRITE #1 "        <register address='0xb9e0188' value='0x" DATA.LONG(A:0x9e0188) "' name='RPMH_VRM_MAX_VOLTAGE_CSR_REG1'/>"
WRITE #1 "        <register address='0xb9e0288' value='0x" DATA.LONG(A:0x9e0288) "' name='RPMH_VRM_MAX_VOLTAGE_CSR_REG2'/>"
WRITE #1 "        <register address='0xb9e0388' value='0x" DATA.LONG(A:0x9e0388) "' name='RPMH_VRM_MAX_VOLTAGE_CSR_REG3'/>"
WRITE #1 "        <register address='0xb9e0488' value='0x" DATA.LONG(A:0x9e0488) "' name='RPMH_VRM_MAX_VOLTAGE_CSR_REG4'/>"
WRITE #1 "        <register address='0xb9e0588' value='0x" DATA.LONG(A:0x9e0588) "' name='RPMH_VRM_MAX_VOLTAGE_CSR_REG5'/>"
WRITE #1 "        <register address='0xb9e0688' value='0x" DATA.LONG(A:0x9e0688) "' name='RPMH_VRM_MAX_VOLTAGE_CSR_REG6'/>"
WRITE #1 "        <register address='0xb9e0788' value='0x" DATA.LONG(A:0x9e0788) "' name='RPMH_VRM_MAX_VOLTAGE_CSR_REG7'/>"
WRITE #1 "        <register address='0xb9e0888' value='0x" DATA.LONG(A:0x9e0888) "' name='RPMH_VRM_MAX_VOLTAGE_CSR_REG8'/>"
WRITE #1 "        <register address='0xb9e0988' value='0x" DATA.LONG(A:0x9e0988) "' name='RPMH_VRM_MAX_VOLTAGE_CSR_REG9'/>"
WRITE #1 "        <register address='0xb9e0a88' value='0x" DATA.LONG(A:0x9e0a88) "' name='RPMH_VRM_MAX_VOLTAGE_CSR_REG10'/>"
WRITE #1 "        <register address='0xb9e0b88' value='0x" DATA.LONG(A:0x9e0b88) "' name='RPMH_VRM_MAX_VOLTAGE_CSR_REG11'/>"
WRITE #1 "        <register address='0xb9e0c88' value='0x" DATA.LONG(A:0x9e0c88) "' name='RPMH_VRM_MAX_VOLTAGE_CSR_REG12'/>"
WRITE #1 "        <register address='0xb9e0d88' value='0x" DATA.LONG(A:0x9e0d88) "' name='RPMH_VRM_MAX_VOLTAGE_CSR_REG13'/>"
WRITE #1 "        <register address='0xb9e0e88' value='0x" DATA.LONG(A:0x9e0e88) "' name='RPMH_VRM_MAX_VOLTAGE_CSR_REG14'/>"
WRITE #1 "        <register address='0xb9e0f88' value='0x" DATA.LONG(A:0x9e0f88) "' name='RPMH_VRM_MAX_VOLTAGE_CSR_REG15'/>"
WRITE #1 "        <register address='0xb9e1088' value='0x" DATA.LONG(A:0x9e1088) "' name='RPMH_VRM_MAX_VOLTAGE_CSR_REG16'/>"
WRITE #1 "        <register address='0xb9e1188' value='0x" DATA.LONG(A:0x9e1188) "' name='RPMH_VRM_MAX_VOLTAGE_CSR_REG17'/>"
WRITE #1 "        <register address='0xb9e1288' value='0x" DATA.LONG(A:0x9e1288) "' name='RPMH_VRM_MAX_VOLTAGE_CSR_REG18'/>"
WRITE #1 "        <register address='0xb9e1388' value='0x" DATA.LONG(A:0x9e1388) "' name='RPMH_VRM_MAX_VOLTAGE_CSR_REG19'/>"
WRITE #1 "        <register address='0xb9e1488' value='0x" DATA.LONG(A:0x9e1488) "' name='RPMH_VRM_MAX_VOLTAGE_CSR_REG20'/>"
WRITE #1 "        <register address='0xb9e1588' value='0x" DATA.LONG(A:0x9e1588) "' name='RPMH_VRM_MAX_VOLTAGE_CSR_REG21'/>"
WRITE #1 "        <register address='0xb9e1688' value='0x" DATA.LONG(A:0x9e1688) "' name='RPMH_VRM_MAX_VOLTAGE_CSR_REG22'/>"
WRITE #1 "        <register address='0xb9e1788' value='0x" DATA.LONG(A:0x9e1788) "' name='RPMH_VRM_MAX_VOLTAGE_CSR_REG23'/>"
WRITE #1 "        <register address='0xb9e1888' value='0x" DATA.LONG(A:0x9e1888) "' name='RPMH_VRM_MAX_VOLTAGE_CSR_REG24'/>"
WRITE #1 "        <register address='0xb9e1988' value='0x" DATA.LONG(A:0x9e1988) "' name='RPMH_VRM_MAX_VOLTAGE_CSR_REG25'/>"
WRITE #1 "        <register address='0xb9e1a88' value='0x" DATA.LONG(A:0x9e1a88) "' name='RPMH_VRM_MAX_VOLTAGE_CSR_REG26'/>"
WRITE #1 "        <register address='0xb9e1b88' value='0x" DATA.LONG(A:0x9e1b88) "' name='RPMH_VRM_MAX_VOLTAGE_CSR_REG27'/>"
WRITE #1 "        <register address='0xb9e1c88' value='0x" DATA.LONG(A:0x9e1c88) "' name='RPMH_VRM_MAX_VOLTAGE_CSR_REG28'/>"
WRITE #1 "        <register address='0xb9e1d88' value='0x" DATA.LONG(A:0x9e1d88) "' name='RPMH_VRM_MAX_VOLTAGE_CSR_REG29'/>"
WRITE #1 "        <register address='0xb9e1e88' value='0x" DATA.LONG(A:0x9e1e88) "' name='RPMH_VRM_MAX_VOLTAGE_CSR_REG30'/>"
WRITE #1 "        <register address='0xb9e1f88' value='0x" DATA.LONG(A:0x9e1f88) "' name='RPMH_VRM_MAX_VOLTAGE_CSR_REG31'/>"
WRITE #1 "        <register address='0xb9e2088' value='0x" DATA.LONG(A:0x9e2088) "' name='RPMH_VRM_MAX_VOLTAGE_CSR_REG32'/>"
WRITE #1 "        <register address='0xb9e2188' value='0x" DATA.LONG(A:0x9e2188) "' name='RPMH_VRM_MAX_VOLTAGE_CSR_REG33'/>"
WRITE #1 "        <register address='0xb9e2288' value='0x" DATA.LONG(A:0x9e2288) "' name='RPMH_VRM_MAX_VOLTAGE_CSR_REG34'/>"
WRITE #1 "        <register address='0xb9e2388' value='0x" DATA.LONG(A:0x9e2388) "' name='RPMH_VRM_MAX_VOLTAGE_CSR_REG35'/>"
WRITE #1 "        <register address='0xb9e2488' value='0x" DATA.LONG(A:0x9e2488) "' name='RPMH_VRM_MAX_VOLTAGE_CSR_REG36'/>"
WRITE #1 "        <register address='0xb9e2588' value='0x" DATA.LONG(A:0x9e2588) "' name='RPMH_VRM_MAX_VOLTAGE_CSR_REG37'/>"
WRITE #1 "        <register address='0xb9e2688' value='0x" DATA.LONG(A:0x9e2688) "' name='RPMH_VRM_MAX_VOLTAGE_CSR_REG38'/>"
WRITE #1 "        <register address='0xb9e2788' value='0x" DATA.LONG(A:0x9e2788) "' name='RPMH_VRM_MAX_VOLTAGE_CSR_REG39'/>"
WRITE #1 "        <register address='0xb9e2888' value='0x" DATA.LONG(A:0x9e2888) "' name='RPMH_VRM_MAX_VOLTAGE_CSR_REG40'/>"
WRITE #1 "        <register address='0xb9e2988' value='0x" DATA.LONG(A:0x9e2988) "' name='RPMH_VRM_MAX_VOLTAGE_CSR_REG41'/>"
WRITE #1 "        <register address='0xb9e2a88' value='0x" DATA.LONG(A:0x9e2a88) "' name='RPMH_VRM_MAX_VOLTAGE_CSR_REG42'/>"
WRITE #1 "        <register address='0xb9e2b88' value='0x" DATA.LONG(A:0x9e2b88) "' name='RPMH_VRM_MAX_VOLTAGE_CSR_REG43'/>"
WRITE #1 "        <register address='0xb9e2c88' value='0x" DATA.LONG(A:0x9e2c88) "' name='RPMH_VRM_MAX_VOLTAGE_CSR_REG44'/>"
WRITE #1 "        <register address='0xb9e2d88' value='0x" DATA.LONG(A:0x9e2d88) "' name='RPMH_VRM_MAX_VOLTAGE_CSR_REG45'/>"
WRITE #1 "        <register address='0xb9e008c' value='0x" DATA.LONG(A:0x9e008c) "' name='RPMH_VRM_VOLTAGE_SEQ_ID_CSR_REG0'/>"
WRITE #1 "        <register address='0xb9e018c' value='0x" DATA.LONG(A:0x9e018c) "' name='RPMH_VRM_VOLTAGE_SEQ_ID_CSR_REG1'/>"
WRITE #1 "        <register address='0xb9e028c' value='0x" DATA.LONG(A:0x9e028c) "' name='RPMH_VRM_VOLTAGE_SEQ_ID_CSR_REG2'/>"
WRITE #1 "        <register address='0xb9e038c' value='0x" DATA.LONG(A:0x9e038c) "' name='RPMH_VRM_VOLTAGE_SEQ_ID_CSR_REG3'/>"
WRITE #1 "        <register address='0xb9e048c' value='0x" DATA.LONG(A:0x9e048c) "' name='RPMH_VRM_VOLTAGE_SEQ_ID_CSR_REG4'/>"
WRITE #1 "        <register address='0xb9e058c' value='0x" DATA.LONG(A:0x9e058c) "' name='RPMH_VRM_VOLTAGE_SEQ_ID_CSR_REG5'/>"
WRITE #1 "        <register address='0xb9e068c' value='0x" DATA.LONG(A:0x9e068c) "' name='RPMH_VRM_VOLTAGE_SEQ_ID_CSR_REG6'/>"
WRITE #1 "        <register address='0xb9e078c' value='0x" DATA.LONG(A:0x9e078c) "' name='RPMH_VRM_VOLTAGE_SEQ_ID_CSR_REG7'/>"
WRITE #1 "        <register address='0xb9e088c' value='0x" DATA.LONG(A:0x9e088c) "' name='RPMH_VRM_VOLTAGE_SEQ_ID_CSR_REG8'/>"
WRITE #1 "        <register address='0xb9e098c' value='0x" DATA.LONG(A:0x9e098c) "' name='RPMH_VRM_VOLTAGE_SEQ_ID_CSR_REG9'/>"
WRITE #1 "        <register address='0xb9e0a8c' value='0x" DATA.LONG(A:0x9e0a8c) "' name='RPMH_VRM_VOLTAGE_SEQ_ID_CSR_REG10'/>"
WRITE #1 "        <register address='0xb9e0b8c' value='0x" DATA.LONG(A:0x9e0b8c) "' name='RPMH_VRM_VOLTAGE_SEQ_ID_CSR_REG11'/>"
WRITE #1 "        <register address='0xb9e0c8c' value='0x" DATA.LONG(A:0x9e0c8c) "' name='RPMH_VRM_VOLTAGE_SEQ_ID_CSR_REG12'/>"
WRITE #1 "        <register address='0xb9e0d8c' value='0x" DATA.LONG(A:0x9e0d8c) "' name='RPMH_VRM_VOLTAGE_SEQ_ID_CSR_REG13'/>"
WRITE #1 "        <register address='0xb9e0e8c' value='0x" DATA.LONG(A:0x9e0e8c) "' name='RPMH_VRM_VOLTAGE_SEQ_ID_CSR_REG14'/>"
WRITE #1 "        <register address='0xb9e0f8c' value='0x" DATA.LONG(A:0x9e0f8c) "' name='RPMH_VRM_VOLTAGE_SEQ_ID_CSR_REG15'/>"
WRITE #1 "        <register address='0xb9e108c' value='0x" DATA.LONG(A:0x9e108c) "' name='RPMH_VRM_VOLTAGE_SEQ_ID_CSR_REG16'/>"
WRITE #1 "        <register address='0xb9e118c' value='0x" DATA.LONG(A:0x9e118c) "' name='RPMH_VRM_VOLTAGE_SEQ_ID_CSR_REG17'/>"
WRITE #1 "        <register address='0xb9e128c' value='0x" DATA.LONG(A:0x9e128c) "' name='RPMH_VRM_VOLTAGE_SEQ_ID_CSR_REG18'/>"
WRITE #1 "        <register address='0xb9e138c' value='0x" DATA.LONG(A:0x9e138c) "' name='RPMH_VRM_VOLTAGE_SEQ_ID_CSR_REG19'/>"
WRITE #1 "        <register address='0xb9e148c' value='0x" DATA.LONG(A:0x9e148c) "' name='RPMH_VRM_VOLTAGE_SEQ_ID_CSR_REG20'/>"
WRITE #1 "        <register address='0xb9e158c' value='0x" DATA.LONG(A:0x9e158c) "' name='RPMH_VRM_VOLTAGE_SEQ_ID_CSR_REG21'/>"
WRITE #1 "        <register address='0xb9e168c' value='0x" DATA.LONG(A:0x9e168c) "' name='RPMH_VRM_VOLTAGE_SEQ_ID_CSR_REG22'/>"
WRITE #1 "        <register address='0xb9e178c' value='0x" DATA.LONG(A:0x9e178c) "' name='RPMH_VRM_VOLTAGE_SEQ_ID_CSR_REG23'/>"
WRITE #1 "        <register address='0xb9e188c' value='0x" DATA.LONG(A:0x9e188c) "' name='RPMH_VRM_VOLTAGE_SEQ_ID_CSR_REG24'/>"
WRITE #1 "        <register address='0xb9e198c' value='0x" DATA.LONG(A:0x9e198c) "' name='RPMH_VRM_VOLTAGE_SEQ_ID_CSR_REG25'/>"
WRITE #1 "        <register address='0xb9e1a8c' value='0x" DATA.LONG(A:0x9e1a8c) "' name='RPMH_VRM_VOLTAGE_SEQ_ID_CSR_REG26'/>"
WRITE #1 "        <register address='0xb9e1b8c' value='0x" DATA.LONG(A:0x9e1b8c) "' name='RPMH_VRM_VOLTAGE_SEQ_ID_CSR_REG27'/>"
WRITE #1 "        <register address='0xb9e1c8c' value='0x" DATA.LONG(A:0x9e1c8c) "' name='RPMH_VRM_VOLTAGE_SEQ_ID_CSR_REG28'/>"
WRITE #1 "        <register address='0xb9e1d8c' value='0x" DATA.LONG(A:0x9e1d8c) "' name='RPMH_VRM_VOLTAGE_SEQ_ID_CSR_REG29'/>"
WRITE #1 "        <register address='0xb9e1e8c' value='0x" DATA.LONG(A:0x9e1e8c) "' name='RPMH_VRM_VOLTAGE_SEQ_ID_CSR_REG30'/>"
WRITE #1 "        <register address='0xb9e1f8c' value='0x" DATA.LONG(A:0x9e1f8c) "' name='RPMH_VRM_VOLTAGE_SEQ_ID_CSR_REG31'/>"
WRITE #1 "        <register address='0xb9e208c' value='0x" DATA.LONG(A:0x9e208c) "' name='RPMH_VRM_VOLTAGE_SEQ_ID_CSR_REG32'/>"
WRITE #1 "        <register address='0xb9e218c' value='0x" DATA.LONG(A:0x9e218c) "' name='RPMH_VRM_VOLTAGE_SEQ_ID_CSR_REG33'/>"
WRITE #1 "        <register address='0xb9e228c' value='0x" DATA.LONG(A:0x9e228c) "' name='RPMH_VRM_VOLTAGE_SEQ_ID_CSR_REG34'/>"
WRITE #1 "        <register address='0xb9e238c' value='0x" DATA.LONG(A:0x9e238c) "' name='RPMH_VRM_VOLTAGE_SEQ_ID_CSR_REG35'/>"
WRITE #1 "        <register address='0xb9e248c' value='0x" DATA.LONG(A:0x9e248c) "' name='RPMH_VRM_VOLTAGE_SEQ_ID_CSR_REG36'/>"
WRITE #1 "        <register address='0xb9e258c' value='0x" DATA.LONG(A:0x9e258c) "' name='RPMH_VRM_VOLTAGE_SEQ_ID_CSR_REG37'/>"
WRITE #1 "        <register address='0xb9e268c' value='0x" DATA.LONG(A:0x9e268c) "' name='RPMH_VRM_VOLTAGE_SEQ_ID_CSR_REG38'/>"
WRITE #1 "        <register address='0xb9e278c' value='0x" DATA.LONG(A:0x9e278c) "' name='RPMH_VRM_VOLTAGE_SEQ_ID_CSR_REG39'/>"
WRITE #1 "        <register address='0xb9e288c' value='0x" DATA.LONG(A:0x9e288c) "' name='RPMH_VRM_VOLTAGE_SEQ_ID_CSR_REG40'/>"
WRITE #1 "        <register address='0xb9e298c' value='0x" DATA.LONG(A:0x9e298c) "' name='RPMH_VRM_VOLTAGE_SEQ_ID_CSR_REG41'/>"
WRITE #1 "        <register address='0xb9e2a8c' value='0x" DATA.LONG(A:0x9e2a8c) "' name='RPMH_VRM_VOLTAGE_SEQ_ID_CSR_REG42'/>"
WRITE #1 "        <register address='0xb9e2b8c' value='0x" DATA.LONG(A:0x9e2b8c) "' name='RPMH_VRM_VOLTAGE_SEQ_ID_CSR_REG43'/>"
WRITE #1 "        <register address='0xb9e2c8c' value='0x" DATA.LONG(A:0x9e2c8c) "' name='RPMH_VRM_VOLTAGE_SEQ_ID_CSR_REG44'/>"
WRITE #1 "        <register address='0xb9e2d8c' value='0x" DATA.LONG(A:0x9e2d8c) "' name='RPMH_VRM_VOLTAGE_SEQ_ID_CSR_REG45'/>"
WRITE #1 "        <register address='0xb9e0090' value='0x" DATA.LONG(A:0x9e0090) "' name='RPMH_VRM_ENABLE_SEQ_ID_CSR_REG0'/>"
WRITE #1 "        <register address='0xb9e0190' value='0x" DATA.LONG(A:0x9e0190) "' name='RPMH_VRM_ENABLE_SEQ_ID_CSR_REG1'/>"
WRITE #1 "        <register address='0xb9e0290' value='0x" DATA.LONG(A:0x9e0290) "' name='RPMH_VRM_ENABLE_SEQ_ID_CSR_REG2'/>"
WRITE #1 "        <register address='0xb9e0390' value='0x" DATA.LONG(A:0x9e0390) "' name='RPMH_VRM_ENABLE_SEQ_ID_CSR_REG3'/>"
WRITE #1 "        <register address='0xb9e0490' value='0x" DATA.LONG(A:0x9e0490) "' name='RPMH_VRM_ENABLE_SEQ_ID_CSR_REG4'/>"
WRITE #1 "        <register address='0xb9e0590' value='0x" DATA.LONG(A:0x9e0590) "' name='RPMH_VRM_ENABLE_SEQ_ID_CSR_REG5'/>"
WRITE #1 "        <register address='0xb9e0690' value='0x" DATA.LONG(A:0x9e0690) "' name='RPMH_VRM_ENABLE_SEQ_ID_CSR_REG6'/>"
WRITE #1 "        <register address='0xb9e0790' value='0x" DATA.LONG(A:0x9e0790) "' name='RPMH_VRM_ENABLE_SEQ_ID_CSR_REG7'/>"
WRITE #1 "        <register address='0xb9e0890' value='0x" DATA.LONG(A:0x9e0890) "' name='RPMH_VRM_ENABLE_SEQ_ID_CSR_REG8'/>"
WRITE #1 "        <register address='0xb9e0990' value='0x" DATA.LONG(A:0x9e0990) "' name='RPMH_VRM_ENABLE_SEQ_ID_CSR_REG9'/>"
WRITE #1 "        <register address='0xb9e0a90' value='0x" DATA.LONG(A:0x9e0a90) "' name='RPMH_VRM_ENABLE_SEQ_ID_CSR_REG10'/>"
WRITE #1 "        <register address='0xb9e0b90' value='0x" DATA.LONG(A:0x9e0b90) "' name='RPMH_VRM_ENABLE_SEQ_ID_CSR_REG11'/>"
WRITE #1 "        <register address='0xb9e0c90' value='0x" DATA.LONG(A:0x9e0c90) "' name='RPMH_VRM_ENABLE_SEQ_ID_CSR_REG12'/>"
WRITE #1 "        <register address='0xb9e0d90' value='0x" DATA.LONG(A:0x9e0d90) "' name='RPMH_VRM_ENABLE_SEQ_ID_CSR_REG13'/>"
WRITE #1 "        <register address='0xb9e0e90' value='0x" DATA.LONG(A:0x9e0e90) "' name='RPMH_VRM_ENABLE_SEQ_ID_CSR_REG14'/>"
WRITE #1 "        <register address='0xb9e0f90' value='0x" DATA.LONG(A:0x9e0f90) "' name='RPMH_VRM_ENABLE_SEQ_ID_CSR_REG15'/>"
WRITE #1 "        <register address='0xb9e1090' value='0x" DATA.LONG(A:0x9e1090) "' name='RPMH_VRM_ENABLE_SEQ_ID_CSR_REG16'/>"
WRITE #1 "        <register address='0xb9e1190' value='0x" DATA.LONG(A:0x9e1190) "' name='RPMH_VRM_ENABLE_SEQ_ID_CSR_REG17'/>"
WRITE #1 "        <register address='0xb9e1290' value='0x" DATA.LONG(A:0x9e1290) "' name='RPMH_VRM_ENABLE_SEQ_ID_CSR_REG18'/>"
WRITE #1 "        <register address='0xb9e1390' value='0x" DATA.LONG(A:0x9e1390) "' name='RPMH_VRM_ENABLE_SEQ_ID_CSR_REG19'/>"
WRITE #1 "        <register address='0xb9e1490' value='0x" DATA.LONG(A:0x9e1490) "' name='RPMH_VRM_ENABLE_SEQ_ID_CSR_REG20'/>"
WRITE #1 "        <register address='0xb9e1590' value='0x" DATA.LONG(A:0x9e1590) "' name='RPMH_VRM_ENABLE_SEQ_ID_CSR_REG21'/>"
WRITE #1 "        <register address='0xb9e1690' value='0x" DATA.LONG(A:0x9e1690) "' name='RPMH_VRM_ENABLE_SEQ_ID_CSR_REG22'/>"
WRITE #1 "        <register address='0xb9e1790' value='0x" DATA.LONG(A:0x9e1790) "' name='RPMH_VRM_ENABLE_SEQ_ID_CSR_REG23'/>"
WRITE #1 "        <register address='0xb9e1890' value='0x" DATA.LONG(A:0x9e1890) "' name='RPMH_VRM_ENABLE_SEQ_ID_CSR_REG24'/>"
WRITE #1 "        <register address='0xb9e1990' value='0x" DATA.LONG(A:0x9e1990) "' name='RPMH_VRM_ENABLE_SEQ_ID_CSR_REG25'/>"
WRITE #1 "        <register address='0xb9e1a90' value='0x" DATA.LONG(A:0x9e1a90) "' name='RPMH_VRM_ENABLE_SEQ_ID_CSR_REG26'/>"
WRITE #1 "        <register address='0xb9e1b90' value='0x" DATA.LONG(A:0x9e1b90) "' name='RPMH_VRM_ENABLE_SEQ_ID_CSR_REG27'/>"
WRITE #1 "        <register address='0xb9e1c90' value='0x" DATA.LONG(A:0x9e1c90) "' name='RPMH_VRM_ENABLE_SEQ_ID_CSR_REG28'/>"
WRITE #1 "        <register address='0xb9e1d90' value='0x" DATA.LONG(A:0x9e1d90) "' name='RPMH_VRM_ENABLE_SEQ_ID_CSR_REG29'/>"
WRITE #1 "        <register address='0xb9e1e90' value='0x" DATA.LONG(A:0x9e1e90) "' name='RPMH_VRM_ENABLE_SEQ_ID_CSR_REG30'/>"
WRITE #1 "        <register address='0xb9e1f90' value='0x" DATA.LONG(A:0x9e1f90) "' name='RPMH_VRM_ENABLE_SEQ_ID_CSR_REG31'/>"
WRITE #1 "        <register address='0xb9e2090' value='0x" DATA.LONG(A:0x9e2090) "' name='RPMH_VRM_ENABLE_SEQ_ID_CSR_REG32'/>"
WRITE #1 "        <register address='0xb9e2190' value='0x" DATA.LONG(A:0x9e2190) "' name='RPMH_VRM_ENABLE_SEQ_ID_CSR_REG33'/>"
WRITE #1 "        <register address='0xb9e2290' value='0x" DATA.LONG(A:0x9e2290) "' name='RPMH_VRM_ENABLE_SEQ_ID_CSR_REG34'/>"
WRITE #1 "        <register address='0xb9e2390' value='0x" DATA.LONG(A:0x9e2390) "' name='RPMH_VRM_ENABLE_SEQ_ID_CSR_REG35'/>"
WRITE #1 "        <register address='0xb9e2490' value='0x" DATA.LONG(A:0x9e2490) "' name='RPMH_VRM_ENABLE_SEQ_ID_CSR_REG36'/>"
WRITE #1 "        <register address='0xb9e2590' value='0x" DATA.LONG(A:0x9e2590) "' name='RPMH_VRM_ENABLE_SEQ_ID_CSR_REG37'/>"
WRITE #1 "        <register address='0xb9e2690' value='0x" DATA.LONG(A:0x9e2690) "' name='RPMH_VRM_ENABLE_SEQ_ID_CSR_REG38'/>"
WRITE #1 "        <register address='0xb9e2790' value='0x" DATA.LONG(A:0x9e2790) "' name='RPMH_VRM_ENABLE_SEQ_ID_CSR_REG39'/>"
WRITE #1 "        <register address='0xb9e2890' value='0x" DATA.LONG(A:0x9e2890) "' name='RPMH_VRM_ENABLE_SEQ_ID_CSR_REG40'/>"
WRITE #1 "        <register address='0xb9e2990' value='0x" DATA.LONG(A:0x9e2990) "' name='RPMH_VRM_ENABLE_SEQ_ID_CSR_REG41'/>"
WRITE #1 "        <register address='0xb9e2a90' value='0x" DATA.LONG(A:0x9e2a90) "' name='RPMH_VRM_ENABLE_SEQ_ID_CSR_REG42'/>"
WRITE #1 "        <register address='0xb9e2b90' value='0x" DATA.LONG(A:0x9e2b90) "' name='RPMH_VRM_ENABLE_SEQ_ID_CSR_REG43'/>"
WRITE #1 "        <register address='0xb9e2c90' value='0x" DATA.LONG(A:0x9e2c90) "' name='RPMH_VRM_ENABLE_SEQ_ID_CSR_REG44'/>"
WRITE #1 "        <register address='0xb9e2d90' value='0x" DATA.LONG(A:0x9e2d90) "' name='RPMH_VRM_ENABLE_SEQ_ID_CSR_REG45'/>"
WRITE #1 "        <register address='0xb9e0094' value='0x" DATA.LONG(A:0x9e0094) "' name='RPMH_VRM_MODE_SEQ_ID_CSR_REG0'/>"
WRITE #1 "        <register address='0xb9e0194' value='0x" DATA.LONG(A:0x9e0194) "' name='RPMH_VRM_MODE_SEQ_ID_CSR_REG1'/>"
WRITE #1 "        <register address='0xb9e0294' value='0x" DATA.LONG(A:0x9e0294) "' name='RPMH_VRM_MODE_SEQ_ID_CSR_REG2'/>"
WRITE #1 "        <register address='0xb9e0394' value='0x" DATA.LONG(A:0x9e0394) "' name='RPMH_VRM_MODE_SEQ_ID_CSR_REG3'/>"
WRITE #1 "        <register address='0xb9e0494' value='0x" DATA.LONG(A:0x9e0494) "' name='RPMH_VRM_MODE_SEQ_ID_CSR_REG4'/>"
WRITE #1 "        <register address='0xb9e0594' value='0x" DATA.LONG(A:0x9e0594) "' name='RPMH_VRM_MODE_SEQ_ID_CSR_REG5'/>"
WRITE #1 "        <register address='0xb9e0694' value='0x" DATA.LONG(A:0x9e0694) "' name='RPMH_VRM_MODE_SEQ_ID_CSR_REG6'/>"
WRITE #1 "        <register address='0xb9e0794' value='0x" DATA.LONG(A:0x9e0794) "' name='RPMH_VRM_MODE_SEQ_ID_CSR_REG7'/>"
WRITE #1 "        <register address='0xb9e0894' value='0x" DATA.LONG(A:0x9e0894) "' name='RPMH_VRM_MODE_SEQ_ID_CSR_REG8'/>"
WRITE #1 "        <register address='0xb9e0994' value='0x" DATA.LONG(A:0x9e0994) "' name='RPMH_VRM_MODE_SEQ_ID_CSR_REG9'/>"
WRITE #1 "        <register address='0xb9e0a94' value='0x" DATA.LONG(A:0x9e0a94) "' name='RPMH_VRM_MODE_SEQ_ID_CSR_REG10'/>"
WRITE #1 "        <register address='0xb9e0b94' value='0x" DATA.LONG(A:0x9e0b94) "' name='RPMH_VRM_MODE_SEQ_ID_CSR_REG11'/>"
WRITE #1 "        <register address='0xb9e0c94' value='0x" DATA.LONG(A:0x9e0c94) "' name='RPMH_VRM_MODE_SEQ_ID_CSR_REG12'/>"
WRITE #1 "        <register address='0xb9e0d94' value='0x" DATA.LONG(A:0x9e0d94) "' name='RPMH_VRM_MODE_SEQ_ID_CSR_REG13'/>"
WRITE #1 "        <register address='0xb9e0e94' value='0x" DATA.LONG(A:0x9e0e94) "' name='RPMH_VRM_MODE_SEQ_ID_CSR_REG14'/>"
WRITE #1 "        <register address='0xb9e0f94' value='0x" DATA.LONG(A:0x9e0f94) "' name='RPMH_VRM_MODE_SEQ_ID_CSR_REG15'/>"
WRITE #1 "        <register address='0xb9e1094' value='0x" DATA.LONG(A:0x9e1094) "' name='RPMH_VRM_MODE_SEQ_ID_CSR_REG16'/>"
WRITE #1 "        <register address='0xb9e1194' value='0x" DATA.LONG(A:0x9e1194) "' name='RPMH_VRM_MODE_SEQ_ID_CSR_REG17'/>"
WRITE #1 "        <register address='0xb9e1294' value='0x" DATA.LONG(A:0x9e1294) "' name='RPMH_VRM_MODE_SEQ_ID_CSR_REG18'/>"
WRITE #1 "        <register address='0xb9e1394' value='0x" DATA.LONG(A:0x9e1394) "' name='RPMH_VRM_MODE_SEQ_ID_CSR_REG19'/>"
WRITE #1 "        <register address='0xb9e1494' value='0x" DATA.LONG(A:0x9e1494) "' name='RPMH_VRM_MODE_SEQ_ID_CSR_REG20'/>"
WRITE #1 "        <register address='0xb9e1594' value='0x" DATA.LONG(A:0x9e1594) "' name='RPMH_VRM_MODE_SEQ_ID_CSR_REG21'/>"
WRITE #1 "        <register address='0xb9e1694' value='0x" DATA.LONG(A:0x9e1694) "' name='RPMH_VRM_MODE_SEQ_ID_CSR_REG22'/>"
WRITE #1 "        <register address='0xb9e1794' value='0x" DATA.LONG(A:0x9e1794) "' name='RPMH_VRM_MODE_SEQ_ID_CSR_REG23'/>"
WRITE #1 "        <register address='0xb9e1894' value='0x" DATA.LONG(A:0x9e1894) "' name='RPMH_VRM_MODE_SEQ_ID_CSR_REG24'/>"
WRITE #1 "        <register address='0xb9e1994' value='0x" DATA.LONG(A:0x9e1994) "' name='RPMH_VRM_MODE_SEQ_ID_CSR_REG25'/>"
WRITE #1 "        <register address='0xb9e1a94' value='0x" DATA.LONG(A:0x9e1a94) "' name='RPMH_VRM_MODE_SEQ_ID_CSR_REG26'/>"
WRITE #1 "        <register address='0xb9e1b94' value='0x" DATA.LONG(A:0x9e1b94) "' name='RPMH_VRM_MODE_SEQ_ID_CSR_REG27'/>"
WRITE #1 "        <register address='0xb9e1c94' value='0x" DATA.LONG(A:0x9e1c94) "' name='RPMH_VRM_MODE_SEQ_ID_CSR_REG28'/>"
WRITE #1 "        <register address='0xb9e1d94' value='0x" DATA.LONG(A:0x9e1d94) "' name='RPMH_VRM_MODE_SEQ_ID_CSR_REG29'/>"
WRITE #1 "        <register address='0xb9e1e94' value='0x" DATA.LONG(A:0x9e1e94) "' name='RPMH_VRM_MODE_SEQ_ID_CSR_REG30'/>"
WRITE #1 "        <register address='0xb9e1f94' value='0x" DATA.LONG(A:0x9e1f94) "' name='RPMH_VRM_MODE_SEQ_ID_CSR_REG31'/>"
WRITE #1 "        <register address='0xb9e2094' value='0x" DATA.LONG(A:0x9e2094) "' name='RPMH_VRM_MODE_SEQ_ID_CSR_REG32'/>"
WRITE #1 "        <register address='0xb9e2194' value='0x" DATA.LONG(A:0x9e2194) "' name='RPMH_VRM_MODE_SEQ_ID_CSR_REG33'/>"
WRITE #1 "        <register address='0xb9e2294' value='0x" DATA.LONG(A:0x9e2294) "' name='RPMH_VRM_MODE_SEQ_ID_CSR_REG34'/>"
WRITE #1 "        <register address='0xb9e2394' value='0x" DATA.LONG(A:0x9e2394) "' name='RPMH_VRM_MODE_SEQ_ID_CSR_REG35'/>"
WRITE #1 "        <register address='0xb9e2494' value='0x" DATA.LONG(A:0x9e2494) "' name='RPMH_VRM_MODE_SEQ_ID_CSR_REG36'/>"
WRITE #1 "        <register address='0xb9e2594' value='0x" DATA.LONG(A:0x9e2594) "' name='RPMH_VRM_MODE_SEQ_ID_CSR_REG37'/>"
WRITE #1 "        <register address='0xb9e2694' value='0x" DATA.LONG(A:0x9e2694) "' name='RPMH_VRM_MODE_SEQ_ID_CSR_REG38'/>"
WRITE #1 "        <register address='0xb9e2794' value='0x" DATA.LONG(A:0x9e2794) "' name='RPMH_VRM_MODE_SEQ_ID_CSR_REG39'/>"
WRITE #1 "        <register address='0xb9e2894' value='0x" DATA.LONG(A:0x9e2894) "' name='RPMH_VRM_MODE_SEQ_ID_CSR_REG40'/>"
WRITE #1 "        <register address='0xb9e2994' value='0x" DATA.LONG(A:0x9e2994) "' name='RPMH_VRM_MODE_SEQ_ID_CSR_REG41'/>"
WRITE #1 "        <register address='0xb9e2a94' value='0x" DATA.LONG(A:0x9e2a94) "' name='RPMH_VRM_MODE_SEQ_ID_CSR_REG42'/>"
WRITE #1 "        <register address='0xb9e2b94' value='0x" DATA.LONG(A:0x9e2b94) "' name='RPMH_VRM_MODE_SEQ_ID_CSR_REG43'/>"
WRITE #1 "        <register address='0xb9e2c94' value='0x" DATA.LONG(A:0x9e2c94) "' name='RPMH_VRM_MODE_SEQ_ID_CSR_REG44'/>"
WRITE #1 "        <register address='0xb9e2d94' value='0x" DATA.LONG(A:0x9e2d94) "' name='RPMH_VRM_MODE_SEQ_ID_CSR_REG45'/>"
WRITE #1 "        <register address='0xb9e00a8' value='0x" DATA.LONG(A:0x9e00a8) "' name='RPMH_VRM_VOLTAGE_DEP_ENABLE_CSR_REG0'/>"
WRITE #1 "        <register address='0xb9e01a8' value='0x" DATA.LONG(A:0x9e01a8) "' name='RPMH_VRM_VOLTAGE_DEP_ENABLE_CSR_REG1'/>"
WRITE #1 "        <register address='0xb9e02a8' value='0x" DATA.LONG(A:0x9e02a8) "' name='RPMH_VRM_VOLTAGE_DEP_ENABLE_CSR_REG2'/>"
WRITE #1 "        <register address='0xb9e03a8' value='0x" DATA.LONG(A:0x9e03a8) "' name='RPMH_VRM_VOLTAGE_DEP_ENABLE_CSR_REG3'/>"
WRITE #1 "        <register address='0xb9e04a8' value='0x" DATA.LONG(A:0x9e04a8) "' name='RPMH_VRM_VOLTAGE_DEP_ENABLE_CSR_REG4'/>"
WRITE #1 "        <register address='0xb9e05a8' value='0x" DATA.LONG(A:0x9e05a8) "' name='RPMH_VRM_VOLTAGE_DEP_ENABLE_CSR_REG5'/>"
WRITE #1 "        <register address='0xb9e06a8' value='0x" DATA.LONG(A:0x9e06a8) "' name='RPMH_VRM_VOLTAGE_DEP_ENABLE_CSR_REG6'/>"
WRITE #1 "        <register address='0xb9e07a8' value='0x" DATA.LONG(A:0x9e07a8) "' name='RPMH_VRM_VOLTAGE_DEP_ENABLE_CSR_REG7'/>"
WRITE #1 "        <register address='0xb9e08a8' value='0x" DATA.LONG(A:0x9e08a8) "' name='RPMH_VRM_VOLTAGE_DEP_ENABLE_CSR_REG8'/>"
WRITE #1 "        <register address='0xb9e09a8' value='0x" DATA.LONG(A:0x9e09a8) "' name='RPMH_VRM_VOLTAGE_DEP_ENABLE_CSR_REG9'/>"
WRITE #1 "        <register address='0xb9e0aa8' value='0x" DATA.LONG(A:0x9e0aa8) "' name='RPMH_VRM_VOLTAGE_DEP_ENABLE_CSR_REG10'/>"
WRITE #1 "        <register address='0xb9e0ba8' value='0x" DATA.LONG(A:0x9e0ba8) "' name='RPMH_VRM_VOLTAGE_DEP_ENABLE_CSR_REG11'/>"
WRITE #1 "        <register address='0xb9e0ca8' value='0x" DATA.LONG(A:0x9e0ca8) "' name='RPMH_VRM_VOLTAGE_DEP_ENABLE_CSR_REG12'/>"
WRITE #1 "        <register address='0xb9e0da8' value='0x" DATA.LONG(A:0x9e0da8) "' name='RPMH_VRM_VOLTAGE_DEP_ENABLE_CSR_REG13'/>"
WRITE #1 "        <register address='0xb9e0ea8' value='0x" DATA.LONG(A:0x9e0ea8) "' name='RPMH_VRM_VOLTAGE_DEP_ENABLE_CSR_REG14'/>"
WRITE #1 "        <register address='0xb9e0fa8' value='0x" DATA.LONG(A:0x9e0fa8) "' name='RPMH_VRM_VOLTAGE_DEP_ENABLE_CSR_REG15'/>"
WRITE #1 "        <register address='0xb9e10a8' value='0x" DATA.LONG(A:0x9e10a8) "' name='RPMH_VRM_VOLTAGE_DEP_ENABLE_CSR_REG16'/>"
WRITE #1 "        <register address='0xb9e11a8' value='0x" DATA.LONG(A:0x9e11a8) "' name='RPMH_VRM_VOLTAGE_DEP_ENABLE_CSR_REG17'/>"
WRITE #1 "        <register address='0xb9e12a8' value='0x" DATA.LONG(A:0x9e12a8) "' name='RPMH_VRM_VOLTAGE_DEP_ENABLE_CSR_REG18'/>"
WRITE #1 "        <register address='0xb9e13a8' value='0x" DATA.LONG(A:0x9e13a8) "' name='RPMH_VRM_VOLTAGE_DEP_ENABLE_CSR_REG19'/>"
WRITE #1 "        <register address='0xb9e14a8' value='0x" DATA.LONG(A:0x9e14a8) "' name='RPMH_VRM_VOLTAGE_DEP_ENABLE_CSR_REG20'/>"
WRITE #1 "        <register address='0xb9e15a8' value='0x" DATA.LONG(A:0x9e15a8) "' name='RPMH_VRM_VOLTAGE_DEP_ENABLE_CSR_REG21'/>"
WRITE #1 "        <register address='0xb9e16a8' value='0x" DATA.LONG(A:0x9e16a8) "' name='RPMH_VRM_VOLTAGE_DEP_ENABLE_CSR_REG22'/>"
WRITE #1 "        <register address='0xb9e17a8' value='0x" DATA.LONG(A:0x9e17a8) "' name='RPMH_VRM_VOLTAGE_DEP_ENABLE_CSR_REG23'/>"
WRITE #1 "        <register address='0xb9e18a8' value='0x" DATA.LONG(A:0x9e18a8) "' name='RPMH_VRM_VOLTAGE_DEP_ENABLE_CSR_REG24'/>"
WRITE #1 "        <register address='0xb9e19a8' value='0x" DATA.LONG(A:0x9e19a8) "' name='RPMH_VRM_VOLTAGE_DEP_ENABLE_CSR_REG25'/>"
WRITE #1 "        <register address='0xb9e1aa8' value='0x" DATA.LONG(A:0x9e1aa8) "' name='RPMH_VRM_VOLTAGE_DEP_ENABLE_CSR_REG26'/>"
WRITE #1 "        <register address='0xb9e1ba8' value='0x" DATA.LONG(A:0x9e1ba8) "' name='RPMH_VRM_VOLTAGE_DEP_ENABLE_CSR_REG27'/>"
WRITE #1 "        <register address='0xb9e1ca8' value='0x" DATA.LONG(A:0x9e1ca8) "' name='RPMH_VRM_VOLTAGE_DEP_ENABLE_CSR_REG28'/>"
WRITE #1 "        <register address='0xb9e1da8' value='0x" DATA.LONG(A:0x9e1da8) "' name='RPMH_VRM_VOLTAGE_DEP_ENABLE_CSR_REG29'/>"
WRITE #1 "        <register address='0xb9e1ea8' value='0x" DATA.LONG(A:0x9e1ea8) "' name='RPMH_VRM_VOLTAGE_DEP_ENABLE_CSR_REG30'/>"
WRITE #1 "        <register address='0xb9e1fa8' value='0x" DATA.LONG(A:0x9e1fa8) "' name='RPMH_VRM_VOLTAGE_DEP_ENABLE_CSR_REG31'/>"
WRITE #1 "        <register address='0xb9e20a8' value='0x" DATA.LONG(A:0x9e20a8) "' name='RPMH_VRM_VOLTAGE_DEP_ENABLE_CSR_REG32'/>"
WRITE #1 "        <register address='0xb9e21a8' value='0x" DATA.LONG(A:0x9e21a8) "' name='RPMH_VRM_VOLTAGE_DEP_ENABLE_CSR_REG33'/>"
WRITE #1 "        <register address='0xb9e22a8' value='0x" DATA.LONG(A:0x9e22a8) "' name='RPMH_VRM_VOLTAGE_DEP_ENABLE_CSR_REG34'/>"
WRITE #1 "        <register address='0xb9e23a8' value='0x" DATA.LONG(A:0x9e23a8) "' name='RPMH_VRM_VOLTAGE_DEP_ENABLE_CSR_REG35'/>"
WRITE #1 "        <register address='0xb9e24a8' value='0x" DATA.LONG(A:0x9e24a8) "' name='RPMH_VRM_VOLTAGE_DEP_ENABLE_CSR_REG36'/>"
WRITE #1 "        <register address='0xb9e25a8' value='0x" DATA.LONG(A:0x9e25a8) "' name='RPMH_VRM_VOLTAGE_DEP_ENABLE_CSR_REG37'/>"
WRITE #1 "        <register address='0xb9e26a8' value='0x" DATA.LONG(A:0x9e26a8) "' name='RPMH_VRM_VOLTAGE_DEP_ENABLE_CSR_REG38'/>"
WRITE #1 "        <register address='0xb9e27a8' value='0x" DATA.LONG(A:0x9e27a8) "' name='RPMH_VRM_VOLTAGE_DEP_ENABLE_CSR_REG39'/>"
WRITE #1 "        <register address='0xb9e28a8' value='0x" DATA.LONG(A:0x9e28a8) "' name='RPMH_VRM_VOLTAGE_DEP_ENABLE_CSR_REG40'/>"
WRITE #1 "        <register address='0xb9e29a8' value='0x" DATA.LONG(A:0x9e29a8) "' name='RPMH_VRM_VOLTAGE_DEP_ENABLE_CSR_REG41'/>"
WRITE #1 "        <register address='0xb9e2aa8' value='0x" DATA.LONG(A:0x9e2aa8) "' name='RPMH_VRM_VOLTAGE_DEP_ENABLE_CSR_REG42'/>"
WRITE #1 "        <register address='0xb9e2ba8' value='0x" DATA.LONG(A:0x9e2ba8) "' name='RPMH_VRM_VOLTAGE_DEP_ENABLE_CSR_REG43'/>"
WRITE #1 "        <register address='0xb9e2ca8' value='0x" DATA.LONG(A:0x9e2ca8) "' name='RPMH_VRM_VOLTAGE_DEP_ENABLE_CSR_REG44'/>"
WRITE #1 "        <register address='0xb9e2da8' value='0x" DATA.LONG(A:0x9e2da8) "' name='RPMH_VRM_VOLTAGE_DEP_ENABLE_CSR_REG45'/>"
WRITE #1 "        <register address='0xb9e00ac' value='0x" DATA.LONG(A:0x9e00ac) "' name='RPMH_VRM_ENABLE_DEP_ENABLE_CSR_REG0'/>"
WRITE #1 "        <register address='0xb9e01ac' value='0x" DATA.LONG(A:0x9e01ac) "' name='RPMH_VRM_ENABLE_DEP_ENABLE_CSR_REG1'/>"
WRITE #1 "        <register address='0xb9e02ac' value='0x" DATA.LONG(A:0x9e02ac) "' name='RPMH_VRM_ENABLE_DEP_ENABLE_CSR_REG2'/>"
WRITE #1 "        <register address='0xb9e03ac' value='0x" DATA.LONG(A:0x9e03ac) "' name='RPMH_VRM_ENABLE_DEP_ENABLE_CSR_REG3'/>"
WRITE #1 "        <register address='0xb9e04ac' value='0x" DATA.LONG(A:0x9e04ac) "' name='RPMH_VRM_ENABLE_DEP_ENABLE_CSR_REG4'/>"
WRITE #1 "        <register address='0xb9e05ac' value='0x" DATA.LONG(A:0x9e05ac) "' name='RPMH_VRM_ENABLE_DEP_ENABLE_CSR_REG5'/>"
WRITE #1 "        <register address='0xb9e06ac' value='0x" DATA.LONG(A:0x9e06ac) "' name='RPMH_VRM_ENABLE_DEP_ENABLE_CSR_REG6'/>"
WRITE #1 "        <register address='0xb9e07ac' value='0x" DATA.LONG(A:0x9e07ac) "' name='RPMH_VRM_ENABLE_DEP_ENABLE_CSR_REG7'/>"
WRITE #1 "        <register address='0xb9e08ac' value='0x" DATA.LONG(A:0x9e08ac) "' name='RPMH_VRM_ENABLE_DEP_ENABLE_CSR_REG8'/>"
WRITE #1 "        <register address='0xb9e09ac' value='0x" DATA.LONG(A:0x9e09ac) "' name='RPMH_VRM_ENABLE_DEP_ENABLE_CSR_REG9'/>"
WRITE #1 "        <register address='0xb9e0aac' value='0x" DATA.LONG(A:0x9e0aac) "' name='RPMH_VRM_ENABLE_DEP_ENABLE_CSR_REG10'/>"
WRITE #1 "        <register address='0xb9e0bac' value='0x" DATA.LONG(A:0x9e0bac) "' name='RPMH_VRM_ENABLE_DEP_ENABLE_CSR_REG11'/>"
WRITE #1 "        <register address='0xb9e0cac' value='0x" DATA.LONG(A:0x9e0cac) "' name='RPMH_VRM_ENABLE_DEP_ENABLE_CSR_REG12'/>"
WRITE #1 "        <register address='0xb9e0dac' value='0x" DATA.LONG(A:0x9e0dac) "' name='RPMH_VRM_ENABLE_DEP_ENABLE_CSR_REG13'/>"
WRITE #1 "        <register address='0xb9e0eac' value='0x" DATA.LONG(A:0x9e0eac) "' name='RPMH_VRM_ENABLE_DEP_ENABLE_CSR_REG14'/>"
WRITE #1 "        <register address='0xb9e0fac' value='0x" DATA.LONG(A:0x9e0fac) "' name='RPMH_VRM_ENABLE_DEP_ENABLE_CSR_REG15'/>"
WRITE #1 "        <register address='0xb9e10ac' value='0x" DATA.LONG(A:0x9e10ac) "' name='RPMH_VRM_ENABLE_DEP_ENABLE_CSR_REG16'/>"
WRITE #1 "        <register address='0xb9e11ac' value='0x" DATA.LONG(A:0x9e11ac) "' name='RPMH_VRM_ENABLE_DEP_ENABLE_CSR_REG17'/>"
WRITE #1 "        <register address='0xb9e12ac' value='0x" DATA.LONG(A:0x9e12ac) "' name='RPMH_VRM_ENABLE_DEP_ENABLE_CSR_REG18'/>"
WRITE #1 "        <register address='0xb9e13ac' value='0x" DATA.LONG(A:0x9e13ac) "' name='RPMH_VRM_ENABLE_DEP_ENABLE_CSR_REG19'/>"
WRITE #1 "        <register address='0xb9e14ac' value='0x" DATA.LONG(A:0x9e14ac) "' name='RPMH_VRM_ENABLE_DEP_ENABLE_CSR_REG20'/>"
WRITE #1 "        <register address='0xb9e15ac' value='0x" DATA.LONG(A:0x9e15ac) "' name='RPMH_VRM_ENABLE_DEP_ENABLE_CSR_REG21'/>"
WRITE #1 "        <register address='0xb9e16ac' value='0x" DATA.LONG(A:0x9e16ac) "' name='RPMH_VRM_ENABLE_DEP_ENABLE_CSR_REG22'/>"
WRITE #1 "        <register address='0xb9e17ac' value='0x" DATA.LONG(A:0x9e17ac) "' name='RPMH_VRM_ENABLE_DEP_ENABLE_CSR_REG23'/>"
WRITE #1 "        <register address='0xb9e18ac' value='0x" DATA.LONG(A:0x9e18ac) "' name='RPMH_VRM_ENABLE_DEP_ENABLE_CSR_REG24'/>"
WRITE #1 "        <register address='0xb9e19ac' value='0x" DATA.LONG(A:0x9e19ac) "' name='RPMH_VRM_ENABLE_DEP_ENABLE_CSR_REG25'/>"
WRITE #1 "        <register address='0xb9e1aac' value='0x" DATA.LONG(A:0x9e1aac) "' name='RPMH_VRM_ENABLE_DEP_ENABLE_CSR_REG26'/>"
WRITE #1 "        <register address='0xb9e1bac' value='0x" DATA.LONG(A:0x9e1bac) "' name='RPMH_VRM_ENABLE_DEP_ENABLE_CSR_REG27'/>"
WRITE #1 "        <register address='0xb9e1cac' value='0x" DATA.LONG(A:0x9e1cac) "' name='RPMH_VRM_ENABLE_DEP_ENABLE_CSR_REG28'/>"
WRITE #1 "        <register address='0xb9e1dac' value='0x" DATA.LONG(A:0x9e1dac) "' name='RPMH_VRM_ENABLE_DEP_ENABLE_CSR_REG29'/>"
WRITE #1 "        <register address='0xb9e1eac' value='0x" DATA.LONG(A:0x9e1eac) "' name='RPMH_VRM_ENABLE_DEP_ENABLE_CSR_REG30'/>"
WRITE #1 "        <register address='0xb9e1fac' value='0x" DATA.LONG(A:0x9e1fac) "' name='RPMH_VRM_ENABLE_DEP_ENABLE_CSR_REG31'/>"
WRITE #1 "        <register address='0xb9e20ac' value='0x" DATA.LONG(A:0x9e20ac) "' name='RPMH_VRM_ENABLE_DEP_ENABLE_CSR_REG32'/>"
WRITE #1 "        <register address='0xb9e21ac' value='0x" DATA.LONG(A:0x9e21ac) "' name='RPMH_VRM_ENABLE_DEP_ENABLE_CSR_REG33'/>"
WRITE #1 "        <register address='0xb9e22ac' value='0x" DATA.LONG(A:0x9e22ac) "' name='RPMH_VRM_ENABLE_DEP_ENABLE_CSR_REG34'/>"
WRITE #1 "        <register address='0xb9e23ac' value='0x" DATA.LONG(A:0x9e23ac) "' name='RPMH_VRM_ENABLE_DEP_ENABLE_CSR_REG35'/>"
WRITE #1 "        <register address='0xb9e24ac' value='0x" DATA.LONG(A:0x9e24ac) "' name='RPMH_VRM_ENABLE_DEP_ENABLE_CSR_REG36'/>"
WRITE #1 "        <register address='0xb9e25ac' value='0x" DATA.LONG(A:0x9e25ac) "' name='RPMH_VRM_ENABLE_DEP_ENABLE_CSR_REG37'/>"
WRITE #1 "        <register address='0xb9e26ac' value='0x" DATA.LONG(A:0x9e26ac) "' name='RPMH_VRM_ENABLE_DEP_ENABLE_CSR_REG38'/>"
WRITE #1 "        <register address='0xb9e27ac' value='0x" DATA.LONG(A:0x9e27ac) "' name='RPMH_VRM_ENABLE_DEP_ENABLE_CSR_REG39'/>"
WRITE #1 "        <register address='0xb9e28ac' value='0x" DATA.LONG(A:0x9e28ac) "' name='RPMH_VRM_ENABLE_DEP_ENABLE_CSR_REG40'/>"
WRITE #1 "        <register address='0xb9e29ac' value='0x" DATA.LONG(A:0x9e29ac) "' name='RPMH_VRM_ENABLE_DEP_ENABLE_CSR_REG41'/>"
WRITE #1 "        <register address='0xb9e2aac' value='0x" DATA.LONG(A:0x9e2aac) "' name='RPMH_VRM_ENABLE_DEP_ENABLE_CSR_REG42'/>"
WRITE #1 "        <register address='0xb9e2bac' value='0x" DATA.LONG(A:0x9e2bac) "' name='RPMH_VRM_ENABLE_DEP_ENABLE_CSR_REG43'/>"
WRITE #1 "        <register address='0xb9e2cac' value='0x" DATA.LONG(A:0x9e2cac) "' name='RPMH_VRM_ENABLE_DEP_ENABLE_CSR_REG44'/>"
WRITE #1 "        <register address='0xb9e2dac' value='0x" DATA.LONG(A:0x9e2dac) "' name='RPMH_VRM_ENABLE_DEP_ENABLE_CSR_REG45'/>"
WRITE #1 "        <register address='0xb9e00b0' value='0x" DATA.LONG(A:0x9e00b0) "' name='RPMH_VRM_MODE_DEP_ENABLE_CSR_REG0'/>"
WRITE #1 "        <register address='0xb9e01b0' value='0x" DATA.LONG(A:0x9e01b0) "' name='RPMH_VRM_MODE_DEP_ENABLE_CSR_REG1'/>"
WRITE #1 "        <register address='0xb9e02b0' value='0x" DATA.LONG(A:0x9e02b0) "' name='RPMH_VRM_MODE_DEP_ENABLE_CSR_REG2'/>"
WRITE #1 "        <register address='0xb9e03b0' value='0x" DATA.LONG(A:0x9e03b0) "' name='RPMH_VRM_MODE_DEP_ENABLE_CSR_REG3'/>"
WRITE #1 "        <register address='0xb9e04b0' value='0x" DATA.LONG(A:0x9e04b0) "' name='RPMH_VRM_MODE_DEP_ENABLE_CSR_REG4'/>"
WRITE #1 "        <register address='0xb9e05b0' value='0x" DATA.LONG(A:0x9e05b0) "' name='RPMH_VRM_MODE_DEP_ENABLE_CSR_REG5'/>"
WRITE #1 "        <register address='0xb9e06b0' value='0x" DATA.LONG(A:0x9e06b0) "' name='RPMH_VRM_MODE_DEP_ENABLE_CSR_REG6'/>"
WRITE #1 "        <register address='0xb9e07b0' value='0x" DATA.LONG(A:0x9e07b0) "' name='RPMH_VRM_MODE_DEP_ENABLE_CSR_REG7'/>"
WRITE #1 "        <register address='0xb9e08b0' value='0x" DATA.LONG(A:0x9e08b0) "' name='RPMH_VRM_MODE_DEP_ENABLE_CSR_REG8'/>"
WRITE #1 "        <register address='0xb9e09b0' value='0x" DATA.LONG(A:0x9e09b0) "' name='RPMH_VRM_MODE_DEP_ENABLE_CSR_REG9'/>"
WRITE #1 "        <register address='0xb9e0ab0' value='0x" DATA.LONG(A:0x9e0ab0) "' name='RPMH_VRM_MODE_DEP_ENABLE_CSR_REG10'/>"
WRITE #1 "        <register address='0xb9e0bb0' value='0x" DATA.LONG(A:0x9e0bb0) "' name='RPMH_VRM_MODE_DEP_ENABLE_CSR_REG11'/>"
WRITE #1 "        <register address='0xb9e0cb0' value='0x" DATA.LONG(A:0x9e0cb0) "' name='RPMH_VRM_MODE_DEP_ENABLE_CSR_REG12'/>"
WRITE #1 "        <register address='0xb9e0db0' value='0x" DATA.LONG(A:0x9e0db0) "' name='RPMH_VRM_MODE_DEP_ENABLE_CSR_REG13'/>"
WRITE #1 "        <register address='0xb9e0eb0' value='0x" DATA.LONG(A:0x9e0eb0) "' name='RPMH_VRM_MODE_DEP_ENABLE_CSR_REG14'/>"
WRITE #1 "        <register address='0xb9e0fb0' value='0x" DATA.LONG(A:0x9e0fb0) "' name='RPMH_VRM_MODE_DEP_ENABLE_CSR_REG15'/>"
WRITE #1 "        <register address='0xb9e10b0' value='0x" DATA.LONG(A:0x9e10b0) "' name='RPMH_VRM_MODE_DEP_ENABLE_CSR_REG16'/>"
WRITE #1 "        <register address='0xb9e11b0' value='0x" DATA.LONG(A:0x9e11b0) "' name='RPMH_VRM_MODE_DEP_ENABLE_CSR_REG17'/>"
WRITE #1 "        <register address='0xb9e12b0' value='0x" DATA.LONG(A:0x9e12b0) "' name='RPMH_VRM_MODE_DEP_ENABLE_CSR_REG18'/>"
WRITE #1 "        <register address='0xb9e13b0' value='0x" DATA.LONG(A:0x9e13b0) "' name='RPMH_VRM_MODE_DEP_ENABLE_CSR_REG19'/>"
WRITE #1 "        <register address='0xb9e14b0' value='0x" DATA.LONG(A:0x9e14b0) "' name='RPMH_VRM_MODE_DEP_ENABLE_CSR_REG20'/>"
WRITE #1 "        <register address='0xb9e15b0' value='0x" DATA.LONG(A:0x9e15b0) "' name='RPMH_VRM_MODE_DEP_ENABLE_CSR_REG21'/>"
WRITE #1 "        <register address='0xb9e16b0' value='0x" DATA.LONG(A:0x9e16b0) "' name='RPMH_VRM_MODE_DEP_ENABLE_CSR_REG22'/>"
WRITE #1 "        <register address='0xb9e17b0' value='0x" DATA.LONG(A:0x9e17b0) "' name='RPMH_VRM_MODE_DEP_ENABLE_CSR_REG23'/>"
WRITE #1 "        <register address='0xb9e18b0' value='0x" DATA.LONG(A:0x9e18b0) "' name='RPMH_VRM_MODE_DEP_ENABLE_CSR_REG24'/>"
WRITE #1 "        <register address='0xb9e19b0' value='0x" DATA.LONG(A:0x9e19b0) "' name='RPMH_VRM_MODE_DEP_ENABLE_CSR_REG25'/>"
WRITE #1 "        <register address='0xb9e1ab0' value='0x" DATA.LONG(A:0x9e1ab0) "' name='RPMH_VRM_MODE_DEP_ENABLE_CSR_REG26'/>"
WRITE #1 "        <register address='0xb9e1bb0' value='0x" DATA.LONG(A:0x9e1bb0) "' name='RPMH_VRM_MODE_DEP_ENABLE_CSR_REG27'/>"
WRITE #1 "        <register address='0xb9e1cb0' value='0x" DATA.LONG(A:0x9e1cb0) "' name='RPMH_VRM_MODE_DEP_ENABLE_CSR_REG28'/>"
WRITE #1 "        <register address='0xb9e1db0' value='0x" DATA.LONG(A:0x9e1db0) "' name='RPMH_VRM_MODE_DEP_ENABLE_CSR_REG29'/>"
WRITE #1 "        <register address='0xb9e1eb0' value='0x" DATA.LONG(A:0x9e1eb0) "' name='RPMH_VRM_MODE_DEP_ENABLE_CSR_REG30'/>"
WRITE #1 "        <register address='0xb9e1fb0' value='0x" DATA.LONG(A:0x9e1fb0) "' name='RPMH_VRM_MODE_DEP_ENABLE_CSR_REG31'/>"
WRITE #1 "        <register address='0xb9e20b0' value='0x" DATA.LONG(A:0x9e20b0) "' name='RPMH_VRM_MODE_DEP_ENABLE_CSR_REG32'/>"
WRITE #1 "        <register address='0xb9e21b0' value='0x" DATA.LONG(A:0x9e21b0) "' name='RPMH_VRM_MODE_DEP_ENABLE_CSR_REG33'/>"
WRITE #1 "        <register address='0xb9e22b0' value='0x" DATA.LONG(A:0x9e22b0) "' name='RPMH_VRM_MODE_DEP_ENABLE_CSR_REG34'/>"
WRITE #1 "        <register address='0xb9e23b0' value='0x" DATA.LONG(A:0x9e23b0) "' name='RPMH_VRM_MODE_DEP_ENABLE_CSR_REG35'/>"
WRITE #1 "        <register address='0xb9e24b0' value='0x" DATA.LONG(A:0x9e24b0) "' name='RPMH_VRM_MODE_DEP_ENABLE_CSR_REG36'/>"
WRITE #1 "        <register address='0xb9e25b0' value='0x" DATA.LONG(A:0x9e25b0) "' name='RPMH_VRM_MODE_DEP_ENABLE_CSR_REG37'/>"
WRITE #1 "        <register address='0xb9e26b0' value='0x" DATA.LONG(A:0x9e26b0) "' name='RPMH_VRM_MODE_DEP_ENABLE_CSR_REG38'/>"
WRITE #1 "        <register address='0xb9e27b0' value='0x" DATA.LONG(A:0x9e27b0) "' name='RPMH_VRM_MODE_DEP_ENABLE_CSR_REG39'/>"
WRITE #1 "        <register address='0xb9e28b0' value='0x" DATA.LONG(A:0x9e28b0) "' name='RPMH_VRM_MODE_DEP_ENABLE_CSR_REG40'/>"
WRITE #1 "        <register address='0xb9e29b0' value='0x" DATA.LONG(A:0x9e29b0) "' name='RPMH_VRM_MODE_DEP_ENABLE_CSR_REG41'/>"
WRITE #1 "        <register address='0xb9e2ab0' value='0x" DATA.LONG(A:0x9e2ab0) "' name='RPMH_VRM_MODE_DEP_ENABLE_CSR_REG42'/>"
WRITE #1 "        <register address='0xb9e2bb0' value='0x" DATA.LONG(A:0x9e2bb0) "' name='RPMH_VRM_MODE_DEP_ENABLE_CSR_REG43'/>"
WRITE #1 "        <register address='0xb9e2cb0' value='0x" DATA.LONG(A:0x9e2cb0) "' name='RPMH_VRM_MODE_DEP_ENABLE_CSR_REG44'/>"
WRITE #1 "        <register address='0xb9e2db0' value='0x" DATA.LONG(A:0x9e2db0) "' name='RPMH_VRM_MODE_DEP_ENABLE_CSR_REG45'/>"
WRITE #1 "        <register address='0xb9e00c4' value='0x" DATA.LONG(A:0x9e00c4) "' name='RPMH_VRM_VOLTAGE_SETTLING_BLOCK_ENABLE_CSR_REG0'/>"
WRITE #1 "        <register address='0xb9e01c4' value='0x" DATA.LONG(A:0x9e01c4) "' name='RPMH_VRM_VOLTAGE_SETTLING_BLOCK_ENABLE_CSR_REG1'/>"
WRITE #1 "        <register address='0xb9e02c4' value='0x" DATA.LONG(A:0x9e02c4) "' name='RPMH_VRM_VOLTAGE_SETTLING_BLOCK_ENABLE_CSR_REG2'/>"
WRITE #1 "        <register address='0xb9e03c4' value='0x" DATA.LONG(A:0x9e03c4) "' name='RPMH_VRM_VOLTAGE_SETTLING_BLOCK_ENABLE_CSR_REG3'/>"
WRITE #1 "        <register address='0xb9e04c4' value='0x" DATA.LONG(A:0x9e04c4) "' name='RPMH_VRM_VOLTAGE_SETTLING_BLOCK_ENABLE_CSR_REG4'/>"
WRITE #1 "        <register address='0xb9e05c4' value='0x" DATA.LONG(A:0x9e05c4) "' name='RPMH_VRM_VOLTAGE_SETTLING_BLOCK_ENABLE_CSR_REG5'/>"
WRITE #1 "        <register address='0xb9e06c4' value='0x" DATA.LONG(A:0x9e06c4) "' name='RPMH_VRM_VOLTAGE_SETTLING_BLOCK_ENABLE_CSR_REG6'/>"
WRITE #1 "        <register address='0xb9e07c4' value='0x" DATA.LONG(A:0x9e07c4) "' name='RPMH_VRM_VOLTAGE_SETTLING_BLOCK_ENABLE_CSR_REG7'/>"
WRITE #1 "        <register address='0xb9e08c4' value='0x" DATA.LONG(A:0x9e08c4) "' name='RPMH_VRM_VOLTAGE_SETTLING_BLOCK_ENABLE_CSR_REG8'/>"
WRITE #1 "        <register address='0xb9e09c4' value='0x" DATA.LONG(A:0x9e09c4) "' name='RPMH_VRM_VOLTAGE_SETTLING_BLOCK_ENABLE_CSR_REG9'/>"
WRITE #1 "        <register address='0xb9e0ac4' value='0x" DATA.LONG(A:0x9e0ac4) "' name='RPMH_VRM_VOLTAGE_SETTLING_BLOCK_ENABLE_CSR_REG10'/>"
WRITE #1 "        <register address='0xb9e0bc4' value='0x" DATA.LONG(A:0x9e0bc4) "' name='RPMH_VRM_VOLTAGE_SETTLING_BLOCK_ENABLE_CSR_REG11'/>"
WRITE #1 "        <register address='0xb9e0cc4' value='0x" DATA.LONG(A:0x9e0cc4) "' name='RPMH_VRM_VOLTAGE_SETTLING_BLOCK_ENABLE_CSR_REG12'/>"
WRITE #1 "        <register address='0xb9e0dc4' value='0x" DATA.LONG(A:0x9e0dc4) "' name='RPMH_VRM_VOLTAGE_SETTLING_BLOCK_ENABLE_CSR_REG13'/>"
WRITE #1 "        <register address='0xb9e0ec4' value='0x" DATA.LONG(A:0x9e0ec4) "' name='RPMH_VRM_VOLTAGE_SETTLING_BLOCK_ENABLE_CSR_REG14'/>"
WRITE #1 "        <register address='0xb9e0fc4' value='0x" DATA.LONG(A:0x9e0fc4) "' name='RPMH_VRM_VOLTAGE_SETTLING_BLOCK_ENABLE_CSR_REG15'/>"
WRITE #1 "        <register address='0xb9e10c4' value='0x" DATA.LONG(A:0x9e10c4) "' name='RPMH_VRM_VOLTAGE_SETTLING_BLOCK_ENABLE_CSR_REG16'/>"
WRITE #1 "        <register address='0xb9e11c4' value='0x" DATA.LONG(A:0x9e11c4) "' name='RPMH_VRM_VOLTAGE_SETTLING_BLOCK_ENABLE_CSR_REG17'/>"
WRITE #1 "        <register address='0xb9e12c4' value='0x" DATA.LONG(A:0x9e12c4) "' name='RPMH_VRM_VOLTAGE_SETTLING_BLOCK_ENABLE_CSR_REG18'/>"
WRITE #1 "        <register address='0xb9e13c4' value='0x" DATA.LONG(A:0x9e13c4) "' name='RPMH_VRM_VOLTAGE_SETTLING_BLOCK_ENABLE_CSR_REG19'/>"
WRITE #1 "        <register address='0xb9e14c4' value='0x" DATA.LONG(A:0x9e14c4) "' name='RPMH_VRM_VOLTAGE_SETTLING_BLOCK_ENABLE_CSR_REG20'/>"
WRITE #1 "        <register address='0xb9e15c4' value='0x" DATA.LONG(A:0x9e15c4) "' name='RPMH_VRM_VOLTAGE_SETTLING_BLOCK_ENABLE_CSR_REG21'/>"
WRITE #1 "        <register address='0xb9e16c4' value='0x" DATA.LONG(A:0x9e16c4) "' name='RPMH_VRM_VOLTAGE_SETTLING_BLOCK_ENABLE_CSR_REG22'/>"
WRITE #1 "        <register address='0xb9e17c4' value='0x" DATA.LONG(A:0x9e17c4) "' name='RPMH_VRM_VOLTAGE_SETTLING_BLOCK_ENABLE_CSR_REG23'/>"
WRITE #1 "        <register address='0xb9e18c4' value='0x" DATA.LONG(A:0x9e18c4) "' name='RPMH_VRM_VOLTAGE_SETTLING_BLOCK_ENABLE_CSR_REG24'/>"
WRITE #1 "        <register address='0xb9e19c4' value='0x" DATA.LONG(A:0x9e19c4) "' name='RPMH_VRM_VOLTAGE_SETTLING_BLOCK_ENABLE_CSR_REG25'/>"
WRITE #1 "        <register address='0xb9e1ac4' value='0x" DATA.LONG(A:0x9e1ac4) "' name='RPMH_VRM_VOLTAGE_SETTLING_BLOCK_ENABLE_CSR_REG26'/>"
WRITE #1 "        <register address='0xb9e1bc4' value='0x" DATA.LONG(A:0x9e1bc4) "' name='RPMH_VRM_VOLTAGE_SETTLING_BLOCK_ENABLE_CSR_REG27'/>"
WRITE #1 "        <register address='0xb9e1cc4' value='0x" DATA.LONG(A:0x9e1cc4) "' name='RPMH_VRM_VOLTAGE_SETTLING_BLOCK_ENABLE_CSR_REG28'/>"
WRITE #1 "        <register address='0xb9e1dc4' value='0x" DATA.LONG(A:0x9e1dc4) "' name='RPMH_VRM_VOLTAGE_SETTLING_BLOCK_ENABLE_CSR_REG29'/>"
WRITE #1 "        <register address='0xb9e1ec4' value='0x" DATA.LONG(A:0x9e1ec4) "' name='RPMH_VRM_VOLTAGE_SETTLING_BLOCK_ENABLE_CSR_REG30'/>"
WRITE #1 "        <register address='0xb9e1fc4' value='0x" DATA.LONG(A:0x9e1fc4) "' name='RPMH_VRM_VOLTAGE_SETTLING_BLOCK_ENABLE_CSR_REG31'/>"
WRITE #1 "        <register address='0xb9e20c4' value='0x" DATA.LONG(A:0x9e20c4) "' name='RPMH_VRM_VOLTAGE_SETTLING_BLOCK_ENABLE_CSR_REG32'/>"
WRITE #1 "        <register address='0xb9e21c4' value='0x" DATA.LONG(A:0x9e21c4) "' name='RPMH_VRM_VOLTAGE_SETTLING_BLOCK_ENABLE_CSR_REG33'/>"
WRITE #1 "        <register address='0xb9e22c4' value='0x" DATA.LONG(A:0x9e22c4) "' name='RPMH_VRM_VOLTAGE_SETTLING_BLOCK_ENABLE_CSR_REG34'/>"
WRITE #1 "        <register address='0xb9e23c4' value='0x" DATA.LONG(A:0x9e23c4) "' name='RPMH_VRM_VOLTAGE_SETTLING_BLOCK_ENABLE_CSR_REG35'/>"
WRITE #1 "        <register address='0xb9e24c4' value='0x" DATA.LONG(A:0x9e24c4) "' name='RPMH_VRM_VOLTAGE_SETTLING_BLOCK_ENABLE_CSR_REG36'/>"
WRITE #1 "        <register address='0xb9e25c4' value='0x" DATA.LONG(A:0x9e25c4) "' name='RPMH_VRM_VOLTAGE_SETTLING_BLOCK_ENABLE_CSR_REG37'/>"
WRITE #1 "        <register address='0xb9e26c4' value='0x" DATA.LONG(A:0x9e26c4) "' name='RPMH_VRM_VOLTAGE_SETTLING_BLOCK_ENABLE_CSR_REG38'/>"
WRITE #1 "        <register address='0xb9e27c4' value='0x" DATA.LONG(A:0x9e27c4) "' name='RPMH_VRM_VOLTAGE_SETTLING_BLOCK_ENABLE_CSR_REG39'/>"
WRITE #1 "        <register address='0xb9e28c4' value='0x" DATA.LONG(A:0x9e28c4) "' name='RPMH_VRM_VOLTAGE_SETTLING_BLOCK_ENABLE_CSR_REG40'/>"
WRITE #1 "        <register address='0xb9e29c4' value='0x" DATA.LONG(A:0x9e29c4) "' name='RPMH_VRM_VOLTAGE_SETTLING_BLOCK_ENABLE_CSR_REG41'/>"
WRITE #1 "        <register address='0xb9e2ac4' value='0x" DATA.LONG(A:0x9e2ac4) "' name='RPMH_VRM_VOLTAGE_SETTLING_BLOCK_ENABLE_CSR_REG42'/>"
WRITE #1 "        <register address='0xb9e2bc4' value='0x" DATA.LONG(A:0x9e2bc4) "' name='RPMH_VRM_VOLTAGE_SETTLING_BLOCK_ENABLE_CSR_REG43'/>"
WRITE #1 "        <register address='0xb9e2cc4' value='0x" DATA.LONG(A:0x9e2cc4) "' name='RPMH_VRM_VOLTAGE_SETTLING_BLOCK_ENABLE_CSR_REG44'/>"
WRITE #1 "        <register address='0xb9e2dc4' value='0x" DATA.LONG(A:0x9e2dc4) "' name='RPMH_VRM_VOLTAGE_SETTLING_BLOCK_ENABLE_CSR_REG45'/>"
WRITE #1 "        <register address='0xb9e00c8' value='0x" DATA.LONG(A:0x9e00c8) "' name='RPMH_VRM_ENABLE_SETTLING_BLOCK_ENABLE_CSR_REG0'/>"
WRITE #1 "        <register address='0xb9e01c8' value='0x" DATA.LONG(A:0x9e01c8) "' name='RPMH_VRM_ENABLE_SETTLING_BLOCK_ENABLE_CSR_REG1'/>"
WRITE #1 "        <register address='0xb9e02c8' value='0x" DATA.LONG(A:0x9e02c8) "' name='RPMH_VRM_ENABLE_SETTLING_BLOCK_ENABLE_CSR_REG2'/>"
WRITE #1 "        <register address='0xb9e03c8' value='0x" DATA.LONG(A:0x9e03c8) "' name='RPMH_VRM_ENABLE_SETTLING_BLOCK_ENABLE_CSR_REG3'/>"
WRITE #1 "        <register address='0xb9e04c8' value='0x" DATA.LONG(A:0x9e04c8) "' name='RPMH_VRM_ENABLE_SETTLING_BLOCK_ENABLE_CSR_REG4'/>"
WRITE #1 "        <register address='0xb9e05c8' value='0x" DATA.LONG(A:0x9e05c8) "' name='RPMH_VRM_ENABLE_SETTLING_BLOCK_ENABLE_CSR_REG5'/>"
WRITE #1 "        <register address='0xb9e06c8' value='0x" DATA.LONG(A:0x9e06c8) "' name='RPMH_VRM_ENABLE_SETTLING_BLOCK_ENABLE_CSR_REG6'/>"
WRITE #1 "        <register address='0xb9e07c8' value='0x" DATA.LONG(A:0x9e07c8) "' name='RPMH_VRM_ENABLE_SETTLING_BLOCK_ENABLE_CSR_REG7'/>"
WRITE #1 "        <register address='0xb9e08c8' value='0x" DATA.LONG(A:0x9e08c8) "' name='RPMH_VRM_ENABLE_SETTLING_BLOCK_ENABLE_CSR_REG8'/>"
WRITE #1 "        <register address='0xb9e09c8' value='0x" DATA.LONG(A:0x9e09c8) "' name='RPMH_VRM_ENABLE_SETTLING_BLOCK_ENABLE_CSR_REG9'/>"
WRITE #1 "        <register address='0xb9e0ac8' value='0x" DATA.LONG(A:0x9e0ac8) "' name='RPMH_VRM_ENABLE_SETTLING_BLOCK_ENABLE_CSR_REG10'/>"
WRITE #1 "        <register address='0xb9e0bc8' value='0x" DATA.LONG(A:0x9e0bc8) "' name='RPMH_VRM_ENABLE_SETTLING_BLOCK_ENABLE_CSR_REG11'/>"
WRITE #1 "        <register address='0xb9e0cc8' value='0x" DATA.LONG(A:0x9e0cc8) "' name='RPMH_VRM_ENABLE_SETTLING_BLOCK_ENABLE_CSR_REG12'/>"
WRITE #1 "        <register address='0xb9e0dc8' value='0x" DATA.LONG(A:0x9e0dc8) "' name='RPMH_VRM_ENABLE_SETTLING_BLOCK_ENABLE_CSR_REG13'/>"
WRITE #1 "        <register address='0xb9e0ec8' value='0x" DATA.LONG(A:0x9e0ec8) "' name='RPMH_VRM_ENABLE_SETTLING_BLOCK_ENABLE_CSR_REG14'/>"
WRITE #1 "        <register address='0xb9e0fc8' value='0x" DATA.LONG(A:0x9e0fc8) "' name='RPMH_VRM_ENABLE_SETTLING_BLOCK_ENABLE_CSR_REG15'/>"
WRITE #1 "        <register address='0xb9e10c8' value='0x" DATA.LONG(A:0x9e10c8) "' name='RPMH_VRM_ENABLE_SETTLING_BLOCK_ENABLE_CSR_REG16'/>"
WRITE #1 "        <register address='0xb9e11c8' value='0x" DATA.LONG(A:0x9e11c8) "' name='RPMH_VRM_ENABLE_SETTLING_BLOCK_ENABLE_CSR_REG17'/>"
WRITE #1 "        <register address='0xb9e12c8' value='0x" DATA.LONG(A:0x9e12c8) "' name='RPMH_VRM_ENABLE_SETTLING_BLOCK_ENABLE_CSR_REG18'/>"
WRITE #1 "        <register address='0xb9e13c8' value='0x" DATA.LONG(A:0x9e13c8) "' name='RPMH_VRM_ENABLE_SETTLING_BLOCK_ENABLE_CSR_REG19'/>"
WRITE #1 "        <register address='0xb9e14c8' value='0x" DATA.LONG(A:0x9e14c8) "' name='RPMH_VRM_ENABLE_SETTLING_BLOCK_ENABLE_CSR_REG20'/>"
WRITE #1 "        <register address='0xb9e15c8' value='0x" DATA.LONG(A:0x9e15c8) "' name='RPMH_VRM_ENABLE_SETTLING_BLOCK_ENABLE_CSR_REG21'/>"
WRITE #1 "        <register address='0xb9e16c8' value='0x" DATA.LONG(A:0x9e16c8) "' name='RPMH_VRM_ENABLE_SETTLING_BLOCK_ENABLE_CSR_REG22'/>"
WRITE #1 "        <register address='0xb9e17c8' value='0x" DATA.LONG(A:0x9e17c8) "' name='RPMH_VRM_ENABLE_SETTLING_BLOCK_ENABLE_CSR_REG23'/>"
WRITE #1 "        <register address='0xb9e18c8' value='0x" DATA.LONG(A:0x9e18c8) "' name='RPMH_VRM_ENABLE_SETTLING_BLOCK_ENABLE_CSR_REG24'/>"
WRITE #1 "        <register address='0xb9e19c8' value='0x" DATA.LONG(A:0x9e19c8) "' name='RPMH_VRM_ENABLE_SETTLING_BLOCK_ENABLE_CSR_REG25'/>"
WRITE #1 "        <register address='0xb9e1ac8' value='0x" DATA.LONG(A:0x9e1ac8) "' name='RPMH_VRM_ENABLE_SETTLING_BLOCK_ENABLE_CSR_REG26'/>"
WRITE #1 "        <register address='0xb9e1bc8' value='0x" DATA.LONG(A:0x9e1bc8) "' name='RPMH_VRM_ENABLE_SETTLING_BLOCK_ENABLE_CSR_REG27'/>"
WRITE #1 "        <register address='0xb9e1cc8' value='0x" DATA.LONG(A:0x9e1cc8) "' name='RPMH_VRM_ENABLE_SETTLING_BLOCK_ENABLE_CSR_REG28'/>"
WRITE #1 "        <register address='0xb9e1dc8' value='0x" DATA.LONG(A:0x9e1dc8) "' name='RPMH_VRM_ENABLE_SETTLING_BLOCK_ENABLE_CSR_REG29'/>"
WRITE #1 "        <register address='0xb9e1ec8' value='0x" DATA.LONG(A:0x9e1ec8) "' name='RPMH_VRM_ENABLE_SETTLING_BLOCK_ENABLE_CSR_REG30'/>"
WRITE #1 "        <register address='0xb9e1fc8' value='0x" DATA.LONG(A:0x9e1fc8) "' name='RPMH_VRM_ENABLE_SETTLING_BLOCK_ENABLE_CSR_REG31'/>"
WRITE #1 "        <register address='0xb9e20c8' value='0x" DATA.LONG(A:0x9e20c8) "' name='RPMH_VRM_ENABLE_SETTLING_BLOCK_ENABLE_CSR_REG32'/>"
WRITE #1 "        <register address='0xb9e21c8' value='0x" DATA.LONG(A:0x9e21c8) "' name='RPMH_VRM_ENABLE_SETTLING_BLOCK_ENABLE_CSR_REG33'/>"
WRITE #1 "        <register address='0xb9e22c8' value='0x" DATA.LONG(A:0x9e22c8) "' name='RPMH_VRM_ENABLE_SETTLING_BLOCK_ENABLE_CSR_REG34'/>"
WRITE #1 "        <register address='0xb9e23c8' value='0x" DATA.LONG(A:0x9e23c8) "' name='RPMH_VRM_ENABLE_SETTLING_BLOCK_ENABLE_CSR_REG35'/>"
WRITE #1 "        <register address='0xb9e24c8' value='0x" DATA.LONG(A:0x9e24c8) "' name='RPMH_VRM_ENABLE_SETTLING_BLOCK_ENABLE_CSR_REG36'/>"
WRITE #1 "        <register address='0xb9e25c8' value='0x" DATA.LONG(A:0x9e25c8) "' name='RPMH_VRM_ENABLE_SETTLING_BLOCK_ENABLE_CSR_REG37'/>"
WRITE #1 "        <register address='0xb9e26c8' value='0x" DATA.LONG(A:0x9e26c8) "' name='RPMH_VRM_ENABLE_SETTLING_BLOCK_ENABLE_CSR_REG38'/>"
WRITE #1 "        <register address='0xb9e27c8' value='0x" DATA.LONG(A:0x9e27c8) "' name='RPMH_VRM_ENABLE_SETTLING_BLOCK_ENABLE_CSR_REG39'/>"
WRITE #1 "        <register address='0xb9e28c8' value='0x" DATA.LONG(A:0x9e28c8) "' name='RPMH_VRM_ENABLE_SETTLING_BLOCK_ENABLE_CSR_REG40'/>"
WRITE #1 "        <register address='0xb9e29c8' value='0x" DATA.LONG(A:0x9e29c8) "' name='RPMH_VRM_ENABLE_SETTLING_BLOCK_ENABLE_CSR_REG41'/>"
WRITE #1 "        <register address='0xb9e2ac8' value='0x" DATA.LONG(A:0x9e2ac8) "' name='RPMH_VRM_ENABLE_SETTLING_BLOCK_ENABLE_CSR_REG42'/>"
WRITE #1 "        <register address='0xb9e2bc8' value='0x" DATA.LONG(A:0x9e2bc8) "' name='RPMH_VRM_ENABLE_SETTLING_BLOCK_ENABLE_CSR_REG43'/>"
WRITE #1 "        <register address='0xb9e2cc8' value='0x" DATA.LONG(A:0x9e2cc8) "' name='RPMH_VRM_ENABLE_SETTLING_BLOCK_ENABLE_CSR_REG44'/>"
WRITE #1 "        <register address='0xb9e2dc8' value='0x" DATA.LONG(A:0x9e2dc8) "' name='RPMH_VRM_ENABLE_SETTLING_BLOCK_ENABLE_CSR_REG45'/>"
WRITE #1 "        <register address='0xb9e00cc' value='0x" DATA.LONG(A:0x9e00cc) "' name='RPMH_VRM_MODE_SETTLING_BLOCK_ENABLE_CSR_REG0'/>"
WRITE #1 "        <register address='0xb9e01cc' value='0x" DATA.LONG(A:0x9e01cc) "' name='RPMH_VRM_MODE_SETTLING_BLOCK_ENABLE_CSR_REG1'/>"
WRITE #1 "        <register address='0xb9e02cc' value='0x" DATA.LONG(A:0x9e02cc) "' name='RPMH_VRM_MODE_SETTLING_BLOCK_ENABLE_CSR_REG2'/>"
WRITE #1 "        <register address='0xb9e03cc' value='0x" DATA.LONG(A:0x9e03cc) "' name='RPMH_VRM_MODE_SETTLING_BLOCK_ENABLE_CSR_REG3'/>"
WRITE #1 "        <register address='0xb9e04cc' value='0x" DATA.LONG(A:0x9e04cc) "' name='RPMH_VRM_MODE_SETTLING_BLOCK_ENABLE_CSR_REG4'/>"
WRITE #1 "        <register address='0xb9e05cc' value='0x" DATA.LONG(A:0x9e05cc) "' name='RPMH_VRM_MODE_SETTLING_BLOCK_ENABLE_CSR_REG5'/>"
WRITE #1 "        <register address='0xb9e06cc' value='0x" DATA.LONG(A:0x9e06cc) "' name='RPMH_VRM_MODE_SETTLING_BLOCK_ENABLE_CSR_REG6'/>"
WRITE #1 "        <register address='0xb9e07cc' value='0x" DATA.LONG(A:0x9e07cc) "' name='RPMH_VRM_MODE_SETTLING_BLOCK_ENABLE_CSR_REG7'/>"
WRITE #1 "        <register address='0xb9e08cc' value='0x" DATA.LONG(A:0x9e08cc) "' name='RPMH_VRM_MODE_SETTLING_BLOCK_ENABLE_CSR_REG8'/>"
WRITE #1 "        <register address='0xb9e09cc' value='0x" DATA.LONG(A:0x9e09cc) "' name='RPMH_VRM_MODE_SETTLING_BLOCK_ENABLE_CSR_REG9'/>"
WRITE #1 "        <register address='0xb9e0acc' value='0x" DATA.LONG(A:0x9e0acc) "' name='RPMH_VRM_MODE_SETTLING_BLOCK_ENABLE_CSR_REG10'/>"
WRITE #1 "        <register address='0xb9e0bcc' value='0x" DATA.LONG(A:0x9e0bcc) "' name='RPMH_VRM_MODE_SETTLING_BLOCK_ENABLE_CSR_REG11'/>"
WRITE #1 "        <register address='0xb9e0ccc' value='0x" DATA.LONG(A:0x9e0ccc) "' name='RPMH_VRM_MODE_SETTLING_BLOCK_ENABLE_CSR_REG12'/>"
WRITE #1 "        <register address='0xb9e0dcc' value='0x" DATA.LONG(A:0x9e0dcc) "' name='RPMH_VRM_MODE_SETTLING_BLOCK_ENABLE_CSR_REG13'/>"
WRITE #1 "        <register address='0xb9e0ecc' value='0x" DATA.LONG(A:0x9e0ecc) "' name='RPMH_VRM_MODE_SETTLING_BLOCK_ENABLE_CSR_REG14'/>"
WRITE #1 "        <register address='0xb9e0fcc' value='0x" DATA.LONG(A:0x9e0fcc) "' name='RPMH_VRM_MODE_SETTLING_BLOCK_ENABLE_CSR_REG15'/>"
WRITE #1 "        <register address='0xb9e10cc' value='0x" DATA.LONG(A:0x9e10cc) "' name='RPMH_VRM_MODE_SETTLING_BLOCK_ENABLE_CSR_REG16'/>"
WRITE #1 "        <register address='0xb9e11cc' value='0x" DATA.LONG(A:0x9e11cc) "' name='RPMH_VRM_MODE_SETTLING_BLOCK_ENABLE_CSR_REG17'/>"
WRITE #1 "        <register address='0xb9e12cc' value='0x" DATA.LONG(A:0x9e12cc) "' name='RPMH_VRM_MODE_SETTLING_BLOCK_ENABLE_CSR_REG18'/>"
WRITE #1 "        <register address='0xb9e13cc' value='0x" DATA.LONG(A:0x9e13cc) "' name='RPMH_VRM_MODE_SETTLING_BLOCK_ENABLE_CSR_REG19'/>"
WRITE #1 "        <register address='0xb9e14cc' value='0x" DATA.LONG(A:0x9e14cc) "' name='RPMH_VRM_MODE_SETTLING_BLOCK_ENABLE_CSR_REG20'/>"
WRITE #1 "        <register address='0xb9e15cc' value='0x" DATA.LONG(A:0x9e15cc) "' name='RPMH_VRM_MODE_SETTLING_BLOCK_ENABLE_CSR_REG21'/>"
WRITE #1 "        <register address='0xb9e16cc' value='0x" DATA.LONG(A:0x9e16cc) "' name='RPMH_VRM_MODE_SETTLING_BLOCK_ENABLE_CSR_REG22'/>"
WRITE #1 "        <register address='0xb9e17cc' value='0x" DATA.LONG(A:0x9e17cc) "' name='RPMH_VRM_MODE_SETTLING_BLOCK_ENABLE_CSR_REG23'/>"
WRITE #1 "        <register address='0xb9e18cc' value='0x" DATA.LONG(A:0x9e18cc) "' name='RPMH_VRM_MODE_SETTLING_BLOCK_ENABLE_CSR_REG24'/>"
WRITE #1 "        <register address='0xb9e19cc' value='0x" DATA.LONG(A:0x9e19cc) "' name='RPMH_VRM_MODE_SETTLING_BLOCK_ENABLE_CSR_REG25'/>"
WRITE #1 "        <register address='0xb9e1acc' value='0x" DATA.LONG(A:0x9e1acc) "' name='RPMH_VRM_MODE_SETTLING_BLOCK_ENABLE_CSR_REG26'/>"
WRITE #1 "        <register address='0xb9e1bcc' value='0x" DATA.LONG(A:0x9e1bcc) "' name='RPMH_VRM_MODE_SETTLING_BLOCK_ENABLE_CSR_REG27'/>"
WRITE #1 "        <register address='0xb9e1ccc' value='0x" DATA.LONG(A:0x9e1ccc) "' name='RPMH_VRM_MODE_SETTLING_BLOCK_ENABLE_CSR_REG28'/>"
WRITE #1 "        <register address='0xb9e1dcc' value='0x" DATA.LONG(A:0x9e1dcc) "' name='RPMH_VRM_MODE_SETTLING_BLOCK_ENABLE_CSR_REG29'/>"
WRITE #1 "        <register address='0xb9e1ecc' value='0x" DATA.LONG(A:0x9e1ecc) "' name='RPMH_VRM_MODE_SETTLING_BLOCK_ENABLE_CSR_REG30'/>"
WRITE #1 "        <register address='0xb9e1fcc' value='0x" DATA.LONG(A:0x9e1fcc) "' name='RPMH_VRM_MODE_SETTLING_BLOCK_ENABLE_CSR_REG31'/>"
WRITE #1 "        <register address='0xb9e20cc' value='0x" DATA.LONG(A:0x9e20cc) "' name='RPMH_VRM_MODE_SETTLING_BLOCK_ENABLE_CSR_REG32'/>"
WRITE #1 "        <register address='0xb9e21cc' value='0x" DATA.LONG(A:0x9e21cc) "' name='RPMH_VRM_MODE_SETTLING_BLOCK_ENABLE_CSR_REG33'/>"
WRITE #1 "        <register address='0xb9e22cc' value='0x" DATA.LONG(A:0x9e22cc) "' name='RPMH_VRM_MODE_SETTLING_BLOCK_ENABLE_CSR_REG34'/>"
WRITE #1 "        <register address='0xb9e23cc' value='0x" DATA.LONG(A:0x9e23cc) "' name='RPMH_VRM_MODE_SETTLING_BLOCK_ENABLE_CSR_REG35'/>"
WRITE #1 "        <register address='0xb9e24cc' value='0x" DATA.LONG(A:0x9e24cc) "' name='RPMH_VRM_MODE_SETTLING_BLOCK_ENABLE_CSR_REG36'/>"
WRITE #1 "        <register address='0xb9e25cc' value='0x" DATA.LONG(A:0x9e25cc) "' name='RPMH_VRM_MODE_SETTLING_BLOCK_ENABLE_CSR_REG37'/>"
WRITE #1 "        <register address='0xb9e26cc' value='0x" DATA.LONG(A:0x9e26cc) "' name='RPMH_VRM_MODE_SETTLING_BLOCK_ENABLE_CSR_REG38'/>"
WRITE #1 "        <register address='0xb9e27cc' value='0x" DATA.LONG(A:0x9e27cc) "' name='RPMH_VRM_MODE_SETTLING_BLOCK_ENABLE_CSR_REG39'/>"
WRITE #1 "        <register address='0xb9e28cc' value='0x" DATA.LONG(A:0x9e28cc) "' name='RPMH_VRM_MODE_SETTLING_BLOCK_ENABLE_CSR_REG40'/>"
WRITE #1 "        <register address='0xb9e29cc' value='0x" DATA.LONG(A:0x9e29cc) "' name='RPMH_VRM_MODE_SETTLING_BLOCK_ENABLE_CSR_REG41'/>"
WRITE #1 "        <register address='0xb9e2acc' value='0x" DATA.LONG(A:0x9e2acc) "' name='RPMH_VRM_MODE_SETTLING_BLOCK_ENABLE_CSR_REG42'/>"
WRITE #1 "        <register address='0xb9e2bcc' value='0x" DATA.LONG(A:0x9e2bcc) "' name='RPMH_VRM_MODE_SETTLING_BLOCK_ENABLE_CSR_REG43'/>"
WRITE #1 "        <register address='0xb9e2ccc' value='0x" DATA.LONG(A:0x9e2ccc) "' name='RPMH_VRM_MODE_SETTLING_BLOCK_ENABLE_CSR_REG44'/>"
WRITE #1 "        <register address='0xb9e2dcc' value='0x" DATA.LONG(A:0x9e2dcc) "' name='RPMH_VRM_MODE_SETTLING_BLOCK_ENABLE_CSR_REG45'/>"
WRITE #1 "        <register address='0xb9e00d4' value='0x" DATA.LONG(A:0x9e00d4) "' name='RPMH_VRM_VREG_READY_ENABLE_CSR_REG0'/>"
WRITE #1 "        <register address='0xb9e01d4' value='0x" DATA.LONG(A:0x9e01d4) "' name='RPMH_VRM_VREG_READY_ENABLE_CSR_REG1'/>"
WRITE #1 "        <register address='0xb9e02d4' value='0x" DATA.LONG(A:0x9e02d4) "' name='RPMH_VRM_VREG_READY_ENABLE_CSR_REG2'/>"
WRITE #1 "        <register address='0xb9e03d4' value='0x" DATA.LONG(A:0x9e03d4) "' name='RPMH_VRM_VREG_READY_ENABLE_CSR_REG3'/>"
WRITE #1 "        <register address='0xb9e04d4' value='0x" DATA.LONG(A:0x9e04d4) "' name='RPMH_VRM_VREG_READY_ENABLE_CSR_REG4'/>"
WRITE #1 "        <register address='0xb9e05d4' value='0x" DATA.LONG(A:0x9e05d4) "' name='RPMH_VRM_VREG_READY_ENABLE_CSR_REG5'/>"
WRITE #1 "        <register address='0xb9e06d4' value='0x" DATA.LONG(A:0x9e06d4) "' name='RPMH_VRM_VREG_READY_ENABLE_CSR_REG6'/>"
WRITE #1 "        <register address='0xb9e07d4' value='0x" DATA.LONG(A:0x9e07d4) "' name='RPMH_VRM_VREG_READY_ENABLE_CSR_REG7'/>"
WRITE #1 "        <register address='0xb9e08d4' value='0x" DATA.LONG(A:0x9e08d4) "' name='RPMH_VRM_VREG_READY_ENABLE_CSR_REG8'/>"
WRITE #1 "        <register address='0xb9e09d4' value='0x" DATA.LONG(A:0x9e09d4) "' name='RPMH_VRM_VREG_READY_ENABLE_CSR_REG9'/>"
WRITE #1 "        <register address='0xb9e0ad4' value='0x" DATA.LONG(A:0x9e0ad4) "' name='RPMH_VRM_VREG_READY_ENABLE_CSR_REG10'/>"
WRITE #1 "        <register address='0xb9e0bd4' value='0x" DATA.LONG(A:0x9e0bd4) "' name='RPMH_VRM_VREG_READY_ENABLE_CSR_REG11'/>"
WRITE #1 "        <register address='0xb9e0cd4' value='0x" DATA.LONG(A:0x9e0cd4) "' name='RPMH_VRM_VREG_READY_ENABLE_CSR_REG12'/>"
WRITE #1 "        <register address='0xb9e0dd4' value='0x" DATA.LONG(A:0x9e0dd4) "' name='RPMH_VRM_VREG_READY_ENABLE_CSR_REG13'/>"
WRITE #1 "        <register address='0xb9e0ed4' value='0x" DATA.LONG(A:0x9e0ed4) "' name='RPMH_VRM_VREG_READY_ENABLE_CSR_REG14'/>"
WRITE #1 "        <register address='0xb9e0fd4' value='0x" DATA.LONG(A:0x9e0fd4) "' name='RPMH_VRM_VREG_READY_ENABLE_CSR_REG15'/>"
WRITE #1 "        <register address='0xb9e10d4' value='0x" DATA.LONG(A:0x9e10d4) "' name='RPMH_VRM_VREG_READY_ENABLE_CSR_REG16'/>"
WRITE #1 "        <register address='0xb9e11d4' value='0x" DATA.LONG(A:0x9e11d4) "' name='RPMH_VRM_VREG_READY_ENABLE_CSR_REG17'/>"
WRITE #1 "        <register address='0xb9e12d4' value='0x" DATA.LONG(A:0x9e12d4) "' name='RPMH_VRM_VREG_READY_ENABLE_CSR_REG18'/>"
WRITE #1 "        <register address='0xb9e13d4' value='0x" DATA.LONG(A:0x9e13d4) "' name='RPMH_VRM_VREG_READY_ENABLE_CSR_REG19'/>"
WRITE #1 "        <register address='0xb9e14d4' value='0x" DATA.LONG(A:0x9e14d4) "' name='RPMH_VRM_VREG_READY_ENABLE_CSR_REG20'/>"
WRITE #1 "        <register address='0xb9e15d4' value='0x" DATA.LONG(A:0x9e15d4) "' name='RPMH_VRM_VREG_READY_ENABLE_CSR_REG21'/>"
WRITE #1 "        <register address='0xb9e16d4' value='0x" DATA.LONG(A:0x9e16d4) "' name='RPMH_VRM_VREG_READY_ENABLE_CSR_REG22'/>"
WRITE #1 "        <register address='0xb9e17d4' value='0x" DATA.LONG(A:0x9e17d4) "' name='RPMH_VRM_VREG_READY_ENABLE_CSR_REG23'/>"
WRITE #1 "        <register address='0xb9e18d4' value='0x" DATA.LONG(A:0x9e18d4) "' name='RPMH_VRM_VREG_READY_ENABLE_CSR_REG24'/>"
WRITE #1 "        <register address='0xb9e19d4' value='0x" DATA.LONG(A:0x9e19d4) "' name='RPMH_VRM_VREG_READY_ENABLE_CSR_REG25'/>"
WRITE #1 "        <register address='0xb9e1ad4' value='0x" DATA.LONG(A:0x9e1ad4) "' name='RPMH_VRM_VREG_READY_ENABLE_CSR_REG26'/>"
WRITE #1 "        <register address='0xb9e1bd4' value='0x" DATA.LONG(A:0x9e1bd4) "' name='RPMH_VRM_VREG_READY_ENABLE_CSR_REG27'/>"
WRITE #1 "        <register address='0xb9e1cd4' value='0x" DATA.LONG(A:0x9e1cd4) "' name='RPMH_VRM_VREG_READY_ENABLE_CSR_REG28'/>"
WRITE #1 "        <register address='0xb9e1dd4' value='0x" DATA.LONG(A:0x9e1dd4) "' name='RPMH_VRM_VREG_READY_ENABLE_CSR_REG29'/>"
WRITE #1 "        <register address='0xb9e1ed4' value='0x" DATA.LONG(A:0x9e1ed4) "' name='RPMH_VRM_VREG_READY_ENABLE_CSR_REG30'/>"
WRITE #1 "        <register address='0xb9e1fd4' value='0x" DATA.LONG(A:0x9e1fd4) "' name='RPMH_VRM_VREG_READY_ENABLE_CSR_REG31'/>"
WRITE #1 "        <register address='0xb9e20d4' value='0x" DATA.LONG(A:0x9e20d4) "' name='RPMH_VRM_VREG_READY_ENABLE_CSR_REG32'/>"
WRITE #1 "        <register address='0xb9e21d4' value='0x" DATA.LONG(A:0x9e21d4) "' name='RPMH_VRM_VREG_READY_ENABLE_CSR_REG33'/>"
WRITE #1 "        <register address='0xb9e22d4' value='0x" DATA.LONG(A:0x9e22d4) "' name='RPMH_VRM_VREG_READY_ENABLE_CSR_REG34'/>"
WRITE #1 "        <register address='0xb9e23d4' value='0x" DATA.LONG(A:0x9e23d4) "' name='RPMH_VRM_VREG_READY_ENABLE_CSR_REG35'/>"
WRITE #1 "        <register address='0xb9e24d4' value='0x" DATA.LONG(A:0x9e24d4) "' name='RPMH_VRM_VREG_READY_ENABLE_CSR_REG36'/>"
WRITE #1 "        <register address='0xb9e25d4' value='0x" DATA.LONG(A:0x9e25d4) "' name='RPMH_VRM_VREG_READY_ENABLE_CSR_REG37'/>"
WRITE #1 "        <register address='0xb9e26d4' value='0x" DATA.LONG(A:0x9e26d4) "' name='RPMH_VRM_VREG_READY_ENABLE_CSR_REG38'/>"
WRITE #1 "        <register address='0xb9e27d4' value='0x" DATA.LONG(A:0x9e27d4) "' name='RPMH_VRM_VREG_READY_ENABLE_CSR_REG39'/>"
WRITE #1 "        <register address='0xb9e28d4' value='0x" DATA.LONG(A:0x9e28d4) "' name='RPMH_VRM_VREG_READY_ENABLE_CSR_REG40'/>"
WRITE #1 "        <register address='0xb9e29d4' value='0x" DATA.LONG(A:0x9e29d4) "' name='RPMH_VRM_VREG_READY_ENABLE_CSR_REG41'/>"
WRITE #1 "        <register address='0xb9e2ad4' value='0x" DATA.LONG(A:0x9e2ad4) "' name='RPMH_VRM_VREG_READY_ENABLE_CSR_REG42'/>"
WRITE #1 "        <register address='0xb9e2bd4' value='0x" DATA.LONG(A:0x9e2bd4) "' name='RPMH_VRM_VREG_READY_ENABLE_CSR_REG43'/>"
WRITE #1 "        <register address='0xb9e2cd4' value='0x" DATA.LONG(A:0x9e2cd4) "' name='RPMH_VRM_VREG_READY_ENABLE_CSR_REG44'/>"
WRITE #1 "        <register address='0xb9e2dd4' value='0x" DATA.LONG(A:0x9e2dd4) "' name='RPMH_VRM_VREG_READY_ENABLE_CSR_REG45'/>"
WRITE #1 "        <register address='0xb9e00d8' value='0x" DATA.LONG(A:0x9e00d8) "' name='RPMH_VRM_VREG_READY_WDOG_ERROR_ENABLE_CSR_REG0'/>"
WRITE #1 "        <register address='0xb9e01d8' value='0x" DATA.LONG(A:0x9e01d8) "' name='RPMH_VRM_VREG_READY_WDOG_ERROR_ENABLE_CSR_REG1'/>"
WRITE #1 "        <register address='0xb9e02d8' value='0x" DATA.LONG(A:0x9e02d8) "' name='RPMH_VRM_VREG_READY_WDOG_ERROR_ENABLE_CSR_REG2'/>"
WRITE #1 "        <register address='0xb9e03d8' value='0x" DATA.LONG(A:0x9e03d8) "' name='RPMH_VRM_VREG_READY_WDOG_ERROR_ENABLE_CSR_REG3'/>"
WRITE #1 "        <register address='0xb9e04d8' value='0x" DATA.LONG(A:0x9e04d8) "' name='RPMH_VRM_VREG_READY_WDOG_ERROR_ENABLE_CSR_REG4'/>"
WRITE #1 "        <register address='0xb9e05d8' value='0x" DATA.LONG(A:0x9e05d8) "' name='RPMH_VRM_VREG_READY_WDOG_ERROR_ENABLE_CSR_REG5'/>"
WRITE #1 "        <register address='0xb9e06d8' value='0x" DATA.LONG(A:0x9e06d8) "' name='RPMH_VRM_VREG_READY_WDOG_ERROR_ENABLE_CSR_REG6'/>"
WRITE #1 "        <register address='0xb9e07d8' value='0x" DATA.LONG(A:0x9e07d8) "' name='RPMH_VRM_VREG_READY_WDOG_ERROR_ENABLE_CSR_REG7'/>"
WRITE #1 "        <register address='0xb9e08d8' value='0x" DATA.LONG(A:0x9e08d8) "' name='RPMH_VRM_VREG_READY_WDOG_ERROR_ENABLE_CSR_REG8'/>"
WRITE #1 "        <register address='0xb9e09d8' value='0x" DATA.LONG(A:0x9e09d8) "' name='RPMH_VRM_VREG_READY_WDOG_ERROR_ENABLE_CSR_REG9'/>"
WRITE #1 "        <register address='0xb9e0ad8' value='0x" DATA.LONG(A:0x9e0ad8) "' name='RPMH_VRM_VREG_READY_WDOG_ERROR_ENABLE_CSR_REG10'/>"
WRITE #1 "        <register address='0xb9e0bd8' value='0x" DATA.LONG(A:0x9e0bd8) "' name='RPMH_VRM_VREG_READY_WDOG_ERROR_ENABLE_CSR_REG11'/>"
WRITE #1 "        <register address='0xb9e0cd8' value='0x" DATA.LONG(A:0x9e0cd8) "' name='RPMH_VRM_VREG_READY_WDOG_ERROR_ENABLE_CSR_REG12'/>"
WRITE #1 "        <register address='0xb9e0dd8' value='0x" DATA.LONG(A:0x9e0dd8) "' name='RPMH_VRM_VREG_READY_WDOG_ERROR_ENABLE_CSR_REG13'/>"
WRITE #1 "        <register address='0xb9e0ed8' value='0x" DATA.LONG(A:0x9e0ed8) "' name='RPMH_VRM_VREG_READY_WDOG_ERROR_ENABLE_CSR_REG14'/>"
WRITE #1 "        <register address='0xb9e0fd8' value='0x" DATA.LONG(A:0x9e0fd8) "' name='RPMH_VRM_VREG_READY_WDOG_ERROR_ENABLE_CSR_REG15'/>"
WRITE #1 "        <register address='0xb9e10d8' value='0x" DATA.LONG(A:0x9e10d8) "' name='RPMH_VRM_VREG_READY_WDOG_ERROR_ENABLE_CSR_REG16'/>"
WRITE #1 "        <register address='0xb9e11d8' value='0x" DATA.LONG(A:0x9e11d8) "' name='RPMH_VRM_VREG_READY_WDOG_ERROR_ENABLE_CSR_REG17'/>"
WRITE #1 "        <register address='0xb9e12d8' value='0x" DATA.LONG(A:0x9e12d8) "' name='RPMH_VRM_VREG_READY_WDOG_ERROR_ENABLE_CSR_REG18'/>"
WRITE #1 "        <register address='0xb9e13d8' value='0x" DATA.LONG(A:0x9e13d8) "' name='RPMH_VRM_VREG_READY_WDOG_ERROR_ENABLE_CSR_REG19'/>"
WRITE #1 "        <register address='0xb9e14d8' value='0x" DATA.LONG(A:0x9e14d8) "' name='RPMH_VRM_VREG_READY_WDOG_ERROR_ENABLE_CSR_REG20'/>"
WRITE #1 "        <register address='0xb9e15d8' value='0x" DATA.LONG(A:0x9e15d8) "' name='RPMH_VRM_VREG_READY_WDOG_ERROR_ENABLE_CSR_REG21'/>"
WRITE #1 "        <register address='0xb9e16d8' value='0x" DATA.LONG(A:0x9e16d8) "' name='RPMH_VRM_VREG_READY_WDOG_ERROR_ENABLE_CSR_REG22'/>"
WRITE #1 "        <register address='0xb9e17d8' value='0x" DATA.LONG(A:0x9e17d8) "' name='RPMH_VRM_VREG_READY_WDOG_ERROR_ENABLE_CSR_REG23'/>"
WRITE #1 "        <register address='0xb9e18d8' value='0x" DATA.LONG(A:0x9e18d8) "' name='RPMH_VRM_VREG_READY_WDOG_ERROR_ENABLE_CSR_REG24'/>"
WRITE #1 "        <register address='0xb9e19d8' value='0x" DATA.LONG(A:0x9e19d8) "' name='RPMH_VRM_VREG_READY_WDOG_ERROR_ENABLE_CSR_REG25'/>"
WRITE #1 "        <register address='0xb9e1ad8' value='0x" DATA.LONG(A:0x9e1ad8) "' name='RPMH_VRM_VREG_READY_WDOG_ERROR_ENABLE_CSR_REG26'/>"
WRITE #1 "        <register address='0xb9e1bd8' value='0x" DATA.LONG(A:0x9e1bd8) "' name='RPMH_VRM_VREG_READY_WDOG_ERROR_ENABLE_CSR_REG27'/>"
WRITE #1 "        <register address='0xb9e1cd8' value='0x" DATA.LONG(A:0x9e1cd8) "' name='RPMH_VRM_VREG_READY_WDOG_ERROR_ENABLE_CSR_REG28'/>"
WRITE #1 "        <register address='0xb9e1dd8' value='0x" DATA.LONG(A:0x9e1dd8) "' name='RPMH_VRM_VREG_READY_WDOG_ERROR_ENABLE_CSR_REG29'/>"
WRITE #1 "        <register address='0xb9e1ed8' value='0x" DATA.LONG(A:0x9e1ed8) "' name='RPMH_VRM_VREG_READY_WDOG_ERROR_ENABLE_CSR_REG30'/>"
WRITE #1 "        <register address='0xb9e1fd8' value='0x" DATA.LONG(A:0x9e1fd8) "' name='RPMH_VRM_VREG_READY_WDOG_ERROR_ENABLE_CSR_REG31'/>"
WRITE #1 "        <register address='0xb9e20d8' value='0x" DATA.LONG(A:0x9e20d8) "' name='RPMH_VRM_VREG_READY_WDOG_ERROR_ENABLE_CSR_REG32'/>"
WRITE #1 "        <register address='0xb9e21d8' value='0x" DATA.LONG(A:0x9e21d8) "' name='RPMH_VRM_VREG_READY_WDOG_ERROR_ENABLE_CSR_REG33'/>"
WRITE #1 "        <register address='0xb9e22d8' value='0x" DATA.LONG(A:0x9e22d8) "' name='RPMH_VRM_VREG_READY_WDOG_ERROR_ENABLE_CSR_REG34'/>"
WRITE #1 "        <register address='0xb9e23d8' value='0x" DATA.LONG(A:0x9e23d8) "' name='RPMH_VRM_VREG_READY_WDOG_ERROR_ENABLE_CSR_REG35'/>"
WRITE #1 "        <register address='0xb9e24d8' value='0x" DATA.LONG(A:0x9e24d8) "' name='RPMH_VRM_VREG_READY_WDOG_ERROR_ENABLE_CSR_REG36'/>"
WRITE #1 "        <register address='0xb9e25d8' value='0x" DATA.LONG(A:0x9e25d8) "' name='RPMH_VRM_VREG_READY_WDOG_ERROR_ENABLE_CSR_REG37'/>"
WRITE #1 "        <register address='0xb9e26d8' value='0x" DATA.LONG(A:0x9e26d8) "' name='RPMH_VRM_VREG_READY_WDOG_ERROR_ENABLE_CSR_REG38'/>"
WRITE #1 "        <register address='0xb9e27d8' value='0x" DATA.LONG(A:0x9e27d8) "' name='RPMH_VRM_VREG_READY_WDOG_ERROR_ENABLE_CSR_REG39'/>"
WRITE #1 "        <register address='0xb9e28d8' value='0x" DATA.LONG(A:0x9e28d8) "' name='RPMH_VRM_VREG_READY_WDOG_ERROR_ENABLE_CSR_REG40'/>"
WRITE #1 "        <register address='0xb9e29d8' value='0x" DATA.LONG(A:0x9e29d8) "' name='RPMH_VRM_VREG_READY_WDOG_ERROR_ENABLE_CSR_REG41'/>"
WRITE #1 "        <register address='0xb9e2ad8' value='0x" DATA.LONG(A:0x9e2ad8) "' name='RPMH_VRM_VREG_READY_WDOG_ERROR_ENABLE_CSR_REG42'/>"
WRITE #1 "        <register address='0xb9e2bd8' value='0x" DATA.LONG(A:0x9e2bd8) "' name='RPMH_VRM_VREG_READY_WDOG_ERROR_ENABLE_CSR_REG43'/>"
WRITE #1 "        <register address='0xb9e2cd8' value='0x" DATA.LONG(A:0x9e2cd8) "' name='RPMH_VRM_VREG_READY_WDOG_ERROR_ENABLE_CSR_REG44'/>"
WRITE #1 "        <register address='0xb9e2dd8' value='0x" DATA.LONG(A:0x9e2dd8) "' name='RPMH_VRM_VREG_READY_WDOG_ERROR_ENABLE_CSR_REG45'/>"
WRITE #1 "        <register address='0xb9e00dc' value='0x" DATA.LONG(A:0x9e00dc) "' name='RPMH_VRM_VREG_READY_LEGACY_MODE_CSR_REG0'/>"
WRITE #1 "        <register address='0xb9e01dc' value='0x" DATA.LONG(A:0x9e01dc) "' name='RPMH_VRM_VREG_READY_LEGACY_MODE_CSR_REG1'/>"
WRITE #1 "        <register address='0xb9e02dc' value='0x" DATA.LONG(A:0x9e02dc) "' name='RPMH_VRM_VREG_READY_LEGACY_MODE_CSR_REG2'/>"
WRITE #1 "        <register address='0xb9e03dc' value='0x" DATA.LONG(A:0x9e03dc) "' name='RPMH_VRM_VREG_READY_LEGACY_MODE_CSR_REG3'/>"
WRITE #1 "        <register address='0xb9e04dc' value='0x" DATA.LONG(A:0x9e04dc) "' name='RPMH_VRM_VREG_READY_LEGACY_MODE_CSR_REG4'/>"
WRITE #1 "        <register address='0xb9e05dc' value='0x" DATA.LONG(A:0x9e05dc) "' name='RPMH_VRM_VREG_READY_LEGACY_MODE_CSR_REG5'/>"
WRITE #1 "        <register address='0xb9e06dc' value='0x" DATA.LONG(A:0x9e06dc) "' name='RPMH_VRM_VREG_READY_LEGACY_MODE_CSR_REG6'/>"
WRITE #1 "        <register address='0xb9e07dc' value='0x" DATA.LONG(A:0x9e07dc) "' name='RPMH_VRM_VREG_READY_LEGACY_MODE_CSR_REG7'/>"
WRITE #1 "        <register address='0xb9e08dc' value='0x" DATA.LONG(A:0x9e08dc) "' name='RPMH_VRM_VREG_READY_LEGACY_MODE_CSR_REG8'/>"
WRITE #1 "        <register address='0xb9e09dc' value='0x" DATA.LONG(A:0x9e09dc) "' name='RPMH_VRM_VREG_READY_LEGACY_MODE_CSR_REG9'/>"
WRITE #1 "        <register address='0xb9e0adc' value='0x" DATA.LONG(A:0x9e0adc) "' name='RPMH_VRM_VREG_READY_LEGACY_MODE_CSR_REG10'/>"
WRITE #1 "        <register address='0xb9e0bdc' value='0x" DATA.LONG(A:0x9e0bdc) "' name='RPMH_VRM_VREG_READY_LEGACY_MODE_CSR_REG11'/>"
WRITE #1 "        <register address='0xb9e0cdc' value='0x" DATA.LONG(A:0x9e0cdc) "' name='RPMH_VRM_VREG_READY_LEGACY_MODE_CSR_REG12'/>"
WRITE #1 "        <register address='0xb9e0ddc' value='0x" DATA.LONG(A:0x9e0ddc) "' name='RPMH_VRM_VREG_READY_LEGACY_MODE_CSR_REG13'/>"
WRITE #1 "        <register address='0xb9e0edc' value='0x" DATA.LONG(A:0x9e0edc) "' name='RPMH_VRM_VREG_READY_LEGACY_MODE_CSR_REG14'/>"
WRITE #1 "        <register address='0xb9e0fdc' value='0x" DATA.LONG(A:0x9e0fdc) "' name='RPMH_VRM_VREG_READY_LEGACY_MODE_CSR_REG15'/>"
WRITE #1 "        <register address='0xb9e10dc' value='0x" DATA.LONG(A:0x9e10dc) "' name='RPMH_VRM_VREG_READY_LEGACY_MODE_CSR_REG16'/>"
WRITE #1 "        <register address='0xb9e11dc' value='0x" DATA.LONG(A:0x9e11dc) "' name='RPMH_VRM_VREG_READY_LEGACY_MODE_CSR_REG17'/>"
WRITE #1 "        <register address='0xb9e12dc' value='0x" DATA.LONG(A:0x9e12dc) "' name='RPMH_VRM_VREG_READY_LEGACY_MODE_CSR_REG18'/>"
WRITE #1 "        <register address='0xb9e13dc' value='0x" DATA.LONG(A:0x9e13dc) "' name='RPMH_VRM_VREG_READY_LEGACY_MODE_CSR_REG19'/>"
WRITE #1 "        <register address='0xb9e14dc' value='0x" DATA.LONG(A:0x9e14dc) "' name='RPMH_VRM_VREG_READY_LEGACY_MODE_CSR_REG20'/>"
WRITE #1 "        <register address='0xb9e15dc' value='0x" DATA.LONG(A:0x9e15dc) "' name='RPMH_VRM_VREG_READY_LEGACY_MODE_CSR_REG21'/>"
WRITE #1 "        <register address='0xb9e16dc' value='0x" DATA.LONG(A:0x9e16dc) "' name='RPMH_VRM_VREG_READY_LEGACY_MODE_CSR_REG22'/>"
WRITE #1 "        <register address='0xb9e17dc' value='0x" DATA.LONG(A:0x9e17dc) "' name='RPMH_VRM_VREG_READY_LEGACY_MODE_CSR_REG23'/>"
WRITE #1 "        <register address='0xb9e18dc' value='0x" DATA.LONG(A:0x9e18dc) "' name='RPMH_VRM_VREG_READY_LEGACY_MODE_CSR_REG24'/>"
WRITE #1 "        <register address='0xb9e19dc' value='0x" DATA.LONG(A:0x9e19dc) "' name='RPMH_VRM_VREG_READY_LEGACY_MODE_CSR_REG25'/>"
WRITE #1 "        <register address='0xb9e1adc' value='0x" DATA.LONG(A:0x9e1adc) "' name='RPMH_VRM_VREG_READY_LEGACY_MODE_CSR_REG26'/>"
WRITE #1 "        <register address='0xb9e1bdc' value='0x" DATA.LONG(A:0x9e1bdc) "' name='RPMH_VRM_VREG_READY_LEGACY_MODE_CSR_REG27'/>"
WRITE #1 "        <register address='0xb9e1cdc' value='0x" DATA.LONG(A:0x9e1cdc) "' name='RPMH_VRM_VREG_READY_LEGACY_MODE_CSR_REG28'/>"
WRITE #1 "        <register address='0xb9e1ddc' value='0x" DATA.LONG(A:0x9e1ddc) "' name='RPMH_VRM_VREG_READY_LEGACY_MODE_CSR_REG29'/>"
WRITE #1 "        <register address='0xb9e1edc' value='0x" DATA.LONG(A:0x9e1edc) "' name='RPMH_VRM_VREG_READY_LEGACY_MODE_CSR_REG30'/>"
WRITE #1 "        <register address='0xb9e1fdc' value='0x" DATA.LONG(A:0x9e1fdc) "' name='RPMH_VRM_VREG_READY_LEGACY_MODE_CSR_REG31'/>"
WRITE #1 "        <register address='0xb9e20dc' value='0x" DATA.LONG(A:0x9e20dc) "' name='RPMH_VRM_VREG_READY_LEGACY_MODE_CSR_REG32'/>"
WRITE #1 "        <register address='0xb9e21dc' value='0x" DATA.LONG(A:0x9e21dc) "' name='RPMH_VRM_VREG_READY_LEGACY_MODE_CSR_REG33'/>"
WRITE #1 "        <register address='0xb9e22dc' value='0x" DATA.LONG(A:0x9e22dc) "' name='RPMH_VRM_VREG_READY_LEGACY_MODE_CSR_REG34'/>"
WRITE #1 "        <register address='0xb9e23dc' value='0x" DATA.LONG(A:0x9e23dc) "' name='RPMH_VRM_VREG_READY_LEGACY_MODE_CSR_REG35'/>"
WRITE #1 "        <register address='0xb9e24dc' value='0x" DATA.LONG(A:0x9e24dc) "' name='RPMH_VRM_VREG_READY_LEGACY_MODE_CSR_REG36'/>"
WRITE #1 "        <register address='0xb9e25dc' value='0x" DATA.LONG(A:0x9e25dc) "' name='RPMH_VRM_VREG_READY_LEGACY_MODE_CSR_REG37'/>"
WRITE #1 "        <register address='0xb9e26dc' value='0x" DATA.LONG(A:0x9e26dc) "' name='RPMH_VRM_VREG_READY_LEGACY_MODE_CSR_REG38'/>"
WRITE #1 "        <register address='0xb9e27dc' value='0x" DATA.LONG(A:0x9e27dc) "' name='RPMH_VRM_VREG_READY_LEGACY_MODE_CSR_REG39'/>"
WRITE #1 "        <register address='0xb9e28dc' value='0x" DATA.LONG(A:0x9e28dc) "' name='RPMH_VRM_VREG_READY_LEGACY_MODE_CSR_REG40'/>"
WRITE #1 "        <register address='0xb9e29dc' value='0x" DATA.LONG(A:0x9e29dc) "' name='RPMH_VRM_VREG_READY_LEGACY_MODE_CSR_REG41'/>"
WRITE #1 "        <register address='0xb9e2adc' value='0x" DATA.LONG(A:0x9e2adc) "' name='RPMH_VRM_VREG_READY_LEGACY_MODE_CSR_REG42'/>"
WRITE #1 "        <register address='0xb9e2bdc' value='0x" DATA.LONG(A:0x9e2bdc) "' name='RPMH_VRM_VREG_READY_LEGACY_MODE_CSR_REG43'/>"
WRITE #1 "        <register address='0xb9e2cdc' value='0x" DATA.LONG(A:0x9e2cdc) "' name='RPMH_VRM_VREG_READY_LEGACY_MODE_CSR_REG44'/>"
WRITE #1 "        <register address='0xb9e2ddc' value='0x" DATA.LONG(A:0x9e2ddc) "' name='RPMH_VRM_VREG_READY_LEGACY_MODE_CSR_REG45'/>"
WRITE #1 "        <register address='0xb9e2e80' value='0x" DATA.LONG(A:0x9e2e80) "' name='RPMH_VRM_TYPE_CSR_XOB0'/>"
WRITE #1 "        <register address='0xb9e2f80' value='0x" DATA.LONG(A:0x9e2f80) "' name='RPMH_VRM_TYPE_CSR_XOB1'/>"
WRITE #1 "        <register address='0xb9e3080' value='0x" DATA.LONG(A:0x9e3080) "' name='RPMH_VRM_TYPE_CSR_XOB2'/>"
WRITE #1 "        <register address='0xb9e3180' value='0x" DATA.LONG(A:0x9e3180) "' name='RPMH_VRM_TYPE_CSR_XOB3'/>"
WRITE #1 "        <register address='0xb9e3280' value='0x" DATA.LONG(A:0x9e3280) "' name='RPMH_VRM_TYPE_CSR_XOB4'/>"
WRITE #1 "        <register address='0xb9e3380' value='0x" DATA.LONG(A:0x9e3380) "' name='RPMH_VRM_TYPE_CSR_XOB5'/>"
WRITE #1 "        <register address='0xb9e3480' value='0x" DATA.LONG(A:0x9e3480) "' name='RPMH_VRM_TYPE_CSR_XOB6'/>"
WRITE #1 "        <register address='0xb9e3580' value='0x" DATA.LONG(A:0x9e3580) "' name='RPMH_VRM_TYPE_CSR_XOB7'/>"
WRITE #1 "        <register address='0xb9e3680' value='0x" DATA.LONG(A:0x9e3680) "' name='RPMH_VRM_TYPE_CSR_XOB8'/>"
WRITE #1 "        <register address='0xb9e3780' value='0x" DATA.LONG(A:0x9e3780) "' name='RPMH_VRM_TYPE_CSR_XOB9'/>"
WRITE #1 "        <register address='0xb9e3880' value='0x" DATA.LONG(A:0x9e3880) "' name='RPMH_VRM_TYPE_CSR_XOB10'/>"
WRITE #1 "        <register address='0xb9e3980' value='0x" DATA.LONG(A:0x9e3980) "' name='RPMH_VRM_TYPE_CSR_XOB11'/>"
WRITE #1 "        <register address='0xb9e3a80' value='0x" DATA.LONG(A:0x9e3a80) "' name='RPMH_VRM_TYPE_CSR_XOB12'/>"
WRITE #1 "        <register address='0xb9e3b80' value='0x" DATA.LONG(A:0x9e3b80) "' name='RPMH_VRM_TYPE_CSR_XOB13'/>"
WRITE #1 "        <register address='0xb9e3c80' value='0x" DATA.LONG(A:0x9e3c80) "' name='RPMH_VRM_TYPE_CSR_XOB14'/>"
WRITE #1 "        <register address='0xb9e3d80' value='0x" DATA.LONG(A:0x9e3d80) "' name='RPMH_VRM_TYPE_CSR_XOB15'/>"
WRITE #1 "        <register address='0xb9e2e84' value='0x" DATA.LONG(A:0x9e2e84) "' name='RPMH_VRM_BASE_ADDR_CSR_XOB0'/>"
WRITE #1 "        <register address='0xb9e2f84' value='0x" DATA.LONG(A:0x9e2f84) "' name='RPMH_VRM_BASE_ADDR_CSR_XOB1'/>"
WRITE #1 "        <register address='0xb9e3084' value='0x" DATA.LONG(A:0x9e3084) "' name='RPMH_VRM_BASE_ADDR_CSR_XOB2'/>"
WRITE #1 "        <register address='0xb9e3184' value='0x" DATA.LONG(A:0x9e3184) "' name='RPMH_VRM_BASE_ADDR_CSR_XOB3'/>"
WRITE #1 "        <register address='0xb9e3284' value='0x" DATA.LONG(A:0x9e3284) "' name='RPMH_VRM_BASE_ADDR_CSR_XOB4'/>"
WRITE #1 "        <register address='0xb9e3384' value='0x" DATA.LONG(A:0x9e3384) "' name='RPMH_VRM_BASE_ADDR_CSR_XOB5'/>"
WRITE #1 "        <register address='0xb9e3484' value='0x" DATA.LONG(A:0x9e3484) "' name='RPMH_VRM_BASE_ADDR_CSR_XOB6'/>"
WRITE #1 "        <register address='0xb9e3584' value='0x" DATA.LONG(A:0x9e3584) "' name='RPMH_VRM_BASE_ADDR_CSR_XOB7'/>"
WRITE #1 "        <register address='0xb9e3684' value='0x" DATA.LONG(A:0x9e3684) "' name='RPMH_VRM_BASE_ADDR_CSR_XOB8'/>"
WRITE #1 "        <register address='0xb9e3784' value='0x" DATA.LONG(A:0x9e3784) "' name='RPMH_VRM_BASE_ADDR_CSR_XOB9'/>"
WRITE #1 "        <register address='0xb9e3884' value='0x" DATA.LONG(A:0x9e3884) "' name='RPMH_VRM_BASE_ADDR_CSR_XOB10'/>"
WRITE #1 "        <register address='0xb9e3984' value='0x" DATA.LONG(A:0x9e3984) "' name='RPMH_VRM_BASE_ADDR_CSR_XOB11'/>"
WRITE #1 "        <register address='0xb9e3a84' value='0x" DATA.LONG(A:0x9e3a84) "' name='RPMH_VRM_BASE_ADDR_CSR_XOB12'/>"
WRITE #1 "        <register address='0xb9e3b84' value='0x" DATA.LONG(A:0x9e3b84) "' name='RPMH_VRM_BASE_ADDR_CSR_XOB13'/>"
WRITE #1 "        <register address='0xb9e3c84' value='0x" DATA.LONG(A:0x9e3c84) "' name='RPMH_VRM_BASE_ADDR_CSR_XOB14'/>"
WRITE #1 "        <register address='0xb9e3d84' value='0x" DATA.LONG(A:0x9e3d84) "' name='RPMH_VRM_BASE_ADDR_CSR_XOB15'/>"
WRITE #1 "        <register address='0xb9e2e90' value='0x" DATA.LONG(A:0x9e2e90) "' name='RPMH_VRM_ENABLE_SEQ_ID_CSR_XOB0'/>"
WRITE #1 "        <register address='0xb9e2f90' value='0x" DATA.LONG(A:0x9e2f90) "' name='RPMH_VRM_ENABLE_SEQ_ID_CSR_XOB1'/>"
WRITE #1 "        <register address='0xb9e3090' value='0x" DATA.LONG(A:0x9e3090) "' name='RPMH_VRM_ENABLE_SEQ_ID_CSR_XOB2'/>"
WRITE #1 "        <register address='0xb9e3190' value='0x" DATA.LONG(A:0x9e3190) "' name='RPMH_VRM_ENABLE_SEQ_ID_CSR_XOB3'/>"
WRITE #1 "        <register address='0xb9e3290' value='0x" DATA.LONG(A:0x9e3290) "' name='RPMH_VRM_ENABLE_SEQ_ID_CSR_XOB4'/>"
WRITE #1 "        <register address='0xb9e3390' value='0x" DATA.LONG(A:0x9e3390) "' name='RPMH_VRM_ENABLE_SEQ_ID_CSR_XOB5'/>"
WRITE #1 "        <register address='0xb9e3490' value='0x" DATA.LONG(A:0x9e3490) "' name='RPMH_VRM_ENABLE_SEQ_ID_CSR_XOB6'/>"
WRITE #1 "        <register address='0xb9e3590' value='0x" DATA.LONG(A:0x9e3590) "' name='RPMH_VRM_ENABLE_SEQ_ID_CSR_XOB7'/>"
WRITE #1 "        <register address='0xb9e3690' value='0x" DATA.LONG(A:0x9e3690) "' name='RPMH_VRM_ENABLE_SEQ_ID_CSR_XOB8'/>"
WRITE #1 "        <register address='0xb9e3790' value='0x" DATA.LONG(A:0x9e3790) "' name='RPMH_VRM_ENABLE_SEQ_ID_CSR_XOB9'/>"
WRITE #1 "        <register address='0xb9e3890' value='0x" DATA.LONG(A:0x9e3890) "' name='RPMH_VRM_ENABLE_SEQ_ID_CSR_XOB10'/>"
WRITE #1 "        <register address='0xb9e3990' value='0x" DATA.LONG(A:0x9e3990) "' name='RPMH_VRM_ENABLE_SEQ_ID_CSR_XOB11'/>"
WRITE #1 "        <register address='0xb9e3a90' value='0x" DATA.LONG(A:0x9e3a90) "' name='RPMH_VRM_ENABLE_SEQ_ID_CSR_XOB12'/>"
WRITE #1 "        <register address='0xb9e3b90' value='0x" DATA.LONG(A:0x9e3b90) "' name='RPMH_VRM_ENABLE_SEQ_ID_CSR_XOB13'/>"
WRITE #1 "        <register address='0xb9e3c90' value='0x" DATA.LONG(A:0x9e3c90) "' name='RPMH_VRM_ENABLE_SEQ_ID_CSR_XOB14'/>"
WRITE #1 "        <register address='0xb9e3d90' value='0x" DATA.LONG(A:0x9e3d90) "' name='RPMH_VRM_ENABLE_SEQ_ID_CSR_XOB15'/>"
WRITE #1 "        <register address='0xb9e2eac' value='0x" DATA.LONG(A:0x9e2eac) "' name='RPMH_VRM_ENABLE_DEP_ENABLE_CSR_XOB0'/>"
WRITE #1 "        <register address='0xb9e2fac' value='0x" DATA.LONG(A:0x9e2fac) "' name='RPMH_VRM_ENABLE_DEP_ENABLE_CSR_XOB1'/>"
WRITE #1 "        <register address='0xb9e30ac' value='0x" DATA.LONG(A:0x9e30ac) "' name='RPMH_VRM_ENABLE_DEP_ENABLE_CSR_XOB2'/>"
WRITE #1 "        <register address='0xb9e31ac' value='0x" DATA.LONG(A:0x9e31ac) "' name='RPMH_VRM_ENABLE_DEP_ENABLE_CSR_XOB3'/>"
WRITE #1 "        <register address='0xb9e32ac' value='0x" DATA.LONG(A:0x9e32ac) "' name='RPMH_VRM_ENABLE_DEP_ENABLE_CSR_XOB4'/>"
WRITE #1 "        <register address='0xb9e33ac' value='0x" DATA.LONG(A:0x9e33ac) "' name='RPMH_VRM_ENABLE_DEP_ENABLE_CSR_XOB5'/>"
WRITE #1 "        <register address='0xb9e34ac' value='0x" DATA.LONG(A:0x9e34ac) "' name='RPMH_VRM_ENABLE_DEP_ENABLE_CSR_XOB6'/>"
WRITE #1 "        <register address='0xb9e35ac' value='0x" DATA.LONG(A:0x9e35ac) "' name='RPMH_VRM_ENABLE_DEP_ENABLE_CSR_XOB7'/>"
WRITE #1 "        <register address='0xb9e36ac' value='0x" DATA.LONG(A:0x9e36ac) "' name='RPMH_VRM_ENABLE_DEP_ENABLE_CSR_XOB8'/>"
WRITE #1 "        <register address='0xb9e37ac' value='0x" DATA.LONG(A:0x9e37ac) "' name='RPMH_VRM_ENABLE_DEP_ENABLE_CSR_XOB9'/>"
WRITE #1 "        <register address='0xb9e38ac' value='0x" DATA.LONG(A:0x9e38ac) "' name='RPMH_VRM_ENABLE_DEP_ENABLE_CSR_XOB10'/>"
WRITE #1 "        <register address='0xb9e39ac' value='0x" DATA.LONG(A:0x9e39ac) "' name='RPMH_VRM_ENABLE_DEP_ENABLE_CSR_XOB11'/>"
WRITE #1 "        <register address='0xb9e3aac' value='0x" DATA.LONG(A:0x9e3aac) "' name='RPMH_VRM_ENABLE_DEP_ENABLE_CSR_XOB12'/>"
WRITE #1 "        <register address='0xb9e3bac' value='0x" DATA.LONG(A:0x9e3bac) "' name='RPMH_VRM_ENABLE_DEP_ENABLE_CSR_XOB13'/>"
WRITE #1 "        <register address='0xb9e3cac' value='0x" DATA.LONG(A:0x9e3cac) "' name='RPMH_VRM_ENABLE_DEP_ENABLE_CSR_XOB14'/>"
WRITE #1 "        <register address='0xb9e3dac' value='0x" DATA.LONG(A:0x9e3dac) "' name='RPMH_VRM_ENABLE_DEP_ENABLE_CSR_XOB15'/>"
WRITE #1 "        <register address='0xb9e2ec8' value='0x" DATA.LONG(A:0x9e2ec8) "' name='RPMH_VRM_ENABLE_SETTLING_BLOCK_ENABLE_CSR_XOB0'/>"
WRITE #1 "        <register address='0xb9e2fc8' value='0x" DATA.LONG(A:0x9e2fc8) "' name='RPMH_VRM_ENABLE_SETTLING_BLOCK_ENABLE_CSR_XOB1'/>"
WRITE #1 "        <register address='0xb9e30c8' value='0x" DATA.LONG(A:0x9e30c8) "' name='RPMH_VRM_ENABLE_SETTLING_BLOCK_ENABLE_CSR_XOB2'/>"
WRITE #1 "        <register address='0xb9e31c8' value='0x" DATA.LONG(A:0x9e31c8) "' name='RPMH_VRM_ENABLE_SETTLING_BLOCK_ENABLE_CSR_XOB3'/>"
WRITE #1 "        <register address='0xb9e32c8' value='0x" DATA.LONG(A:0x9e32c8) "' name='RPMH_VRM_ENABLE_SETTLING_BLOCK_ENABLE_CSR_XOB4'/>"
WRITE #1 "        <register address='0xb9e33c8' value='0x" DATA.LONG(A:0x9e33c8) "' name='RPMH_VRM_ENABLE_SETTLING_BLOCK_ENABLE_CSR_XOB5'/>"
WRITE #1 "        <register address='0xb9e34c8' value='0x" DATA.LONG(A:0x9e34c8) "' name='RPMH_VRM_ENABLE_SETTLING_BLOCK_ENABLE_CSR_XOB6'/>"
WRITE #1 "        <register address='0xb9e35c8' value='0x" DATA.LONG(A:0x9e35c8) "' name='RPMH_VRM_ENABLE_SETTLING_BLOCK_ENABLE_CSR_XOB7'/>"
WRITE #1 "        <register address='0xb9e36c8' value='0x" DATA.LONG(A:0x9e36c8) "' name='RPMH_VRM_ENABLE_SETTLING_BLOCK_ENABLE_CSR_XOB8'/>"
WRITE #1 "        <register address='0xb9e37c8' value='0x" DATA.LONG(A:0x9e37c8) "' name='RPMH_VRM_ENABLE_SETTLING_BLOCK_ENABLE_CSR_XOB9'/>"
WRITE #1 "        <register address='0xb9e38c8' value='0x" DATA.LONG(A:0x9e38c8) "' name='RPMH_VRM_ENABLE_SETTLING_BLOCK_ENABLE_CSR_XOB10'/>"
WRITE #1 "        <register address='0xb9e39c8' value='0x" DATA.LONG(A:0x9e39c8) "' name='RPMH_VRM_ENABLE_SETTLING_BLOCK_ENABLE_CSR_XOB11'/>"
WRITE #1 "        <register address='0xb9e3ac8' value='0x" DATA.LONG(A:0x9e3ac8) "' name='RPMH_VRM_ENABLE_SETTLING_BLOCK_ENABLE_CSR_XOB12'/>"
WRITE #1 "        <register address='0xb9e3bc8' value='0x" DATA.LONG(A:0x9e3bc8) "' name='RPMH_VRM_ENABLE_SETTLING_BLOCK_ENABLE_CSR_XOB13'/>"
WRITE #1 "        <register address='0xb9e3cc8' value='0x" DATA.LONG(A:0x9e3cc8) "' name='RPMH_VRM_ENABLE_SETTLING_BLOCK_ENABLE_CSR_XOB14'/>"
WRITE #1 "        <register address='0xb9e3dc8' value='0x" DATA.LONG(A:0x9e3dc8) "' name='RPMH_VRM_ENABLE_SETTLING_BLOCK_ENABLE_CSR_XOB15'/>"
WRITE #1 "        <register address='0xb9e2ecc' value='0x" DATA.LONG(A:0x9e2ecc) "' name='RPMH_VRM_XOB_READY_ENABLE_CSR_REG0'/>"
WRITE #1 "        <register address='0xb9e2fcc' value='0x" DATA.LONG(A:0x9e2fcc) "' name='RPMH_VRM_XOB_READY_ENABLE_CSR_REG1'/>"
WRITE #1 "        <register address='0xb9e30cc' value='0x" DATA.LONG(A:0x9e30cc) "' name='RPMH_VRM_XOB_READY_ENABLE_CSR_REG2'/>"
WRITE #1 "        <register address='0xb9e31cc' value='0x" DATA.LONG(A:0x9e31cc) "' name='RPMH_VRM_XOB_READY_ENABLE_CSR_REG3'/>"
WRITE #1 "        <register address='0xb9e32cc' value='0x" DATA.LONG(A:0x9e32cc) "' name='RPMH_VRM_XOB_READY_ENABLE_CSR_REG4'/>"
WRITE #1 "        <register address='0xb9e33cc' value='0x" DATA.LONG(A:0x9e33cc) "' name='RPMH_VRM_XOB_READY_ENABLE_CSR_REG5'/>"
WRITE #1 "        <register address='0xb9e34cc' value='0x" DATA.LONG(A:0x9e34cc) "' name='RPMH_VRM_XOB_READY_ENABLE_CSR_REG6'/>"
WRITE #1 "        <register address='0xb9e35cc' value='0x" DATA.LONG(A:0x9e35cc) "' name='RPMH_VRM_XOB_READY_ENABLE_CSR_REG7'/>"
WRITE #1 "        <register address='0xb9e36cc' value='0x" DATA.LONG(A:0x9e36cc) "' name='RPMH_VRM_XOB_READY_ENABLE_CSR_REG8'/>"
WRITE #1 "        <register address='0xb9e37cc' value='0x" DATA.LONG(A:0x9e37cc) "' name='RPMH_VRM_XOB_READY_ENABLE_CSR_REG9'/>"
WRITE #1 "        <register address='0xb9e38cc' value='0x" DATA.LONG(A:0x9e38cc) "' name='RPMH_VRM_XOB_READY_ENABLE_CSR_REG10'/>"
WRITE #1 "        <register address='0xb9e39cc' value='0x" DATA.LONG(A:0x9e39cc) "' name='RPMH_VRM_XOB_READY_ENABLE_CSR_REG11'/>"
WRITE #1 "        <register address='0xb9e3acc' value='0x" DATA.LONG(A:0x9e3acc) "' name='RPMH_VRM_XOB_READY_ENABLE_CSR_REG12'/>"
WRITE #1 "        <register address='0xb9e3bcc' value='0x" DATA.LONG(A:0x9e3bcc) "' name='RPMH_VRM_XOB_READY_ENABLE_CSR_REG13'/>"
WRITE #1 "        <register address='0xb9e3ccc' value='0x" DATA.LONG(A:0x9e3ccc) "' name='RPMH_VRM_XOB_READY_ENABLE_CSR_REG14'/>"
WRITE #1 "        <register address='0xb9e3dcc' value='0x" DATA.LONG(A:0x9e3dcc) "' name='RPMH_VRM_XOB_READY_ENABLE_CSR_REG15'/>"
WRITE #1 "        <register address='0xb9e3e80' value='0x" DATA.LONG(A:0x9e3e80) "' name='RPMH_VRM_TYPE_CSR_XO0'/>"
WRITE #1 "        <register address='0xb9e3e84' value='0x" DATA.LONG(A:0x9e3e84) "' name='RPMH_VRM_BASE_ADDR_CSR_XO0'/>"
WRITE #1 "        <register address='0xb9e3e90' value='0x" DATA.LONG(A:0x9e3e90) "' name='RPMH_VRM_ENABLE_SEQ_ID_CSR_XO0'/>"
WRITE #1 "        <register address='0xb9e3eac' value='0x" DATA.LONG(A:0x9e3eac) "' name='RPMH_VRM_ENABLE_DEP_ENABLE_CSR_XO0'/>"
WRITE #1 "        <register address='0xb9e3ec8' value='0x" DATA.LONG(A:0x9e3ec8) "' name='RPMH_VRM_ENABLE_SETTLING_BLOCK_ENABLE_CSR_XO0'/>"
WRITE #1 "        <register address='0xb9e3ecc' value='0x" DATA.LONG(A:0x9e3ecc) "' name='RPMH_VRM_XO_READY_ENABLE_CSR_REG0'/>"
WRITE #1 "        <register address='0xb9ec8e4' value='0x" DATA.LONG(A:0x9ec8e4) "' name='RPMH_VRM_VOLTAGE_ENABLE_SETTLING_DEP_ENABLE_CSR_REG0'/>"
WRITE #1 "        <register address='0xb9ec9e4' value='0x" DATA.LONG(A:0x9ec9e4) "' name='RPMH_VRM_VOLTAGE_ENABLE_SETTLING_DEP_ENABLE_CSR_REG1'/>"
WRITE #1 "        <register address='0xb9ecae4' value='0x" DATA.LONG(A:0x9ecae4) "' name='RPMH_VRM_VOLTAGE_ENABLE_SETTLING_DEP_ENABLE_CSR_REG2'/>"
WRITE #1 "        <register address='0xb9ecbe4' value='0x" DATA.LONG(A:0x9ecbe4) "' name='RPMH_VRM_VOLTAGE_ENABLE_SETTLING_DEP_ENABLE_CSR_REG3'/>"
WRITE #1 "        <register address='0xb9ecce4' value='0x" DATA.LONG(A:0x9ecce4) "' name='RPMH_VRM_VOLTAGE_ENABLE_SETTLING_DEP_ENABLE_CSR_REG4'/>"
WRITE #1 "        <register address='0xb9ecde4' value='0x" DATA.LONG(A:0x9ecde4) "' name='RPMH_VRM_VOLTAGE_ENABLE_SETTLING_DEP_ENABLE_CSR_REG5'/>"
WRITE #1 "        <register address='0xb9ecee4' value='0x" DATA.LONG(A:0x9ecee4) "' name='RPMH_VRM_VOLTAGE_ENABLE_SETTLING_DEP_ENABLE_CSR_REG6'/>"
WRITE #1 "        <register address='0xb9ecfe4' value='0x" DATA.LONG(A:0x9ecfe4) "' name='RPMH_VRM_VOLTAGE_ENABLE_SETTLING_DEP_ENABLE_CSR_REG7'/>"
WRITE #1 "        <register address='0xb9ed0e4' value='0x" DATA.LONG(A:0x9ed0e4) "' name='RPMH_VRM_VOLTAGE_ENABLE_SETTLING_DEP_ENABLE_CSR_REG8'/>"
WRITE #1 "        <register address='0xb9ed1e4' value='0x" DATA.LONG(A:0x9ed1e4) "' name='RPMH_VRM_VOLTAGE_ENABLE_SETTLING_DEP_ENABLE_CSR_REG9'/>"
WRITE #1 "        <register address='0xb9ed2e4' value='0x" DATA.LONG(A:0x9ed2e4) "' name='RPMH_VRM_VOLTAGE_ENABLE_SETTLING_DEP_ENABLE_CSR_REG10'/>"
WRITE #1 "        <register address='0xb9ed3e4' value='0x" DATA.LONG(A:0x9ed3e4) "' name='RPMH_VRM_VOLTAGE_ENABLE_SETTLING_DEP_ENABLE_CSR_REG11'/>"
WRITE #1 "        <register address='0xb9ed4e4' value='0x" DATA.LONG(A:0x9ed4e4) "' name='RPMH_VRM_VOLTAGE_ENABLE_SETTLING_DEP_ENABLE_CSR_REG12'/>"
WRITE #1 "        <register address='0xb9ed5e4' value='0x" DATA.LONG(A:0x9ed5e4) "' name='RPMH_VRM_VOLTAGE_ENABLE_SETTLING_DEP_ENABLE_CSR_REG13'/>"
WRITE #1 "        <register address='0xb9ed6e4' value='0x" DATA.LONG(A:0x9ed6e4) "' name='RPMH_VRM_VOLTAGE_ENABLE_SETTLING_DEP_ENABLE_CSR_REG14'/>"
WRITE #1 "        <register address='0xb9ed7e4' value='0x" DATA.LONG(A:0x9ed7e4) "' name='RPMH_VRM_VOLTAGE_ENABLE_SETTLING_DEP_ENABLE_CSR_REG15'/>"
WRITE #1 "        <register address='0xb9ed8e4' value='0x" DATA.LONG(A:0x9ed8e4) "' name='RPMH_VRM_VOLTAGE_ENABLE_SETTLING_DEP_ENABLE_CSR_REG16'/>"
WRITE #1 "        <register address='0xb9ed9e4' value='0x" DATA.LONG(A:0x9ed9e4) "' name='RPMH_VRM_VOLTAGE_ENABLE_SETTLING_DEP_ENABLE_CSR_REG17'/>"
WRITE #1 "        <register address='0xb9edae4' value='0x" DATA.LONG(A:0x9edae4) "' name='RPMH_VRM_VOLTAGE_ENABLE_SETTLING_DEP_ENABLE_CSR_REG18'/>"
WRITE #1 "        <register address='0xb9edbe4' value='0x" DATA.LONG(A:0x9edbe4) "' name='RPMH_VRM_VOLTAGE_ENABLE_SETTLING_DEP_ENABLE_CSR_REG19'/>"
WRITE #1 "        <register address='0xb9edce4' value='0x" DATA.LONG(A:0x9edce4) "' name='RPMH_VRM_VOLTAGE_ENABLE_SETTLING_DEP_ENABLE_CSR_REG20'/>"
WRITE #1 "        <register address='0xb9edde4' value='0x" DATA.LONG(A:0x9edde4) "' name='RPMH_VRM_VOLTAGE_ENABLE_SETTLING_DEP_ENABLE_CSR_REG21'/>"
WRITE #1 "        <register address='0xb9edee4' value='0x" DATA.LONG(A:0x9edee4) "' name='RPMH_VRM_VOLTAGE_ENABLE_SETTLING_DEP_ENABLE_CSR_REG22'/>"
WRITE #1 "        <register address='0xb9edfe4' value='0x" DATA.LONG(A:0x9edfe4) "' name='RPMH_VRM_VOLTAGE_ENABLE_SETTLING_DEP_ENABLE_CSR_REG23'/>"
WRITE #1 "        <register address='0xb9ee0e4' value='0x" DATA.LONG(A:0x9ee0e4) "' name='RPMH_VRM_VOLTAGE_ENABLE_SETTLING_DEP_ENABLE_CSR_REG24'/>"
WRITE #1 "        <register address='0xb9ee1e4' value='0x" DATA.LONG(A:0x9ee1e4) "' name='RPMH_VRM_VOLTAGE_ENABLE_SETTLING_DEP_ENABLE_CSR_REG25'/>"
WRITE #1 "        <register address='0xb9ee2e4' value='0x" DATA.LONG(A:0x9ee2e4) "' name='RPMH_VRM_VOLTAGE_ENABLE_SETTLING_DEP_ENABLE_CSR_REG26'/>"
WRITE #1 "        <register address='0xb9ee3e4' value='0x" DATA.LONG(A:0x9ee3e4) "' name='RPMH_VRM_VOLTAGE_ENABLE_SETTLING_DEP_ENABLE_CSR_REG27'/>"
WRITE #1 "        <register address='0xb9ee4e4' value='0x" DATA.LONG(A:0x9ee4e4) "' name='RPMH_VRM_VOLTAGE_ENABLE_SETTLING_DEP_ENABLE_CSR_REG28'/>"
WRITE #1 "        <register address='0xb9ee5e4' value='0x" DATA.LONG(A:0x9ee5e4) "' name='RPMH_VRM_VOLTAGE_ENABLE_SETTLING_DEP_ENABLE_CSR_REG29'/>"
WRITE #1 "        <register address='0xb9ee6e4' value='0x" DATA.LONG(A:0x9ee6e4) "' name='RPMH_VRM_VOLTAGE_ENABLE_SETTLING_DEP_ENABLE_CSR_REG30'/>"
WRITE #1 "        <register address='0xb9ee7e4' value='0x" DATA.LONG(A:0x9ee7e4) "' name='RPMH_VRM_VOLTAGE_ENABLE_SETTLING_DEP_ENABLE_CSR_REG31'/>"
WRITE #1 "        <register address='0xb9ee8e4' value='0x" DATA.LONG(A:0x9ee8e4) "' name='RPMH_VRM_VOLTAGE_ENABLE_SETTLING_DEP_ENABLE_CSR_REG32'/>"
WRITE #1 "        <register address='0xb9ee9e4' value='0x" DATA.LONG(A:0x9ee9e4) "' name='RPMH_VRM_VOLTAGE_ENABLE_SETTLING_DEP_ENABLE_CSR_REG33'/>"
WRITE #1 "        <register address='0xb9eeae4' value='0x" DATA.LONG(A:0x9eeae4) "' name='RPMH_VRM_VOLTAGE_ENABLE_SETTLING_DEP_ENABLE_CSR_REG34'/>"
WRITE #1 "        <register address='0xb9eebe4' value='0x" DATA.LONG(A:0x9eebe4) "' name='RPMH_VRM_VOLTAGE_ENABLE_SETTLING_DEP_ENABLE_CSR_REG35'/>"
WRITE #1 "        <register address='0xb9eece4' value='0x" DATA.LONG(A:0x9eece4) "' name='RPMH_VRM_VOLTAGE_ENABLE_SETTLING_DEP_ENABLE_CSR_REG36'/>"
WRITE #1 "        <register address='0xb9eede4' value='0x" DATA.LONG(A:0x9eede4) "' name='RPMH_VRM_VOLTAGE_ENABLE_SETTLING_DEP_ENABLE_CSR_REG37'/>"
WRITE #1 "        <register address='0xb9eeee4' value='0x" DATA.LONG(A:0x9eeee4) "' name='RPMH_VRM_VOLTAGE_ENABLE_SETTLING_DEP_ENABLE_CSR_REG38'/>"
WRITE #1 "        <register address='0xb9eefe4' value='0x" DATA.LONG(A:0x9eefe4) "' name='RPMH_VRM_VOLTAGE_ENABLE_SETTLING_DEP_ENABLE_CSR_REG39'/>"
WRITE #1 "        <register address='0xb9ef0e4' value='0x" DATA.LONG(A:0x9ef0e4) "' name='RPMH_VRM_VOLTAGE_ENABLE_SETTLING_DEP_ENABLE_CSR_REG40'/>"
WRITE #1 "        <register address='0xb9ef1e4' value='0x" DATA.LONG(A:0x9ef1e4) "' name='RPMH_VRM_VOLTAGE_ENABLE_SETTLING_DEP_ENABLE_CSR_REG41'/>"
WRITE #1 "        <register address='0xb9ef2e4' value='0x" DATA.LONG(A:0x9ef2e4) "' name='RPMH_VRM_VOLTAGE_ENABLE_SETTLING_DEP_ENABLE_CSR_REG42'/>"
WRITE #1 "        <register address='0xb9ef3e4' value='0x" DATA.LONG(A:0x9ef3e4) "' name='RPMH_VRM_VOLTAGE_ENABLE_SETTLING_DEP_ENABLE_CSR_REG43'/>"
WRITE #1 "        <register address='0xb9ef4e4' value='0x" DATA.LONG(A:0x9ef4e4) "' name='RPMH_VRM_VOLTAGE_ENABLE_SETTLING_DEP_ENABLE_CSR_REG44'/>"
WRITE #1 "        <register address='0xb9ef5e4' value='0x" DATA.LONG(A:0x9ef5e4) "' name='RPMH_VRM_VOLTAGE_ENABLE_SETTLING_DEP_ENABLE_CSR_REG45'/>"
WRITE #1 "        <register address='0xb9e00fc' value='0x" DATA.LONG(A:0x9e00fc) "' name='RPMH_VRM_SW_WORKAROUND_CSR_REG0'/>"
WRITE #1 "        <register address='0xb9e01fc' value='0x" DATA.LONG(A:0x9e01fc) "' name='RPMH_VRM_SW_WORKAROUND_CSR_REG1'/>"
WRITE #1 "        <register address='0xb9e02fc' value='0x" DATA.LONG(A:0x9e02fc) "' name='RPMH_VRM_SW_WORKAROUND_CSR_REG2'/>"
WRITE #1 "        <register address='0xb9e03fc' value='0x" DATA.LONG(A:0x9e03fc) "' name='RPMH_VRM_SW_WORKAROUND_CSR_REG3'/>"
WRITE #1 "        <register address='0xb9e04fc' value='0x" DATA.LONG(A:0x9e04fc) "' name='RPMH_VRM_SW_WORKAROUND_CSR_REG4'/>"
WRITE #1 "        <register address='0xb9e05fc' value='0x" DATA.LONG(A:0x9e05fc) "' name='RPMH_VRM_SW_WORKAROUND_CSR_REG5'/>"
WRITE #1 "        <register address='0xb9e06fc' value='0x" DATA.LONG(A:0x9e06fc) "' name='RPMH_VRM_SW_WORKAROUND_CSR_REG6'/>"
WRITE #1 "        <register address='0xb9e07fc' value='0x" DATA.LONG(A:0x9e07fc) "' name='RPMH_VRM_SW_WORKAROUND_CSR_REG7'/>"
WRITE #1 "        <register address='0xb9e08fc' value='0x" DATA.LONG(A:0x9e08fc) "' name='RPMH_VRM_SW_WORKAROUND_CSR_REG8'/>"
WRITE #1 "        <register address='0xb9e09fc' value='0x" DATA.LONG(A:0x9e09fc) "' name='RPMH_VRM_SW_WORKAROUND_CSR_REG9'/>"
WRITE #1 "        <register address='0xb9e0afc' value='0x" DATA.LONG(A:0x9e0afc) "' name='RPMH_VRM_SW_WORKAROUND_CSR_REG10'/>"
WRITE #1 "        <register address='0xb9e0bfc' value='0x" DATA.LONG(A:0x9e0bfc) "' name='RPMH_VRM_SW_WORKAROUND_CSR_REG11'/>"
WRITE #1 "        <register address='0xb9e0cfc' value='0x" DATA.LONG(A:0x9e0cfc) "' name='RPMH_VRM_SW_WORKAROUND_CSR_REG12'/>"
WRITE #1 "        <register address='0xb9e0dfc' value='0x" DATA.LONG(A:0x9e0dfc) "' name='RPMH_VRM_SW_WORKAROUND_CSR_REG13'/>"
WRITE #1 "        <register address='0xb9e0efc' value='0x" DATA.LONG(A:0x9e0efc) "' name='RPMH_VRM_SW_WORKAROUND_CSR_REG14'/>"
WRITE #1 "        <register address='0xb9e0ffc' value='0x" DATA.LONG(A:0x9e0ffc) "' name='RPMH_VRM_SW_WORKAROUND_CSR_REG15'/>"
WRITE #1 "        <register address='0xb9e10fc' value='0x" DATA.LONG(A:0x9e10fc) "' name='RPMH_VRM_SW_WORKAROUND_CSR_REG16'/>"
WRITE #1 "        <register address='0xb9e11fc' value='0x" DATA.LONG(A:0x9e11fc) "' name='RPMH_VRM_SW_WORKAROUND_CSR_REG17'/>"
WRITE #1 "        <register address='0xb9e12fc' value='0x" DATA.LONG(A:0x9e12fc) "' name='RPMH_VRM_SW_WORKAROUND_CSR_REG18'/>"
WRITE #1 "        <register address='0xb9e13fc' value='0x" DATA.LONG(A:0x9e13fc) "' name='RPMH_VRM_SW_WORKAROUND_CSR_REG19'/>"
WRITE #1 "        <register address='0xb9e14fc' value='0x" DATA.LONG(A:0x9e14fc) "' name='RPMH_VRM_SW_WORKAROUND_CSR_REG20'/>"
WRITE #1 "        <register address='0xb9e15fc' value='0x" DATA.LONG(A:0x9e15fc) "' name='RPMH_VRM_SW_WORKAROUND_CSR_REG21'/>"
WRITE #1 "        <register address='0xb9e16fc' value='0x" DATA.LONG(A:0x9e16fc) "' name='RPMH_VRM_SW_WORKAROUND_CSR_REG22'/>"
WRITE #1 "        <register address='0xb9e17fc' value='0x" DATA.LONG(A:0x9e17fc) "' name='RPMH_VRM_SW_WORKAROUND_CSR_REG23'/>"
WRITE #1 "        <register address='0xb9e18fc' value='0x" DATA.LONG(A:0x9e18fc) "' name='RPMH_VRM_SW_WORKAROUND_CSR_REG24'/>"
WRITE #1 "        <register address='0xb9e19fc' value='0x" DATA.LONG(A:0x9e19fc) "' name='RPMH_VRM_SW_WORKAROUND_CSR_REG25'/>"
WRITE #1 "        <register address='0xb9e1afc' value='0x" DATA.LONG(A:0x9e1afc) "' name='RPMH_VRM_SW_WORKAROUND_CSR_REG26'/>"
WRITE #1 "        <register address='0xb9e1bfc' value='0x" DATA.LONG(A:0x9e1bfc) "' name='RPMH_VRM_SW_WORKAROUND_CSR_REG27'/>"
WRITE #1 "        <register address='0xb9e1cfc' value='0x" DATA.LONG(A:0x9e1cfc) "' name='RPMH_VRM_SW_WORKAROUND_CSR_REG28'/>"
WRITE #1 "        <register address='0xb9e1dfc' value='0x" DATA.LONG(A:0x9e1dfc) "' name='RPMH_VRM_SW_WORKAROUND_CSR_REG29'/>"
WRITE #1 "        <register address='0xb9e1efc' value='0x" DATA.LONG(A:0x9e1efc) "' name='RPMH_VRM_SW_WORKAROUND_CSR_REG30'/>"
WRITE #1 "        <register address='0xb9e1ffc' value='0x" DATA.LONG(A:0x9e1ffc) "' name='RPMH_VRM_SW_WORKAROUND_CSR_REG31'/>"
WRITE #1 "        <register address='0xb9e20fc' value='0x" DATA.LONG(A:0x9e20fc) "' name='RPMH_VRM_SW_WORKAROUND_CSR_REG32'/>"
WRITE #1 "        <register address='0xb9e21fc' value='0x" DATA.LONG(A:0x9e21fc) "' name='RPMH_VRM_SW_WORKAROUND_CSR_REG33'/>"
WRITE #1 "        <register address='0xb9e22fc' value='0x" DATA.LONG(A:0x9e22fc) "' name='RPMH_VRM_SW_WORKAROUND_CSR_REG34'/>"
WRITE #1 "        <register address='0xb9e23fc' value='0x" DATA.LONG(A:0x9e23fc) "' name='RPMH_VRM_SW_WORKAROUND_CSR_REG35'/>"
WRITE #1 "        <register address='0xb9e24fc' value='0x" DATA.LONG(A:0x9e24fc) "' name='RPMH_VRM_SW_WORKAROUND_CSR_REG36'/>"
WRITE #1 "        <register address='0xb9e25fc' value='0x" DATA.LONG(A:0x9e25fc) "' name='RPMH_VRM_SW_WORKAROUND_CSR_REG37'/>"
WRITE #1 "        <register address='0xb9e26fc' value='0x" DATA.LONG(A:0x9e26fc) "' name='RPMH_VRM_SW_WORKAROUND_CSR_REG38'/>"
WRITE #1 "        <register address='0xb9e27fc' value='0x" DATA.LONG(A:0x9e27fc) "' name='RPMH_VRM_SW_WORKAROUND_CSR_REG39'/>"
WRITE #1 "        <register address='0xb9e28fc' value='0x" DATA.LONG(A:0x9e28fc) "' name='RPMH_VRM_SW_WORKAROUND_CSR_REG40'/>"
WRITE #1 "        <register address='0xb9e29fc' value='0x" DATA.LONG(A:0x9e29fc) "' name='RPMH_VRM_SW_WORKAROUND_CSR_REG41'/>"
WRITE #1 "        <register address='0xb9e2afc' value='0x" DATA.LONG(A:0x9e2afc) "' name='RPMH_VRM_SW_WORKAROUND_CSR_REG42'/>"
WRITE #1 "        <register address='0xb9e2bfc' value='0x" DATA.LONG(A:0x9e2bfc) "' name='RPMH_VRM_SW_WORKAROUND_CSR_REG43'/>"
WRITE #1 "        <register address='0xb9e2cfc' value='0x" DATA.LONG(A:0x9e2cfc) "' name='RPMH_VRM_SW_WORKAROUND_CSR_REG44'/>"
WRITE #1 "        <register address='0xb9e2dfc' value='0x" DATA.LONG(A:0x9e2dfc) "' name='RPMH_VRM_SW_WORKAROUND_CSR_REG45'/>"
WRITE #1 "        <register address='0xb9ef000' value='0x" DATA.LONG(A:0x9ef000) "' name='RPMH_VRM_XO_SETTLING_TIME_CSR_RES0'/>"
WRITE #1 "        <register address='0xb9ef108' value='0x" DATA.LONG(A:0x9ef108) "' name='RPMH_VRM_XOB_SETTLING_TIME_CSR_RES0'/>"
WRITE #1 "        <register address='0xb9ef10c' value='0x" DATA.LONG(A:0x9ef10c) "' name='RPMH_VRM_XOB_SETTLING_TIME_CSR_RES1'/>"
WRITE #1 "        <register address='0xb9ef110' value='0x" DATA.LONG(A:0x9ef110) "' name='RPMH_VRM_XOB_SETTLING_TIME_CSR_RES2'/>"
WRITE #1 "        <register address='0xb9ef114' value='0x" DATA.LONG(A:0x9ef114) "' name='RPMH_VRM_XOB_SETTLING_TIME_CSR_RES3'/>"
WRITE #1 "        <register address='0xb9ef118' value='0x" DATA.LONG(A:0x9ef118) "' name='RPMH_VRM_XOB_SETTLING_TIME_CSR_RES4'/>"
WRITE #1 "        <register address='0xb9ef11c' value='0x" DATA.LONG(A:0x9ef11c) "' name='RPMH_VRM_XOB_SETTLING_TIME_CSR_RES5'/>"
WRITE #1 "        <register address='0xb9ef120' value='0x" DATA.LONG(A:0x9ef120) "' name='RPMH_VRM_XOB_SETTLING_TIME_CSR_RES6'/>"
WRITE #1 "        <register address='0xb9ef124' value='0x" DATA.LONG(A:0x9ef124) "' name='RPMH_VRM_XOB_SETTLING_TIME_CSR_RES7'/>"
WRITE #1 "        <register address='0xb9ef128' value='0x" DATA.LONG(A:0x9ef128) "' name='RPMH_VRM_XOB_SETTLING_TIME_CSR_RES8'/>"
WRITE #1 "        <register address='0xb9ef12c' value='0x" DATA.LONG(A:0x9ef12c) "' name='RPMH_VRM_XOB_SETTLING_TIME_CSR_RES9'/>"
WRITE #1 "        <register address='0xb9ef130' value='0x" DATA.LONG(A:0x9ef130) "' name='RPMH_VRM_XOB_SETTLING_TIME_CSR_RES10'/>"
WRITE #1 "        <register address='0xb9ef134' value='0x" DATA.LONG(A:0x9ef134) "' name='RPMH_VRM_XOB_SETTLING_TIME_CSR_RES11'/>"
WRITE #1 "        <register address='0xb9ef138' value='0x" DATA.LONG(A:0x9ef138) "' name='RPMH_VRM_XOB_SETTLING_TIME_CSR_RES12'/>"
WRITE #1 "        <register address='0xb9ef13c' value='0x" DATA.LONG(A:0x9ef13c) "' name='RPMH_VRM_XOB_SETTLING_TIME_CSR_RES13'/>"
WRITE #1 "        <register address='0xb9ef140' value='0x" DATA.LONG(A:0x9ef140) "' name='RPMH_VRM_XOB_SETTLING_TIME_CSR_RES14'/>"
WRITE #1 "        <register address='0xb9ef144' value='0x" DATA.LONG(A:0x9ef144) "' name='RPMH_VRM_XOB_SETTLING_TIME_CSR_RES15'/>"
WRITE #1 "        <register address='0xb9f0000' value='0x" DATA.LONG(A:0x9f0000) "' name='RPMH_VRM_VOLTAGE_ADDR_OFFSET_CSR_TYPE0'/>"
WRITE #1 "        <register address='0xb9f0060' value='0x" DATA.LONG(A:0x9f0060) "' name='RPMH_VRM_VOLTAGE_ADDR_OFFSET_CSR_TYPE1'/>"
WRITE #1 "        <register address='0xb9f00c0' value='0x" DATA.LONG(A:0x9f00c0) "' name='RPMH_VRM_VOLTAGE_ADDR_OFFSET_CSR_TYPE2'/>"
WRITE #1 "        <register address='0xb9f0120' value='0x" DATA.LONG(A:0x9f0120) "' name='RPMH_VRM_VOLTAGE_ADDR_OFFSET_CSR_TYPE3'/>"
WRITE #1 "        <register address='0xb9f0180' value='0x" DATA.LONG(A:0x9f0180) "' name='RPMH_VRM_VOLTAGE_ADDR_OFFSET_CSR_TYPE4'/>"
WRITE #1 "        <register address='0xb9f01e0' value='0x" DATA.LONG(A:0x9f01e0) "' name='RPMH_VRM_VOLTAGE_ADDR_OFFSET_CSR_TYPE5'/>"
WRITE #1 "        <register address='0xb9f0240' value='0x" DATA.LONG(A:0x9f0240) "' name='RPMH_VRM_VOLTAGE_ADDR_OFFSET_CSR_TYPE6'/>"
WRITE #1 "        <register address='0xb9f02a0' value='0x" DATA.LONG(A:0x9f02a0) "' name='RPMH_VRM_VOLTAGE_ADDR_OFFSET_CSR_TYPE7'/>"
WRITE #1 "        <register address='0xb9f0300' value='0x" DATA.LONG(A:0x9f0300) "' name='RPMH_VRM_VOLTAGE_ADDR_OFFSET_CSR_TYPE8'/>"
WRITE #1 "        <register address='0xb9f0360' value='0x" DATA.LONG(A:0x9f0360) "' name='RPMH_VRM_VOLTAGE_ADDR_OFFSET_CSR_TYPE9'/>"
WRITE #1 "        <register address='0xb9f03c0' value='0x" DATA.LONG(A:0x9f03c0) "' name='RPMH_VRM_VOLTAGE_ADDR_OFFSET_CSR_TYPE10'/>"
WRITE #1 "        <register address='0xb9f0420' value='0x" DATA.LONG(A:0x9f0420) "' name='RPMH_VRM_VOLTAGE_ADDR_OFFSET_CSR_TYPE11'/>"
WRITE #1 "        <register address='0xb9f0480' value='0x" DATA.LONG(A:0x9f0480) "' name='RPMH_VRM_VOLTAGE_ADDR_OFFSET_CSR_TYPE12'/>"
WRITE #1 "        <register address='0xb9f04e0' value='0x" DATA.LONG(A:0x9f04e0) "' name='RPMH_VRM_VOLTAGE_ADDR_OFFSET_CSR_TYPE13'/>"
WRITE #1 "        <register address='0xb9f0540' value='0x" DATA.LONG(A:0x9f0540) "' name='RPMH_VRM_VOLTAGE_ADDR_OFFSET_CSR_TYPE14'/>"
WRITE #1 "        <register address='0xb9f05a0' value='0x" DATA.LONG(A:0x9f05a0) "' name='RPMH_VRM_VOLTAGE_ADDR_OFFSET_CSR_TYPE15'/>"
WRITE #1 "        <register address='0xb9f0004' value='0x" DATA.LONG(A:0x9f0004) "' name='RPMH_VRM_ENABLE_ADDR_OFFSET_CSR_TYPE0'/>"
WRITE #1 "        <register address='0xb9f0064' value='0x" DATA.LONG(A:0x9f0064) "' name='RPMH_VRM_ENABLE_ADDR_OFFSET_CSR_TYPE1'/>"
WRITE #1 "        <register address='0xb9f00c4' value='0x" DATA.LONG(A:0x9f00c4) "' name='RPMH_VRM_ENABLE_ADDR_OFFSET_CSR_TYPE2'/>"
WRITE #1 "        <register address='0xb9f0124' value='0x" DATA.LONG(A:0x9f0124) "' name='RPMH_VRM_ENABLE_ADDR_OFFSET_CSR_TYPE3'/>"
WRITE #1 "        <register address='0xb9f0184' value='0x" DATA.LONG(A:0x9f0184) "' name='RPMH_VRM_ENABLE_ADDR_OFFSET_CSR_TYPE4'/>"
WRITE #1 "        <register address='0xb9f01e4' value='0x" DATA.LONG(A:0x9f01e4) "' name='RPMH_VRM_ENABLE_ADDR_OFFSET_CSR_TYPE5'/>"
WRITE #1 "        <register address='0xb9f0244' value='0x" DATA.LONG(A:0x9f0244) "' name='RPMH_VRM_ENABLE_ADDR_OFFSET_CSR_TYPE6'/>"
WRITE #1 "        <register address='0xb9f02a4' value='0x" DATA.LONG(A:0x9f02a4) "' name='RPMH_VRM_ENABLE_ADDR_OFFSET_CSR_TYPE7'/>"
WRITE #1 "        <register address='0xb9f0304' value='0x" DATA.LONG(A:0x9f0304) "' name='RPMH_VRM_ENABLE_ADDR_OFFSET_CSR_TYPE8'/>"
WRITE #1 "        <register address='0xb9f0364' value='0x" DATA.LONG(A:0x9f0364) "' name='RPMH_VRM_ENABLE_ADDR_OFFSET_CSR_TYPE9'/>"
WRITE #1 "        <register address='0xb9f03c4' value='0x" DATA.LONG(A:0x9f03c4) "' name='RPMH_VRM_ENABLE_ADDR_OFFSET_CSR_TYPE10'/>"
WRITE #1 "        <register address='0xb9f0424' value='0x" DATA.LONG(A:0x9f0424) "' name='RPMH_VRM_ENABLE_ADDR_OFFSET_CSR_TYPE11'/>"
WRITE #1 "        <register address='0xb9f0484' value='0x" DATA.LONG(A:0x9f0484) "' name='RPMH_VRM_ENABLE_ADDR_OFFSET_CSR_TYPE12'/>"
WRITE #1 "        <register address='0xb9f04e4' value='0x" DATA.LONG(A:0x9f04e4) "' name='RPMH_VRM_ENABLE_ADDR_OFFSET_CSR_TYPE13'/>"
WRITE #1 "        <register address='0xb9f0544' value='0x" DATA.LONG(A:0x9f0544) "' name='RPMH_VRM_ENABLE_ADDR_OFFSET_CSR_TYPE14'/>"
WRITE #1 "        <register address='0xb9f05a4' value='0x" DATA.LONG(A:0x9f05a4) "' name='RPMH_VRM_ENABLE_ADDR_OFFSET_CSR_TYPE15'/>"
WRITE #1 "        <register address='0xb9f0008' value='0x" DATA.LONG(A:0x9f0008) "' name='RPMH_VRM_MODE_ADDR_OFFSET_CSR_TYPE0'/>"
WRITE #1 "        <register address='0xb9f0068' value='0x" DATA.LONG(A:0x9f0068) "' name='RPMH_VRM_MODE_ADDR_OFFSET_CSR_TYPE1'/>"
WRITE #1 "        <register address='0xb9f00c8' value='0x" DATA.LONG(A:0x9f00c8) "' name='RPMH_VRM_MODE_ADDR_OFFSET_CSR_TYPE2'/>"
WRITE #1 "        <register address='0xb9f0128' value='0x" DATA.LONG(A:0x9f0128) "' name='RPMH_VRM_MODE_ADDR_OFFSET_CSR_TYPE3'/>"
WRITE #1 "        <register address='0xb9f0188' value='0x" DATA.LONG(A:0x9f0188) "' name='RPMH_VRM_MODE_ADDR_OFFSET_CSR_TYPE4'/>"
WRITE #1 "        <register address='0xb9f01e8' value='0x" DATA.LONG(A:0x9f01e8) "' name='RPMH_VRM_MODE_ADDR_OFFSET_CSR_TYPE5'/>"
WRITE #1 "        <register address='0xb9f0248' value='0x" DATA.LONG(A:0x9f0248) "' name='RPMH_VRM_MODE_ADDR_OFFSET_CSR_TYPE6'/>"
WRITE #1 "        <register address='0xb9f02a8' value='0x" DATA.LONG(A:0x9f02a8) "' name='RPMH_VRM_MODE_ADDR_OFFSET_CSR_TYPE7'/>"
WRITE #1 "        <register address='0xb9f0308' value='0x" DATA.LONG(A:0x9f0308) "' name='RPMH_VRM_MODE_ADDR_OFFSET_CSR_TYPE8'/>"
WRITE #1 "        <register address='0xb9f0368' value='0x" DATA.LONG(A:0x9f0368) "' name='RPMH_VRM_MODE_ADDR_OFFSET_CSR_TYPE9'/>"
WRITE #1 "        <register address='0xb9f03c8' value='0x" DATA.LONG(A:0x9f03c8) "' name='RPMH_VRM_MODE_ADDR_OFFSET_CSR_TYPE10'/>"
WRITE #1 "        <register address='0xb9f0428' value='0x" DATA.LONG(A:0x9f0428) "' name='RPMH_VRM_MODE_ADDR_OFFSET_CSR_TYPE11'/>"
WRITE #1 "        <register address='0xb9f0488' value='0x" DATA.LONG(A:0x9f0488) "' name='RPMH_VRM_MODE_ADDR_OFFSET_CSR_TYPE12'/>"
WRITE #1 "        <register address='0xb9f04e8' value='0x" DATA.LONG(A:0x9f04e8) "' name='RPMH_VRM_MODE_ADDR_OFFSET_CSR_TYPE13'/>"
WRITE #1 "        <register address='0xb9f0548' value='0x" DATA.LONG(A:0x9f0548) "' name='RPMH_VRM_MODE_ADDR_OFFSET_CSR_TYPE14'/>"
WRITE #1 "        <register address='0xb9f05a8' value='0x" DATA.LONG(A:0x9f05a8) "' name='RPMH_VRM_MODE_ADDR_OFFSET_CSR_TYPE15'/>"
WRITE #1 "        <register address='0xb9f001c' value='0x" DATA.LONG(A:0x9f001c) "' name='RPMH_VRM_VOLTAGE_STEPPER_SETTLING_TIME_CSR_TYPE0'/>"
WRITE #1 "        <register address='0xb9f007c' value='0x" DATA.LONG(A:0x9f007c) "' name='RPMH_VRM_VOLTAGE_STEPPER_SETTLING_TIME_CSR_TYPE1'/>"
WRITE #1 "        <register address='0xb9f00dc' value='0x" DATA.LONG(A:0x9f00dc) "' name='RPMH_VRM_VOLTAGE_STEPPER_SETTLING_TIME_CSR_TYPE2'/>"
WRITE #1 "        <register address='0xb9f013c' value='0x" DATA.LONG(A:0x9f013c) "' name='RPMH_VRM_VOLTAGE_STEPPER_SETTLING_TIME_CSR_TYPE3'/>"
WRITE #1 "        <register address='0xb9f019c' value='0x" DATA.LONG(A:0x9f019c) "' name='RPMH_VRM_VOLTAGE_STEPPER_SETTLING_TIME_CSR_TYPE4'/>"
WRITE #1 "        <register address='0xb9f01fc' value='0x" DATA.LONG(A:0x9f01fc) "' name='RPMH_VRM_VOLTAGE_STEPPER_SETTLING_TIME_CSR_TYPE5'/>"
WRITE #1 "        <register address='0xb9f025c' value='0x" DATA.LONG(A:0x9f025c) "' name='RPMH_VRM_VOLTAGE_STEPPER_SETTLING_TIME_CSR_TYPE6'/>"
WRITE #1 "        <register address='0xb9f02bc' value='0x" DATA.LONG(A:0x9f02bc) "' name='RPMH_VRM_VOLTAGE_STEPPER_SETTLING_TIME_CSR_TYPE7'/>"
WRITE #1 "        <register address='0xb9f031c' value='0x" DATA.LONG(A:0x9f031c) "' name='RPMH_VRM_VOLTAGE_STEPPER_SETTLING_TIME_CSR_TYPE8'/>"
WRITE #1 "        <register address='0xb9f037c' value='0x" DATA.LONG(A:0x9f037c) "' name='RPMH_VRM_VOLTAGE_STEPPER_SETTLING_TIME_CSR_TYPE9'/>"
WRITE #1 "        <register address='0xb9f03dc' value='0x" DATA.LONG(A:0x9f03dc) "' name='RPMH_VRM_VOLTAGE_STEPPER_SETTLING_TIME_CSR_TYPE10'/>"
WRITE #1 "        <register address='0xb9f043c' value='0x" DATA.LONG(A:0x9f043c) "' name='RPMH_VRM_VOLTAGE_STEPPER_SETTLING_TIME_CSR_TYPE11'/>"
WRITE #1 "        <register address='0xb9f049c' value='0x" DATA.LONG(A:0x9f049c) "' name='RPMH_VRM_VOLTAGE_STEPPER_SETTLING_TIME_CSR_TYPE12'/>"
WRITE #1 "        <register address='0xb9f04fc' value='0x" DATA.LONG(A:0x9f04fc) "' name='RPMH_VRM_VOLTAGE_STEPPER_SETTLING_TIME_CSR_TYPE13'/>"
WRITE #1 "        <register address='0xb9f055c' value='0x" DATA.LONG(A:0x9f055c) "' name='RPMH_VRM_VOLTAGE_STEPPER_SETTLING_TIME_CSR_TYPE14'/>"
WRITE #1 "        <register address='0xb9f05bc' value='0x" DATA.LONG(A:0x9f05bc) "' name='RPMH_VRM_VOLTAGE_STEPPER_SETTLING_TIME_CSR_TYPE15'/>"
WRITE #1 "        <register address='0xb9f0020' value='0x" DATA.LONG(A:0x9f0020) "' name='RPMH_VRM_VOLTAGE_FIXED_UP_SETTLING_TIME_CSR_TYPE0'/>"
WRITE #1 "        <register address='0xb9f0080' value='0x" DATA.LONG(A:0x9f0080) "' name='RPMH_VRM_VOLTAGE_FIXED_UP_SETTLING_TIME_CSR_TYPE1'/>"
WRITE #1 "        <register address='0xb9f00e0' value='0x" DATA.LONG(A:0x9f00e0) "' name='RPMH_VRM_VOLTAGE_FIXED_UP_SETTLING_TIME_CSR_TYPE2'/>"
WRITE #1 "        <register address='0xb9f0140' value='0x" DATA.LONG(A:0x9f0140) "' name='RPMH_VRM_VOLTAGE_FIXED_UP_SETTLING_TIME_CSR_TYPE3'/>"
WRITE #1 "        <register address='0xb9f01a0' value='0x" DATA.LONG(A:0x9f01a0) "' name='RPMH_VRM_VOLTAGE_FIXED_UP_SETTLING_TIME_CSR_TYPE4'/>"
WRITE #1 "        <register address='0xb9f0200' value='0x" DATA.LONG(A:0x9f0200) "' name='RPMH_VRM_VOLTAGE_FIXED_UP_SETTLING_TIME_CSR_TYPE5'/>"
WRITE #1 "        <register address='0xb9f0260' value='0x" DATA.LONG(A:0x9f0260) "' name='RPMH_VRM_VOLTAGE_FIXED_UP_SETTLING_TIME_CSR_TYPE6'/>"
WRITE #1 "        <register address='0xb9f02c0' value='0x" DATA.LONG(A:0x9f02c0) "' name='RPMH_VRM_VOLTAGE_FIXED_UP_SETTLING_TIME_CSR_TYPE7'/>"
WRITE #1 "        <register address='0xb9f0320' value='0x" DATA.LONG(A:0x9f0320) "' name='RPMH_VRM_VOLTAGE_FIXED_UP_SETTLING_TIME_CSR_TYPE8'/>"
WRITE #1 "        <register address='0xb9f0380' value='0x" DATA.LONG(A:0x9f0380) "' name='RPMH_VRM_VOLTAGE_FIXED_UP_SETTLING_TIME_CSR_TYPE9'/>"
WRITE #1 "        <register address='0xb9f03e0' value='0x" DATA.LONG(A:0x9f03e0) "' name='RPMH_VRM_VOLTAGE_FIXED_UP_SETTLING_TIME_CSR_TYPE10'/>"
WRITE #1 "        <register address='0xb9f0440' value='0x" DATA.LONG(A:0x9f0440) "' name='RPMH_VRM_VOLTAGE_FIXED_UP_SETTLING_TIME_CSR_TYPE11'/>"
WRITE #1 "        <register address='0xb9f04a0' value='0x" DATA.LONG(A:0x9f04a0) "' name='RPMH_VRM_VOLTAGE_FIXED_UP_SETTLING_TIME_CSR_TYPE12'/>"
WRITE #1 "        <register address='0xb9f0500' value='0x" DATA.LONG(A:0x9f0500) "' name='RPMH_VRM_VOLTAGE_FIXED_UP_SETTLING_TIME_CSR_TYPE13'/>"
WRITE #1 "        <register address='0xb9f0560' value='0x" DATA.LONG(A:0x9f0560) "' name='RPMH_VRM_VOLTAGE_FIXED_UP_SETTLING_TIME_CSR_TYPE14'/>"
WRITE #1 "        <register address='0xb9f05c0' value='0x" DATA.LONG(A:0x9f05c0) "' name='RPMH_VRM_VOLTAGE_FIXED_UP_SETTLING_TIME_CSR_TYPE15'/>"
WRITE #1 "        <register address='0xb9f0024' value='0x" DATA.LONG(A:0x9f0024) "' name='RPMH_VRM_VOLTAGE_FIXED_DOWN_SETTLING_TIME_CSR_TYPE0'/>"
WRITE #1 "        <register address='0xb9f0084' value='0x" DATA.LONG(A:0x9f0084) "' name='RPMH_VRM_VOLTAGE_FIXED_DOWN_SETTLING_TIME_CSR_TYPE1'/>"
WRITE #1 "        <register address='0xb9f00e4' value='0x" DATA.LONG(A:0x9f00e4) "' name='RPMH_VRM_VOLTAGE_FIXED_DOWN_SETTLING_TIME_CSR_TYPE2'/>"
WRITE #1 "        <register address='0xb9f0144' value='0x" DATA.LONG(A:0x9f0144) "' name='RPMH_VRM_VOLTAGE_FIXED_DOWN_SETTLING_TIME_CSR_TYPE3'/>"
WRITE #1 "        <register address='0xb9f01a4' value='0x" DATA.LONG(A:0x9f01a4) "' name='RPMH_VRM_VOLTAGE_FIXED_DOWN_SETTLING_TIME_CSR_TYPE4'/>"
WRITE #1 "        <register address='0xb9f0204' value='0x" DATA.LONG(A:0x9f0204) "' name='RPMH_VRM_VOLTAGE_FIXED_DOWN_SETTLING_TIME_CSR_TYPE5'/>"
WRITE #1 "        <register address='0xb9f0264' value='0x" DATA.LONG(A:0x9f0264) "' name='RPMH_VRM_VOLTAGE_FIXED_DOWN_SETTLING_TIME_CSR_TYPE6'/>"
WRITE #1 "        <register address='0xb9f02c4' value='0x" DATA.LONG(A:0x9f02c4) "' name='RPMH_VRM_VOLTAGE_FIXED_DOWN_SETTLING_TIME_CSR_TYPE7'/>"
WRITE #1 "        <register address='0xb9f0324' value='0x" DATA.LONG(A:0x9f0324) "' name='RPMH_VRM_VOLTAGE_FIXED_DOWN_SETTLING_TIME_CSR_TYPE8'/>"
WRITE #1 "        <register address='0xb9f0384' value='0x" DATA.LONG(A:0x9f0384) "' name='RPMH_VRM_VOLTAGE_FIXED_DOWN_SETTLING_TIME_CSR_TYPE9'/>"
WRITE #1 "        <register address='0xb9f03e4' value='0x" DATA.LONG(A:0x9f03e4) "' name='RPMH_VRM_VOLTAGE_FIXED_DOWN_SETTLING_TIME_CSR_TYPE10'/>"
WRITE #1 "        <register address='0xb9f0444' value='0x" DATA.LONG(A:0x9f0444) "' name='RPMH_VRM_VOLTAGE_FIXED_DOWN_SETTLING_TIME_CSR_TYPE11'/>"
WRITE #1 "        <register address='0xb9f04a4' value='0x" DATA.LONG(A:0x9f04a4) "' name='RPMH_VRM_VOLTAGE_FIXED_DOWN_SETTLING_TIME_CSR_TYPE12'/>"
WRITE #1 "        <register address='0xb9f0504' value='0x" DATA.LONG(A:0x9f0504) "' name='RPMH_VRM_VOLTAGE_FIXED_DOWN_SETTLING_TIME_CSR_TYPE13'/>"
WRITE #1 "        <register address='0xb9f0564' value='0x" DATA.LONG(A:0x9f0564) "' name='RPMH_VRM_VOLTAGE_FIXED_DOWN_SETTLING_TIME_CSR_TYPE14'/>"
WRITE #1 "        <register address='0xb9f05c4' value='0x" DATA.LONG(A:0x9f05c4) "' name='RPMH_VRM_VOLTAGE_FIXED_DOWN_SETTLING_TIME_CSR_TYPE15'/>"
WRITE #1 "        <register address='0xb9f0ff0' value='0x" DATA.LONG(A:0x9f0ff0) "' name='RPMH_VRM_VOLTAGE_UP_SETTLING_TIME_SEL'/>"
WRITE #1 "        <register address='0xb9f0ff4' value='0x" DATA.LONG(A:0x9f0ff4) "' name='RPMH_VRM_VOLTAGE_DOWN_SETTLING_TIME_SEL'/>"
WRITE #1 "        <register address='0xb9f0028' value='0x" DATA.LONG(A:0x9f0028) "' name='RPMH_VRM_ENABLE_STEPPER_SETTLING_TIME_CSR_TYPE0'/>"
WRITE #1 "        <register address='0xb9f0088' value='0x" DATA.LONG(A:0x9f0088) "' name='RPMH_VRM_ENABLE_STEPPER_SETTLING_TIME_CSR_TYPE1'/>"
WRITE #1 "        <register address='0xb9f00e8' value='0x" DATA.LONG(A:0x9f00e8) "' name='RPMH_VRM_ENABLE_STEPPER_SETTLING_TIME_CSR_TYPE2'/>"
WRITE #1 "        <register address='0xb9f0148' value='0x" DATA.LONG(A:0x9f0148) "' name='RPMH_VRM_ENABLE_STEPPER_SETTLING_TIME_CSR_TYPE3'/>"
WRITE #1 "        <register address='0xb9f01a8' value='0x" DATA.LONG(A:0x9f01a8) "' name='RPMH_VRM_ENABLE_STEPPER_SETTLING_TIME_CSR_TYPE4'/>"
WRITE #1 "        <register address='0xb9f0208' value='0x" DATA.LONG(A:0x9f0208) "' name='RPMH_VRM_ENABLE_STEPPER_SETTLING_TIME_CSR_TYPE5'/>"
WRITE #1 "        <register address='0xb9f0268' value='0x" DATA.LONG(A:0x9f0268) "' name='RPMH_VRM_ENABLE_STEPPER_SETTLING_TIME_CSR_TYPE6'/>"
WRITE #1 "        <register address='0xb9f02c8' value='0x" DATA.LONG(A:0x9f02c8) "' name='RPMH_VRM_ENABLE_STEPPER_SETTLING_TIME_CSR_TYPE7'/>"
WRITE #1 "        <register address='0xb9f0328' value='0x" DATA.LONG(A:0x9f0328) "' name='RPMH_VRM_ENABLE_STEPPER_SETTLING_TIME_CSR_TYPE8'/>"
WRITE #1 "        <register address='0xb9f0388' value='0x" DATA.LONG(A:0x9f0388) "' name='RPMH_VRM_ENABLE_STEPPER_SETTLING_TIME_CSR_TYPE9'/>"
WRITE #1 "        <register address='0xb9f03e8' value='0x" DATA.LONG(A:0x9f03e8) "' name='RPMH_VRM_ENABLE_STEPPER_SETTLING_TIME_CSR_TYPE10'/>"
WRITE #1 "        <register address='0xb9f0448' value='0x" DATA.LONG(A:0x9f0448) "' name='RPMH_VRM_ENABLE_STEPPER_SETTLING_TIME_CSR_TYPE11'/>"
WRITE #1 "        <register address='0xb9f04a8' value='0x" DATA.LONG(A:0x9f04a8) "' name='RPMH_VRM_ENABLE_STEPPER_SETTLING_TIME_CSR_TYPE12'/>"
WRITE #1 "        <register address='0xb9f0508' value='0x" DATA.LONG(A:0x9f0508) "' name='RPMH_VRM_ENABLE_STEPPER_SETTLING_TIME_CSR_TYPE13'/>"
WRITE #1 "        <register address='0xb9f0568' value='0x" DATA.LONG(A:0x9f0568) "' name='RPMH_VRM_ENABLE_STEPPER_SETTLING_TIME_CSR_TYPE14'/>"
WRITE #1 "        <register address='0xb9f05c8' value='0x" DATA.LONG(A:0x9f05c8) "' name='RPMH_VRM_ENABLE_STEPPER_SETTLING_TIME_CSR_TYPE15'/>"
WRITE #1 "        <register address='0xb9f002c' value='0x" DATA.LONG(A:0x9f002c) "' name='RPMH_VRM_ENABLE_FIXED_SETTLING_TIME_CSR_TYPE0'/>"
WRITE #1 "        <register address='0xb9f008c' value='0x" DATA.LONG(A:0x9f008c) "' name='RPMH_VRM_ENABLE_FIXED_SETTLING_TIME_CSR_TYPE1'/>"
WRITE #1 "        <register address='0xb9f00ec' value='0x" DATA.LONG(A:0x9f00ec) "' name='RPMH_VRM_ENABLE_FIXED_SETTLING_TIME_CSR_TYPE2'/>"
WRITE #1 "        <register address='0xb9f014c' value='0x" DATA.LONG(A:0x9f014c) "' name='RPMH_VRM_ENABLE_FIXED_SETTLING_TIME_CSR_TYPE3'/>"
WRITE #1 "        <register address='0xb9f01ac' value='0x" DATA.LONG(A:0x9f01ac) "' name='RPMH_VRM_ENABLE_FIXED_SETTLING_TIME_CSR_TYPE4'/>"
WRITE #1 "        <register address='0xb9f020c' value='0x" DATA.LONG(A:0x9f020c) "' name='RPMH_VRM_ENABLE_FIXED_SETTLING_TIME_CSR_TYPE5'/>"
WRITE #1 "        <register address='0xb9f026c' value='0x" DATA.LONG(A:0x9f026c) "' name='RPMH_VRM_ENABLE_FIXED_SETTLING_TIME_CSR_TYPE6'/>"
WRITE #1 "        <register address='0xb9f02cc' value='0x" DATA.LONG(A:0x9f02cc) "' name='RPMH_VRM_ENABLE_FIXED_SETTLING_TIME_CSR_TYPE7'/>"
WRITE #1 "        <register address='0xb9f032c' value='0x" DATA.LONG(A:0x9f032c) "' name='RPMH_VRM_ENABLE_FIXED_SETTLING_TIME_CSR_TYPE8'/>"
WRITE #1 "        <register address='0xb9f038c' value='0x" DATA.LONG(A:0x9f038c) "' name='RPMH_VRM_ENABLE_FIXED_SETTLING_TIME_CSR_TYPE9'/>"
WRITE #1 "        <register address='0xb9f03ec' value='0x" DATA.LONG(A:0x9f03ec) "' name='RPMH_VRM_ENABLE_FIXED_SETTLING_TIME_CSR_TYPE10'/>"
WRITE #1 "        <register address='0xb9f044c' value='0x" DATA.LONG(A:0x9f044c) "' name='RPMH_VRM_ENABLE_FIXED_SETTLING_TIME_CSR_TYPE11'/>"
WRITE #1 "        <register address='0xb9f04ac' value='0x" DATA.LONG(A:0x9f04ac) "' name='RPMH_VRM_ENABLE_FIXED_SETTLING_TIME_CSR_TYPE12'/>"
WRITE #1 "        <register address='0xb9f050c' value='0x" DATA.LONG(A:0x9f050c) "' name='RPMH_VRM_ENABLE_FIXED_SETTLING_TIME_CSR_TYPE13'/>"
WRITE #1 "        <register address='0xb9f056c' value='0x" DATA.LONG(A:0x9f056c) "' name='RPMH_VRM_ENABLE_FIXED_SETTLING_TIME_CSR_TYPE14'/>"
WRITE #1 "        <register address='0xb9f05cc' value='0x" DATA.LONG(A:0x9f05cc) "' name='RPMH_VRM_ENABLE_FIXED_SETTLING_TIME_CSR_TYPE15'/>"
WRITE #1 "        <register address='0xb9f0030' value='0x" DATA.LONG(A:0x9f0030) "' name='RPMH_VRM_ENABLE_WARM_UP_TIME_CSR_TYPE0'/>"
WRITE #1 "        <register address='0xb9f0090' value='0x" DATA.LONG(A:0x9f0090) "' name='RPMH_VRM_ENABLE_WARM_UP_TIME_CSR_TYPE1'/>"
WRITE #1 "        <register address='0xb9f00f0' value='0x" DATA.LONG(A:0x9f00f0) "' name='RPMH_VRM_ENABLE_WARM_UP_TIME_CSR_TYPE2'/>"
WRITE #1 "        <register address='0xb9f0150' value='0x" DATA.LONG(A:0x9f0150) "' name='RPMH_VRM_ENABLE_WARM_UP_TIME_CSR_TYPE3'/>"
WRITE #1 "        <register address='0xb9f01b0' value='0x" DATA.LONG(A:0x9f01b0) "' name='RPMH_VRM_ENABLE_WARM_UP_TIME_CSR_TYPE4'/>"
WRITE #1 "        <register address='0xb9f0210' value='0x" DATA.LONG(A:0x9f0210) "' name='RPMH_VRM_ENABLE_WARM_UP_TIME_CSR_TYPE5'/>"
WRITE #1 "        <register address='0xb9f0270' value='0x" DATA.LONG(A:0x9f0270) "' name='RPMH_VRM_ENABLE_WARM_UP_TIME_CSR_TYPE6'/>"
WRITE #1 "        <register address='0xb9f02d0' value='0x" DATA.LONG(A:0x9f02d0) "' name='RPMH_VRM_ENABLE_WARM_UP_TIME_CSR_TYPE7'/>"
WRITE #1 "        <register address='0xb9f0330' value='0x" DATA.LONG(A:0x9f0330) "' name='RPMH_VRM_ENABLE_WARM_UP_TIME_CSR_TYPE8'/>"
WRITE #1 "        <register address='0xb9f0390' value='0x" DATA.LONG(A:0x9f0390) "' name='RPMH_VRM_ENABLE_WARM_UP_TIME_CSR_TYPE9'/>"
WRITE #1 "        <register address='0xb9f03f0' value='0x" DATA.LONG(A:0x9f03f0) "' name='RPMH_VRM_ENABLE_WARM_UP_TIME_CSR_TYPE10'/>"
WRITE #1 "        <register address='0xb9f0450' value='0x" DATA.LONG(A:0x9f0450) "' name='RPMH_VRM_ENABLE_WARM_UP_TIME_CSR_TYPE11'/>"
WRITE #1 "        <register address='0xb9f04b0' value='0x" DATA.LONG(A:0x9f04b0) "' name='RPMH_VRM_ENABLE_WARM_UP_TIME_CSR_TYPE12'/>"
WRITE #1 "        <register address='0xb9f0510' value='0x" DATA.LONG(A:0x9f0510) "' name='RPMH_VRM_ENABLE_WARM_UP_TIME_CSR_TYPE13'/>"
WRITE #1 "        <register address='0xb9f0570' value='0x" DATA.LONG(A:0x9f0570) "' name='RPMH_VRM_ENABLE_WARM_UP_TIME_CSR_TYPE14'/>"
WRITE #1 "        <register address='0xb9f05d0' value='0x" DATA.LONG(A:0x9f05d0) "' name='RPMH_VRM_ENABLE_WARM_UP_TIME_CSR_TYPE15'/>"
WRITE #1 "        <register address='0xb9f0ff8' value='0x" DATA.LONG(A:0x9f0ff8) "' name='RPMH_VRM_ENABLE_UP_SETTLING_TIME_SEL'/>"
WRITE #1 "        <register address='0xb9f0034' value='0x" DATA.LONG(A:0x9f0034) "' name='RPMH_VRM_MODE_SETTLING_TIME_CSR_TYPE0'/>"
WRITE #1 "        <register address='0xb9f0094' value='0x" DATA.LONG(A:0x9f0094) "' name='RPMH_VRM_MODE_SETTLING_TIME_CSR_TYPE1'/>"
WRITE #1 "        <register address='0xb9f00f4' value='0x" DATA.LONG(A:0x9f00f4) "' name='RPMH_VRM_MODE_SETTLING_TIME_CSR_TYPE2'/>"
WRITE #1 "        <register address='0xb9f0154' value='0x" DATA.LONG(A:0x9f0154) "' name='RPMH_VRM_MODE_SETTLING_TIME_CSR_TYPE3'/>"
WRITE #1 "        <register address='0xb9f01b4' value='0x" DATA.LONG(A:0x9f01b4) "' name='RPMH_VRM_MODE_SETTLING_TIME_CSR_TYPE4'/>"
WRITE #1 "        <register address='0xb9f0214' value='0x" DATA.LONG(A:0x9f0214) "' name='RPMH_VRM_MODE_SETTLING_TIME_CSR_TYPE5'/>"
WRITE #1 "        <register address='0xb9f0274' value='0x" DATA.LONG(A:0x9f0274) "' name='RPMH_VRM_MODE_SETTLING_TIME_CSR_TYPE6'/>"
WRITE #1 "        <register address='0xb9f02d4' value='0x" DATA.LONG(A:0x9f02d4) "' name='RPMH_VRM_MODE_SETTLING_TIME_CSR_TYPE7'/>"
WRITE #1 "        <register address='0xb9f0334' value='0x" DATA.LONG(A:0x9f0334) "' name='RPMH_VRM_MODE_SETTLING_TIME_CSR_TYPE8'/>"
WRITE #1 "        <register address='0xb9f0394' value='0x" DATA.LONG(A:0x9f0394) "' name='RPMH_VRM_MODE_SETTLING_TIME_CSR_TYPE9'/>"
WRITE #1 "        <register address='0xb9f03f4' value='0x" DATA.LONG(A:0x9f03f4) "' name='RPMH_VRM_MODE_SETTLING_TIME_CSR_TYPE10'/>"
WRITE #1 "        <register address='0xb9f0454' value='0x" DATA.LONG(A:0x9f0454) "' name='RPMH_VRM_MODE_SETTLING_TIME_CSR_TYPE11'/>"
WRITE #1 "        <register address='0xb9f04b4' value='0x" DATA.LONG(A:0x9f04b4) "' name='RPMH_VRM_MODE_SETTLING_TIME_CSR_TYPE12'/>"
WRITE #1 "        <register address='0xb9f0514' value='0x" DATA.LONG(A:0x9f0514) "' name='RPMH_VRM_MODE_SETTLING_TIME_CSR_TYPE13'/>"
WRITE #1 "        <register address='0xb9f0574' value='0x" DATA.LONG(A:0x9f0574) "' name='RPMH_VRM_MODE_SETTLING_TIME_CSR_TYPE14'/>"
WRITE #1 "        <register address='0xb9f05d4' value='0x" DATA.LONG(A:0x9f05d4) "' name='RPMH_VRM_MODE_SETTLING_TIME_CSR_TYPE15'/>"
WRITE #1 "        <register address='0xb9f003c' value='0x" DATA.LONG(A:0x9f003c) "' name='RPMH_VRM_VREG_READY_WDOG_TIMER_MUL_CSR_TYPE0'/>"
WRITE #1 "        <register address='0xb9f009c' value='0x" DATA.LONG(A:0x9f009c) "' name='RPMH_VRM_VREG_READY_WDOG_TIMER_MUL_CSR_TYPE1'/>"
WRITE #1 "        <register address='0xb9f00fc' value='0x" DATA.LONG(A:0x9f00fc) "' name='RPMH_VRM_VREG_READY_WDOG_TIMER_MUL_CSR_TYPE2'/>"
WRITE #1 "        <register address='0xb9f015c' value='0x" DATA.LONG(A:0x9f015c) "' name='RPMH_VRM_VREG_READY_WDOG_TIMER_MUL_CSR_TYPE3'/>"
WRITE #1 "        <register address='0xb9f01bc' value='0x" DATA.LONG(A:0x9f01bc) "' name='RPMH_VRM_VREG_READY_WDOG_TIMER_MUL_CSR_TYPE4'/>"
WRITE #1 "        <register address='0xb9f021c' value='0x" DATA.LONG(A:0x9f021c) "' name='RPMH_VRM_VREG_READY_WDOG_TIMER_MUL_CSR_TYPE5'/>"
WRITE #1 "        <register address='0xb9f027c' value='0x" DATA.LONG(A:0x9f027c) "' name='RPMH_VRM_VREG_READY_WDOG_TIMER_MUL_CSR_TYPE6'/>"
WRITE #1 "        <register address='0xb9f02dc' value='0x" DATA.LONG(A:0x9f02dc) "' name='RPMH_VRM_VREG_READY_WDOG_TIMER_MUL_CSR_TYPE7'/>"
WRITE #1 "        <register address='0xb9f033c' value='0x" DATA.LONG(A:0x9f033c) "' name='RPMH_VRM_VREG_READY_WDOG_TIMER_MUL_CSR_TYPE8'/>"
WRITE #1 "        <register address='0xb9f039c' value='0x" DATA.LONG(A:0x9f039c) "' name='RPMH_VRM_VREG_READY_WDOG_TIMER_MUL_CSR_TYPE9'/>"
WRITE #1 "        <register address='0xb9f03fc' value='0x" DATA.LONG(A:0x9f03fc) "' name='RPMH_VRM_VREG_READY_WDOG_TIMER_MUL_CSR_TYPE10'/>"
WRITE #1 "        <register address='0xb9f045c' value='0x" DATA.LONG(A:0x9f045c) "' name='RPMH_VRM_VREG_READY_WDOG_TIMER_MUL_CSR_TYPE11'/>"
WRITE #1 "        <register address='0xb9f04bc' value='0x" DATA.LONG(A:0x9f04bc) "' name='RPMH_VRM_VREG_READY_WDOG_TIMER_MUL_CSR_TYPE12'/>"
WRITE #1 "        <register address='0xb9f051c' value='0x" DATA.LONG(A:0x9f051c) "' name='RPMH_VRM_VREG_READY_WDOG_TIMER_MUL_CSR_TYPE13'/>"
WRITE #1 "        <register address='0xb9f057c' value='0x" DATA.LONG(A:0x9f057c) "' name='RPMH_VRM_VREG_READY_WDOG_TIMER_MUL_CSR_TYPE14'/>"
WRITE #1 "        <register address='0xb9f05dc' value='0x" DATA.LONG(A:0x9f05dc) "' name='RPMH_VRM_VREG_READY_WDOG_TIMER_MUL_CSR_TYPE15'/>"
WRITE #1 "        <register address='0xb9f0040' value='0x" DATA.LONG(A:0x9f0040) "' name='RPMH_VRM_VOLTAGE_UP_EXTRA_TIME_TYPE0'/>"
WRITE #1 "        <register address='0xb9f00a0' value='0x" DATA.LONG(A:0x9f00a0) "' name='RPMH_VRM_VOLTAGE_UP_EXTRA_TIME_TYPE1'/>"
WRITE #1 "        <register address='0xb9f0100' value='0x" DATA.LONG(A:0x9f0100) "' name='RPMH_VRM_VOLTAGE_UP_EXTRA_TIME_TYPE2'/>"
WRITE #1 "        <register address='0xb9f0160' value='0x" DATA.LONG(A:0x9f0160) "' name='RPMH_VRM_VOLTAGE_UP_EXTRA_TIME_TYPE3'/>"
WRITE #1 "        <register address='0xb9f01c0' value='0x" DATA.LONG(A:0x9f01c0) "' name='RPMH_VRM_VOLTAGE_UP_EXTRA_TIME_TYPE4'/>"
WRITE #1 "        <register address='0xb9f0220' value='0x" DATA.LONG(A:0x9f0220) "' name='RPMH_VRM_VOLTAGE_UP_EXTRA_TIME_TYPE5'/>"
WRITE #1 "        <register address='0xb9f0280' value='0x" DATA.LONG(A:0x9f0280) "' name='RPMH_VRM_VOLTAGE_UP_EXTRA_TIME_TYPE6'/>"
WRITE #1 "        <register address='0xb9f02e0' value='0x" DATA.LONG(A:0x9f02e0) "' name='RPMH_VRM_VOLTAGE_UP_EXTRA_TIME_TYPE7'/>"
WRITE #1 "        <register address='0xb9f0340' value='0x" DATA.LONG(A:0x9f0340) "' name='RPMH_VRM_VOLTAGE_UP_EXTRA_TIME_TYPE8'/>"
WRITE #1 "        <register address='0xb9f03a0' value='0x" DATA.LONG(A:0x9f03a0) "' name='RPMH_VRM_VOLTAGE_UP_EXTRA_TIME_TYPE9'/>"
WRITE #1 "        <register address='0xb9f0400' value='0x" DATA.LONG(A:0x9f0400) "' name='RPMH_VRM_VOLTAGE_UP_EXTRA_TIME_TYPE10'/>"
WRITE #1 "        <register address='0xb9f0460' value='0x" DATA.LONG(A:0x9f0460) "' name='RPMH_VRM_VOLTAGE_UP_EXTRA_TIME_TYPE11'/>"
WRITE #1 "        <register address='0xb9f04c0' value='0x" DATA.LONG(A:0x9f04c0) "' name='RPMH_VRM_VOLTAGE_UP_EXTRA_TIME_TYPE12'/>"
WRITE #1 "        <register address='0xb9f0520' value='0x" DATA.LONG(A:0x9f0520) "' name='RPMH_VRM_VOLTAGE_UP_EXTRA_TIME_TYPE13'/>"
WRITE #1 "        <register address='0xb9f0580' value='0x" DATA.LONG(A:0x9f0580) "' name='RPMH_VRM_VOLTAGE_UP_EXTRA_TIME_TYPE14'/>"
WRITE #1 "        <register address='0xb9f05e0' value='0x" DATA.LONG(A:0x9f05e0) "' name='RPMH_VRM_VOLTAGE_UP_EXTRA_TIME_TYPE15'/>"
WRITE #1 "        <register address='0xb9f0044' value='0x" DATA.LONG(A:0x9f0044) "' name='RPMH_VRM_VOLTAGE_DOWN_EXTRA_TIME_TYPE0'/>"
WRITE #1 "        <register address='0xb9f00a4' value='0x" DATA.LONG(A:0x9f00a4) "' name='RPMH_VRM_VOLTAGE_DOWN_EXTRA_TIME_TYPE1'/>"
WRITE #1 "        <register address='0xb9f0104' value='0x" DATA.LONG(A:0x9f0104) "' name='RPMH_VRM_VOLTAGE_DOWN_EXTRA_TIME_TYPE2'/>"
WRITE #1 "        <register address='0xb9f0164' value='0x" DATA.LONG(A:0x9f0164) "' name='RPMH_VRM_VOLTAGE_DOWN_EXTRA_TIME_TYPE3'/>"
WRITE #1 "        <register address='0xb9f01c4' value='0x" DATA.LONG(A:0x9f01c4) "' name='RPMH_VRM_VOLTAGE_DOWN_EXTRA_TIME_TYPE4'/>"
WRITE #1 "        <register address='0xb9f0224' value='0x" DATA.LONG(A:0x9f0224) "' name='RPMH_VRM_VOLTAGE_DOWN_EXTRA_TIME_TYPE5'/>"
WRITE #1 "        <register address='0xb9f0284' value='0x" DATA.LONG(A:0x9f0284) "' name='RPMH_VRM_VOLTAGE_DOWN_EXTRA_TIME_TYPE6'/>"
WRITE #1 "        <register address='0xb9f02e4' value='0x" DATA.LONG(A:0x9f02e4) "' name='RPMH_VRM_VOLTAGE_DOWN_EXTRA_TIME_TYPE7'/>"
WRITE #1 "        <register address='0xb9f0344' value='0x" DATA.LONG(A:0x9f0344) "' name='RPMH_VRM_VOLTAGE_DOWN_EXTRA_TIME_TYPE8'/>"
WRITE #1 "        <register address='0xb9f03a4' value='0x" DATA.LONG(A:0x9f03a4) "' name='RPMH_VRM_VOLTAGE_DOWN_EXTRA_TIME_TYPE9'/>"
WRITE #1 "        <register address='0xb9f0404' value='0x" DATA.LONG(A:0x9f0404) "' name='RPMH_VRM_VOLTAGE_DOWN_EXTRA_TIME_TYPE10'/>"
WRITE #1 "        <register address='0xb9f0464' value='0x" DATA.LONG(A:0x9f0464) "' name='RPMH_VRM_VOLTAGE_DOWN_EXTRA_TIME_TYPE11'/>"
WRITE #1 "        <register address='0xb9f04c4' value='0x" DATA.LONG(A:0x9f04c4) "' name='RPMH_VRM_VOLTAGE_DOWN_EXTRA_TIME_TYPE12'/>"
WRITE #1 "        <register address='0xb9f0524' value='0x" DATA.LONG(A:0x9f0524) "' name='RPMH_VRM_VOLTAGE_DOWN_EXTRA_TIME_TYPE13'/>"
WRITE #1 "        <register address='0xb9f0584' value='0x" DATA.LONG(A:0x9f0584) "' name='RPMH_VRM_VOLTAGE_DOWN_EXTRA_TIME_TYPE14'/>"
WRITE #1 "        <register address='0xb9f05e4' value='0x" DATA.LONG(A:0x9f05e4) "' name='RPMH_VRM_VOLTAGE_DOWN_EXTRA_TIME_TYPE15'/>"
WRITE #1 "        <register address='0xb9f004c' value='0x" DATA.LONG(A:0x9f004c) "' name='RPMH_VRM_VREG_CLR_ADDR_OFFSET_CSR_TYPE0'/>"
WRITE #1 "        <register address='0xb9f00ac' value='0x" DATA.LONG(A:0x9f00ac) "' name='RPMH_VRM_VREG_CLR_ADDR_OFFSET_CSR_TYPE1'/>"
WRITE #1 "        <register address='0xb9f010c' value='0x" DATA.LONG(A:0x9f010c) "' name='RPMH_VRM_VREG_CLR_ADDR_OFFSET_CSR_TYPE2'/>"
WRITE #1 "        <register address='0xb9f016c' value='0x" DATA.LONG(A:0x9f016c) "' name='RPMH_VRM_VREG_CLR_ADDR_OFFSET_CSR_TYPE3'/>"
WRITE #1 "        <register address='0xb9f01cc' value='0x" DATA.LONG(A:0x9f01cc) "' name='RPMH_VRM_VREG_CLR_ADDR_OFFSET_CSR_TYPE4'/>"
WRITE #1 "        <register address='0xb9f022c' value='0x" DATA.LONG(A:0x9f022c) "' name='RPMH_VRM_VREG_CLR_ADDR_OFFSET_CSR_TYPE5'/>"
WRITE #1 "        <register address='0xb9f028c' value='0x" DATA.LONG(A:0x9f028c) "' name='RPMH_VRM_VREG_CLR_ADDR_OFFSET_CSR_TYPE6'/>"
WRITE #1 "        <register address='0xb9f02ec' value='0x" DATA.LONG(A:0x9f02ec) "' name='RPMH_VRM_VREG_CLR_ADDR_OFFSET_CSR_TYPE7'/>"
WRITE #1 "        <register address='0xb9f034c' value='0x" DATA.LONG(A:0x9f034c) "' name='RPMH_VRM_VREG_CLR_ADDR_OFFSET_CSR_TYPE8'/>"
WRITE #1 "        <register address='0xb9f03ac' value='0x" DATA.LONG(A:0x9f03ac) "' name='RPMH_VRM_VREG_CLR_ADDR_OFFSET_CSR_TYPE9'/>"
WRITE #1 "        <register address='0xb9f040c' value='0x" DATA.LONG(A:0x9f040c) "' name='RPMH_VRM_VREG_CLR_ADDR_OFFSET_CSR_TYPE10'/>"
WRITE #1 "        <register address='0xb9f046c' value='0x" DATA.LONG(A:0x9f046c) "' name='RPMH_VRM_VREG_CLR_ADDR_OFFSET_CSR_TYPE11'/>"
WRITE #1 "        <register address='0xb9f04cc' value='0x" DATA.LONG(A:0x9f04cc) "' name='RPMH_VRM_VREG_CLR_ADDR_OFFSET_CSR_TYPE12'/>"
WRITE #1 "        <register address='0xb9f052c' value='0x" DATA.LONG(A:0x9f052c) "' name='RPMH_VRM_VREG_CLR_ADDR_OFFSET_CSR_TYPE13'/>"
WRITE #1 "        <register address='0xb9f058c' value='0x" DATA.LONG(A:0x9f058c) "' name='RPMH_VRM_VREG_CLR_ADDR_OFFSET_CSR_TYPE14'/>"
WRITE #1 "        <register address='0xb9f05ec' value='0x" DATA.LONG(A:0x9f05ec) "' name='RPMH_VRM_VREG_CLR_ADDR_OFFSET_CSR_TYPE15'/>"
WRITE #1 "        <register address='0xb9f0050' value='0x" DATA.LONG(A:0x9f0050) "' name='RPMH_VRM_VREG_CLR_DATA_CSR_TYPE0'/>"
WRITE #1 "        <register address='0xb9f00b0' value='0x" DATA.LONG(A:0x9f00b0) "' name='RPMH_VRM_VREG_CLR_DATA_CSR_TYPE1'/>"
WRITE #1 "        <register address='0xb9f0110' value='0x" DATA.LONG(A:0x9f0110) "' name='RPMH_VRM_VREG_CLR_DATA_CSR_TYPE2'/>"
WRITE #1 "        <register address='0xb9f0170' value='0x" DATA.LONG(A:0x9f0170) "' name='RPMH_VRM_VREG_CLR_DATA_CSR_TYPE3'/>"
WRITE #1 "        <register address='0xb9f01d0' value='0x" DATA.LONG(A:0x9f01d0) "' name='RPMH_VRM_VREG_CLR_DATA_CSR_TYPE4'/>"
WRITE #1 "        <register address='0xb9f0230' value='0x" DATA.LONG(A:0x9f0230) "' name='RPMH_VRM_VREG_CLR_DATA_CSR_TYPE5'/>"
WRITE #1 "        <register address='0xb9f0290' value='0x" DATA.LONG(A:0x9f0290) "' name='RPMH_VRM_VREG_CLR_DATA_CSR_TYPE6'/>"
WRITE #1 "        <register address='0xb9f02f0' value='0x" DATA.LONG(A:0x9f02f0) "' name='RPMH_VRM_VREG_CLR_DATA_CSR_TYPE7'/>"
WRITE #1 "        <register address='0xb9f0350' value='0x" DATA.LONG(A:0x9f0350) "' name='RPMH_VRM_VREG_CLR_DATA_CSR_TYPE8'/>"
WRITE #1 "        <register address='0xb9f03b0' value='0x" DATA.LONG(A:0x9f03b0) "' name='RPMH_VRM_VREG_CLR_DATA_CSR_TYPE9'/>"
WRITE #1 "        <register address='0xb9f0410' value='0x" DATA.LONG(A:0x9f0410) "' name='RPMH_VRM_VREG_CLR_DATA_CSR_TYPE10'/>"
WRITE #1 "        <register address='0xb9f0470' value='0x" DATA.LONG(A:0x9f0470) "' name='RPMH_VRM_VREG_CLR_DATA_CSR_TYPE11'/>"
WRITE #1 "        <register address='0xb9f04d0' value='0x" DATA.LONG(A:0x9f04d0) "' name='RPMH_VRM_VREG_CLR_DATA_CSR_TYPE12'/>"
WRITE #1 "        <register address='0xb9f0530' value='0x" DATA.LONG(A:0x9f0530) "' name='RPMH_VRM_VREG_CLR_DATA_CSR_TYPE13'/>"
WRITE #1 "        <register address='0xb9f0590' value='0x" DATA.LONG(A:0x9f0590) "' name='RPMH_VRM_VREG_CLR_DATA_CSR_TYPE14'/>"
WRITE #1 "        <register address='0xb9f05f0' value='0x" DATA.LONG(A:0x9f05f0) "' name='RPMH_VRM_VREG_CLR_DATA_CSR_TYPE15'/>"
WRITE #1 "        <register address='0xb9f0054' value='0x" DATA.LONG(A:0x9f0054) "' name='RPMH_VRM_DISCHARGE_TIME_CSR_TYPE0'/>"
WRITE #1 "        <register address='0xb9f00b4' value='0x" DATA.LONG(A:0x9f00b4) "' name='RPMH_VRM_DISCHARGE_TIME_CSR_TYPE1'/>"
WRITE #1 "        <register address='0xb9f0114' value='0x" DATA.LONG(A:0x9f0114) "' name='RPMH_VRM_DISCHARGE_TIME_CSR_TYPE2'/>"
WRITE #1 "        <register address='0xb9f0174' value='0x" DATA.LONG(A:0x9f0174) "' name='RPMH_VRM_DISCHARGE_TIME_CSR_TYPE3'/>"
WRITE #1 "        <register address='0xb9f01d4' value='0x" DATA.LONG(A:0x9f01d4) "' name='RPMH_VRM_DISCHARGE_TIME_CSR_TYPE4'/>"
WRITE #1 "        <register address='0xb9f0234' value='0x" DATA.LONG(A:0x9f0234) "' name='RPMH_VRM_DISCHARGE_TIME_CSR_TYPE5'/>"
WRITE #1 "        <register address='0xb9f0294' value='0x" DATA.LONG(A:0x9f0294) "' name='RPMH_VRM_DISCHARGE_TIME_CSR_TYPE6'/>"
WRITE #1 "        <register address='0xb9f02f4' value='0x" DATA.LONG(A:0x9f02f4) "' name='RPMH_VRM_DISCHARGE_TIME_CSR_TYPE7'/>"
WRITE #1 "        <register address='0xb9f0354' value='0x" DATA.LONG(A:0x9f0354) "' name='RPMH_VRM_DISCHARGE_TIME_CSR_TYPE8'/>"
WRITE #1 "        <register address='0xb9f03b4' value='0x" DATA.LONG(A:0x9f03b4) "' name='RPMH_VRM_DISCHARGE_TIME_CSR_TYPE9'/>"
WRITE #1 "        <register address='0xb9f0414' value='0x" DATA.LONG(A:0x9f0414) "' name='RPMH_VRM_DISCHARGE_TIME_CSR_TYPE10'/>"
WRITE #1 "        <register address='0xb9f0474' value='0x" DATA.LONG(A:0x9f0474) "' name='RPMH_VRM_DISCHARGE_TIME_CSR_TYPE11'/>"
WRITE #1 "        <register address='0xb9f04d4' value='0x" DATA.LONG(A:0x9f04d4) "' name='RPMH_VRM_DISCHARGE_TIME_CSR_TYPE12'/>"
WRITE #1 "        <register address='0xb9f0534' value='0x" DATA.LONG(A:0x9f0534) "' name='RPMH_VRM_DISCHARGE_TIME_CSR_TYPE13'/>"
WRITE #1 "        <register address='0xb9f0594' value='0x" DATA.LONG(A:0x9f0594) "' name='RPMH_VRM_DISCHARGE_TIME_CSR_TYPE14'/>"
WRITE #1 "        <register address='0xb9f05f4' value='0x" DATA.LONG(A:0x9f05f4) "' name='RPMH_VRM_DISCHARGE_TIME_CSR_TYPE15'/>"
WRITE #1 "        <register address='0xb9f1000' value='0x" DATA.LONG(A:0x9f1000) "' name='RPMH_VRM_VOLTAGE_DEP_IRQ_STATUS_0_CSR'/>"
WRITE #1 "        <register address='0xb9f1004' value='0x" DATA.LONG(A:0x9f1004) "' name='RPMH_VRM_VOLTAGE_DEP_IRQ_STATUS_1_CSR'/>"
WRITE #1 "        <register address='0xb9f1018' value='0x" DATA.LONG(A:0x9f1018) "' name='RPMH_VRM_ENABLE_DEP_IRQ_STATUS_0_CSR'/>"
WRITE #1 "        <register address='0xb9f101c' value='0x" DATA.LONG(A:0x9f101c) "' name='RPMH_VRM_ENABLE_DEP_IRQ_STATUS_1_CSR'/>"
WRITE #1 "        <register address='0xb9f1038' value='0x" DATA.LONG(A:0x9f1038) "' name='RPMH_VRM_MODE_DEP_IRQ_STATUS_0_CSR'/>"
WRITE #1 "        <register address='0xb9f103c' value='0x" DATA.LONG(A:0x9f103c) "' name='RPMH_VRM_MODE_DEP_IRQ_STATUS_1_CSR'/>"
WRITE #1 "        <register address='0xb9f1108' value='0x" DATA.LONG(A:0x9f1108) "' name='RPMH_VRM_VOLTAGE_CHANGE_IRQ_STATUS_0_CSR'/>"
WRITE #1 "        <register address='0xb9f110c' value='0x" DATA.LONG(A:0x9f110c) "' name='RPMH_VRM_VOLTAGE_CHANGE_IRQ_STATUS_1_CSR'/>"
WRITE #1 "        <register address='0xb9f1120' value='0x" DATA.LONG(A:0x9f1120) "' name='RPMH_VRM_ENABLE_CHANGE_IRQ_STATUS_0_CSR'/>"
WRITE #1 "        <register address='0xb9f1124' value='0x" DATA.LONG(A:0x9f1124) "' name='RPMH_VRM_ENABLE_CHANGE_IRQ_STATUS_1_CSR'/>"
WRITE #1 "        <register address='0xb9f1140' value='0x" DATA.LONG(A:0x9f1140) "' name='RPMH_VRM_MODE_CHANGE_IRQ_STATUS_0_CSR'/>"
WRITE #1 "        <register address='0xb9f1144' value='0x" DATA.LONG(A:0x9f1144) "' name='RPMH_VRM_MODE_CHANGE_IRQ_STATUS_1_CSR'/>"
WRITE #1 "        <register address='0xb9f1170' value='0x" DATA.LONG(A:0x9f1170) "' name='RPMH_VRM_VOLTAGE_SETTLED_IRQ_STATUS_0_CSR'/>"
WRITE #1 "        <register address='0xb9f1174' value='0x" DATA.LONG(A:0x9f1174) "' name='RPMH_VRM_VOLTAGE_SETTLED_IRQ_STATUS_1_CSR'/>"
WRITE #1 "        <register address='0xb9f1188' value='0x" DATA.LONG(A:0x9f1188) "' name='RPMH_VRM_ENABLE_SETTLED_IRQ_STATUS_0_CSR'/>"
WRITE #1 "        <register address='0xb9f118c' value='0x" DATA.LONG(A:0x9f118c) "' name='RPMH_VRM_ENABLE_SETTLED_IRQ_STATUS_1_CSR'/>"
WRITE #1 "        <register address='0xb9f11a0' value='0x" DATA.LONG(A:0x9f11a0) "' name='RPMH_VRM_MODE_SETTLED_IRQ_STATUS_0_CSR'/>"
WRITE #1 "        <register address='0xb9f11a4' value='0x" DATA.LONG(A:0x9f11a4) "' name='RPMH_VRM_MODE_SETTLED_IRQ_STATUS_1_CSR'/>"
WRITE #1 "        <register address='0xb9f1270' value='0x" DATA.LONG(A:0x9f1270) "' name='RPMH_VRM_VREG_READY_WDOG_IRQ_STATUS_0_CSR'/>"
WRITE #1 "        <register address='0xb9f1274' value='0x" DATA.LONG(A:0x9f1274) "' name='RPMH_VRM_VREG_READY_WDOG_IRQ_STATUS_1_CSR'/>"
WRITE #1 "        <register address='0xb9f12c0' value='0x" DATA.LONG(A:0x9f12c0) "' name='RPMH_VRM_VOLTAGE_DEP_IRQ_ENABLE_0_CSR'/>"
WRITE #1 "        <register address='0xb9f12c4' value='0x" DATA.LONG(A:0x9f12c4) "' name='RPMH_VRM_VOLTAGE_DEP_IRQ_ENABLE_1_CSR'/>"
WRITE #1 "        <register address='0xb9f12d8' value='0x" DATA.LONG(A:0x9f12d8) "' name='RPMH_VRM_ENABLE_DEP_IRQ_ENABLE_0_CSR'/>"
WRITE #1 "        <register address='0xb9f12dc' value='0x" DATA.LONG(A:0x9f12dc) "' name='RPMH_VRM_ENABLE_DEP_IRQ_ENABLE_1_CSR'/>"
WRITE #1 "        <register address='0xb9f12f8' value='0x" DATA.LONG(A:0x9f12f8) "' name='RPMH_VRM_MODE_DEP_IRQ_ENABLE_0_CSR'/>"
WRITE #1 "        <register address='0xb9f12fc' value='0x" DATA.LONG(A:0x9f12fc) "' name='RPMH_VRM_MODE_DEP_IRQ_ENABLE_1_CSR'/>"
WRITE #1 "        <register address='0xb9f13c8' value='0x" DATA.LONG(A:0x9f13c8) "' name='RPMH_VRM_VOLTAGE_CHANGE_IRQ_ENABLE_0_CSR'/>"
WRITE #1 "        <register address='0xb9f13cc' value='0x" DATA.LONG(A:0x9f13cc) "' name='RPMH_VRM_VOLTAGE_CHANGE_IRQ_ENABLE_1_CSR'/>"
WRITE #1 "        <register address='0xb9f13e0' value='0x" DATA.LONG(A:0x9f13e0) "' name='RPMH_VRM_ENABLE_CHANGE_IRQ_ENABLE_0_CSR'/>"
WRITE #1 "        <register address='0xb9f13e4' value='0x" DATA.LONG(A:0x9f13e4) "' name='RPMH_VRM_ENABLE_CHANGE_IRQ_ENABLE_1_CSR'/>"
WRITE #1 "        <register address='0xb9f1400' value='0x" DATA.LONG(A:0x9f1400) "' name='RPMH_VRM_MODE_CHANGE_IRQ_ENABLE_0_CSR'/>"
WRITE #1 "        <register address='0xb9f1404' value='0x" DATA.LONG(A:0x9f1404) "' name='RPMH_VRM_MODE_CHANGE_IRQ_ENABLE_1_CSR'/>"
WRITE #1 "        <register address='0xb9f14d0' value='0x" DATA.LONG(A:0x9f14d0) "' name='RPMH_VRM_VOLTAGE_SETTLED_IRQ_ENABLE_0_CSR'/>"
WRITE #1 "        <register address='0xb9f14d4' value='0x" DATA.LONG(A:0x9f14d4) "' name='RPMH_VRM_VOLTAGE_SETTLED_IRQ_ENABLE_1_CSR'/>"
WRITE #1 "        <register address='0xb9f14e8' value='0x" DATA.LONG(A:0x9f14e8) "' name='RPMH_VRM_ENABLE_SETTLED_IRQ_ENABLE_0_CSR'/>"
WRITE #1 "        <register address='0xb9f14ec' value='0x" DATA.LONG(A:0x9f14ec) "' name='RPMH_VRM_ENABLE_SETTLED_IRQ_ENABLE_1_CSR'/>"
WRITE #1 "        <register address='0xb9f1508' value='0x" DATA.LONG(A:0x9f1508) "' name='RPMH_VRM_MODE_SETTLED_IRQ_ENABLE_0_CSR'/>"
WRITE #1 "        <register address='0xb9f150c' value='0x" DATA.LONG(A:0x9f150c) "' name='RPMH_VRM_MODE_SETTLED_IRQ_ENABLE_1_CSR'/>"
WRITE #1 "        <register address='0xb9f1538' value='0x" DATA.LONG(A:0x9f1538) "' name='RPMH_VRM_VREG_READY_WDOG_IRQ_ENABLE_0_CSR'/>"
WRITE #1 "        <register address='0xb9f153c' value='0x" DATA.LONG(A:0x9f153c) "' name='RPMH_VRM_VREG_READY_WDOG_IRQ_ENABLE_1_CSR'/>"
WRITE #1 "        <register address='0xb9f17b4' value='0x" DATA.LONG(A:0x9f17b4) "' name='RPMH_VRM_MAX_VOLTAGE_VIOLATION_IRQ_STATUS_0_CSR'/>"
WRITE #1 "        <register address='0xb9f17b8' value='0x" DATA.LONG(A:0x9f17b8) "' name='RPMH_VRM_MAX_VOLTAGE_VIOLATION_IRQ_STATUS_1_CSR'/>"
WRITE #1 "        <register address='0xb9f17c0' value='0x" DATA.LONG(A:0x9f17c0) "' name='RPMH_VRM_MAX_VOLTAGE_VIOLATION_IRQ_ENABLE_0_CSR'/>"
WRITE #1 "        <register address='0xb9f17c4' value='0x" DATA.LONG(A:0x9f17c4) "' name='RPMH_VRM_MAX_VOLTAGE_VIOLATION_IRQ_ENABLE_1_CSR'/>"
WRITE #1 "        <register address='0xb9f18cc' value='0x" DATA.LONG(A:0x9f18cc) "' name='RPMH_VRM_CTT_OVERFLOW_IRQ_STATUS_CSR'/>"
WRITE #1 "        <register address='0xb9f18d0' value='0x" DATA.LONG(A:0x9f18d0) "' name='RPMH_VRM_CTT_OVERFLOW_IRQ_ENABLE_CSR'/>"
WRITE #1 "        <register address='0xb9f18d8' value='0x" DATA.LONG(A:0x9f18d8) "' name='RPMH_VRM_S_PORT_FAILURE_IRQ_STATUS_CSR'/>"
WRITE #1 "        <register address='0xb9f18dc' value='0x" DATA.LONG(A:0x9f18dc) "' name='RPMH_VRM_S_PORT_FAILURE_IRQ_ENABLE_CSR'/>"
WRITE #1 "        <register address='0xb9f18f4' value='0x" DATA.LONG(A:0x9f18f4) "' name='RPMH_VRM_SEQUENCER_IRQ_ENABLE_PRE_CSR'/>"
WRITE #1 "        <register address='0xb9f18f8' value='0x" DATA.LONG(A:0x9f18f8) "' name='RPMH_VRM_SEQUENCER_IRQ_ENABLE_POST_CSR'/>"
WRITE #1 "        <register address='0xb9f18fc' value='0x" DATA.LONG(A:0x9f18fc) "' name='RPMH_VRM_SEQUENCER_IRQ_STATUS_PRE_CSR'/>"
WRITE #1 "        <register address='0xb9f1900' value='0x" DATA.LONG(A:0x9f1900) "' name='RPMH_VRM_SEQUENCER_IRQ_STATUS_POST_CSR'/>"
WRITE #1 "        <register address='0xb9f2000' value='0x" DATA.LONG(A:0x9f2000) "' name='RPMH_VRM_SEQUENCER0_STATUS_CSR'/>"
WRITE #1 "        <register address='0xb9f2004' value='0x" DATA.LONG(A:0x9f2004) "' name='RPMH_VRM_SEQUENCER1_STATUS_CSR'/>"
WRITE #1 "        <register address='0xb9f2008' value='0x" DATA.LONG(A:0x9f2008) "' name='RPMH_VRM_SEQUENCER2_STATUS_CSR'/>"
WRITE #1 "        <register address='0xb9f200c' value='0x" DATA.LONG(A:0x9f200c) "' name='RPMH_VRM_SEQUENCER3_STATUS_CSR'/>"
WRITE #1 "        <register address='0xb9f2010' value='0x" DATA.LONG(A:0x9f2010) "' name='RPMH_VRM_SEQUENCER4_STATUS_CSR'/>"
WRITE #1 "        <register address='0xb9f2014' value='0x" DATA.LONG(A:0x9f2014) "' name='RPMH_VRM_SEQUENCER5_STATUS_CSR'/>"
WRITE #1 "        <register address='0xb9f2018' value='0x" DATA.LONG(A:0x9f2018) "' name='RPMH_VRM_SEQUENCER6_STATUS_CSR'/>"
WRITE #1 "        <register address='0xb9f201c' value='0x" DATA.LONG(A:0x9f201c) "' name='RPMH_VRM_SEQUENCER7_STATUS_CSR'/>"
WRITE #1 "        <register address='0xb9f2020' value='0x" DATA.LONG(A:0x9f2020) "' name='RPMH_VRM_SEQUENCER8_STATUS_CSR'/>"
WRITE #1 "        <register address='0xb9f2024' value='0x" DATA.LONG(A:0x9f2024) "' name='RPMH_VRM_SEQUENCER9_STATUS_CSR'/>"
WRITE #1 "        <register address='0xb9f2028' value='0x" DATA.LONG(A:0x9f2028) "' name='RPMH_VRM_SEQUENCER10_STATUS_CSR'/>"
WRITE #1 "        <register address='0xb9f202c' value='0x" DATA.LONG(A:0x9f202c) "' name='RPMH_VRM_SEQUENCER11_STATUS_CSR'/>"
WRITE #1 "        <register address='0xb9f2030' value='0x" DATA.LONG(A:0x9f2030) "' name='RPMH_VRM_SEQUENCER12_STATUS_CSR'/>"
WRITE #1 "        <register address='0xb9f2034' value='0x" DATA.LONG(A:0x9f2034) "' name='RPMH_VRM_SEQUENCER13_STATUS_CSR'/>"
WRITE #1 "        <register address='0xb9f2038' value='0x" DATA.LONG(A:0x9f2038) "' name='RPMH_VRM_SEQUENCER14_STATUS_CSR'/>"
WRITE #1 "        <register address='0xb9f203c' value='0x" DATA.LONG(A:0x9f203c) "' name='RPMH_VRM_SEQUENCER15_STATUS_CSR'/>"
WRITE #1 "        <register address='0xb9f2040' value='0x" DATA.LONG(A:0x9f2040) "' name='RPMH_VRM_SEQUENCER16_STATUS_CSR'/>"
WRITE #1 "        <register address='0xb9f2044' value='0x" DATA.LONG(A:0x9f2044) "' name='RPMH_VRM_SEQUENCER17_STATUS_CSR'/>"
WRITE #1 "        <register address='0xb9f2048' value='0x" DATA.LONG(A:0x9f2048) "' name='RPMH_VRM_SEQUENCER18_STATUS_CSR'/>"
WRITE #1 "        <register address='0xb9f204c' value='0x" DATA.LONG(A:0x9f204c) "' name='RPMH_VRM_SEQUENCER19_STATUS_CSR'/>"
WRITE #1 "        <register address='0xb9f2050' value='0x" DATA.LONG(A:0x9f2050) "' name='RPMH_VRM_SEQUENCER20_STATUS_CSR'/>"
WRITE #1 "        <register address='0xb9f2054' value='0x" DATA.LONG(A:0x9f2054) "' name='RPMH_VRM_SEQUENCER21_STATUS_CSR'/>"
WRITE #1 "        <register address='0xb9f2058' value='0x" DATA.LONG(A:0x9f2058) "' name='RPMH_VRM_SEQUENCER22_STATUS_CSR'/>"
WRITE #1 "        <register address='0xb9f205c' value='0x" DATA.LONG(A:0x9f205c) "' name='RPMH_VRM_SEQUENCER23_STATUS_CSR'/>"
WRITE #1 "        <register address='0xb9f2060' value='0x" DATA.LONG(A:0x9f2060) "' name='RPMH_VRM_SEQUENCER24_STATUS_CSR'/>"
WRITE #1 "        <register address='0xb9f2064' value='0x" DATA.LONG(A:0x9f2064) "' name='RPMH_VRM_SEQUENCER25_STATUS_CSR'/>"
WRITE #1 "        <register address='0xb9f2068' value='0x" DATA.LONG(A:0x9f2068) "' name='RPMH_VRM_SEQUENCER26_STATUS_CSR'/>"
WRITE #1 "        <register address='0xb9f206c' value='0x" DATA.LONG(A:0x9f206c) "' name='RPMH_VRM_SEQUENCER27_STATUS_CSR'/>"
WRITE #1 "        <register address='0xb9f2070' value='0x" DATA.LONG(A:0x9f2070) "' name='RPMH_VRM_SEQUENCER28_STATUS_CSR'/>"
WRITE #1 "        <register address='0xb9f2074' value='0x" DATA.LONG(A:0x9f2074) "' name='RPMH_VRM_SEQUENCER29_STATUS_CSR'/>"
WRITE #1 "        <register address='0xb9f2078' value='0x" DATA.LONG(A:0x9f2078) "' name='RPMH_VRM_SEQUENCER30_STATUS_CSR'/>"
WRITE #1 "        <register address='0xb9f207c' value='0x" DATA.LONG(A:0x9f207c) "' name='RPMH_VRM_SEQUENCER31_STATUS_CSR'/>"
WRITE #1 "        <register address='0xb9f2100' value='0x" DATA.LONG(A:0x9f2100) "' name='RPMH_VRM_VRM_IDLE_STATUS_CSR'/>"
WRITE #1 "        <register address='0xb9f3190' value='0x" DATA.LONG(A:0x9f3190) "' name='RPMH_VRM_SEQ_START_ADDR0'/>"
WRITE #1 "        <register address='0xb9f3194' value='0x" DATA.LONG(A:0x9f3194) "' name='RPMH_VRM_SEQ_START_ADDR1'/>"
WRITE #1 "        <register address='0xb9f3198' value='0x" DATA.LONG(A:0x9f3198) "' name='RPMH_VRM_SEQ_START_ADDR2'/>"
WRITE #1 "        <register address='0xb9f319c' value='0x" DATA.LONG(A:0x9f319c) "' name='RPMH_VRM_SEQ_START_ADDR3'/>"
WRITE #1 "        <register address='0xb9f31a0' value='0x" DATA.LONG(A:0x9f31a0) "' name='RPMH_VRM_SEQ_START_ADDR4'/>"
WRITE #1 "        <register address='0xb9f31a4' value='0x" DATA.LONG(A:0x9f31a4) "' name='RPMH_VRM_SEQ_START_ADDR5'/>"
WRITE #1 "        <register address='0xb9f31a8' value='0x" DATA.LONG(A:0x9f31a8) "' name='RPMH_VRM_SEQ_START_ADDR6'/>"
WRITE #1 "        <register address='0xb9f31ac' value='0x" DATA.LONG(A:0x9f31ac) "' name='RPMH_VRM_SEQ_START_ADDR7'/>"
WRITE #1 "        <register address='0xb9f31f4' value='0x" DATA.LONG(A:0x9f31f4) "' name='RPMH_VRM_SEQ_WORD0'/>"
WRITE #1 "        <register address='0xb9f31f8' value='0x" DATA.LONG(A:0x9f31f8) "' name='RPMH_VRM_SEQ_WORD1'/>"
WRITE #1 "        <register address='0xb9f31fc' value='0x" DATA.LONG(A:0x9f31fc) "' name='RPMH_VRM_SEQ_WORD2'/>"
WRITE #1 "        <register address='0xb9f3200' value='0x" DATA.LONG(A:0x9f3200) "' name='RPMH_VRM_SEQ_WORD3'/>"
WRITE #1 "        <register address='0xb9f3204' value='0x" DATA.LONG(A:0x9f3204) "' name='RPMH_VRM_SEQ_WORD4'/>"
WRITE #1 "        <register address='0xb9f3208' value='0x" DATA.LONG(A:0x9f3208) "' name='RPMH_VRM_SEQ_WORD5'/>"
WRITE #1 "        <register address='0xb9f320c' value='0x" DATA.LONG(A:0x9f320c) "' name='RPMH_VRM_SEQ_WORD6'/>"
WRITE #1 "        <register address='0xb9f3210' value='0x" DATA.LONG(A:0x9f3210) "' name='RPMH_VRM_SEQ_WORD7'/>"
WRITE #1 "        <register address='0xb9f3214' value='0x" DATA.LONG(A:0x9f3214) "' name='RPMH_VRM_SEQ_WORD8'/>"
WRITE #1 "        <register address='0xb9f3218' value='0x" DATA.LONG(A:0x9f3218) "' name='RPMH_VRM_SEQ_WORD9'/>"
WRITE #1 "        <register address='0xb9f321c' value='0x" DATA.LONG(A:0x9f321c) "' name='RPMH_VRM_SEQ_WORD10'/>"
WRITE #1 "        <register address='0xb9f3220' value='0x" DATA.LONG(A:0x9f3220) "' name='RPMH_VRM_SEQ_WORD11'/>"
WRITE #1 "        <register address='0xb9f3224' value='0x" DATA.LONG(A:0x9f3224) "' name='RPMH_VRM_SEQ_WORD12'/>"
WRITE #1 "        <register address='0xb9f3228' value='0x" DATA.LONG(A:0x9f3228) "' name='RPMH_VRM_SEQ_WORD13'/>"
WRITE #1 "        <register address='0xb9f322c' value='0x" DATA.LONG(A:0x9f322c) "' name='RPMH_VRM_SEQ_WORD14'/>"
WRITE #1 "        <register address='0xb9f3230' value='0x" DATA.LONG(A:0x9f3230) "' name='RPMH_VRM_SEQ_WORD15'/>"
WRITE #1 "        <register address='0xb9f3234' value='0x" DATA.LONG(A:0x9f3234) "' name='RPMH_VRM_SEQ_WORD16'/>"
WRITE #1 "        <register address='0xb9f3238' value='0x" DATA.LONG(A:0x9f3238) "' name='RPMH_VRM_SEQ_WORD17'/>"
WRITE #1 "        <register address='0xb9f323c' value='0x" DATA.LONG(A:0x9f323c) "' name='RPMH_VRM_SEQ_WORD18'/>"
WRITE #1 "        <register address='0xb9f3240' value='0x" DATA.LONG(A:0x9f3240) "' name='RPMH_VRM_SEQ_WORD19'/>"
WRITE #1 "        <register address='0xb9f3244' value='0x" DATA.LONG(A:0x9f3244) "' name='RPMH_VRM_SEQ_WORD20'/>"
WRITE #1 "        <register address='0xb9f3248' value='0x" DATA.LONG(A:0x9f3248) "' name='RPMH_VRM_SEQ_WORD21'/>"
WRITE #1 "        <register address='0xb9f324c' value='0x" DATA.LONG(A:0x9f324c) "' name='RPMH_VRM_SEQ_WORD22'/>"
WRITE #1 "        <register address='0xb9f3250' value='0x" DATA.LONG(A:0x9f3250) "' name='RPMH_VRM_SEQ_WORD23'/>"
WRITE #1 "        <register address='0xb9f3254' value='0x" DATA.LONG(A:0x9f3254) "' name='RPMH_VRM_SEQ_WORD24'/>"
WRITE #1 "        <register address='0xb9f3258' value='0x" DATA.LONG(A:0x9f3258) "' name='RPMH_VRM_SEQ_WORD25'/>"
WRITE #1 "        <register address='0xb9f325c' value='0x" DATA.LONG(A:0x9f325c) "' name='RPMH_VRM_SEQ_WORD26'/>"
WRITE #1 "        <register address='0xb9f3260' value='0x" DATA.LONG(A:0x9f3260) "' name='RPMH_VRM_SEQ_WORD27'/>"
WRITE #1 "        <register address='0xb9f3264' value='0x" DATA.LONG(A:0x9f3264) "' name='RPMH_VRM_SEQ_WORD28'/>"
WRITE #1 "        <register address='0xb9f3268' value='0x" DATA.LONG(A:0x9f3268) "' name='RPMH_VRM_SEQ_WORD29'/>"
WRITE #1 "        <register address='0xb9f326c' value='0x" DATA.LONG(A:0x9f326c) "' name='RPMH_VRM_SEQ_WORD30'/>"
WRITE #1 "        <register address='0xb9f3270' value='0x" DATA.LONG(A:0x9f3270) "' name='RPMH_VRM_SEQ_WORD31'/>"
WRITE #1 "        <register address='0xb9f35f4' value='0x" DATA.LONG(A:0x9f35f4) "' name='RPMH_VRM_SEQ_DATA_0_SEQCERS0'/>"
WRITE #1 "        <register address='0xb9f3600' value='0x" DATA.LONG(A:0x9f3600) "' name='RPMH_VRM_SEQ_DATA_0_SEQCERS1'/>"
WRITE #1 "        <register address='0xb9f360c' value='0x" DATA.LONG(A:0x9f360c) "' name='RPMH_VRM_SEQ_DATA_0_SEQCERS2'/>"
WRITE #1 "        <register address='0xb9f3618' value='0x" DATA.LONG(A:0x9f3618) "' name='RPMH_VRM_SEQ_DATA_0_SEQCERS3'/>"
WRITE #1 "        <register address='0xb9f3624' value='0x" DATA.LONG(A:0x9f3624) "' name='RPMH_VRM_SEQ_DATA_0_SEQCERS4'/>"
WRITE #1 "        <register address='0xb9f3630' value='0x" DATA.LONG(A:0x9f3630) "' name='RPMH_VRM_SEQ_DATA_0_SEQCERS5'/>"
WRITE #1 "        <register address='0xb9f363c' value='0x" DATA.LONG(A:0x9f363c) "' name='RPMH_VRM_SEQ_DATA_0_SEQCERS6'/>"
WRITE #1 "        <register address='0xb9f3648' value='0x" DATA.LONG(A:0x9f3648) "' name='RPMH_VRM_SEQ_DATA_0_SEQCERS7'/>"
WRITE #1 "        <register address='0xb9f3654' value='0x" DATA.LONG(A:0x9f3654) "' name='RPMH_VRM_SEQ_DATA_0_SEQCERS8'/>"
WRITE #1 "        <register address='0xb9f3660' value='0x" DATA.LONG(A:0x9f3660) "' name='RPMH_VRM_SEQ_DATA_0_SEQCERS9'/>"
WRITE #1 "        <register address='0xb9f366c' value='0x" DATA.LONG(A:0x9f366c) "' name='RPMH_VRM_SEQ_DATA_0_SEQCERS10'/>"
WRITE #1 "        <register address='0xb9f3678' value='0x" DATA.LONG(A:0x9f3678) "' name='RPMH_VRM_SEQ_DATA_0_SEQCERS11'/>"
WRITE #1 "        <register address='0xb9f3684' value='0x" DATA.LONG(A:0x9f3684) "' name='RPMH_VRM_SEQ_DATA_0_SEQCERS12'/>"
WRITE #1 "        <register address='0xb9f3690' value='0x" DATA.LONG(A:0x9f3690) "' name='RPMH_VRM_SEQ_DATA_0_SEQCERS13'/>"
WRITE #1 "        <register address='0xb9f369c' value='0x" DATA.LONG(A:0x9f369c) "' name='RPMH_VRM_SEQ_DATA_0_SEQCERS14'/>"
WRITE #1 "        <register address='0xb9f36a8' value='0x" DATA.LONG(A:0x9f36a8) "' name='RPMH_VRM_SEQ_DATA_0_SEQCERS15'/>"
WRITE #1 "        <register address='0xb9f36b4' value='0x" DATA.LONG(A:0x9f36b4) "' name='RPMH_VRM_SEQ_DATA_0_SEQCERS16'/>"
WRITE #1 "        <register address='0xb9f36c0' value='0x" DATA.LONG(A:0x9f36c0) "' name='RPMH_VRM_SEQ_DATA_0_SEQCERS17'/>"
WRITE #1 "        <register address='0xb9f36cc' value='0x" DATA.LONG(A:0x9f36cc) "' name='RPMH_VRM_SEQ_DATA_0_SEQCERS18'/>"
WRITE #1 "        <register address='0xb9f36d8' value='0x" DATA.LONG(A:0x9f36d8) "' name='RPMH_VRM_SEQ_DATA_0_SEQCERS19'/>"
WRITE #1 "        <register address='0xb9f36e4' value='0x" DATA.LONG(A:0x9f36e4) "' name='RPMH_VRM_SEQ_DATA_0_SEQCERS20'/>"
WRITE #1 "        <register address='0xb9f36f0' value='0x" DATA.LONG(A:0x9f36f0) "' name='RPMH_VRM_SEQ_DATA_0_SEQCERS21'/>"
WRITE #1 "        <register address='0xb9f36fc' value='0x" DATA.LONG(A:0x9f36fc) "' name='RPMH_VRM_SEQ_DATA_0_SEQCERS22'/>"
WRITE #1 "        <register address='0xb9f3708' value='0x" DATA.LONG(A:0x9f3708) "' name='RPMH_VRM_SEQ_DATA_0_SEQCERS23'/>"
WRITE #1 "        <register address='0xb9f3714' value='0x" DATA.LONG(A:0x9f3714) "' name='RPMH_VRM_SEQ_DATA_0_SEQCERS24'/>"
WRITE #1 "        <register address='0xb9f3720' value='0x" DATA.LONG(A:0x9f3720) "' name='RPMH_VRM_SEQ_DATA_0_SEQCERS25'/>"
WRITE #1 "        <register address='0xb9f372c' value='0x" DATA.LONG(A:0x9f372c) "' name='RPMH_VRM_SEQ_DATA_0_SEQCERS26'/>"
WRITE #1 "        <register address='0xb9f3738' value='0x" DATA.LONG(A:0x9f3738) "' name='RPMH_VRM_SEQ_DATA_0_SEQCERS27'/>"
WRITE #1 "        <register address='0xb9f3744' value='0x" DATA.LONG(A:0x9f3744) "' name='RPMH_VRM_SEQ_DATA_0_SEQCERS28'/>"
WRITE #1 "        <register address='0xb9f3750' value='0x" DATA.LONG(A:0x9f3750) "' name='RPMH_VRM_SEQ_DATA_0_SEQCERS29'/>"
WRITE #1 "        <register address='0xb9f375c' value='0x" DATA.LONG(A:0x9f375c) "' name='RPMH_VRM_SEQ_DATA_0_SEQCERS30'/>"
WRITE #1 "        <register address='0xb9f3768' value='0x" DATA.LONG(A:0x9f3768) "' name='RPMH_VRM_SEQ_DATA_0_SEQCERS31'/>"
WRITE #1 "        <register address='0xb9f35f8' value='0x" DATA.LONG(A:0x9f35f8) "' name='RPMH_VRM_SEQ_DATA_1_SEQCERS0'/>"
WRITE #1 "        <register address='0xb9f3604' value='0x" DATA.LONG(A:0x9f3604) "' name='RPMH_VRM_SEQ_DATA_1_SEQCERS1'/>"
WRITE #1 "        <register address='0xb9f3610' value='0x" DATA.LONG(A:0x9f3610) "' name='RPMH_VRM_SEQ_DATA_1_SEQCERS2'/>"
WRITE #1 "        <register address='0xb9f361c' value='0x" DATA.LONG(A:0x9f361c) "' name='RPMH_VRM_SEQ_DATA_1_SEQCERS3'/>"
WRITE #1 "        <register address='0xb9f3628' value='0x" DATA.LONG(A:0x9f3628) "' name='RPMH_VRM_SEQ_DATA_1_SEQCERS4'/>"
WRITE #1 "        <register address='0xb9f3634' value='0x" DATA.LONG(A:0x9f3634) "' name='RPMH_VRM_SEQ_DATA_1_SEQCERS5'/>"
WRITE #1 "        <register address='0xb9f3640' value='0x" DATA.LONG(A:0x9f3640) "' name='RPMH_VRM_SEQ_DATA_1_SEQCERS6'/>"
WRITE #1 "        <register address='0xb9f364c' value='0x" DATA.LONG(A:0x9f364c) "' name='RPMH_VRM_SEQ_DATA_1_SEQCERS7'/>"
WRITE #1 "        <register address='0xb9f3658' value='0x" DATA.LONG(A:0x9f3658) "' name='RPMH_VRM_SEQ_DATA_1_SEQCERS8'/>"
WRITE #1 "        <register address='0xb9f3664' value='0x" DATA.LONG(A:0x9f3664) "' name='RPMH_VRM_SEQ_DATA_1_SEQCERS9'/>"
WRITE #1 "        <register address='0xb9f3670' value='0x" DATA.LONG(A:0x9f3670) "' name='RPMH_VRM_SEQ_DATA_1_SEQCERS10'/>"
WRITE #1 "        <register address='0xb9f367c' value='0x" DATA.LONG(A:0x9f367c) "' name='RPMH_VRM_SEQ_DATA_1_SEQCERS11'/>"
WRITE #1 "        <register address='0xb9f3688' value='0x" DATA.LONG(A:0x9f3688) "' name='RPMH_VRM_SEQ_DATA_1_SEQCERS12'/>"
WRITE #1 "        <register address='0xb9f3694' value='0x" DATA.LONG(A:0x9f3694) "' name='RPMH_VRM_SEQ_DATA_1_SEQCERS13'/>"
WRITE #1 "        <register address='0xb9f36a0' value='0x" DATA.LONG(A:0x9f36a0) "' name='RPMH_VRM_SEQ_DATA_1_SEQCERS14'/>"
WRITE #1 "        <register address='0xb9f36ac' value='0x" DATA.LONG(A:0x9f36ac) "' name='RPMH_VRM_SEQ_DATA_1_SEQCERS15'/>"
WRITE #1 "        <register address='0xb9f36b8' value='0x" DATA.LONG(A:0x9f36b8) "' name='RPMH_VRM_SEQ_DATA_1_SEQCERS16'/>"
WRITE #1 "        <register address='0xb9f36c4' value='0x" DATA.LONG(A:0x9f36c4) "' name='RPMH_VRM_SEQ_DATA_1_SEQCERS17'/>"
WRITE #1 "        <register address='0xb9f36d0' value='0x" DATA.LONG(A:0x9f36d0) "' name='RPMH_VRM_SEQ_DATA_1_SEQCERS18'/>"
WRITE #1 "        <register address='0xb9f36dc' value='0x" DATA.LONG(A:0x9f36dc) "' name='RPMH_VRM_SEQ_DATA_1_SEQCERS19'/>"
WRITE #1 "        <register address='0xb9f36e8' value='0x" DATA.LONG(A:0x9f36e8) "' name='RPMH_VRM_SEQ_DATA_1_SEQCERS20'/>"
WRITE #1 "        <register address='0xb9f36f4' value='0x" DATA.LONG(A:0x9f36f4) "' name='RPMH_VRM_SEQ_DATA_1_SEQCERS21'/>"
WRITE #1 "        <register address='0xb9f3700' value='0x" DATA.LONG(A:0x9f3700) "' name='RPMH_VRM_SEQ_DATA_1_SEQCERS22'/>"
WRITE #1 "        <register address='0xb9f370c' value='0x" DATA.LONG(A:0x9f370c) "' name='RPMH_VRM_SEQ_DATA_1_SEQCERS23'/>"
WRITE #1 "        <register address='0xb9f3718' value='0x" DATA.LONG(A:0x9f3718) "' name='RPMH_VRM_SEQ_DATA_1_SEQCERS24'/>"
WRITE #1 "        <register address='0xb9f3724' value='0x" DATA.LONG(A:0x9f3724) "' name='RPMH_VRM_SEQ_DATA_1_SEQCERS25'/>"
WRITE #1 "        <register address='0xb9f3730' value='0x" DATA.LONG(A:0x9f3730) "' name='RPMH_VRM_SEQ_DATA_1_SEQCERS26'/>"
WRITE #1 "        <register address='0xb9f373c' value='0x" DATA.LONG(A:0x9f373c) "' name='RPMH_VRM_SEQ_DATA_1_SEQCERS27'/>"
WRITE #1 "        <register address='0xb9f3748' value='0x" DATA.LONG(A:0x9f3748) "' name='RPMH_VRM_SEQ_DATA_1_SEQCERS28'/>"
WRITE #1 "        <register address='0xb9f3754' value='0x" DATA.LONG(A:0x9f3754) "' name='RPMH_VRM_SEQ_DATA_1_SEQCERS29'/>"
WRITE #1 "        <register address='0xb9f3760' value='0x" DATA.LONG(A:0x9f3760) "' name='RPMH_VRM_SEQ_DATA_1_SEQCERS30'/>"
WRITE #1 "        <register address='0xb9f376c' value='0x" DATA.LONG(A:0x9f376c) "' name='RPMH_VRM_SEQ_DATA_1_SEQCERS31'/>"
WRITE #1 "        <register address='0xb9f35fc' value='0x" DATA.LONG(A:0x9f35fc) "' name='RPMH_VRM_SEQ_DATA_2_SEQCERS0'/>"
WRITE #1 "        <register address='0xb9f3608' value='0x" DATA.LONG(A:0x9f3608) "' name='RPMH_VRM_SEQ_DATA_2_SEQCERS1'/>"
WRITE #1 "        <register address='0xb9f3614' value='0x" DATA.LONG(A:0x9f3614) "' name='RPMH_VRM_SEQ_DATA_2_SEQCERS2'/>"
WRITE #1 "        <register address='0xb9f3620' value='0x" DATA.LONG(A:0x9f3620) "' name='RPMH_VRM_SEQ_DATA_2_SEQCERS3'/>"
WRITE #1 "        <register address='0xb9f362c' value='0x" DATA.LONG(A:0x9f362c) "' name='RPMH_VRM_SEQ_DATA_2_SEQCERS4'/>"
WRITE #1 "        <register address='0xb9f3638' value='0x" DATA.LONG(A:0x9f3638) "' name='RPMH_VRM_SEQ_DATA_2_SEQCERS5'/>"
WRITE #1 "        <register address='0xb9f3644' value='0x" DATA.LONG(A:0x9f3644) "' name='RPMH_VRM_SEQ_DATA_2_SEQCERS6'/>"
WRITE #1 "        <register address='0xb9f3650' value='0x" DATA.LONG(A:0x9f3650) "' name='RPMH_VRM_SEQ_DATA_2_SEQCERS7'/>"
WRITE #1 "        <register address='0xb9f365c' value='0x" DATA.LONG(A:0x9f365c) "' name='RPMH_VRM_SEQ_DATA_2_SEQCERS8'/>"
WRITE #1 "        <register address='0xb9f3668' value='0x" DATA.LONG(A:0x9f3668) "' name='RPMH_VRM_SEQ_DATA_2_SEQCERS9'/>"
WRITE #1 "        <register address='0xb9f3674' value='0x" DATA.LONG(A:0x9f3674) "' name='RPMH_VRM_SEQ_DATA_2_SEQCERS10'/>"
WRITE #1 "        <register address='0xb9f3680' value='0x" DATA.LONG(A:0x9f3680) "' name='RPMH_VRM_SEQ_DATA_2_SEQCERS11'/>"
WRITE #1 "        <register address='0xb9f368c' value='0x" DATA.LONG(A:0x9f368c) "' name='RPMH_VRM_SEQ_DATA_2_SEQCERS12'/>"
WRITE #1 "        <register address='0xb9f3698' value='0x" DATA.LONG(A:0x9f3698) "' name='RPMH_VRM_SEQ_DATA_2_SEQCERS13'/>"
WRITE #1 "        <register address='0xb9f36a4' value='0x" DATA.LONG(A:0x9f36a4) "' name='RPMH_VRM_SEQ_DATA_2_SEQCERS14'/>"
WRITE #1 "        <register address='0xb9f36b0' value='0x" DATA.LONG(A:0x9f36b0) "' name='RPMH_VRM_SEQ_DATA_2_SEQCERS15'/>"
WRITE #1 "        <register address='0xb9f36bc' value='0x" DATA.LONG(A:0x9f36bc) "' name='RPMH_VRM_SEQ_DATA_2_SEQCERS16'/>"
WRITE #1 "        <register address='0xb9f36c8' value='0x" DATA.LONG(A:0x9f36c8) "' name='RPMH_VRM_SEQ_DATA_2_SEQCERS17'/>"
WRITE #1 "        <register address='0xb9f36d4' value='0x" DATA.LONG(A:0x9f36d4) "' name='RPMH_VRM_SEQ_DATA_2_SEQCERS18'/>"
WRITE #1 "        <register address='0xb9f36e0' value='0x" DATA.LONG(A:0x9f36e0) "' name='RPMH_VRM_SEQ_DATA_2_SEQCERS19'/>"
WRITE #1 "        <register address='0xb9f36ec' value='0x" DATA.LONG(A:0x9f36ec) "' name='RPMH_VRM_SEQ_DATA_2_SEQCERS20'/>"
WRITE #1 "        <register address='0xb9f36f8' value='0x" DATA.LONG(A:0x9f36f8) "' name='RPMH_VRM_SEQ_DATA_2_SEQCERS21'/>"
WRITE #1 "        <register address='0xb9f3704' value='0x" DATA.LONG(A:0x9f3704) "' name='RPMH_VRM_SEQ_DATA_2_SEQCERS22'/>"
WRITE #1 "        <register address='0xb9f3710' value='0x" DATA.LONG(A:0x9f3710) "' name='RPMH_VRM_SEQ_DATA_2_SEQCERS23'/>"
WRITE #1 "        <register address='0xb9f371c' value='0x" DATA.LONG(A:0x9f371c) "' name='RPMH_VRM_SEQ_DATA_2_SEQCERS24'/>"
WRITE #1 "        <register address='0xb9f3728' value='0x" DATA.LONG(A:0x9f3728) "' name='RPMH_VRM_SEQ_DATA_2_SEQCERS25'/>"
WRITE #1 "        <register address='0xb9f3734' value='0x" DATA.LONG(A:0x9f3734) "' name='RPMH_VRM_SEQ_DATA_2_SEQCERS26'/>"
WRITE #1 "        <register address='0xb9f3740' value='0x" DATA.LONG(A:0x9f3740) "' name='RPMH_VRM_SEQ_DATA_2_SEQCERS27'/>"
WRITE #1 "        <register address='0xb9f374c' value='0x" DATA.LONG(A:0x9f374c) "' name='RPMH_VRM_SEQ_DATA_2_SEQCERS28'/>"
WRITE #1 "        <register address='0xb9f3758' value='0x" DATA.LONG(A:0x9f3758) "' name='RPMH_VRM_SEQ_DATA_2_SEQCERS29'/>"
WRITE #1 "        <register address='0xb9f3764' value='0x" DATA.LONG(A:0x9f3764) "' name='RPMH_VRM_SEQ_DATA_2_SEQCERS30'/>"
WRITE #1 "        <register address='0xb9f3770' value='0x" DATA.LONG(A:0x9f3770) "' name='RPMH_VRM_SEQ_DATA_2_SEQCERS31'/>"
WRITE #1 "        <register address='0xb9f5000' value='0x" DATA.LONG(A:0x9f5000) "' name='RPMH_VRM_VRM_VERSION'/>"
WRITE #1 "        <register address='0xb9f5004' value='0x" DATA.LONG(A:0x9f5004) "' name='RPMH_VRM_VREG_READY_EXTRA_TIME'/>"
WRITE #1 "        <register address='0xb9f5008' value='0x" DATA.LONG(A:0x9f5008) "' name='RPMH_VRM_VREG_READY_WDOG_ERROR_ENABLE'/>"
WRITE #1 "        <register address='0xb9f500c' value='0x" DATA.LONG(A:0x9f500c) "' name='RPMH_VRM_VREG_READY_CLR_BR_ADDR_CSR_REG'/>"
WRITE #1 "        <register address='0xb9f5010' value='0x" DATA.LONG(A:0x9f5010) "' name='RPMH_VRM_CMD_SYN_UNBLOCK'/>"
WRITE #1 "        <register address='0xb9f5014' value='0x" DATA.LONG(A:0x9f5014) "' name='RPMH_VRM_MIN_SETTLING_TIME_CSR_REG'/>"
WRITE #1 "        <register address='0xb9f5090' value='0x" DATA.LONG(A:0x9f5090) "' name='RPMH_VRM_RESP_ADDR_DRV0'/>"
WRITE #1 "        <register address='0xb9f5094' value='0x" DATA.LONG(A:0x9f5094) "' name='RPMH_VRM_RESP_ADDR_DRV1'/>"
WRITE #1 "        <register address='0xb9f5098' value='0x" DATA.LONG(A:0x9f5098) "' name='RPMH_VRM_RESP_ADDR_DRV2'/>"
WRITE #1 "        <register address='0xb9f509c' value='0x" DATA.LONG(A:0x9f509c) "' name='RPMH_VRM_RESP_ADDR_DRV3'/>"
WRITE #1 "        <register address='0xb9f50a0' value='0x" DATA.LONG(A:0x9f50a0) "' name='RPMH_VRM_RESP_ADDR_DRV4'/>"
WRITE #1 "        <register address='0xb9f50a4' value='0x" DATA.LONG(A:0x9f50a4) "' name='RPMH_VRM_RESP_ADDR_DRV5'/>"
WRITE #1 "        <register address='0xb9f50a8' value='0x" DATA.LONG(A:0x9f50a8) "' name='RPMH_VRM_RESP_ADDR_DRV6'/>"
WRITE #1 "        <register address='0xb9f50ac' value='0x" DATA.LONG(A:0x9f50ac) "' name='RPMH_VRM_RESP_ADDR_DRV7'/>"
WRITE #1 "        <register address='0xb9f50b0' value='0x" DATA.LONG(A:0x9f50b0) "' name='RPMH_VRM_RESP_ADDR_DRV8'/>"
WRITE #1 "        <register address='0xb9f50b4' value='0x" DATA.LONG(A:0x9f50b4) "' name='RPMH_VRM_RESP_ADDR_DRV9'/>"
WRITE #1 "        <register address='0xb9f50b8' value='0x" DATA.LONG(A:0x9f50b8) "' name='RPMH_VRM_RESP_ADDR_DRV10'/>"
WRITE #1 "        <register address='0xb9f50bc' value='0x" DATA.LONG(A:0x9f50bc) "' name='RPMH_VRM_RESP_ADDR_DRV11'/>"
WRITE #1 "        <register address='0xb9f5100' value='0x" DATA.LONG(A:0x9f5100) "' name='RPMH_VRM_RESP_ADDR2_DRV0'/>"
WRITE #1 "        <register address='0xb9f5104' value='0x" DATA.LONG(A:0x9f5104) "' name='RPMH_VRM_RESP_ADDR2_DRV1'/>"
WRITE #1 "        <register address='0xb9f5108' value='0x" DATA.LONG(A:0x9f5108) "' name='RPMH_VRM_RESP_ADDR2_DRV2'/>"
WRITE #1 "        <register address='0xb9f510c' value='0x" DATA.LONG(A:0x9f510c) "' name='RPMH_VRM_RESP_ADDR2_DRV3'/>"
WRITE #1 "        <register address='0xb9f5110' value='0x" DATA.LONG(A:0x9f5110) "' name='RPMH_VRM_RESP_ADDR2_DRV4'/>"
WRITE #1 "        <register address='0xb9f5114' value='0x" DATA.LONG(A:0x9f5114) "' name='RPMH_VRM_RESP_ADDR2_DRV5'/>"
WRITE #1 "        <register address='0xb9f5118' value='0x" DATA.LONG(A:0x9f5118) "' name='RPMH_VRM_RESP_ADDR2_DRV6'/>"
WRITE #1 "        <register address='0xb9f511c' value='0x" DATA.LONG(A:0x9f511c) "' name='RPMH_VRM_RESP_ADDR2_DRV7'/>"
WRITE #1 "        <register address='0xb9f5120' value='0x" DATA.LONG(A:0x9f5120) "' name='RPMH_VRM_RESP_ADDR2_DRV8'/>"
WRITE #1 "        <register address='0xb9f5124' value='0x" DATA.LONG(A:0x9f5124) "' name='RPMH_VRM_RESP_ADDR2_DRV9'/>"
WRITE #1 "        <register address='0xb9f5128' value='0x" DATA.LONG(A:0x9f5128) "' name='RPMH_VRM_RESP_ADDR2_DRV10'/>"
WRITE #1 "        <register address='0xb9f512c' value='0x" DATA.LONG(A:0x9f512c) "' name='RPMH_VRM_RESP_ADDR2_DRV11'/>"
WRITE #1 "        <register address='0xb9f54a8' value='0x" DATA.LONG(A:0x9f54a8) "' name='RPMH_VRM_VRM_CFG'/>"
WRITE #1 "        <register address='0xb9f54ac' value='0x" DATA.LONG(A:0x9f54ac) "' name='RPMH_VRM_CMD_SYN_CFG'/>"
WRITE #1 "        <register address='0xb9f54b0' value='0x" DATA.LONG(A:0x9f54b0) "' name='RPMH_VRM_SW_WORKAROUND_BR_ADDR0_CSR_REG'/>"
WRITE #1 "        <register address='0xb9f54b4' value='0x" DATA.LONG(A:0x9f54b4) "' name='RPMH_VRM_SW_WORKAROUND_BR_ADDR1_CSR_REG'/>"
WRITE #1 "        <register address='0xb9f54b8' value='0x" DATA.LONG(A:0x9f54b8) "' name='RPMH_VRM_SW_WORKAROUND_BR_ADDR2_CSR_REG'/>"
WRITE #1 "        <register address='0xb9f54bc' value='0x" DATA.LONG(A:0x9f54bc) "' name='RPMH_VRM_VRM_CLK_GATING_EN_CFG'/>"
WRITE #1 "        <register address='0xb9f54c0' value='0x" DATA.LONG(A:0x9f54c0) "' name='RPMH_VRM_VRM_DEBUG_BUS_EN_CFG'/>"
WRITE #1 "        <register address='0xb9f54c4' value='0x" DATA.LONG(A:0x9f54c4) "' name='RPMH_VRM_VRM_DEBUG_BUS_CFG'/>"
WRITE #1 "        <register address='0xba00000' value='0x" DATA.LONG(A:0xa00000) "' name='RPMH_BCM_VOTETABLE_DRV0_ND0'/>"
WRITE #1 "        <register address='0xba00004' value='0x" DATA.LONG(A:0xa00004) "' name='RPMH_BCM_VOTETABLE_DRV0_ND1'/>"
WRITE #1 "        <register address='0xba0000c' value='0x" DATA.LONG(A:0xa0000c) "' name='RPMH_BCM_VOTETABLE_DRV0_ND3'/>"
WRITE #1 "        <register address='0xba00010' value='0x" DATA.LONG(A:0xa00010) "' name='RPMH_BCM_VOTETABLE_DRV0_ND4'/>"
WRITE #1 "        <register address='0xba00014' value='0x" DATA.LONG(A:0xa00014) "' name='RPMH_BCM_VOTETABLE_DRV0_ND5'/>"
WRITE #1 "        <register address='0xba0001c' value='0x" DATA.LONG(A:0xa0001c) "' name='RPMH_BCM_VOTETABLE_DRV0_ND7'/>"
WRITE #1 "        <register address='0xba00024' value='0x" DATA.LONG(A:0xa00024) "' name='RPMH_BCM_VOTETABLE_DRV0_ND9'/>"
WRITE #1 "        <register address='0xba00028' value='0x" DATA.LONG(A:0xa00028) "' name='RPMH_BCM_VOTETABLE_DRV0_ND10'/>"
WRITE #1 "        <register address='0xba00030' value='0x" DATA.LONG(A:0xa00030) "' name='RPMH_BCM_VOTETABLE_DRV0_ND12'/>"
WRITE #1 "        <register address='0xba00034' value='0x" DATA.LONG(A:0xa00034) "' name='RPMH_BCM_VOTETABLE_DRV0_ND13'/>"
WRITE #1 "        <register address='0xba00048' value='0x" DATA.LONG(A:0xa00048) "' name='RPMH_BCM_VOTETABLE_DRV0_ND18'/>"
WRITE #1 "        <register address='0xba0004c' value='0x" DATA.LONG(A:0xa0004c) "' name='RPMH_BCM_VOTETABLE_DRV0_ND19'/>"
WRITE #1 "        <register address='0xba00058' value='0x" DATA.LONG(A:0xa00058) "' name='RPMH_BCM_VOTETABLE_DRV0_ND22'/>"
WRITE #1 "        <register address='0xba0005c' value='0x" DATA.LONG(A:0xa0005c) "' name='RPMH_BCM_VOTETABLE_DRV0_ND23'/>"
WRITE #1 "        <register address='0xba00060' value='0x" DATA.LONG(A:0xa00060) "' name='RPMH_BCM_VOTETABLE_DRV0_ND24'/>"
WRITE #1 "        <register address='0xba00064' value='0x" DATA.LONG(A:0xa00064) "' name='RPMH_BCM_VOTETABLE_DRV0_ND25'/>"
WRITE #1 "        <register address='0xba00068' value='0x" DATA.LONG(A:0xa00068) "' name='RPMH_BCM_VOTETABLE_DRV0_ND26'/>"
WRITE #1 "        <register address='0xba0006c' value='0x" DATA.LONG(A:0xa0006c) "' name='RPMH_BCM_VOTETABLE_DRV0_ND27'/>"
WRITE #1 "        <register address='0xba00074' value='0x" DATA.LONG(A:0xa00074) "' name='RPMH_BCM_VOTETABLE_DRV0_ND29'/>"
WRITE #1 "        <register address='0xba00078' value='0x" DATA.LONG(A:0xa00078) "' name='RPMH_BCM_VOTETABLE_DRV0_ND30'/>"
WRITE #1 "        <register address='0xba0007c' value='0x" DATA.LONG(A:0xa0007c) "' name='RPMH_BCM_VOTETABLE_DRV0_ND31'/>"
WRITE #1 "        <register address='0xba00080' value='0x" DATA.LONG(A:0xa00080) "' name='RPMH_BCM_VOTETABLE_DRV0_ND32'/>"
WRITE #1 "        <register address='0xba00084' value='0x" DATA.LONG(A:0xa00084) "' name='RPMH_BCM_VOTETABLE_DRV0_ND33'/>"
WRITE #1 "        <register address='0xba00088' value='0x" DATA.LONG(A:0xa00088) "' name='RPMH_BCM_VOTETABLE_DRV0_ND34'/>"
WRITE #1 "        <register address='0xba0008c' value='0x" DATA.LONG(A:0xa0008c) "' name='RPMH_BCM_VOTETABLE_DRV0_ND35'/>"
WRITE #1 "        <register address='0xba00090' value='0x" DATA.LONG(A:0xa00090) "' name='RPMH_BCM_VOTETABLE_DRV0_ND36'/>"
WRITE #1 "        <register address='0xba00094' value='0x" DATA.LONG(A:0xa00094) "' name='RPMH_BCM_VOTETABLE_DRV0_ND37'/>"
WRITE #1 "        <register address='0xba00098' value='0x" DATA.LONG(A:0xa00098) "' name='RPMH_BCM_VOTETABLE_DRV0_ND38'/>"
WRITE #1 "        <register address='0xba0009c' value='0x" DATA.LONG(A:0xa0009c) "' name='RPMH_BCM_VOTETABLE_DRV0_ND39'/>"
WRITE #1 "        <register address='0xba000a0' value='0x" DATA.LONG(A:0xa000a0) "' name='RPMH_BCM_VOTETABLE_DRV0_ND40'/>"
WRITE #1 "        <register address='0xba000a4' value='0x" DATA.LONG(A:0xa000a4) "' name='RPMH_BCM_VOTETABLE_DRV0_ND41'/>"
WRITE #1 "        <register address='0xba000a8' value='0x" DATA.LONG(A:0xa000a8) "' name='RPMH_BCM_VOTETABLE_DRV0_ND42'/>"
WRITE #1 "        <register address='0xba000ac' value='0x" DATA.LONG(A:0xa000ac) "' name='RPMH_BCM_VOTETABLE_DRV0_ND43'/>"
WRITE #1 "        <register address='0xba10000' value='0x" DATA.LONG(A:0xa10000) "' name='RPMH_BCM_VOTETABLE_DRV1_ND0'/>"
WRITE #1 "        <register address='0xba10004' value='0x" DATA.LONG(A:0xa10004) "' name='RPMH_BCM_VOTETABLE_DRV1_ND1'/>"
WRITE #1 "        <register address='0xba1000c' value='0x" DATA.LONG(A:0xa1000c) "' name='RPMH_BCM_VOTETABLE_DRV1_ND3'/>"
WRITE #1 "        <register address='0xba10010' value='0x" DATA.LONG(A:0xa10010) "' name='RPMH_BCM_VOTETABLE_DRV1_ND4'/>"
WRITE #1 "        <register address='0xba10014' value='0x" DATA.LONG(A:0xa10014) "' name='RPMH_BCM_VOTETABLE_DRV1_ND5'/>"
WRITE #1 "        <register address='0xba1001c' value='0x" DATA.LONG(A:0xa1001c) "' name='RPMH_BCM_VOTETABLE_DRV1_ND7'/>"
WRITE #1 "        <register address='0xba10024' value='0x" DATA.LONG(A:0xa10024) "' name='RPMH_BCM_VOTETABLE_DRV1_ND9'/>"
WRITE #1 "        <register address='0xba10028' value='0x" DATA.LONG(A:0xa10028) "' name='RPMH_BCM_VOTETABLE_DRV1_ND10'/>"
WRITE #1 "        <register address='0xba10030' value='0x" DATA.LONG(A:0xa10030) "' name='RPMH_BCM_VOTETABLE_DRV1_ND12'/>"
WRITE #1 "        <register address='0xba10034' value='0x" DATA.LONG(A:0xa10034) "' name='RPMH_BCM_VOTETABLE_DRV1_ND13'/>"
WRITE #1 "        <register address='0xba10048' value='0x" DATA.LONG(A:0xa10048) "' name='RPMH_BCM_VOTETABLE_DRV1_ND18'/>"
WRITE #1 "        <register address='0xba1004c' value='0x" DATA.LONG(A:0xa1004c) "' name='RPMH_BCM_VOTETABLE_DRV1_ND19'/>"
WRITE #1 "        <register address='0xba10064' value='0x" DATA.LONG(A:0xa10064) "' name='RPMH_BCM_VOTETABLE_DRV1_ND25'/>"
WRITE #1 "        <register address='0xba10068' value='0x" DATA.LONG(A:0xa10068) "' name='RPMH_BCM_VOTETABLE_DRV1_ND26'/>"
WRITE #1 "        <register address='0xba1006c' value='0x" DATA.LONG(A:0xa1006c) "' name='RPMH_BCM_VOTETABLE_DRV1_ND27'/>"
WRITE #1 "        <register address='0xba10074' value='0x" DATA.LONG(A:0xa10074) "' name='RPMH_BCM_VOTETABLE_DRV1_ND29'/>"
WRITE #1 "        <register address='0xba10078' value='0x" DATA.LONG(A:0xa10078) "' name='RPMH_BCM_VOTETABLE_DRV1_ND30'/>"
WRITE #1 "        <register address='0xba1007c' value='0x" DATA.LONG(A:0xa1007c) "' name='RPMH_BCM_VOTETABLE_DRV1_ND31'/>"
WRITE #1 "        <register address='0xba10080' value='0x" DATA.LONG(A:0xa10080) "' name='RPMH_BCM_VOTETABLE_DRV1_ND32'/>"
WRITE #1 "        <register address='0xba10084' value='0x" DATA.LONG(A:0xa10084) "' name='RPMH_BCM_VOTETABLE_DRV1_ND33'/>"
WRITE #1 "        <register address='0xba10088' value='0x" DATA.LONG(A:0xa10088) "' name='RPMH_BCM_VOTETABLE_DRV1_ND34'/>"
WRITE #1 "        <register address='0xba1008c' value='0x" DATA.LONG(A:0xa1008c) "' name='RPMH_BCM_VOTETABLE_DRV1_ND35'/>"
WRITE #1 "        <register address='0xba10090' value='0x" DATA.LONG(A:0xa10090) "' name='RPMH_BCM_VOTETABLE_DRV1_ND36'/>"
WRITE #1 "        <register address='0xba10094' value='0x" DATA.LONG(A:0xa10094) "' name='RPMH_BCM_VOTETABLE_DRV1_ND37'/>"
WRITE #1 "        <register address='0xba10098' value='0x" DATA.LONG(A:0xa10098) "' name='RPMH_BCM_VOTETABLE_DRV1_ND38'/>"
WRITE #1 "        <register address='0xba1009c' value='0x" DATA.LONG(A:0xa1009c) "' name='RPMH_BCM_VOTETABLE_DRV1_ND39'/>"
WRITE #1 "        <register address='0xba100a0' value='0x" DATA.LONG(A:0xa100a0) "' name='RPMH_BCM_VOTETABLE_DRV1_ND40'/>"
WRITE #1 "        <register address='0xba100a4' value='0x" DATA.LONG(A:0xa100a4) "' name='RPMH_BCM_VOTETABLE_DRV1_ND41'/>"
WRITE #1 "        <register address='0xba100a8' value='0x" DATA.LONG(A:0xa100a8) "' name='RPMH_BCM_VOTETABLE_DRV1_ND42'/>"
WRITE #1 "        <register address='0xba100ac' value='0x" DATA.LONG(A:0xa100ac) "' name='RPMH_BCM_VOTETABLE_DRV1_ND43'/>"
WRITE #1 "        <register address='0xba20000' value='0x" DATA.LONG(A:0xa20000) "' name='RPMH_BCM_VOTETABLE_DRV2_ND0'/>"
WRITE #1 "        <register address='0xba20004' value='0x" DATA.LONG(A:0xa20004) "' name='RPMH_BCM_VOTETABLE_DRV2_ND1'/>"
WRITE #1 "        <register address='0xba20008' value='0x" DATA.LONG(A:0xa20008) "' name='RPMH_BCM_VOTETABLE_DRV2_ND2'/>"
WRITE #1 "        <register address='0xba2000c' value='0x" DATA.LONG(A:0xa2000c) "' name='RPMH_BCM_VOTETABLE_DRV2_ND3'/>"
WRITE #1 "        <register address='0xba20010' value='0x" DATA.LONG(A:0xa20010) "' name='RPMH_BCM_VOTETABLE_DRV2_ND4'/>"
WRITE #1 "        <register address='0xba20014' value='0x" DATA.LONG(A:0xa20014) "' name='RPMH_BCM_VOTETABLE_DRV2_ND5'/>"
WRITE #1 "        <register address='0xba20018' value='0x" DATA.LONG(A:0xa20018) "' name='RPMH_BCM_VOTETABLE_DRV2_ND6'/>"
WRITE #1 "        <register address='0xba2001c' value='0x" DATA.LONG(A:0xa2001c) "' name='RPMH_BCM_VOTETABLE_DRV2_ND7'/>"
WRITE #1 "        <register address='0xba20020' value='0x" DATA.LONG(A:0xa20020) "' name='RPMH_BCM_VOTETABLE_DRV2_ND8'/>"
WRITE #1 "        <register address='0xba20024' value='0x" DATA.LONG(A:0xa20024) "' name='RPMH_BCM_VOTETABLE_DRV2_ND9'/>"
WRITE #1 "        <register address='0xba20028' value='0x" DATA.LONG(A:0xa20028) "' name='RPMH_BCM_VOTETABLE_DRV2_ND10'/>"
WRITE #1 "        <register address='0xba2002c' value='0x" DATA.LONG(A:0xa2002c) "' name='RPMH_BCM_VOTETABLE_DRV2_ND11'/>"
WRITE #1 "        <register address='0xba20030' value='0x" DATA.LONG(A:0xa20030) "' name='RPMH_BCM_VOTETABLE_DRV2_ND12'/>"
WRITE #1 "        <register address='0xba20034' value='0x" DATA.LONG(A:0xa20034) "' name='RPMH_BCM_VOTETABLE_DRV2_ND13'/>"
WRITE #1 "        <register address='0xba20038' value='0x" DATA.LONG(A:0xa20038) "' name='RPMH_BCM_VOTETABLE_DRV2_ND14'/>"
WRITE #1 "        <register address='0xba2003c' value='0x" DATA.LONG(A:0xa2003c) "' name='RPMH_BCM_VOTETABLE_DRV2_ND15'/>"
WRITE #1 "        <register address='0xba20040' value='0x" DATA.LONG(A:0xa20040) "' name='RPMH_BCM_VOTETABLE_DRV2_ND16'/>"
WRITE #1 "        <register address='0xba20044' value='0x" DATA.LONG(A:0xa20044) "' name='RPMH_BCM_VOTETABLE_DRV2_ND17'/>"
WRITE #1 "        <register address='0xba20048' value='0x" DATA.LONG(A:0xa20048) "' name='RPMH_BCM_VOTETABLE_DRV2_ND18'/>"
WRITE #1 "        <register address='0xba2004c' value='0x" DATA.LONG(A:0xa2004c) "' name='RPMH_BCM_VOTETABLE_DRV2_ND19'/>"
WRITE #1 "        <register address='0xba20050' value='0x" DATA.LONG(A:0xa20050) "' name='RPMH_BCM_VOTETABLE_DRV2_ND20'/>"
WRITE #1 "        <register address='0xba20054' value='0x" DATA.LONG(A:0xa20054) "' name='RPMH_BCM_VOTETABLE_DRV2_ND21'/>"
WRITE #1 "        <register address='0xba20058' value='0x" DATA.LONG(A:0xa20058) "' name='RPMH_BCM_VOTETABLE_DRV2_ND22'/>"
WRITE #1 "        <register address='0xba2005c' value='0x" DATA.LONG(A:0xa2005c) "' name='RPMH_BCM_VOTETABLE_DRV2_ND23'/>"
WRITE #1 "        <register address='0xba20060' value='0x" DATA.LONG(A:0xa20060) "' name='RPMH_BCM_VOTETABLE_DRV2_ND24'/>"
WRITE #1 "        <register address='0xba20064' value='0x" DATA.LONG(A:0xa20064) "' name='RPMH_BCM_VOTETABLE_DRV2_ND25'/>"
WRITE #1 "        <register address='0xba20068' value='0x" DATA.LONG(A:0xa20068) "' name='RPMH_BCM_VOTETABLE_DRV2_ND26'/>"
WRITE #1 "        <register address='0xba2006c' value='0x" DATA.LONG(A:0xa2006c) "' name='RPMH_BCM_VOTETABLE_DRV2_ND27'/>"
WRITE #1 "        <register address='0xba20070' value='0x" DATA.LONG(A:0xa20070) "' name='RPMH_BCM_VOTETABLE_DRV2_ND28'/>"
WRITE #1 "        <register address='0xba20074' value='0x" DATA.LONG(A:0xa20074) "' name='RPMH_BCM_VOTETABLE_DRV2_ND29'/>"
WRITE #1 "        <register address='0xba20078' value='0x" DATA.LONG(A:0xa20078) "' name='RPMH_BCM_VOTETABLE_DRV2_ND30'/>"
WRITE #1 "        <register address='0xba2007c' value='0x" DATA.LONG(A:0xa2007c) "' name='RPMH_BCM_VOTETABLE_DRV2_ND31'/>"
WRITE #1 "        <register address='0xba20080' value='0x" DATA.LONG(A:0xa20080) "' name='RPMH_BCM_VOTETABLE_DRV2_ND32'/>"
WRITE #1 "        <register address='0xba20084' value='0x" DATA.LONG(A:0xa20084) "' name='RPMH_BCM_VOTETABLE_DRV2_ND33'/>"
WRITE #1 "        <register address='0xba20088' value='0x" DATA.LONG(A:0xa20088) "' name='RPMH_BCM_VOTETABLE_DRV2_ND34'/>"
WRITE #1 "        <register address='0xba2008c' value='0x" DATA.LONG(A:0xa2008c) "' name='RPMH_BCM_VOTETABLE_DRV2_ND35'/>"
WRITE #1 "        <register address='0xba20090' value='0x" DATA.LONG(A:0xa20090) "' name='RPMH_BCM_VOTETABLE_DRV2_ND36'/>"
WRITE #1 "        <register address='0xba20094' value='0x" DATA.LONG(A:0xa20094) "' name='RPMH_BCM_VOTETABLE_DRV2_ND37'/>"
WRITE #1 "        <register address='0xba20098' value='0x" DATA.LONG(A:0xa20098) "' name='RPMH_BCM_VOTETABLE_DRV2_ND38'/>"
WRITE #1 "        <register address='0xba2009c' value='0x" DATA.LONG(A:0xa2009c) "' name='RPMH_BCM_VOTETABLE_DRV2_ND39'/>"
WRITE #1 "        <register address='0xba200a0' value='0x" DATA.LONG(A:0xa200a0) "' name='RPMH_BCM_VOTETABLE_DRV2_ND40'/>"
WRITE #1 "        <register address='0xba200a4' value='0x" DATA.LONG(A:0xa200a4) "' name='RPMH_BCM_VOTETABLE_DRV2_ND41'/>"
WRITE #1 "        <register address='0xba200a8' value='0x" DATA.LONG(A:0xa200a8) "' name='RPMH_BCM_VOTETABLE_DRV2_ND42'/>"
WRITE #1 "        <register address='0xba200ac' value='0x" DATA.LONG(A:0xa200ac) "' name='RPMH_BCM_VOTETABLE_DRV2_ND43'/>"
WRITE #1 "        <register address='0xba30000' value='0x" DATA.LONG(A:0xa30000) "' name='RPMH_BCM_VOTETABLE_DRV3_ND0'/>"
WRITE #1 "        <register address='0xba30004' value='0x" DATA.LONG(A:0xa30004) "' name='RPMH_BCM_VOTETABLE_DRV3_ND1'/>"
WRITE #1 "        <register address='0xba30008' value='0x" DATA.LONG(A:0xa30008) "' name='RPMH_BCM_VOTETABLE_DRV3_ND2'/>"
WRITE #1 "        <register address='0xba30024' value='0x" DATA.LONG(A:0xa30024) "' name='RPMH_BCM_VOTETABLE_DRV3_ND9'/>"
WRITE #1 "        <register address='0xba30028' value='0x" DATA.LONG(A:0xa30028) "' name='RPMH_BCM_VOTETABLE_DRV3_ND10'/>"
WRITE #1 "        <register address='0xba30030' value='0x" DATA.LONG(A:0xa30030) "' name='RPMH_BCM_VOTETABLE_DRV3_ND12'/>"
WRITE #1 "        <register address='0xba30034' value='0x" DATA.LONG(A:0xa30034) "' name='RPMH_BCM_VOTETABLE_DRV3_ND13'/>"
WRITE #1 "        <register address='0xba30038' value='0x" DATA.LONG(A:0xa30038) "' name='RPMH_BCM_VOTETABLE_DRV3_ND14'/>"
WRITE #1 "        <register address='0xba30048' value='0x" DATA.LONG(A:0xa30048) "' name='RPMH_BCM_VOTETABLE_DRV3_ND18'/>"
WRITE #1 "        <register address='0xba30050' value='0x" DATA.LONG(A:0xa30050) "' name='RPMH_BCM_VOTETABLE_DRV3_ND20'/>"
WRITE #1 "        <register address='0xba30064' value='0x" DATA.LONG(A:0xa30064) "' name='RPMH_BCM_VOTETABLE_DRV3_ND25'/>"
WRITE #1 "        <register address='0xba30068' value='0x" DATA.LONG(A:0xa30068) "' name='RPMH_BCM_VOTETABLE_DRV3_ND26'/>"
WRITE #1 "        <register address='0xba3006c' value='0x" DATA.LONG(A:0xa3006c) "' name='RPMH_BCM_VOTETABLE_DRV3_ND27'/>"
WRITE #1 "        <register address='0xba30070' value='0x" DATA.LONG(A:0xa30070) "' name='RPMH_BCM_VOTETABLE_DRV3_ND28'/>"
WRITE #1 "        <register address='0xba30074' value='0x" DATA.LONG(A:0xa30074) "' name='RPMH_BCM_VOTETABLE_DRV3_ND29'/>"
WRITE #1 "        <register address='0xba30078' value='0x" DATA.LONG(A:0xa30078) "' name='RPMH_BCM_VOTETABLE_DRV3_ND30'/>"
WRITE #1 "        <register address='0xba3007c' value='0x" DATA.LONG(A:0xa3007c) "' name='RPMH_BCM_VOTETABLE_DRV3_ND31'/>"
WRITE #1 "        <register address='0xba30080' value='0x" DATA.LONG(A:0xa30080) "' name='RPMH_BCM_VOTETABLE_DRV3_ND32'/>"
WRITE #1 "        <register address='0xba30084' value='0x" DATA.LONG(A:0xa30084) "' name='RPMH_BCM_VOTETABLE_DRV3_ND33'/>"
WRITE #1 "        <register address='0xba30088' value='0x" DATA.LONG(A:0xa30088) "' name='RPMH_BCM_VOTETABLE_DRV3_ND34'/>"
WRITE #1 "        <register address='0xba3008c' value='0x" DATA.LONG(A:0xa3008c) "' name='RPMH_BCM_VOTETABLE_DRV3_ND35'/>"
WRITE #1 "        <register address='0xba30090' value='0x" DATA.LONG(A:0xa30090) "' name='RPMH_BCM_VOTETABLE_DRV3_ND36'/>"
WRITE #1 "        <register address='0xba30094' value='0x" DATA.LONG(A:0xa30094) "' name='RPMH_BCM_VOTETABLE_DRV3_ND37'/>"
WRITE #1 "        <register address='0xba30098' value='0x" DATA.LONG(A:0xa30098) "' name='RPMH_BCM_VOTETABLE_DRV3_ND38'/>"
WRITE #1 "        <register address='0xba3009c' value='0x" DATA.LONG(A:0xa3009c) "' name='RPMH_BCM_VOTETABLE_DRV3_ND39'/>"
WRITE #1 "        <register address='0xba300a0' value='0x" DATA.LONG(A:0xa300a0) "' name='RPMH_BCM_VOTETABLE_DRV3_ND40'/>"
WRITE #1 "        <register address='0xba300a4' value='0x" DATA.LONG(A:0xa300a4) "' name='RPMH_BCM_VOTETABLE_DRV3_ND41'/>"
WRITE #1 "        <register address='0xba300a8' value='0x" DATA.LONG(A:0xa300a8) "' name='RPMH_BCM_VOTETABLE_DRV3_ND42'/>"
WRITE #1 "        <register address='0xba300ac' value='0x" DATA.LONG(A:0xa300ac) "' name='RPMH_BCM_VOTETABLE_DRV3_ND43'/>"
WRITE #1 "        <register address='0xba300b4' value='0x" DATA.LONG(A:0xa300b4) "' name='RPMH_BCM_VOTETABLE_DRV3_ND45'/>"
WRITE #1 "        <register address='0xba300bc' value='0x" DATA.LONG(A:0xa300bc) "' name='RPMH_BCM_VOTETABLE_DRV3_ND47'/>"
WRITE #1 "        <register address='0xba40000' value='0x" DATA.LONG(A:0xa40000) "' name='RPMH_BCM_VOTETABLE_DRV4_ND0'/>"
WRITE #1 "        <register address='0xba40004' value='0x" DATA.LONG(A:0xa40004) "' name='RPMH_BCM_VOTETABLE_DRV4_ND1'/>"
WRITE #1 "        <register address='0xba40014' value='0x" DATA.LONG(A:0xa40014) "' name='RPMH_BCM_VOTETABLE_DRV4_ND5'/>"
WRITE #1 "        <register address='0xba4001c' value='0x" DATA.LONG(A:0xa4001c) "' name='RPMH_BCM_VOTETABLE_DRV4_ND7'/>"
WRITE #1 "        <register address='0xba40024' value='0x" DATA.LONG(A:0xa40024) "' name='RPMH_BCM_VOTETABLE_DRV4_ND9'/>"
WRITE #1 "        <register address='0xba40030' value='0x" DATA.LONG(A:0xa40030) "' name='RPMH_BCM_VOTETABLE_DRV4_ND12'/>"
WRITE #1 "        <register address='0xba40048' value='0x" DATA.LONG(A:0xa40048) "' name='RPMH_BCM_VOTETABLE_DRV4_ND18'/>"
WRITE #1 "        <register address='0xba40064' value='0x" DATA.LONG(A:0xa40064) "' name='RPMH_BCM_VOTETABLE_DRV4_ND25'/>"
WRITE #1 "        <register address='0xba4006c' value='0x" DATA.LONG(A:0xa4006c) "' name='RPMH_BCM_VOTETABLE_DRV4_ND27'/>"
WRITE #1 "        <register address='0xba40074' value='0x" DATA.LONG(A:0xa40074) "' name='RPMH_BCM_VOTETABLE_DRV4_ND29'/>"
WRITE #1 "        <register address='0xba40078' value='0x" DATA.LONG(A:0xa40078) "' name='RPMH_BCM_VOTETABLE_DRV4_ND30'/>"
WRITE #1 "        <register address='0xba4007c' value='0x" DATA.LONG(A:0xa4007c) "' name='RPMH_BCM_VOTETABLE_DRV4_ND31'/>"
WRITE #1 "        <register address='0xba40080' value='0x" DATA.LONG(A:0xa40080) "' name='RPMH_BCM_VOTETABLE_DRV4_ND32'/>"
WRITE #1 "        <register address='0xba40084' value='0x" DATA.LONG(A:0xa40084) "' name='RPMH_BCM_VOTETABLE_DRV4_ND33'/>"
WRITE #1 "        <register address='0xba40088' value='0x" DATA.LONG(A:0xa40088) "' name='RPMH_BCM_VOTETABLE_DRV4_ND34'/>"
WRITE #1 "        <register address='0xba4008c' value='0x" DATA.LONG(A:0xa4008c) "' name='RPMH_BCM_VOTETABLE_DRV4_ND35'/>"
WRITE #1 "        <register address='0xba40090' value='0x" DATA.LONG(A:0xa40090) "' name='RPMH_BCM_VOTETABLE_DRV4_ND36'/>"
WRITE #1 "        <register address='0xba40094' value='0x" DATA.LONG(A:0xa40094) "' name='RPMH_BCM_VOTETABLE_DRV4_ND37'/>"
WRITE #1 "        <register address='0xba40098' value='0x" DATA.LONG(A:0xa40098) "' name='RPMH_BCM_VOTETABLE_DRV4_ND38'/>"
WRITE #1 "        <register address='0xba4009c' value='0x" DATA.LONG(A:0xa4009c) "' name='RPMH_BCM_VOTETABLE_DRV4_ND39'/>"
WRITE #1 "        <register address='0xba400a0' value='0x" DATA.LONG(A:0xa400a0) "' name='RPMH_BCM_VOTETABLE_DRV4_ND40'/>"
WRITE #1 "        <register address='0xba400a4' value='0x" DATA.LONG(A:0xa400a4) "' name='RPMH_BCM_VOTETABLE_DRV4_ND41'/>"
WRITE #1 "        <register address='0xba400a8' value='0x" DATA.LONG(A:0xa400a8) "' name='RPMH_BCM_VOTETABLE_DRV4_ND42'/>"
WRITE #1 "        <register address='0xba400ac' value='0x" DATA.LONG(A:0xa400ac) "' name='RPMH_BCM_VOTETABLE_DRV4_ND43'/>"
WRITE #1 "        <register address='0xba50000' value='0x" DATA.LONG(A:0xa50000) "' name='RPMH_BCM_VOTETABLE_DRV5_ND0'/>"
WRITE #1 "        <register address='0xba50004' value='0x" DATA.LONG(A:0xa50004) "' name='RPMH_BCM_VOTETABLE_DRV5_ND1'/>"
WRITE #1 "        <register address='0xba50024' value='0x" DATA.LONG(A:0xa50024) "' name='RPMH_BCM_VOTETABLE_DRV5_ND9'/>"
WRITE #1 "        <register address='0xba50030' value='0x" DATA.LONG(A:0xa50030) "' name='RPMH_BCM_VOTETABLE_DRV5_ND12'/>"
WRITE #1 "        <register address='0xba50064' value='0x" DATA.LONG(A:0xa50064) "' name='RPMH_BCM_VOTETABLE_DRV5_ND25'/>"
WRITE #1 "        <register address='0xba5006c' value='0x" DATA.LONG(A:0xa5006c) "' name='RPMH_BCM_VOTETABLE_DRV5_ND27'/>"
WRITE #1 "        <register address='0xba50070' value='0x" DATA.LONG(A:0xa50070) "' name='RPMH_BCM_VOTETABLE_DRV5_ND28'/>"
WRITE #1 "        <register address='0xba50074' value='0x" DATA.LONG(A:0xa50074) "' name='RPMH_BCM_VOTETABLE_DRV5_ND29'/>"
WRITE #1 "        <register address='0xba50078' value='0x" DATA.LONG(A:0xa50078) "' name='RPMH_BCM_VOTETABLE_DRV5_ND30'/>"
WRITE #1 "        <register address='0xba5007c' value='0x" DATA.LONG(A:0xa5007c) "' name='RPMH_BCM_VOTETABLE_DRV5_ND31'/>"
WRITE #1 "        <register address='0xba50080' value='0x" DATA.LONG(A:0xa50080) "' name='RPMH_BCM_VOTETABLE_DRV5_ND32'/>"
WRITE #1 "        <register address='0xba50084' value='0x" DATA.LONG(A:0xa50084) "' name='RPMH_BCM_VOTETABLE_DRV5_ND33'/>"
WRITE #1 "        <register address='0xba50088' value='0x" DATA.LONG(A:0xa50088) "' name='RPMH_BCM_VOTETABLE_DRV5_ND34'/>"
WRITE #1 "        <register address='0xba5008c' value='0x" DATA.LONG(A:0xa5008c) "' name='RPMH_BCM_VOTETABLE_DRV5_ND35'/>"
WRITE #1 "        <register address='0xba50090' value='0x" DATA.LONG(A:0xa50090) "' name='RPMH_BCM_VOTETABLE_DRV5_ND36'/>"
WRITE #1 "        <register address='0xba50094' value='0x" DATA.LONG(A:0xa50094) "' name='RPMH_BCM_VOTETABLE_DRV5_ND37'/>"
WRITE #1 "        <register address='0xba50098' value='0x" DATA.LONG(A:0xa50098) "' name='RPMH_BCM_VOTETABLE_DRV5_ND38'/>"
WRITE #1 "        <register address='0xba5009c' value='0x" DATA.LONG(A:0xa5009c) "' name='RPMH_BCM_VOTETABLE_DRV5_ND39'/>"
WRITE #1 "        <register address='0xba500a0' value='0x" DATA.LONG(A:0xa500a0) "' name='RPMH_BCM_VOTETABLE_DRV5_ND40'/>"
WRITE #1 "        <register address='0xba500a4' value='0x" DATA.LONG(A:0xa500a4) "' name='RPMH_BCM_VOTETABLE_DRV5_ND41'/>"
WRITE #1 "        <register address='0xba500a8' value='0x" DATA.LONG(A:0xa500a8) "' name='RPMH_BCM_VOTETABLE_DRV5_ND42'/>"
WRITE #1 "        <register address='0xba500ac' value='0x" DATA.LONG(A:0xa500ac) "' name='RPMH_BCM_VOTETABLE_DRV5_ND43'/>"
WRITE #1 "        <register address='0xba60000' value='0x" DATA.LONG(A:0xa60000) "' name='RPMH_BCM_VOTETABLE_DRV6_ND0'/>"
WRITE #1 "        <register address='0xba60004' value='0x" DATA.LONG(A:0xa60004) "' name='RPMH_BCM_VOTETABLE_DRV6_ND1'/>"
WRITE #1 "        <register address='0xba60008' value='0x" DATA.LONG(A:0xa60008) "' name='RPMH_BCM_VOTETABLE_DRV6_ND2'/>"
WRITE #1 "        <register address='0xba60030' value='0x" DATA.LONG(A:0xa60030) "' name='RPMH_BCM_VOTETABLE_DRV6_ND12'/>"
WRITE #1 "        <register address='0xba60058' value='0x" DATA.LONG(A:0xa60058) "' name='RPMH_BCM_VOTETABLE_DRV6_ND22'/>"
WRITE #1 "        <register address='0xba60064' value='0x" DATA.LONG(A:0xa60064) "' name='RPMH_BCM_VOTETABLE_DRV6_ND25'/>"
WRITE #1 "        <register address='0xba6006c' value='0x" DATA.LONG(A:0xa6006c) "' name='RPMH_BCM_VOTETABLE_DRV6_ND27'/>"
WRITE #1 "        <register address='0xba60070' value='0x" DATA.LONG(A:0xa60070) "' name='RPMH_BCM_VOTETABLE_DRV6_ND28'/>"
WRITE #1 "        <register address='0xba60074' value='0x" DATA.LONG(A:0xa60074) "' name='RPMH_BCM_VOTETABLE_DRV6_ND29'/>"
WRITE #1 "        <register address='0xba60078' value='0x" DATA.LONG(A:0xa60078) "' name='RPMH_BCM_VOTETABLE_DRV6_ND30'/>"
WRITE #1 "        <register address='0xba6007c' value='0x" DATA.LONG(A:0xa6007c) "' name='RPMH_BCM_VOTETABLE_DRV6_ND31'/>"
WRITE #1 "        <register address='0xba60080' value='0x" DATA.LONG(A:0xa60080) "' name='RPMH_BCM_VOTETABLE_DRV6_ND32'/>"
WRITE #1 "        <register address='0xba60084' value='0x" DATA.LONG(A:0xa60084) "' name='RPMH_BCM_VOTETABLE_DRV6_ND33'/>"
WRITE #1 "        <register address='0xba60088' value='0x" DATA.LONG(A:0xa60088) "' name='RPMH_BCM_VOTETABLE_DRV6_ND34'/>"
WRITE #1 "        <register address='0xba6008c' value='0x" DATA.LONG(A:0xa6008c) "' name='RPMH_BCM_VOTETABLE_DRV6_ND35'/>"
WRITE #1 "        <register address='0xba60090' value='0x" DATA.LONG(A:0xa60090) "' name='RPMH_BCM_VOTETABLE_DRV6_ND36'/>"
WRITE #1 "        <register address='0xba60094' value='0x" DATA.LONG(A:0xa60094) "' name='RPMH_BCM_VOTETABLE_DRV6_ND37'/>"
WRITE #1 "        <register address='0xba60098' value='0x" DATA.LONG(A:0xa60098) "' name='RPMH_BCM_VOTETABLE_DRV6_ND38'/>"
WRITE #1 "        <register address='0xba6009c' value='0x" DATA.LONG(A:0xa6009c) "' name='RPMH_BCM_VOTETABLE_DRV6_ND39'/>"
WRITE #1 "        <register address='0xba600a0' value='0x" DATA.LONG(A:0xa600a0) "' name='RPMH_BCM_VOTETABLE_DRV6_ND40'/>"
WRITE #1 "        <register address='0xba600a4' value='0x" DATA.LONG(A:0xa600a4) "' name='RPMH_BCM_VOTETABLE_DRV6_ND41'/>"
WRITE #1 "        <register address='0xba600a8' value='0x" DATA.LONG(A:0xa600a8) "' name='RPMH_BCM_VOTETABLE_DRV6_ND42'/>"
WRITE #1 "        <register address='0xba600ac' value='0x" DATA.LONG(A:0xa600ac) "' name='RPMH_BCM_VOTETABLE_DRV6_ND43'/>"
WRITE #1 "        <register address='0xba70000' value='0x" DATA.LONG(A:0xa70000) "' name='RPMH_BCM_VOTETABLE_DRV7_ND0'/>"
WRITE #1 "        <register address='0xba70004' value='0x" DATA.LONG(A:0xa70004) "' name='RPMH_BCM_VOTETABLE_DRV7_ND1'/>"
WRITE #1 "        <register address='0xba70014' value='0x" DATA.LONG(A:0xa70014) "' name='RPMH_BCM_VOTETABLE_DRV7_ND5'/>"
WRITE #1 "        <register address='0xba70018' value='0x" DATA.LONG(A:0xa70018) "' name='RPMH_BCM_VOTETABLE_DRV7_ND6'/>"
WRITE #1 "        <register address='0xba7001c' value='0x" DATA.LONG(A:0xa7001c) "' name='RPMH_BCM_VOTETABLE_DRV7_ND7'/>"
WRITE #1 "        <register address='0xba70020' value='0x" DATA.LONG(A:0xa70020) "' name='RPMH_BCM_VOTETABLE_DRV7_ND8'/>"
WRITE #1 "        <register address='0xba7006c' value='0x" DATA.LONG(A:0xa7006c) "' name='RPMH_BCM_VOTETABLE_DRV7_ND27'/>"
WRITE #1 "        <register address='0xba70070' value='0x" DATA.LONG(A:0xa70070) "' name='RPMH_BCM_VOTETABLE_DRV7_ND28'/>"
WRITE #1 "        <register address='0xba70074' value='0x" DATA.LONG(A:0xa70074) "' name='RPMH_BCM_VOTETABLE_DRV7_ND29'/>"
WRITE #1 "        <register address='0xba70078' value='0x" DATA.LONG(A:0xa70078) "' name='RPMH_BCM_VOTETABLE_DRV7_ND30'/>"
WRITE #1 "        <register address='0xba7007c' value='0x" DATA.LONG(A:0xa7007c) "' name='RPMH_BCM_VOTETABLE_DRV7_ND31'/>"
WRITE #1 "        <register address='0xba70080' value='0x" DATA.LONG(A:0xa70080) "' name='RPMH_BCM_VOTETABLE_DRV7_ND32'/>"
WRITE #1 "        <register address='0xba70084' value='0x" DATA.LONG(A:0xa70084) "' name='RPMH_BCM_VOTETABLE_DRV7_ND33'/>"
WRITE #1 "        <register address='0xba70088' value='0x" DATA.LONG(A:0xa70088) "' name='RPMH_BCM_VOTETABLE_DRV7_ND34'/>"
WRITE #1 "        <register address='0xba7008c' value='0x" DATA.LONG(A:0xa7008c) "' name='RPMH_BCM_VOTETABLE_DRV7_ND35'/>"
WRITE #1 "        <register address='0xba70090' value='0x" DATA.LONG(A:0xa70090) "' name='RPMH_BCM_VOTETABLE_DRV7_ND36'/>"
WRITE #1 "        <register address='0xba70094' value='0x" DATA.LONG(A:0xa70094) "' name='RPMH_BCM_VOTETABLE_DRV7_ND37'/>"
WRITE #1 "        <register address='0xba70098' value='0x" DATA.LONG(A:0xa70098) "' name='RPMH_BCM_VOTETABLE_DRV7_ND38'/>"
WRITE #1 "        <register address='0xba7009c' value='0x" DATA.LONG(A:0xa7009c) "' name='RPMH_BCM_VOTETABLE_DRV7_ND39'/>"
WRITE #1 "        <register address='0xba700a0' value='0x" DATA.LONG(A:0xa700a0) "' name='RPMH_BCM_VOTETABLE_DRV7_ND40'/>"
WRITE #1 "        <register address='0xba700a4' value='0x" DATA.LONG(A:0xa700a4) "' name='RPMH_BCM_VOTETABLE_DRV7_ND41'/>"
WRITE #1 "        <register address='0xba700a8' value='0x" DATA.LONG(A:0xa700a8) "' name='RPMH_BCM_VOTETABLE_DRV7_ND42'/>"
WRITE #1 "        <register address='0xba700ac' value='0x" DATA.LONG(A:0xa700ac) "' name='RPMH_BCM_VOTETABLE_DRV7_ND43'/>"
WRITE #1 "        <register address='0xba80000' value='0x" DATA.LONG(A:0xa80000) "' name='RPMH_BCM_VOTETABLE_DRV8_ND0'/>"
WRITE #1 "        <register address='0xba80004' value='0x" DATA.LONG(A:0xa80004) "' name='RPMH_BCM_VOTETABLE_DRV8_ND1'/>"
WRITE #1 "        <register address='0xba80008' value='0x" DATA.LONG(A:0xa80008) "' name='RPMH_BCM_VOTETABLE_DRV8_ND2'/>"
WRITE #1 "        <register address='0xba80030' value='0x" DATA.LONG(A:0xa80030) "' name='RPMH_BCM_VOTETABLE_DRV8_ND12'/>"
WRITE #1 "        <register address='0xba80058' value='0x" DATA.LONG(A:0xa80058) "' name='RPMH_BCM_VOTETABLE_DRV8_ND22'/>"
WRITE #1 "        <register address='0xba80064' value='0x" DATA.LONG(A:0xa80064) "' name='RPMH_BCM_VOTETABLE_DRV8_ND25'/>"
WRITE #1 "        <register address='0xba8006c' value='0x" DATA.LONG(A:0xa8006c) "' name='RPMH_BCM_VOTETABLE_DRV8_ND27'/>"
WRITE #1 "        <register address='0xba80070' value='0x" DATA.LONG(A:0xa80070) "' name='RPMH_BCM_VOTETABLE_DRV8_ND28'/>"
WRITE #1 "        <register address='0xba80074' value='0x" DATA.LONG(A:0xa80074) "' name='RPMH_BCM_VOTETABLE_DRV8_ND29'/>"
WRITE #1 "        <register address='0xba80078' value='0x" DATA.LONG(A:0xa80078) "' name='RPMH_BCM_VOTETABLE_DRV8_ND30'/>"
WRITE #1 "        <register address='0xba8007c' value='0x" DATA.LONG(A:0xa8007c) "' name='RPMH_BCM_VOTETABLE_DRV8_ND31'/>"
WRITE #1 "        <register address='0xba80080' value='0x" DATA.LONG(A:0xa80080) "' name='RPMH_BCM_VOTETABLE_DRV8_ND32'/>"
WRITE #1 "        <register address='0xba80084' value='0x" DATA.LONG(A:0xa80084) "' name='RPMH_BCM_VOTETABLE_DRV8_ND33'/>"
WRITE #1 "        <register address='0xba80088' value='0x" DATA.LONG(A:0xa80088) "' name='RPMH_BCM_VOTETABLE_DRV8_ND34'/>"
WRITE #1 "        <register address='0xba8008c' value='0x" DATA.LONG(A:0xa8008c) "' name='RPMH_BCM_VOTETABLE_DRV8_ND35'/>"
WRITE #1 "        <register address='0xba80090' value='0x" DATA.LONG(A:0xa80090) "' name='RPMH_BCM_VOTETABLE_DRV8_ND36'/>"
WRITE #1 "        <register address='0xba80094' value='0x" DATA.LONG(A:0xa80094) "' name='RPMH_BCM_VOTETABLE_DRV8_ND37'/>"
WRITE #1 "        <register address='0xba80098' value='0x" DATA.LONG(A:0xa80098) "' name='RPMH_BCM_VOTETABLE_DRV8_ND38'/>"
WRITE #1 "        <register address='0xba8009c' value='0x" DATA.LONG(A:0xa8009c) "' name='RPMH_BCM_VOTETABLE_DRV8_ND39'/>"
WRITE #1 "        <register address='0xba800a0' value='0x" DATA.LONG(A:0xa800a0) "' name='RPMH_BCM_VOTETABLE_DRV8_ND40'/>"
WRITE #1 "        <register address='0xba800a4' value='0x" DATA.LONG(A:0xa800a4) "' name='RPMH_BCM_VOTETABLE_DRV8_ND41'/>"
WRITE #1 "        <register address='0xba800a8' value='0x" DATA.LONG(A:0xa800a8) "' name='RPMH_BCM_VOTETABLE_DRV8_ND42'/>"
WRITE #1 "        <register address='0xba800ac' value='0x" DATA.LONG(A:0xa800ac) "' name='RPMH_BCM_VOTETABLE_DRV8_ND43'/>"
WRITE #1 "        <register address='0xba90000' value='0x" DATA.LONG(A:0xa90000) "' name='RPMH_BCM_VOTETABLE_DRV9_ND0'/>"
WRITE #1 "        <register address='0xba90004' value='0x" DATA.LONG(A:0xa90004) "' name='RPMH_BCM_VOTETABLE_DRV9_ND1'/>"
WRITE #1 "        <register address='0xba90008' value='0x" DATA.LONG(A:0xa90008) "' name='RPMH_BCM_VOTETABLE_DRV9_ND2'/>"
WRITE #1 "        <register address='0xba9000c' value='0x" DATA.LONG(A:0xa9000c) "' name='RPMH_BCM_VOTETABLE_DRV9_ND3'/>"
WRITE #1 "        <register address='0xba90024' value='0x" DATA.LONG(A:0xa90024) "' name='RPMH_BCM_VOTETABLE_DRV9_ND9'/>"
WRITE #1 "        <register address='0xba90028' value='0x" DATA.LONG(A:0xa90028) "' name='RPMH_BCM_VOTETABLE_DRV9_ND10'/>"
WRITE #1 "        <register address='0xba90030' value='0x" DATA.LONG(A:0xa90030) "' name='RPMH_BCM_VOTETABLE_DRV9_ND12'/>"
WRITE #1 "        <register address='0xba90034' value='0x" DATA.LONG(A:0xa90034) "' name='RPMH_BCM_VOTETABLE_DRV9_ND13'/>"
WRITE #1 "        <register address='0xba90038' value='0x" DATA.LONG(A:0xa90038) "' name='RPMH_BCM_VOTETABLE_DRV9_ND14'/>"
WRITE #1 "        <register address='0xba90040' value='0x" DATA.LONG(A:0xa90040) "' name='RPMH_BCM_VOTETABLE_DRV9_ND16'/>"
WRITE #1 "        <register address='0xba90048' value='0x" DATA.LONG(A:0xa90048) "' name='RPMH_BCM_VOTETABLE_DRV9_ND18'/>"
WRITE #1 "        <register address='0xba90058' value='0x" DATA.LONG(A:0xa90058) "' name='RPMH_BCM_VOTETABLE_DRV9_ND22'/>"
WRITE #1 "        <register address='0xba9005c' value='0x" DATA.LONG(A:0xa9005c) "' name='RPMH_BCM_VOTETABLE_DRV9_ND23'/>"
WRITE #1 "        <register address='0xba90060' value='0x" DATA.LONG(A:0xa90060) "' name='RPMH_BCM_VOTETABLE_DRV9_ND24'/>"
WRITE #1 "        <register address='0xba90064' value='0x" DATA.LONG(A:0xa90064) "' name='RPMH_BCM_VOTETABLE_DRV9_ND25'/>"
WRITE #1 "        <register address='0xba90068' value='0x" DATA.LONG(A:0xa90068) "' name='RPMH_BCM_VOTETABLE_DRV9_ND26'/>"
WRITE #1 "        <register address='0xba9006c' value='0x" DATA.LONG(A:0xa9006c) "' name='RPMH_BCM_VOTETABLE_DRV9_ND27'/>"
WRITE #1 "        <register address='0xba90070' value='0x" DATA.LONG(A:0xa90070) "' name='RPMH_BCM_VOTETABLE_DRV9_ND28'/>"
WRITE #1 "        <register address='0xba90074' value='0x" DATA.LONG(A:0xa90074) "' name='RPMH_BCM_VOTETABLE_DRV9_ND29'/>"
WRITE #1 "        <register address='0xba90078' value='0x" DATA.LONG(A:0xa90078) "' name='RPMH_BCM_VOTETABLE_DRV9_ND30'/>"
WRITE #1 "        <register address='0xba9007c' value='0x" DATA.LONG(A:0xa9007c) "' name='RPMH_BCM_VOTETABLE_DRV9_ND31'/>"
WRITE #1 "        <register address='0xba90080' value='0x" DATA.LONG(A:0xa90080) "' name='RPMH_BCM_VOTETABLE_DRV9_ND32'/>"
WRITE #1 "        <register address='0xba90084' value='0x" DATA.LONG(A:0xa90084) "' name='RPMH_BCM_VOTETABLE_DRV9_ND33'/>"
WRITE #1 "        <register address='0xba90088' value='0x" DATA.LONG(A:0xa90088) "' name='RPMH_BCM_VOTETABLE_DRV9_ND34'/>"
WRITE #1 "        <register address='0xba9008c' value='0x" DATA.LONG(A:0xa9008c) "' name='RPMH_BCM_VOTETABLE_DRV9_ND35'/>"
WRITE #1 "        <register address='0xba90090' value='0x" DATA.LONG(A:0xa90090) "' name='RPMH_BCM_VOTETABLE_DRV9_ND36'/>"
WRITE #1 "        <register address='0xba90094' value='0x" DATA.LONG(A:0xa90094) "' name='RPMH_BCM_VOTETABLE_DRV9_ND37'/>"
WRITE #1 "        <register address='0xba90098' value='0x" DATA.LONG(A:0xa90098) "' name='RPMH_BCM_VOTETABLE_DRV9_ND38'/>"
WRITE #1 "        <register address='0xba9009c' value='0x" DATA.LONG(A:0xa9009c) "' name='RPMH_BCM_VOTETABLE_DRV9_ND39'/>"
WRITE #1 "        <register address='0xba900a0' value='0x" DATA.LONG(A:0xa900a0) "' name='RPMH_BCM_VOTETABLE_DRV9_ND40'/>"
WRITE #1 "        <register address='0xba900a4' value='0x" DATA.LONG(A:0xa900a4) "' name='RPMH_BCM_VOTETABLE_DRV9_ND41'/>"
WRITE #1 "        <register address='0xba900a8' value='0x" DATA.LONG(A:0xa900a8) "' name='RPMH_BCM_VOTETABLE_DRV9_ND42'/>"
WRITE #1 "        <register address='0xba900ac' value='0x" DATA.LONG(A:0xa900ac) "' name='RPMH_BCM_VOTETABLE_DRV9_ND43'/>"
WRITE #1 "        <register address='0xba900b0' value='0x" DATA.LONG(A:0xa900b0) "' name='RPMH_BCM_VOTETABLE_DRV9_ND44'/>"
WRITE #1 "        <register address='0xba900b8' value='0x" DATA.LONG(A:0xa900b8) "' name='RPMH_BCM_VOTETABLE_DRV9_ND46'/>"
WRITE #1 "        <register address='0xba00200' value='0x" DATA.LONG(A:0xa00200) "' name='RPMH_BCM_SHADOW_STATUS_DRV0_FE_AGG_FSM'/>"
WRITE #1 "        <register address='0xba10200' value='0x" DATA.LONG(A:0xa10200) "' name='RPMH_BCM_SHADOW_STATUS_DRV1_FE_AGG_FSM'/>"
WRITE #1 "        <register address='0xba20200' value='0x" DATA.LONG(A:0xa20200) "' name='RPMH_BCM_SHADOW_STATUS_DRV2_FE_AGG_FSM'/>"
WRITE #1 "        <register address='0xba30200' value='0x" DATA.LONG(A:0xa30200) "' name='RPMH_BCM_SHADOW_STATUS_DRV3_FE_AGG_FSM'/>"
WRITE #1 "        <register address='0xba40200' value='0x" DATA.LONG(A:0xa40200) "' name='RPMH_BCM_SHADOW_STATUS_DRV4_FE_AGG_FSM'/>"
WRITE #1 "        <register address='0xba50200' value='0x" DATA.LONG(A:0xa50200) "' name='RPMH_BCM_SHADOW_STATUS_DRV5_FE_AGG_FSM'/>"
WRITE #1 "        <register address='0xba60200' value='0x" DATA.LONG(A:0xa60200) "' name='RPMH_BCM_SHADOW_STATUS_DRV6_FE_AGG_FSM'/>"
WRITE #1 "        <register address='0xba70200' value='0x" DATA.LONG(A:0xa70200) "' name='RPMH_BCM_SHADOW_STATUS_DRV7_FE_AGG_FSM'/>"
WRITE #1 "        <register address='0xba80200' value='0x" DATA.LONG(A:0xa80200) "' name='RPMH_BCM_SHADOW_STATUS_DRV8_FE_AGG_FSM'/>"
WRITE #1 "        <register address='0xba90200' value='0x" DATA.LONG(A:0xa90200) "' name='RPMH_BCM_SHADOW_STATUS_DRV9_FE_AGG_FSM'/>"
WRITE #1 "        <register address='0xba00204' value='0x" DATA.LONG(A:0xa00204) "' name='RPMH_BCM_SHADOW_STATUS_DRV0_FE_CD0'/>"
WRITE #1 "        <register address='0xba00208' value='0x" DATA.LONG(A:0xa00208) "' name='RPMH_BCM_SHADOW_STATUS_DRV0_FE_CD1'/>"
WRITE #1 "        <register address='0xba0020c' value='0x" DATA.LONG(A:0xa0020c) "' name='RPMH_BCM_SHADOW_STATUS_DRV0_FE_CD2'/>"
WRITE #1 "        <register address='0xba00210' value='0x" DATA.LONG(A:0xa00210) "' name='RPMH_BCM_SHADOW_STATUS_DRV0_FE_CD3'/>"
WRITE #1 "        <register address='0xba00214' value='0x" DATA.LONG(A:0xa00214) "' name='RPMH_BCM_SHADOW_STATUS_DRV0_FE_CD4'/>"
WRITE #1 "        <register address='0xba00218' value='0x" DATA.LONG(A:0xa00218) "' name='RPMH_BCM_SHADOW_STATUS_DRV0_FE_CD5'/>"
WRITE #1 "        <register address='0xba0021c' value='0x" DATA.LONG(A:0xa0021c) "' name='RPMH_BCM_SHADOW_STATUS_DRV0_FE_CD6'/>"
WRITE #1 "        <register address='0xba00220' value='0x" DATA.LONG(A:0xa00220) "' name='RPMH_BCM_SHADOW_STATUS_DRV0_FE_CD7'/>"
WRITE #1 "        <register address='0xba00224' value='0x" DATA.LONG(A:0xa00224) "' name='RPMH_BCM_SHADOW_STATUS_DRV0_FE_CD8'/>"
WRITE #1 "        <register address='0xba00228' value='0x" DATA.LONG(A:0xa00228) "' name='RPMH_BCM_SHADOW_STATUS_DRV0_FE_CD9'/>"
WRITE #1 "        <register address='0xba0022c' value='0x" DATA.LONG(A:0xa0022c) "' name='RPMH_BCM_SHADOW_STATUS_DRV0_FE_CD10'/>"
WRITE #1 "        <register address='0xba00230' value='0x" DATA.LONG(A:0xa00230) "' name='RPMH_BCM_SHADOW_STATUS_DRV0_FE_CD11'/>"
WRITE #1 "        <register address='0xba10204' value='0x" DATA.LONG(A:0xa10204) "' name='RPMH_BCM_SHADOW_STATUS_DRV1_FE_CD0'/>"
WRITE #1 "        <register address='0xba10208' value='0x" DATA.LONG(A:0xa10208) "' name='RPMH_BCM_SHADOW_STATUS_DRV1_FE_CD1'/>"
WRITE #1 "        <register address='0xba1020c' value='0x" DATA.LONG(A:0xa1020c) "' name='RPMH_BCM_SHADOW_STATUS_DRV1_FE_CD2'/>"
WRITE #1 "        <register address='0xba10210' value='0x" DATA.LONG(A:0xa10210) "' name='RPMH_BCM_SHADOW_STATUS_DRV1_FE_CD3'/>"
WRITE #1 "        <register address='0xba10214' value='0x" DATA.LONG(A:0xa10214) "' name='RPMH_BCM_SHADOW_STATUS_DRV1_FE_CD4'/>"
WRITE #1 "        <register address='0xba10218' value='0x" DATA.LONG(A:0xa10218) "' name='RPMH_BCM_SHADOW_STATUS_DRV1_FE_CD5'/>"
WRITE #1 "        <register address='0xba1021c' value='0x" DATA.LONG(A:0xa1021c) "' name='RPMH_BCM_SHADOW_STATUS_DRV1_FE_CD6'/>"
WRITE #1 "        <register address='0xba10220' value='0x" DATA.LONG(A:0xa10220) "' name='RPMH_BCM_SHADOW_STATUS_DRV1_FE_CD7'/>"
WRITE #1 "        <register address='0xba10224' value='0x" DATA.LONG(A:0xa10224) "' name='RPMH_BCM_SHADOW_STATUS_DRV1_FE_CD8'/>"
WRITE #1 "        <register address='0xba10228' value='0x" DATA.LONG(A:0xa10228) "' name='RPMH_BCM_SHADOW_STATUS_DRV1_FE_CD9'/>"
WRITE #1 "        <register address='0xba1022c' value='0x" DATA.LONG(A:0xa1022c) "' name='RPMH_BCM_SHADOW_STATUS_DRV1_FE_CD10'/>"
WRITE #1 "        <register address='0xba10230' value='0x" DATA.LONG(A:0xa10230) "' name='RPMH_BCM_SHADOW_STATUS_DRV1_FE_CD11'/>"
WRITE #1 "        <register address='0xba20204' value='0x" DATA.LONG(A:0xa20204) "' name='RPMH_BCM_SHADOW_STATUS_DRV2_FE_CD0'/>"
WRITE #1 "        <register address='0xba20208' value='0x" DATA.LONG(A:0xa20208) "' name='RPMH_BCM_SHADOW_STATUS_DRV2_FE_CD1'/>"
WRITE #1 "        <register address='0xba2020c' value='0x" DATA.LONG(A:0xa2020c) "' name='RPMH_BCM_SHADOW_STATUS_DRV2_FE_CD2'/>"
WRITE #1 "        <register address='0xba20210' value='0x" DATA.LONG(A:0xa20210) "' name='RPMH_BCM_SHADOW_STATUS_DRV2_FE_CD3'/>"
WRITE #1 "        <register address='0xba20214' value='0x" DATA.LONG(A:0xa20214) "' name='RPMH_BCM_SHADOW_STATUS_DRV2_FE_CD4'/>"
WRITE #1 "        <register address='0xba20218' value='0x" DATA.LONG(A:0xa20218) "' name='RPMH_BCM_SHADOW_STATUS_DRV2_FE_CD5'/>"
WRITE #1 "        <register address='0xba2021c' value='0x" DATA.LONG(A:0xa2021c) "' name='RPMH_BCM_SHADOW_STATUS_DRV2_FE_CD6'/>"
WRITE #1 "        <register address='0xba20220' value='0x" DATA.LONG(A:0xa20220) "' name='RPMH_BCM_SHADOW_STATUS_DRV2_FE_CD7'/>"
WRITE #1 "        <register address='0xba20224' value='0x" DATA.LONG(A:0xa20224) "' name='RPMH_BCM_SHADOW_STATUS_DRV2_FE_CD8'/>"
WRITE #1 "        <register address='0xba20228' value='0x" DATA.LONG(A:0xa20228) "' name='RPMH_BCM_SHADOW_STATUS_DRV2_FE_CD9'/>"
WRITE #1 "        <register address='0xba2022c' value='0x" DATA.LONG(A:0xa2022c) "' name='RPMH_BCM_SHADOW_STATUS_DRV2_FE_CD10'/>"
WRITE #1 "        <register address='0xba20230' value='0x" DATA.LONG(A:0xa20230) "' name='RPMH_BCM_SHADOW_STATUS_DRV2_FE_CD11'/>"
WRITE #1 "        <register address='0xba30204' value='0x" DATA.LONG(A:0xa30204) "' name='RPMH_BCM_SHADOW_STATUS_DRV3_FE_CD0'/>"
WRITE #1 "        <register address='0xba30208' value='0x" DATA.LONG(A:0xa30208) "' name='RPMH_BCM_SHADOW_STATUS_DRV3_FE_CD1'/>"
WRITE #1 "        <register address='0xba3020c' value='0x" DATA.LONG(A:0xa3020c) "' name='RPMH_BCM_SHADOW_STATUS_DRV3_FE_CD2'/>"
WRITE #1 "        <register address='0xba30210' value='0x" DATA.LONG(A:0xa30210) "' name='RPMH_BCM_SHADOW_STATUS_DRV3_FE_CD3'/>"
WRITE #1 "        <register address='0xba30214' value='0x" DATA.LONG(A:0xa30214) "' name='RPMH_BCM_SHADOW_STATUS_DRV3_FE_CD4'/>"
WRITE #1 "        <register address='0xba30218' value='0x" DATA.LONG(A:0xa30218) "' name='RPMH_BCM_SHADOW_STATUS_DRV3_FE_CD5'/>"
WRITE #1 "        <register address='0xba3021c' value='0x" DATA.LONG(A:0xa3021c) "' name='RPMH_BCM_SHADOW_STATUS_DRV3_FE_CD6'/>"
WRITE #1 "        <register address='0xba30220' value='0x" DATA.LONG(A:0xa30220) "' name='RPMH_BCM_SHADOW_STATUS_DRV3_FE_CD7'/>"
WRITE #1 "        <register address='0xba30224' value='0x" DATA.LONG(A:0xa30224) "' name='RPMH_BCM_SHADOW_STATUS_DRV3_FE_CD8'/>"
WRITE #1 "        <register address='0xba30228' value='0x" DATA.LONG(A:0xa30228) "' name='RPMH_BCM_SHADOW_STATUS_DRV3_FE_CD9'/>"
WRITE #1 "        <register address='0xba3022c' value='0x" DATA.LONG(A:0xa3022c) "' name='RPMH_BCM_SHADOW_STATUS_DRV3_FE_CD10'/>"
WRITE #1 "        <register address='0xba30230' value='0x" DATA.LONG(A:0xa30230) "' name='RPMH_BCM_SHADOW_STATUS_DRV3_FE_CD11'/>"
WRITE #1 "        <register address='0xba40204' value='0x" DATA.LONG(A:0xa40204) "' name='RPMH_BCM_SHADOW_STATUS_DRV4_FE_CD0'/>"
WRITE #1 "        <register address='0xba40208' value='0x" DATA.LONG(A:0xa40208) "' name='RPMH_BCM_SHADOW_STATUS_DRV4_FE_CD1'/>"
WRITE #1 "        <register address='0xba4020c' value='0x" DATA.LONG(A:0xa4020c) "' name='RPMH_BCM_SHADOW_STATUS_DRV4_FE_CD2'/>"
WRITE #1 "        <register address='0xba40210' value='0x" DATA.LONG(A:0xa40210) "' name='RPMH_BCM_SHADOW_STATUS_DRV4_FE_CD3'/>"
WRITE #1 "        <register address='0xba40214' value='0x" DATA.LONG(A:0xa40214) "' name='RPMH_BCM_SHADOW_STATUS_DRV4_FE_CD4'/>"
WRITE #1 "        <register address='0xba40218' value='0x" DATA.LONG(A:0xa40218) "' name='RPMH_BCM_SHADOW_STATUS_DRV4_FE_CD5'/>"
WRITE #1 "        <register address='0xba4021c' value='0x" DATA.LONG(A:0xa4021c) "' name='RPMH_BCM_SHADOW_STATUS_DRV4_FE_CD6'/>"
WRITE #1 "        <register address='0xba40220' value='0x" DATA.LONG(A:0xa40220) "' name='RPMH_BCM_SHADOW_STATUS_DRV4_FE_CD7'/>"
WRITE #1 "        <register address='0xba40224' value='0x" DATA.LONG(A:0xa40224) "' name='RPMH_BCM_SHADOW_STATUS_DRV4_FE_CD8'/>"
WRITE #1 "        <register address='0xba40228' value='0x" DATA.LONG(A:0xa40228) "' name='RPMH_BCM_SHADOW_STATUS_DRV4_FE_CD9'/>"
WRITE #1 "        <register address='0xba4022c' value='0x" DATA.LONG(A:0xa4022c) "' name='RPMH_BCM_SHADOW_STATUS_DRV4_FE_CD10'/>"
WRITE #1 "        <register address='0xba40230' value='0x" DATA.LONG(A:0xa40230) "' name='RPMH_BCM_SHADOW_STATUS_DRV4_FE_CD11'/>"
WRITE #1 "        <register address='0xba50204' value='0x" DATA.LONG(A:0xa50204) "' name='RPMH_BCM_SHADOW_STATUS_DRV5_FE_CD0'/>"
WRITE #1 "        <register address='0xba50208' value='0x" DATA.LONG(A:0xa50208) "' name='RPMH_BCM_SHADOW_STATUS_DRV5_FE_CD1'/>"
WRITE #1 "        <register address='0xba5020c' value='0x" DATA.LONG(A:0xa5020c) "' name='RPMH_BCM_SHADOW_STATUS_DRV5_FE_CD2'/>"
WRITE #1 "        <register address='0xba50210' value='0x" DATA.LONG(A:0xa50210) "' name='RPMH_BCM_SHADOW_STATUS_DRV5_FE_CD3'/>"
WRITE #1 "        <register address='0xba50214' value='0x" DATA.LONG(A:0xa50214) "' name='RPMH_BCM_SHADOW_STATUS_DRV5_FE_CD4'/>"
WRITE #1 "        <register address='0xba50218' value='0x" DATA.LONG(A:0xa50218) "' name='RPMH_BCM_SHADOW_STATUS_DRV5_FE_CD5'/>"
WRITE #1 "        <register address='0xba5021c' value='0x" DATA.LONG(A:0xa5021c) "' name='RPMH_BCM_SHADOW_STATUS_DRV5_FE_CD6'/>"
WRITE #1 "        <register address='0xba50220' value='0x" DATA.LONG(A:0xa50220) "' name='RPMH_BCM_SHADOW_STATUS_DRV5_FE_CD7'/>"
WRITE #1 "        <register address='0xba50224' value='0x" DATA.LONG(A:0xa50224) "' name='RPMH_BCM_SHADOW_STATUS_DRV5_FE_CD8'/>"
WRITE #1 "        <register address='0xba50228' value='0x" DATA.LONG(A:0xa50228) "' name='RPMH_BCM_SHADOW_STATUS_DRV5_FE_CD9'/>"
WRITE #1 "        <register address='0xba5022c' value='0x" DATA.LONG(A:0xa5022c) "' name='RPMH_BCM_SHADOW_STATUS_DRV5_FE_CD10'/>"
WRITE #1 "        <register address='0xba50230' value='0x" DATA.LONG(A:0xa50230) "' name='RPMH_BCM_SHADOW_STATUS_DRV5_FE_CD11'/>"
WRITE #1 "        <register address='0xba60204' value='0x" DATA.LONG(A:0xa60204) "' name='RPMH_BCM_SHADOW_STATUS_DRV6_FE_CD0'/>"
WRITE #1 "        <register address='0xba60208' value='0x" DATA.LONG(A:0xa60208) "' name='RPMH_BCM_SHADOW_STATUS_DRV6_FE_CD1'/>"
WRITE #1 "        <register address='0xba6020c' value='0x" DATA.LONG(A:0xa6020c) "' name='RPMH_BCM_SHADOW_STATUS_DRV6_FE_CD2'/>"
WRITE #1 "        <register address='0xba60210' value='0x" DATA.LONG(A:0xa60210) "' name='RPMH_BCM_SHADOW_STATUS_DRV6_FE_CD3'/>"
WRITE #1 "        <register address='0xba60214' value='0x" DATA.LONG(A:0xa60214) "' name='RPMH_BCM_SHADOW_STATUS_DRV6_FE_CD4'/>"
WRITE #1 "        <register address='0xba60218' value='0x" DATA.LONG(A:0xa60218) "' name='RPMH_BCM_SHADOW_STATUS_DRV6_FE_CD5'/>"
WRITE #1 "        <register address='0xba6021c' value='0x" DATA.LONG(A:0xa6021c) "' name='RPMH_BCM_SHADOW_STATUS_DRV6_FE_CD6'/>"
WRITE #1 "        <register address='0xba60220' value='0x" DATA.LONG(A:0xa60220) "' name='RPMH_BCM_SHADOW_STATUS_DRV6_FE_CD7'/>"
WRITE #1 "        <register address='0xba60224' value='0x" DATA.LONG(A:0xa60224) "' name='RPMH_BCM_SHADOW_STATUS_DRV6_FE_CD8'/>"
WRITE #1 "        <register address='0xba60228' value='0x" DATA.LONG(A:0xa60228) "' name='RPMH_BCM_SHADOW_STATUS_DRV6_FE_CD9'/>"
WRITE #1 "        <register address='0xba6022c' value='0x" DATA.LONG(A:0xa6022c) "' name='RPMH_BCM_SHADOW_STATUS_DRV6_FE_CD10'/>"
WRITE #1 "        <register address='0xba60230' value='0x" DATA.LONG(A:0xa60230) "' name='RPMH_BCM_SHADOW_STATUS_DRV6_FE_CD11'/>"
WRITE #1 "        <register address='0xba70204' value='0x" DATA.LONG(A:0xa70204) "' name='RPMH_BCM_SHADOW_STATUS_DRV7_FE_CD0'/>"
WRITE #1 "        <register address='0xba70208' value='0x" DATA.LONG(A:0xa70208) "' name='RPMH_BCM_SHADOW_STATUS_DRV7_FE_CD1'/>"
WRITE #1 "        <register address='0xba7020c' value='0x" DATA.LONG(A:0xa7020c) "' name='RPMH_BCM_SHADOW_STATUS_DRV7_FE_CD2'/>"
WRITE #1 "        <register address='0xba70210' value='0x" DATA.LONG(A:0xa70210) "' name='RPMH_BCM_SHADOW_STATUS_DRV7_FE_CD3'/>"
WRITE #1 "        <register address='0xba70214' value='0x" DATA.LONG(A:0xa70214) "' name='RPMH_BCM_SHADOW_STATUS_DRV7_FE_CD4'/>"
WRITE #1 "        <register address='0xba70218' value='0x" DATA.LONG(A:0xa70218) "' name='RPMH_BCM_SHADOW_STATUS_DRV7_FE_CD5'/>"
WRITE #1 "        <register address='0xba7021c' value='0x" DATA.LONG(A:0xa7021c) "' name='RPMH_BCM_SHADOW_STATUS_DRV7_FE_CD6'/>"
WRITE #1 "        <register address='0xba70220' value='0x" DATA.LONG(A:0xa70220) "' name='RPMH_BCM_SHADOW_STATUS_DRV7_FE_CD7'/>"
WRITE #1 "        <register address='0xba70224' value='0x" DATA.LONG(A:0xa70224) "' name='RPMH_BCM_SHADOW_STATUS_DRV7_FE_CD8'/>"
WRITE #1 "        <register address='0xba70228' value='0x" DATA.LONG(A:0xa70228) "' name='RPMH_BCM_SHADOW_STATUS_DRV7_FE_CD9'/>"
WRITE #1 "        <register address='0xba7022c' value='0x" DATA.LONG(A:0xa7022c) "' name='RPMH_BCM_SHADOW_STATUS_DRV7_FE_CD10'/>"
WRITE #1 "        <register address='0xba70230' value='0x" DATA.LONG(A:0xa70230) "' name='RPMH_BCM_SHADOW_STATUS_DRV7_FE_CD11'/>"
WRITE #1 "        <register address='0xba80204' value='0x" DATA.LONG(A:0xa80204) "' name='RPMH_BCM_SHADOW_STATUS_DRV8_FE_CD0'/>"
WRITE #1 "        <register address='0xba80208' value='0x" DATA.LONG(A:0xa80208) "' name='RPMH_BCM_SHADOW_STATUS_DRV8_FE_CD1'/>"
WRITE #1 "        <register address='0xba8020c' value='0x" DATA.LONG(A:0xa8020c) "' name='RPMH_BCM_SHADOW_STATUS_DRV8_FE_CD2'/>"
WRITE #1 "        <register address='0xba80210' value='0x" DATA.LONG(A:0xa80210) "' name='RPMH_BCM_SHADOW_STATUS_DRV8_FE_CD3'/>"
WRITE #1 "        <register address='0xba80214' value='0x" DATA.LONG(A:0xa80214) "' name='RPMH_BCM_SHADOW_STATUS_DRV8_FE_CD4'/>"
WRITE #1 "        <register address='0xba80218' value='0x" DATA.LONG(A:0xa80218) "' name='RPMH_BCM_SHADOW_STATUS_DRV8_FE_CD5'/>"
WRITE #1 "        <register address='0xba8021c' value='0x" DATA.LONG(A:0xa8021c) "' name='RPMH_BCM_SHADOW_STATUS_DRV8_FE_CD6'/>"
WRITE #1 "        <register address='0xba80220' value='0x" DATA.LONG(A:0xa80220) "' name='RPMH_BCM_SHADOW_STATUS_DRV8_FE_CD7'/>"
WRITE #1 "        <register address='0xba80224' value='0x" DATA.LONG(A:0xa80224) "' name='RPMH_BCM_SHADOW_STATUS_DRV8_FE_CD8'/>"
WRITE #1 "        <register address='0xba80228' value='0x" DATA.LONG(A:0xa80228) "' name='RPMH_BCM_SHADOW_STATUS_DRV8_FE_CD9'/>"
WRITE #1 "        <register address='0xba8022c' value='0x" DATA.LONG(A:0xa8022c) "' name='RPMH_BCM_SHADOW_STATUS_DRV8_FE_CD10'/>"
WRITE #1 "        <register address='0xba80230' value='0x" DATA.LONG(A:0xa80230) "' name='RPMH_BCM_SHADOW_STATUS_DRV8_FE_CD11'/>"
WRITE #1 "        <register address='0xba90204' value='0x" DATA.LONG(A:0xa90204) "' name='RPMH_BCM_SHADOW_STATUS_DRV9_FE_CD0'/>"
WRITE #1 "        <register address='0xba90208' value='0x" DATA.LONG(A:0xa90208) "' name='RPMH_BCM_SHADOW_STATUS_DRV9_FE_CD1'/>"
WRITE #1 "        <register address='0xba9020c' value='0x" DATA.LONG(A:0xa9020c) "' name='RPMH_BCM_SHADOW_STATUS_DRV9_FE_CD2'/>"
WRITE #1 "        <register address='0xba90210' value='0x" DATA.LONG(A:0xa90210) "' name='RPMH_BCM_SHADOW_STATUS_DRV9_FE_CD3'/>"
WRITE #1 "        <register address='0xba90214' value='0x" DATA.LONG(A:0xa90214) "' name='RPMH_BCM_SHADOW_STATUS_DRV9_FE_CD4'/>"
WRITE #1 "        <register address='0xba90218' value='0x" DATA.LONG(A:0xa90218) "' name='RPMH_BCM_SHADOW_STATUS_DRV9_FE_CD5'/>"
WRITE #1 "        <register address='0xba9021c' value='0x" DATA.LONG(A:0xa9021c) "' name='RPMH_BCM_SHADOW_STATUS_DRV9_FE_CD6'/>"
WRITE #1 "        <register address='0xba90220' value='0x" DATA.LONG(A:0xa90220) "' name='RPMH_BCM_SHADOW_STATUS_DRV9_FE_CD7'/>"
WRITE #1 "        <register address='0xba90224' value='0x" DATA.LONG(A:0xa90224) "' name='RPMH_BCM_SHADOW_STATUS_DRV9_FE_CD8'/>"
WRITE #1 "        <register address='0xba90228' value='0x" DATA.LONG(A:0xa90228) "' name='RPMH_BCM_SHADOW_STATUS_DRV9_FE_CD9'/>"
WRITE #1 "        <register address='0xba9022c' value='0x" DATA.LONG(A:0xa9022c) "' name='RPMH_BCM_SHADOW_STATUS_DRV9_FE_CD10'/>"
WRITE #1 "        <register address='0xba90230' value='0x" DATA.LONG(A:0xa90230) "' name='RPMH_BCM_SHADOW_STATUS_DRV9_FE_CD11'/>"
WRITE #1 "        <register address='0xba00284' value='0x" DATA.LONG(A:0xa00284) "' name='RPMH_BCM_SHADOW_STATUS_DRV0_DIRTY_ND_0'/>"
WRITE #1 "        <register address='0xba10284' value='0x" DATA.LONG(A:0xa10284) "' name='RPMH_BCM_SHADOW_STATUS_DRV1_DIRTY_ND_0'/>"
WRITE #1 "        <register address='0xba20284' value='0x" DATA.LONG(A:0xa20284) "' name='RPMH_BCM_SHADOW_STATUS_DRV2_DIRTY_ND_0'/>"
WRITE #1 "        <register address='0xba30284' value='0x" DATA.LONG(A:0xa30284) "' name='RPMH_BCM_SHADOW_STATUS_DRV3_DIRTY_ND_0'/>"
WRITE #1 "        <register address='0xba40284' value='0x" DATA.LONG(A:0xa40284) "' name='RPMH_BCM_SHADOW_STATUS_DRV4_DIRTY_ND_0'/>"
WRITE #1 "        <register address='0xba50284' value='0x" DATA.LONG(A:0xa50284) "' name='RPMH_BCM_SHADOW_STATUS_DRV5_DIRTY_ND_0'/>"
WRITE #1 "        <register address='0xba60284' value='0x" DATA.LONG(A:0xa60284) "' name='RPMH_BCM_SHADOW_STATUS_DRV6_DIRTY_ND_0'/>"
WRITE #1 "        <register address='0xba70284' value='0x" DATA.LONG(A:0xa70284) "' name='RPMH_BCM_SHADOW_STATUS_DRV7_DIRTY_ND_0'/>"
WRITE #1 "        <register address='0xba80284' value='0x" DATA.LONG(A:0xa80284) "' name='RPMH_BCM_SHADOW_STATUS_DRV8_DIRTY_ND_0'/>"
WRITE #1 "        <register address='0xba90284' value='0x" DATA.LONG(A:0xa90284) "' name='RPMH_BCM_SHADOW_STATUS_DRV9_DIRTY_ND_0'/>"
WRITE #1 "        <register address='0xba00288' value='0x" DATA.LONG(A:0xa00288) "' name='RPMH_BCM_SHADOW_STATUS_DRV0_DIRTY_ND_1'/>"
WRITE #1 "        <register address='0xba10288' value='0x" DATA.LONG(A:0xa10288) "' name='RPMH_BCM_SHADOW_STATUS_DRV1_DIRTY_ND_1'/>"
WRITE #1 "        <register address='0xba20288' value='0x" DATA.LONG(A:0xa20288) "' name='RPMH_BCM_SHADOW_STATUS_DRV2_DIRTY_ND_1'/>"
WRITE #1 "        <register address='0xba30288' value='0x" DATA.LONG(A:0xa30288) "' name='RPMH_BCM_SHADOW_STATUS_DRV3_DIRTY_ND_1'/>"
WRITE #1 "        <register address='0xba40288' value='0x" DATA.LONG(A:0xa40288) "' name='RPMH_BCM_SHADOW_STATUS_DRV4_DIRTY_ND_1'/>"
WRITE #1 "        <register address='0xba50288' value='0x" DATA.LONG(A:0xa50288) "' name='RPMH_BCM_SHADOW_STATUS_DRV5_DIRTY_ND_1'/>"
WRITE #1 "        <register address='0xba60288' value='0x" DATA.LONG(A:0xa60288) "' name='RPMH_BCM_SHADOW_STATUS_DRV6_DIRTY_ND_1'/>"
WRITE #1 "        <register address='0xba70288' value='0x" DATA.LONG(A:0xa70288) "' name='RPMH_BCM_SHADOW_STATUS_DRV7_DIRTY_ND_1'/>"
WRITE #1 "        <register address='0xba80288' value='0x" DATA.LONG(A:0xa80288) "' name='RPMH_BCM_SHADOW_STATUS_DRV8_DIRTY_ND_1'/>"
WRITE #1 "        <register address='0xba90288' value='0x" DATA.LONG(A:0xa90288) "' name='RPMH_BCM_SHADOW_STATUS_DRV9_DIRTY_ND_1'/>"
WRITE #1 "        <register address='0xba0028c' value='0x" DATA.LONG(A:0xa0028c) "' name='RPMH_BCM_SHADOW_STATUS_DRV0_SND0'/>"
WRITE #1 "        <register address='0xba00290' value='0x" DATA.LONG(A:0xa00290) "' name='RPMH_BCM_SHADOW_STATUS_DRV0_SND1'/>"
WRITE #1 "        <register address='0xba00294' value='0x" DATA.LONG(A:0xa00294) "' name='RPMH_BCM_SHADOW_STATUS_DRV0_SND2'/>"
WRITE #1 "        <register address='0xba00298' value='0x" DATA.LONG(A:0xa00298) "' name='RPMH_BCM_SHADOW_STATUS_DRV0_SND3'/>"
WRITE #1 "        <register address='0xba1028c' value='0x" DATA.LONG(A:0xa1028c) "' name='RPMH_BCM_SHADOW_STATUS_DRV1_SND0'/>"
WRITE #1 "        <register address='0xba10290' value='0x" DATA.LONG(A:0xa10290) "' name='RPMH_BCM_SHADOW_STATUS_DRV1_SND1'/>"
WRITE #1 "        <register address='0xba10294' value='0x" DATA.LONG(A:0xa10294) "' name='RPMH_BCM_SHADOW_STATUS_DRV1_SND2'/>"
WRITE #1 "        <register address='0xba10298' value='0x" DATA.LONG(A:0xa10298) "' name='RPMH_BCM_SHADOW_STATUS_DRV1_SND3'/>"
WRITE #1 "        <register address='0xba2028c' value='0x" DATA.LONG(A:0xa2028c) "' name='RPMH_BCM_SHADOW_STATUS_DRV2_SND0'/>"
WRITE #1 "        <register address='0xba20290' value='0x" DATA.LONG(A:0xa20290) "' name='RPMH_BCM_SHADOW_STATUS_DRV2_SND1'/>"
WRITE #1 "        <register address='0xba20294' value='0x" DATA.LONG(A:0xa20294) "' name='RPMH_BCM_SHADOW_STATUS_DRV2_SND2'/>"
WRITE #1 "        <register address='0xba20298' value='0x" DATA.LONG(A:0xa20298) "' name='RPMH_BCM_SHADOW_STATUS_DRV2_SND3'/>"
WRITE #1 "        <register address='0xba3028c' value='0x" DATA.LONG(A:0xa3028c) "' name='RPMH_BCM_SHADOW_STATUS_DRV3_SND0'/>"
WRITE #1 "        <register address='0xba30290' value='0x" DATA.LONG(A:0xa30290) "' name='RPMH_BCM_SHADOW_STATUS_DRV3_SND1'/>"
WRITE #1 "        <register address='0xba30294' value='0x" DATA.LONG(A:0xa30294) "' name='RPMH_BCM_SHADOW_STATUS_DRV3_SND2'/>"
WRITE #1 "        <register address='0xba30298' value='0x" DATA.LONG(A:0xa30298) "' name='RPMH_BCM_SHADOW_STATUS_DRV3_SND3'/>"
WRITE #1 "        <register address='0xba4028c' value='0x" DATA.LONG(A:0xa4028c) "' name='RPMH_BCM_SHADOW_STATUS_DRV4_SND0'/>"
WRITE #1 "        <register address='0xba40290' value='0x" DATA.LONG(A:0xa40290) "' name='RPMH_BCM_SHADOW_STATUS_DRV4_SND1'/>"
WRITE #1 "        <register address='0xba40294' value='0x" DATA.LONG(A:0xa40294) "' name='RPMH_BCM_SHADOW_STATUS_DRV4_SND2'/>"
WRITE #1 "        <register address='0xba40298' value='0x" DATA.LONG(A:0xa40298) "' name='RPMH_BCM_SHADOW_STATUS_DRV4_SND3'/>"
WRITE #1 "        <register address='0xba5028c' value='0x" DATA.LONG(A:0xa5028c) "' name='RPMH_BCM_SHADOW_STATUS_DRV5_SND0'/>"
WRITE #1 "        <register address='0xba50290' value='0x" DATA.LONG(A:0xa50290) "' name='RPMH_BCM_SHADOW_STATUS_DRV5_SND1'/>"
WRITE #1 "        <register address='0xba50294' value='0x" DATA.LONG(A:0xa50294) "' name='RPMH_BCM_SHADOW_STATUS_DRV5_SND2'/>"
WRITE #1 "        <register address='0xba50298' value='0x" DATA.LONG(A:0xa50298) "' name='RPMH_BCM_SHADOW_STATUS_DRV5_SND3'/>"
WRITE #1 "        <register address='0xba6028c' value='0x" DATA.LONG(A:0xa6028c) "' name='RPMH_BCM_SHADOW_STATUS_DRV6_SND0'/>"
WRITE #1 "        <register address='0xba60290' value='0x" DATA.LONG(A:0xa60290) "' name='RPMH_BCM_SHADOW_STATUS_DRV6_SND1'/>"
WRITE #1 "        <register address='0xba60294' value='0x" DATA.LONG(A:0xa60294) "' name='RPMH_BCM_SHADOW_STATUS_DRV6_SND2'/>"
WRITE #1 "        <register address='0xba60298' value='0x" DATA.LONG(A:0xa60298) "' name='RPMH_BCM_SHADOW_STATUS_DRV6_SND3'/>"
WRITE #1 "        <register address='0xba7028c' value='0x" DATA.LONG(A:0xa7028c) "' name='RPMH_BCM_SHADOW_STATUS_DRV7_SND0'/>"
WRITE #1 "        <register address='0xba70290' value='0x" DATA.LONG(A:0xa70290) "' name='RPMH_BCM_SHADOW_STATUS_DRV7_SND1'/>"
WRITE #1 "        <register address='0xba70294' value='0x" DATA.LONG(A:0xa70294) "' name='RPMH_BCM_SHADOW_STATUS_DRV7_SND2'/>"
WRITE #1 "        <register address='0xba70298' value='0x" DATA.LONG(A:0xa70298) "' name='RPMH_BCM_SHADOW_STATUS_DRV7_SND3'/>"
WRITE #1 "        <register address='0xba8028c' value='0x" DATA.LONG(A:0xa8028c) "' name='RPMH_BCM_SHADOW_STATUS_DRV8_SND0'/>"
WRITE #1 "        <register address='0xba80290' value='0x" DATA.LONG(A:0xa80290) "' name='RPMH_BCM_SHADOW_STATUS_DRV8_SND1'/>"
WRITE #1 "        <register address='0xba80294' value='0x" DATA.LONG(A:0xa80294) "' name='RPMH_BCM_SHADOW_STATUS_DRV8_SND2'/>"
WRITE #1 "        <register address='0xba80298' value='0x" DATA.LONG(A:0xa80298) "' name='RPMH_BCM_SHADOW_STATUS_DRV8_SND3'/>"
WRITE #1 "        <register address='0xba9028c' value='0x" DATA.LONG(A:0xa9028c) "' name='RPMH_BCM_SHADOW_STATUS_DRV9_SND0'/>"
WRITE #1 "        <register address='0xba90290' value='0x" DATA.LONG(A:0xa90290) "' name='RPMH_BCM_SHADOW_STATUS_DRV9_SND1'/>"
WRITE #1 "        <register address='0xba90294' value='0x" DATA.LONG(A:0xa90294) "' name='RPMH_BCM_SHADOW_STATUS_DRV9_SND2'/>"
WRITE #1 "        <register address='0xba90298' value='0x" DATA.LONG(A:0xa90298) "' name='RPMH_BCM_SHADOW_STATUS_DRV9_SND3'/>"
WRITE #1 "        <register address='0xba0029c' value='0x" DATA.LONG(A:0xa0029c) "' name='RPMH_BCM_SHADOW_STATUS_DRV0_AGG_BW_ND0'/>"
WRITE #1 "        <register address='0xba002a0' value='0x" DATA.LONG(A:0xa002a0) "' name='RPMH_BCM_SHADOW_STATUS_DRV0_AGG_BW_ND1'/>"
WRITE #1 "        <register address='0xba002a4' value='0x" DATA.LONG(A:0xa002a4) "' name='RPMH_BCM_SHADOW_STATUS_DRV0_AGG_BW_ND2'/>"
WRITE #1 "        <register address='0xba002a8' value='0x" DATA.LONG(A:0xa002a8) "' name='RPMH_BCM_SHADOW_STATUS_DRV0_AGG_BW_ND3'/>"
WRITE #1 "        <register address='0xba002ac' value='0x" DATA.LONG(A:0xa002ac) "' name='RPMH_BCM_SHADOW_STATUS_DRV0_AGG_BW_ND4'/>"
WRITE #1 "        <register address='0xba002b0' value='0x" DATA.LONG(A:0xa002b0) "' name='RPMH_BCM_SHADOW_STATUS_DRV0_AGG_BW_ND5'/>"
WRITE #1 "        <register address='0xba002b4' value='0x" DATA.LONG(A:0xa002b4) "' name='RPMH_BCM_SHADOW_STATUS_DRV0_AGG_BW_ND6'/>"
WRITE #1 "        <register address='0xba002b8' value='0x" DATA.LONG(A:0xa002b8) "' name='RPMH_BCM_SHADOW_STATUS_DRV0_AGG_BW_ND7'/>"
WRITE #1 "        <register address='0xba002bc' value='0x" DATA.LONG(A:0xa002bc) "' name='RPMH_BCM_SHADOW_STATUS_DRV0_AGG_BW_ND8'/>"
WRITE #1 "        <register address='0xba002c0' value='0x" DATA.LONG(A:0xa002c0) "' name='RPMH_BCM_SHADOW_STATUS_DRV0_AGG_BW_ND9'/>"
WRITE #1 "        <register address='0xba002c4' value='0x" DATA.LONG(A:0xa002c4) "' name='RPMH_BCM_SHADOW_STATUS_DRV0_AGG_BW_ND10'/>"
WRITE #1 "        <register address='0xba002c8' value='0x" DATA.LONG(A:0xa002c8) "' name='RPMH_BCM_SHADOW_STATUS_DRV0_AGG_BW_ND11'/>"
WRITE #1 "        <register address='0xba002cc' value='0x" DATA.LONG(A:0xa002cc) "' name='RPMH_BCM_SHADOW_STATUS_DRV0_AGG_BW_ND12'/>"
WRITE #1 "        <register address='0xba002d0' value='0x" DATA.LONG(A:0xa002d0) "' name='RPMH_BCM_SHADOW_STATUS_DRV0_AGG_BW_ND13'/>"
WRITE #1 "        <register address='0xba002d4' value='0x" DATA.LONG(A:0xa002d4) "' name='RPMH_BCM_SHADOW_STATUS_DRV0_AGG_BW_ND14'/>"
WRITE #1 "        <register address='0xba002d8' value='0x" DATA.LONG(A:0xa002d8) "' name='RPMH_BCM_SHADOW_STATUS_DRV0_AGG_BW_ND15'/>"
WRITE #1 "        <register address='0xba002dc' value='0x" DATA.LONG(A:0xa002dc) "' name='RPMH_BCM_SHADOW_STATUS_DRV0_AGG_BW_ND16'/>"
WRITE #1 "        <register address='0xba002e0' value='0x" DATA.LONG(A:0xa002e0) "' name='RPMH_BCM_SHADOW_STATUS_DRV0_AGG_BW_ND17'/>"
WRITE #1 "        <register address='0xba002e4' value='0x" DATA.LONG(A:0xa002e4) "' name='RPMH_BCM_SHADOW_STATUS_DRV0_AGG_BW_ND18'/>"
WRITE #1 "        <register address='0xba002e8' value='0x" DATA.LONG(A:0xa002e8) "' name='RPMH_BCM_SHADOW_STATUS_DRV0_AGG_BW_ND19'/>"
WRITE #1 "        <register address='0xba002ec' value='0x" DATA.LONG(A:0xa002ec) "' name='RPMH_BCM_SHADOW_STATUS_DRV0_AGG_BW_ND20'/>"
WRITE #1 "        <register address='0xba002f0' value='0x" DATA.LONG(A:0xa002f0) "' name='RPMH_BCM_SHADOW_STATUS_DRV0_AGG_BW_ND21'/>"
WRITE #1 "        <register address='0xba002f4' value='0x" DATA.LONG(A:0xa002f4) "' name='RPMH_BCM_SHADOW_STATUS_DRV0_AGG_BW_ND22'/>"
WRITE #1 "        <register address='0xba002f8' value='0x" DATA.LONG(A:0xa002f8) "' name='RPMH_BCM_SHADOW_STATUS_DRV0_AGG_BW_ND23'/>"
WRITE #1 "        <register address='0xba002fc' value='0x" DATA.LONG(A:0xa002fc) "' name='RPMH_BCM_SHADOW_STATUS_DRV0_AGG_BW_ND24'/>"
WRITE #1 "        <register address='0xba00300' value='0x" DATA.LONG(A:0xa00300) "' name='RPMH_BCM_SHADOW_STATUS_DRV0_AGG_BW_ND25'/>"
WRITE #1 "        <register address='0xba00304' value='0x" DATA.LONG(A:0xa00304) "' name='RPMH_BCM_SHADOW_STATUS_DRV0_AGG_BW_ND26'/>"
WRITE #1 "        <register address='0xba00308' value='0x" DATA.LONG(A:0xa00308) "' name='RPMH_BCM_SHADOW_STATUS_DRV0_AGG_BW_ND27'/>"
WRITE #1 "        <register address='0xba0030c' value='0x" DATA.LONG(A:0xa0030c) "' name='RPMH_BCM_SHADOW_STATUS_DRV0_AGG_BW_ND28'/>"
WRITE #1 "        <register address='0xba00310' value='0x" DATA.LONG(A:0xa00310) "' name='RPMH_BCM_SHADOW_STATUS_DRV0_AGG_BW_ND29'/>"
WRITE #1 "        <register address='0xba00314' value='0x" DATA.LONG(A:0xa00314) "' name='RPMH_BCM_SHADOW_STATUS_DRV0_AGG_BW_ND30'/>"
WRITE #1 "        <register address='0xba00318' value='0x" DATA.LONG(A:0xa00318) "' name='RPMH_BCM_SHADOW_STATUS_DRV0_AGG_BW_ND31'/>"
WRITE #1 "        <register address='0xba0031c' value='0x" DATA.LONG(A:0xa0031c) "' name='RPMH_BCM_SHADOW_STATUS_DRV0_AGG_BW_ND32'/>"
WRITE #1 "        <register address='0xba00320' value='0x" DATA.LONG(A:0xa00320) "' name='RPMH_BCM_SHADOW_STATUS_DRV0_AGG_BW_ND33'/>"
WRITE #1 "        <register address='0xba00324' value='0x" DATA.LONG(A:0xa00324) "' name='RPMH_BCM_SHADOW_STATUS_DRV0_AGG_BW_ND34'/>"
WRITE #1 "        <register address='0xba00328' value='0x" DATA.LONG(A:0xa00328) "' name='RPMH_BCM_SHADOW_STATUS_DRV0_AGG_BW_ND35'/>"
WRITE #1 "        <register address='0xba0032c' value='0x" DATA.LONG(A:0xa0032c) "' name='RPMH_BCM_SHADOW_STATUS_DRV0_AGG_BW_ND36'/>"
WRITE #1 "        <register address='0xba00330' value='0x" DATA.LONG(A:0xa00330) "' name='RPMH_BCM_SHADOW_STATUS_DRV0_AGG_BW_ND37'/>"
WRITE #1 "        <register address='0xba00334' value='0x" DATA.LONG(A:0xa00334) "' name='RPMH_BCM_SHADOW_STATUS_DRV0_AGG_BW_ND38'/>"
WRITE #1 "        <register address='0xba00338' value='0x" DATA.LONG(A:0xa00338) "' name='RPMH_BCM_SHADOW_STATUS_DRV0_AGG_BW_ND39'/>"
WRITE #1 "        <register address='0xba0033c' value='0x" DATA.LONG(A:0xa0033c) "' name='RPMH_BCM_SHADOW_STATUS_DRV0_AGG_BW_ND40'/>"
WRITE #1 "        <register address='0xba00340' value='0x" DATA.LONG(A:0xa00340) "' name='RPMH_BCM_SHADOW_STATUS_DRV0_AGG_BW_ND41'/>"
WRITE #1 "        <register address='0xba00344' value='0x" DATA.LONG(A:0xa00344) "' name='RPMH_BCM_SHADOW_STATUS_DRV0_AGG_BW_ND42'/>"
WRITE #1 "        <register address='0xba00348' value='0x" DATA.LONG(A:0xa00348) "' name='RPMH_BCM_SHADOW_STATUS_DRV0_AGG_BW_ND43'/>"
WRITE #1 "        <register address='0xba0034c' value='0x" DATA.LONG(A:0xa0034c) "' name='RPMH_BCM_SHADOW_STATUS_DRV0_AGG_BW_ND44'/>"
WRITE #1 "        <register address='0xba00350' value='0x" DATA.LONG(A:0xa00350) "' name='RPMH_BCM_SHADOW_STATUS_DRV0_AGG_BW_ND45'/>"
WRITE #1 "        <register address='0xba00354' value='0x" DATA.LONG(A:0xa00354) "' name='RPMH_BCM_SHADOW_STATUS_DRV0_AGG_BW_ND46'/>"
WRITE #1 "        <register address='0xba00358' value='0x" DATA.LONG(A:0xa00358) "' name='RPMH_BCM_SHADOW_STATUS_DRV0_AGG_BW_ND47'/>"
WRITE #1 "        <register address='0xba1029c' value='0x" DATA.LONG(A:0xa1029c) "' name='RPMH_BCM_SHADOW_STATUS_DRV1_AGG_BW_ND0'/>"
WRITE #1 "        <register address='0xba102a0' value='0x" DATA.LONG(A:0xa102a0) "' name='RPMH_BCM_SHADOW_STATUS_DRV1_AGG_BW_ND1'/>"
WRITE #1 "        <register address='0xba102a4' value='0x" DATA.LONG(A:0xa102a4) "' name='RPMH_BCM_SHADOW_STATUS_DRV1_AGG_BW_ND2'/>"
WRITE #1 "        <register address='0xba102a8' value='0x" DATA.LONG(A:0xa102a8) "' name='RPMH_BCM_SHADOW_STATUS_DRV1_AGG_BW_ND3'/>"
WRITE #1 "        <register address='0xba102ac' value='0x" DATA.LONG(A:0xa102ac) "' name='RPMH_BCM_SHADOW_STATUS_DRV1_AGG_BW_ND4'/>"
WRITE #1 "        <register address='0xba102b0' value='0x" DATA.LONG(A:0xa102b0) "' name='RPMH_BCM_SHADOW_STATUS_DRV1_AGG_BW_ND5'/>"
WRITE #1 "        <register address='0xba102b4' value='0x" DATA.LONG(A:0xa102b4) "' name='RPMH_BCM_SHADOW_STATUS_DRV1_AGG_BW_ND6'/>"
WRITE #1 "        <register address='0xba102b8' value='0x" DATA.LONG(A:0xa102b8) "' name='RPMH_BCM_SHADOW_STATUS_DRV1_AGG_BW_ND7'/>"
WRITE #1 "        <register address='0xba102bc' value='0x" DATA.LONG(A:0xa102bc) "' name='RPMH_BCM_SHADOW_STATUS_DRV1_AGG_BW_ND8'/>"
WRITE #1 "        <register address='0xba102c0' value='0x" DATA.LONG(A:0xa102c0) "' name='RPMH_BCM_SHADOW_STATUS_DRV1_AGG_BW_ND9'/>"
WRITE #1 "        <register address='0xba102c4' value='0x" DATA.LONG(A:0xa102c4) "' name='RPMH_BCM_SHADOW_STATUS_DRV1_AGG_BW_ND10'/>"
WRITE #1 "        <register address='0xba102c8' value='0x" DATA.LONG(A:0xa102c8) "' name='RPMH_BCM_SHADOW_STATUS_DRV1_AGG_BW_ND11'/>"
WRITE #1 "        <register address='0xba102cc' value='0x" DATA.LONG(A:0xa102cc) "' name='RPMH_BCM_SHADOW_STATUS_DRV1_AGG_BW_ND12'/>"
WRITE #1 "        <register address='0xba102d0' value='0x" DATA.LONG(A:0xa102d0) "' name='RPMH_BCM_SHADOW_STATUS_DRV1_AGG_BW_ND13'/>"
WRITE #1 "        <register address='0xba102d4' value='0x" DATA.LONG(A:0xa102d4) "' name='RPMH_BCM_SHADOW_STATUS_DRV1_AGG_BW_ND14'/>"
WRITE #1 "        <register address='0xba102d8' value='0x" DATA.LONG(A:0xa102d8) "' name='RPMH_BCM_SHADOW_STATUS_DRV1_AGG_BW_ND15'/>"
WRITE #1 "        <register address='0xba102dc' value='0x" DATA.LONG(A:0xa102dc) "' name='RPMH_BCM_SHADOW_STATUS_DRV1_AGG_BW_ND16'/>"
WRITE #1 "        <register address='0xba102e0' value='0x" DATA.LONG(A:0xa102e0) "' name='RPMH_BCM_SHADOW_STATUS_DRV1_AGG_BW_ND17'/>"
WRITE #1 "        <register address='0xba102e4' value='0x" DATA.LONG(A:0xa102e4) "' name='RPMH_BCM_SHADOW_STATUS_DRV1_AGG_BW_ND18'/>"
WRITE #1 "        <register address='0xba102e8' value='0x" DATA.LONG(A:0xa102e8) "' name='RPMH_BCM_SHADOW_STATUS_DRV1_AGG_BW_ND19'/>"
WRITE #1 "        <register address='0xba102ec' value='0x" DATA.LONG(A:0xa102ec) "' name='RPMH_BCM_SHADOW_STATUS_DRV1_AGG_BW_ND20'/>"
WRITE #1 "        <register address='0xba102f0' value='0x" DATA.LONG(A:0xa102f0) "' name='RPMH_BCM_SHADOW_STATUS_DRV1_AGG_BW_ND21'/>"
WRITE #1 "        <register address='0xba102f4' value='0x" DATA.LONG(A:0xa102f4) "' name='RPMH_BCM_SHADOW_STATUS_DRV1_AGG_BW_ND22'/>"
WRITE #1 "        <register address='0xba102f8' value='0x" DATA.LONG(A:0xa102f8) "' name='RPMH_BCM_SHADOW_STATUS_DRV1_AGG_BW_ND23'/>"
WRITE #1 "        <register address='0xba102fc' value='0x" DATA.LONG(A:0xa102fc) "' name='RPMH_BCM_SHADOW_STATUS_DRV1_AGG_BW_ND24'/>"
WRITE #1 "        <register address='0xba10300' value='0x" DATA.LONG(A:0xa10300) "' name='RPMH_BCM_SHADOW_STATUS_DRV1_AGG_BW_ND25'/>"
WRITE #1 "        <register address='0xba10304' value='0x" DATA.LONG(A:0xa10304) "' name='RPMH_BCM_SHADOW_STATUS_DRV1_AGG_BW_ND26'/>"
WRITE #1 "        <register address='0xba10308' value='0x" DATA.LONG(A:0xa10308) "' name='RPMH_BCM_SHADOW_STATUS_DRV1_AGG_BW_ND27'/>"
WRITE #1 "        <register address='0xba1030c' value='0x" DATA.LONG(A:0xa1030c) "' name='RPMH_BCM_SHADOW_STATUS_DRV1_AGG_BW_ND28'/>"
WRITE #1 "        <register address='0xba10310' value='0x" DATA.LONG(A:0xa10310) "' name='RPMH_BCM_SHADOW_STATUS_DRV1_AGG_BW_ND29'/>"
WRITE #1 "        <register address='0xba10314' value='0x" DATA.LONG(A:0xa10314) "' name='RPMH_BCM_SHADOW_STATUS_DRV1_AGG_BW_ND30'/>"
WRITE #1 "        <register address='0xba10318' value='0x" DATA.LONG(A:0xa10318) "' name='RPMH_BCM_SHADOW_STATUS_DRV1_AGG_BW_ND31'/>"
WRITE #1 "        <register address='0xba1031c' value='0x" DATA.LONG(A:0xa1031c) "' name='RPMH_BCM_SHADOW_STATUS_DRV1_AGG_BW_ND32'/>"
WRITE #1 "        <register address='0xba10320' value='0x" DATA.LONG(A:0xa10320) "' name='RPMH_BCM_SHADOW_STATUS_DRV1_AGG_BW_ND33'/>"
WRITE #1 "        <register address='0xba10324' value='0x" DATA.LONG(A:0xa10324) "' name='RPMH_BCM_SHADOW_STATUS_DRV1_AGG_BW_ND34'/>"
WRITE #1 "        <register address='0xba10328' value='0x" DATA.LONG(A:0xa10328) "' name='RPMH_BCM_SHADOW_STATUS_DRV1_AGG_BW_ND35'/>"
WRITE #1 "        <register address='0xba1032c' value='0x" DATA.LONG(A:0xa1032c) "' name='RPMH_BCM_SHADOW_STATUS_DRV1_AGG_BW_ND36'/>"
WRITE #1 "        <register address='0xba10330' value='0x" DATA.LONG(A:0xa10330) "' name='RPMH_BCM_SHADOW_STATUS_DRV1_AGG_BW_ND37'/>"
WRITE #1 "        <register address='0xba10334' value='0x" DATA.LONG(A:0xa10334) "' name='RPMH_BCM_SHADOW_STATUS_DRV1_AGG_BW_ND38'/>"
WRITE #1 "        <register address='0xba10338' value='0x" DATA.LONG(A:0xa10338) "' name='RPMH_BCM_SHADOW_STATUS_DRV1_AGG_BW_ND39'/>"
WRITE #1 "        <register address='0xba1033c' value='0x" DATA.LONG(A:0xa1033c) "' name='RPMH_BCM_SHADOW_STATUS_DRV1_AGG_BW_ND40'/>"
WRITE #1 "        <register address='0xba10340' value='0x" DATA.LONG(A:0xa10340) "' name='RPMH_BCM_SHADOW_STATUS_DRV1_AGG_BW_ND41'/>"
WRITE #1 "        <register address='0xba10344' value='0x" DATA.LONG(A:0xa10344) "' name='RPMH_BCM_SHADOW_STATUS_DRV1_AGG_BW_ND42'/>"
WRITE #1 "        <register address='0xba10348' value='0x" DATA.LONG(A:0xa10348) "' name='RPMH_BCM_SHADOW_STATUS_DRV1_AGG_BW_ND43'/>"
WRITE #1 "        <register address='0xba1034c' value='0x" DATA.LONG(A:0xa1034c) "' name='RPMH_BCM_SHADOW_STATUS_DRV1_AGG_BW_ND44'/>"
WRITE #1 "        <register address='0xba10350' value='0x" DATA.LONG(A:0xa10350) "' name='RPMH_BCM_SHADOW_STATUS_DRV1_AGG_BW_ND45'/>"
WRITE #1 "        <register address='0xba10354' value='0x" DATA.LONG(A:0xa10354) "' name='RPMH_BCM_SHADOW_STATUS_DRV1_AGG_BW_ND46'/>"
WRITE #1 "        <register address='0xba10358' value='0x" DATA.LONG(A:0xa10358) "' name='RPMH_BCM_SHADOW_STATUS_DRV1_AGG_BW_ND47'/>"
WRITE #1 "        <register address='0xba2029c' value='0x" DATA.LONG(A:0xa2029c) "' name='RPMH_BCM_SHADOW_STATUS_DRV2_AGG_BW_ND0'/>"
WRITE #1 "        <register address='0xba202a0' value='0x" DATA.LONG(A:0xa202a0) "' name='RPMH_BCM_SHADOW_STATUS_DRV2_AGG_BW_ND1'/>"
WRITE #1 "        <register address='0xba202a4' value='0x" DATA.LONG(A:0xa202a4) "' name='RPMH_BCM_SHADOW_STATUS_DRV2_AGG_BW_ND2'/>"
WRITE #1 "        <register address='0xba202a8' value='0x" DATA.LONG(A:0xa202a8) "' name='RPMH_BCM_SHADOW_STATUS_DRV2_AGG_BW_ND3'/>"
WRITE #1 "        <register address='0xba202ac' value='0x" DATA.LONG(A:0xa202ac) "' name='RPMH_BCM_SHADOW_STATUS_DRV2_AGG_BW_ND4'/>"
WRITE #1 "        <register address='0xba202b0' value='0x" DATA.LONG(A:0xa202b0) "' name='RPMH_BCM_SHADOW_STATUS_DRV2_AGG_BW_ND5'/>"
WRITE #1 "        <register address='0xba202b4' value='0x" DATA.LONG(A:0xa202b4) "' name='RPMH_BCM_SHADOW_STATUS_DRV2_AGG_BW_ND6'/>"
WRITE #1 "        <register address='0xba202b8' value='0x" DATA.LONG(A:0xa202b8) "' name='RPMH_BCM_SHADOW_STATUS_DRV2_AGG_BW_ND7'/>"
WRITE #1 "        <register address='0xba202bc' value='0x" DATA.LONG(A:0xa202bc) "' name='RPMH_BCM_SHADOW_STATUS_DRV2_AGG_BW_ND8'/>"
WRITE #1 "        <register address='0xba202c0' value='0x" DATA.LONG(A:0xa202c0) "' name='RPMH_BCM_SHADOW_STATUS_DRV2_AGG_BW_ND9'/>"
WRITE #1 "        <register address='0xba202c4' value='0x" DATA.LONG(A:0xa202c4) "' name='RPMH_BCM_SHADOW_STATUS_DRV2_AGG_BW_ND10'/>"
WRITE #1 "        <register address='0xba202c8' value='0x" DATA.LONG(A:0xa202c8) "' name='RPMH_BCM_SHADOW_STATUS_DRV2_AGG_BW_ND11'/>"
WRITE #1 "        <register address='0xba202cc' value='0x" DATA.LONG(A:0xa202cc) "' name='RPMH_BCM_SHADOW_STATUS_DRV2_AGG_BW_ND12'/>"
WRITE #1 "        <register address='0xba202d0' value='0x" DATA.LONG(A:0xa202d0) "' name='RPMH_BCM_SHADOW_STATUS_DRV2_AGG_BW_ND13'/>"
WRITE #1 "        <register address='0xba202d4' value='0x" DATA.LONG(A:0xa202d4) "' name='RPMH_BCM_SHADOW_STATUS_DRV2_AGG_BW_ND14'/>"
WRITE #1 "        <register address='0xba202d8' value='0x" DATA.LONG(A:0xa202d8) "' name='RPMH_BCM_SHADOW_STATUS_DRV2_AGG_BW_ND15'/>"
WRITE #1 "        <register address='0xba202dc' value='0x" DATA.LONG(A:0xa202dc) "' name='RPMH_BCM_SHADOW_STATUS_DRV2_AGG_BW_ND16'/>"
WRITE #1 "        <register address='0xba202e0' value='0x" DATA.LONG(A:0xa202e0) "' name='RPMH_BCM_SHADOW_STATUS_DRV2_AGG_BW_ND17'/>"
WRITE #1 "        <register address='0xba202e4' value='0x" DATA.LONG(A:0xa202e4) "' name='RPMH_BCM_SHADOW_STATUS_DRV2_AGG_BW_ND18'/>"
WRITE #1 "        <register address='0xba202e8' value='0x" DATA.LONG(A:0xa202e8) "' name='RPMH_BCM_SHADOW_STATUS_DRV2_AGG_BW_ND19'/>"
WRITE #1 "        <register address='0xba202ec' value='0x" DATA.LONG(A:0xa202ec) "' name='RPMH_BCM_SHADOW_STATUS_DRV2_AGG_BW_ND20'/>"
WRITE #1 "        <register address='0xba202f0' value='0x" DATA.LONG(A:0xa202f0) "' name='RPMH_BCM_SHADOW_STATUS_DRV2_AGG_BW_ND21'/>"
WRITE #1 "        <register address='0xba202f4' value='0x" DATA.LONG(A:0xa202f4) "' name='RPMH_BCM_SHADOW_STATUS_DRV2_AGG_BW_ND22'/>"
WRITE #1 "        <register address='0xba202f8' value='0x" DATA.LONG(A:0xa202f8) "' name='RPMH_BCM_SHADOW_STATUS_DRV2_AGG_BW_ND23'/>"
WRITE #1 "        <register address='0xba202fc' value='0x" DATA.LONG(A:0xa202fc) "' name='RPMH_BCM_SHADOW_STATUS_DRV2_AGG_BW_ND24'/>"
WRITE #1 "        <register address='0xba20300' value='0x" DATA.LONG(A:0xa20300) "' name='RPMH_BCM_SHADOW_STATUS_DRV2_AGG_BW_ND25'/>"
WRITE #1 "        <register address='0xba20304' value='0x" DATA.LONG(A:0xa20304) "' name='RPMH_BCM_SHADOW_STATUS_DRV2_AGG_BW_ND26'/>"
WRITE #1 "        <register address='0xba20308' value='0x" DATA.LONG(A:0xa20308) "' name='RPMH_BCM_SHADOW_STATUS_DRV2_AGG_BW_ND27'/>"
WRITE #1 "        <register address='0xba2030c' value='0x" DATA.LONG(A:0xa2030c) "' name='RPMH_BCM_SHADOW_STATUS_DRV2_AGG_BW_ND28'/>"
WRITE #1 "        <register address='0xba20310' value='0x" DATA.LONG(A:0xa20310) "' name='RPMH_BCM_SHADOW_STATUS_DRV2_AGG_BW_ND29'/>"
WRITE #1 "        <register address='0xba20314' value='0x" DATA.LONG(A:0xa20314) "' name='RPMH_BCM_SHADOW_STATUS_DRV2_AGG_BW_ND30'/>"
WRITE #1 "        <register address='0xba20318' value='0x" DATA.LONG(A:0xa20318) "' name='RPMH_BCM_SHADOW_STATUS_DRV2_AGG_BW_ND31'/>"
WRITE #1 "        <register address='0xba2031c' value='0x" DATA.LONG(A:0xa2031c) "' name='RPMH_BCM_SHADOW_STATUS_DRV2_AGG_BW_ND32'/>"
WRITE #1 "        <register address='0xba20320' value='0x" DATA.LONG(A:0xa20320) "' name='RPMH_BCM_SHADOW_STATUS_DRV2_AGG_BW_ND33'/>"
WRITE #1 "        <register address='0xba20324' value='0x" DATA.LONG(A:0xa20324) "' name='RPMH_BCM_SHADOW_STATUS_DRV2_AGG_BW_ND34'/>"
WRITE #1 "        <register address='0xba20328' value='0x" DATA.LONG(A:0xa20328) "' name='RPMH_BCM_SHADOW_STATUS_DRV2_AGG_BW_ND35'/>"
WRITE #1 "        <register address='0xba2032c' value='0x" DATA.LONG(A:0xa2032c) "' name='RPMH_BCM_SHADOW_STATUS_DRV2_AGG_BW_ND36'/>"
WRITE #1 "        <register address='0xba20330' value='0x" DATA.LONG(A:0xa20330) "' name='RPMH_BCM_SHADOW_STATUS_DRV2_AGG_BW_ND37'/>"
WRITE #1 "        <register address='0xba20334' value='0x" DATA.LONG(A:0xa20334) "' name='RPMH_BCM_SHADOW_STATUS_DRV2_AGG_BW_ND38'/>"
WRITE #1 "        <register address='0xba20338' value='0x" DATA.LONG(A:0xa20338) "' name='RPMH_BCM_SHADOW_STATUS_DRV2_AGG_BW_ND39'/>"
WRITE #1 "        <register address='0xba2033c' value='0x" DATA.LONG(A:0xa2033c) "' name='RPMH_BCM_SHADOW_STATUS_DRV2_AGG_BW_ND40'/>"
WRITE #1 "        <register address='0xba20340' value='0x" DATA.LONG(A:0xa20340) "' name='RPMH_BCM_SHADOW_STATUS_DRV2_AGG_BW_ND41'/>"
WRITE #1 "        <register address='0xba20344' value='0x" DATA.LONG(A:0xa20344) "' name='RPMH_BCM_SHADOW_STATUS_DRV2_AGG_BW_ND42'/>"
WRITE #1 "        <register address='0xba20348' value='0x" DATA.LONG(A:0xa20348) "' name='RPMH_BCM_SHADOW_STATUS_DRV2_AGG_BW_ND43'/>"
WRITE #1 "        <register address='0xba2034c' value='0x" DATA.LONG(A:0xa2034c) "' name='RPMH_BCM_SHADOW_STATUS_DRV2_AGG_BW_ND44'/>"
WRITE #1 "        <register address='0xba20350' value='0x" DATA.LONG(A:0xa20350) "' name='RPMH_BCM_SHADOW_STATUS_DRV2_AGG_BW_ND45'/>"
WRITE #1 "        <register address='0xba20354' value='0x" DATA.LONG(A:0xa20354) "' name='RPMH_BCM_SHADOW_STATUS_DRV2_AGG_BW_ND46'/>"
WRITE #1 "        <register address='0xba20358' value='0x" DATA.LONG(A:0xa20358) "' name='RPMH_BCM_SHADOW_STATUS_DRV2_AGG_BW_ND47'/>"
WRITE #1 "        <register address='0xba3029c' value='0x" DATA.LONG(A:0xa3029c) "' name='RPMH_BCM_SHADOW_STATUS_DRV3_AGG_BW_ND0'/>"
WRITE #1 "        <register address='0xba302a0' value='0x" DATA.LONG(A:0xa302a0) "' name='RPMH_BCM_SHADOW_STATUS_DRV3_AGG_BW_ND1'/>"
WRITE #1 "        <register address='0xba302a4' value='0x" DATA.LONG(A:0xa302a4) "' name='RPMH_BCM_SHADOW_STATUS_DRV3_AGG_BW_ND2'/>"
WRITE #1 "        <register address='0xba302a8' value='0x" DATA.LONG(A:0xa302a8) "' name='RPMH_BCM_SHADOW_STATUS_DRV3_AGG_BW_ND3'/>"
WRITE #1 "        <register address='0xba302ac' value='0x" DATA.LONG(A:0xa302ac) "' name='RPMH_BCM_SHADOW_STATUS_DRV3_AGG_BW_ND4'/>"
WRITE #1 "        <register address='0xba302b0' value='0x" DATA.LONG(A:0xa302b0) "' name='RPMH_BCM_SHADOW_STATUS_DRV3_AGG_BW_ND5'/>"
WRITE #1 "        <register address='0xba302b4' value='0x" DATA.LONG(A:0xa302b4) "' name='RPMH_BCM_SHADOW_STATUS_DRV3_AGG_BW_ND6'/>"
WRITE #1 "        <register address='0xba302b8' value='0x" DATA.LONG(A:0xa302b8) "' name='RPMH_BCM_SHADOW_STATUS_DRV3_AGG_BW_ND7'/>"
WRITE #1 "        <register address='0xba302bc' value='0x" DATA.LONG(A:0xa302bc) "' name='RPMH_BCM_SHADOW_STATUS_DRV3_AGG_BW_ND8'/>"
WRITE #1 "        <register address='0xba302c0' value='0x" DATA.LONG(A:0xa302c0) "' name='RPMH_BCM_SHADOW_STATUS_DRV3_AGG_BW_ND9'/>"
WRITE #1 "        <register address='0xba302c4' value='0x" DATA.LONG(A:0xa302c4) "' name='RPMH_BCM_SHADOW_STATUS_DRV3_AGG_BW_ND10'/>"
WRITE #1 "        <register address='0xba302c8' value='0x" DATA.LONG(A:0xa302c8) "' name='RPMH_BCM_SHADOW_STATUS_DRV3_AGG_BW_ND11'/>"
WRITE #1 "        <register address='0xba302cc' value='0x" DATA.LONG(A:0xa302cc) "' name='RPMH_BCM_SHADOW_STATUS_DRV3_AGG_BW_ND12'/>"
WRITE #1 "        <register address='0xba302d0' value='0x" DATA.LONG(A:0xa302d0) "' name='RPMH_BCM_SHADOW_STATUS_DRV3_AGG_BW_ND13'/>"
WRITE #1 "        <register address='0xba302d4' value='0x" DATA.LONG(A:0xa302d4) "' name='RPMH_BCM_SHADOW_STATUS_DRV3_AGG_BW_ND14'/>"
WRITE #1 "        <register address='0xba302d8' value='0x" DATA.LONG(A:0xa302d8) "' name='RPMH_BCM_SHADOW_STATUS_DRV3_AGG_BW_ND15'/>"
WRITE #1 "        <register address='0xba302dc' value='0x" DATA.LONG(A:0xa302dc) "' name='RPMH_BCM_SHADOW_STATUS_DRV3_AGG_BW_ND16'/>"
WRITE #1 "        <register address='0xba302e0' value='0x" DATA.LONG(A:0xa302e0) "' name='RPMH_BCM_SHADOW_STATUS_DRV3_AGG_BW_ND17'/>"
WRITE #1 "        <register address='0xba302e4' value='0x" DATA.LONG(A:0xa302e4) "' name='RPMH_BCM_SHADOW_STATUS_DRV3_AGG_BW_ND18'/>"
WRITE #1 "        <register address='0xba302e8' value='0x" DATA.LONG(A:0xa302e8) "' name='RPMH_BCM_SHADOW_STATUS_DRV3_AGG_BW_ND19'/>"
WRITE #1 "        <register address='0xba302ec' value='0x" DATA.LONG(A:0xa302ec) "' name='RPMH_BCM_SHADOW_STATUS_DRV3_AGG_BW_ND20'/>"
WRITE #1 "        <register address='0xba302f0' value='0x" DATA.LONG(A:0xa302f0) "' name='RPMH_BCM_SHADOW_STATUS_DRV3_AGG_BW_ND21'/>"
WRITE #1 "        <register address='0xba302f4' value='0x" DATA.LONG(A:0xa302f4) "' name='RPMH_BCM_SHADOW_STATUS_DRV3_AGG_BW_ND22'/>"
WRITE #1 "        <register address='0xba302f8' value='0x" DATA.LONG(A:0xa302f8) "' name='RPMH_BCM_SHADOW_STATUS_DRV3_AGG_BW_ND23'/>"
WRITE #1 "        <register address='0xba302fc' value='0x" DATA.LONG(A:0xa302fc) "' name='RPMH_BCM_SHADOW_STATUS_DRV3_AGG_BW_ND24'/>"
WRITE #1 "        <register address='0xba30300' value='0x" DATA.LONG(A:0xa30300) "' name='RPMH_BCM_SHADOW_STATUS_DRV3_AGG_BW_ND25'/>"
WRITE #1 "        <register address='0xba30304' value='0x" DATA.LONG(A:0xa30304) "' name='RPMH_BCM_SHADOW_STATUS_DRV3_AGG_BW_ND26'/>"
WRITE #1 "        <register address='0xba30308' value='0x" DATA.LONG(A:0xa30308) "' name='RPMH_BCM_SHADOW_STATUS_DRV3_AGG_BW_ND27'/>"
WRITE #1 "        <register address='0xba3030c' value='0x" DATA.LONG(A:0xa3030c) "' name='RPMH_BCM_SHADOW_STATUS_DRV3_AGG_BW_ND28'/>"
WRITE #1 "        <register address='0xba30310' value='0x" DATA.LONG(A:0xa30310) "' name='RPMH_BCM_SHADOW_STATUS_DRV3_AGG_BW_ND29'/>"
WRITE #1 "        <register address='0xba30314' value='0x" DATA.LONG(A:0xa30314) "' name='RPMH_BCM_SHADOW_STATUS_DRV3_AGG_BW_ND30'/>"
WRITE #1 "        <register address='0xba30318' value='0x" DATA.LONG(A:0xa30318) "' name='RPMH_BCM_SHADOW_STATUS_DRV3_AGG_BW_ND31'/>"
WRITE #1 "        <register address='0xba3031c' value='0x" DATA.LONG(A:0xa3031c) "' name='RPMH_BCM_SHADOW_STATUS_DRV3_AGG_BW_ND32'/>"
WRITE #1 "        <register address='0xba30320' value='0x" DATA.LONG(A:0xa30320) "' name='RPMH_BCM_SHADOW_STATUS_DRV3_AGG_BW_ND33'/>"
WRITE #1 "        <register address='0xba30324' value='0x" DATA.LONG(A:0xa30324) "' name='RPMH_BCM_SHADOW_STATUS_DRV3_AGG_BW_ND34'/>"
WRITE #1 "        <register address='0xba30328' value='0x" DATA.LONG(A:0xa30328) "' name='RPMH_BCM_SHADOW_STATUS_DRV3_AGG_BW_ND35'/>"
WRITE #1 "        <register address='0xba3032c' value='0x" DATA.LONG(A:0xa3032c) "' name='RPMH_BCM_SHADOW_STATUS_DRV3_AGG_BW_ND36'/>"
WRITE #1 "        <register address='0xba30330' value='0x" DATA.LONG(A:0xa30330) "' name='RPMH_BCM_SHADOW_STATUS_DRV3_AGG_BW_ND37'/>"
WRITE #1 "        <register address='0xba30334' value='0x" DATA.LONG(A:0xa30334) "' name='RPMH_BCM_SHADOW_STATUS_DRV3_AGG_BW_ND38'/>"
WRITE #1 "        <register address='0xba30338' value='0x" DATA.LONG(A:0xa30338) "' name='RPMH_BCM_SHADOW_STATUS_DRV3_AGG_BW_ND39'/>"
WRITE #1 "        <register address='0xba3033c' value='0x" DATA.LONG(A:0xa3033c) "' name='RPMH_BCM_SHADOW_STATUS_DRV3_AGG_BW_ND40'/>"
WRITE #1 "        <register address='0xba30340' value='0x" DATA.LONG(A:0xa30340) "' name='RPMH_BCM_SHADOW_STATUS_DRV3_AGG_BW_ND41'/>"
WRITE #1 "        <register address='0xba30344' value='0x" DATA.LONG(A:0xa30344) "' name='RPMH_BCM_SHADOW_STATUS_DRV3_AGG_BW_ND42'/>"
WRITE #1 "        <register address='0xba30348' value='0x" DATA.LONG(A:0xa30348) "' name='RPMH_BCM_SHADOW_STATUS_DRV3_AGG_BW_ND43'/>"
WRITE #1 "        <register address='0xba3034c' value='0x" DATA.LONG(A:0xa3034c) "' name='RPMH_BCM_SHADOW_STATUS_DRV3_AGG_BW_ND44'/>"
WRITE #1 "        <register address='0xba30350' value='0x" DATA.LONG(A:0xa30350) "' name='RPMH_BCM_SHADOW_STATUS_DRV3_AGG_BW_ND45'/>"
WRITE #1 "        <register address='0xba30354' value='0x" DATA.LONG(A:0xa30354) "' name='RPMH_BCM_SHADOW_STATUS_DRV3_AGG_BW_ND46'/>"
WRITE #1 "        <register address='0xba30358' value='0x" DATA.LONG(A:0xa30358) "' name='RPMH_BCM_SHADOW_STATUS_DRV3_AGG_BW_ND47'/>"
WRITE #1 "        <register address='0xba4029c' value='0x" DATA.LONG(A:0xa4029c) "' name='RPMH_BCM_SHADOW_STATUS_DRV4_AGG_BW_ND0'/>"
WRITE #1 "        <register address='0xba402a0' value='0x" DATA.LONG(A:0xa402a0) "' name='RPMH_BCM_SHADOW_STATUS_DRV4_AGG_BW_ND1'/>"
WRITE #1 "        <register address='0xba402a4' value='0x" DATA.LONG(A:0xa402a4) "' name='RPMH_BCM_SHADOW_STATUS_DRV4_AGG_BW_ND2'/>"
WRITE #1 "        <register address='0xba402a8' value='0x" DATA.LONG(A:0xa402a8) "' name='RPMH_BCM_SHADOW_STATUS_DRV4_AGG_BW_ND3'/>"
WRITE #1 "        <register address='0xba402ac' value='0x" DATA.LONG(A:0xa402ac) "' name='RPMH_BCM_SHADOW_STATUS_DRV4_AGG_BW_ND4'/>"
WRITE #1 "        <register address='0xba402b0' value='0x" DATA.LONG(A:0xa402b0) "' name='RPMH_BCM_SHADOW_STATUS_DRV4_AGG_BW_ND5'/>"
WRITE #1 "        <register address='0xba402b4' value='0x" DATA.LONG(A:0xa402b4) "' name='RPMH_BCM_SHADOW_STATUS_DRV4_AGG_BW_ND6'/>"
WRITE #1 "        <register address='0xba402b8' value='0x" DATA.LONG(A:0xa402b8) "' name='RPMH_BCM_SHADOW_STATUS_DRV4_AGG_BW_ND7'/>"
WRITE #1 "        <register address='0xba402bc' value='0x" DATA.LONG(A:0xa402bc) "' name='RPMH_BCM_SHADOW_STATUS_DRV4_AGG_BW_ND8'/>"
WRITE #1 "        <register address='0xba402c0' value='0x" DATA.LONG(A:0xa402c0) "' name='RPMH_BCM_SHADOW_STATUS_DRV4_AGG_BW_ND9'/>"
WRITE #1 "        <register address='0xba402c4' value='0x" DATA.LONG(A:0xa402c4) "' name='RPMH_BCM_SHADOW_STATUS_DRV4_AGG_BW_ND10'/>"
WRITE #1 "        <register address='0xba402c8' value='0x" DATA.LONG(A:0xa402c8) "' name='RPMH_BCM_SHADOW_STATUS_DRV4_AGG_BW_ND11'/>"
WRITE #1 "        <register address='0xba402cc' value='0x" DATA.LONG(A:0xa402cc) "' name='RPMH_BCM_SHADOW_STATUS_DRV4_AGG_BW_ND12'/>"
WRITE #1 "        <register address='0xba402d0' value='0x" DATA.LONG(A:0xa402d0) "' name='RPMH_BCM_SHADOW_STATUS_DRV4_AGG_BW_ND13'/>"
WRITE #1 "        <register address='0xba402d4' value='0x" DATA.LONG(A:0xa402d4) "' name='RPMH_BCM_SHADOW_STATUS_DRV4_AGG_BW_ND14'/>"
WRITE #1 "        <register address='0xba402d8' value='0x" DATA.LONG(A:0xa402d8) "' name='RPMH_BCM_SHADOW_STATUS_DRV4_AGG_BW_ND15'/>"
WRITE #1 "        <register address='0xba402dc' value='0x" DATA.LONG(A:0xa402dc) "' name='RPMH_BCM_SHADOW_STATUS_DRV4_AGG_BW_ND16'/>"
WRITE #1 "        <register address='0xba402e0' value='0x" DATA.LONG(A:0xa402e0) "' name='RPMH_BCM_SHADOW_STATUS_DRV4_AGG_BW_ND17'/>"
WRITE #1 "        <register address='0xba402e4' value='0x" DATA.LONG(A:0xa402e4) "' name='RPMH_BCM_SHADOW_STATUS_DRV4_AGG_BW_ND18'/>"
WRITE #1 "        <register address='0xba402e8' value='0x" DATA.LONG(A:0xa402e8) "' name='RPMH_BCM_SHADOW_STATUS_DRV4_AGG_BW_ND19'/>"
WRITE #1 "        <register address='0xba402ec' value='0x" DATA.LONG(A:0xa402ec) "' name='RPMH_BCM_SHADOW_STATUS_DRV4_AGG_BW_ND20'/>"
WRITE #1 "        <register address='0xba402f0' value='0x" DATA.LONG(A:0xa402f0) "' name='RPMH_BCM_SHADOW_STATUS_DRV4_AGG_BW_ND21'/>"
WRITE #1 "        <register address='0xba402f4' value='0x" DATA.LONG(A:0xa402f4) "' name='RPMH_BCM_SHADOW_STATUS_DRV4_AGG_BW_ND22'/>"
WRITE #1 "        <register address='0xba402f8' value='0x" DATA.LONG(A:0xa402f8) "' name='RPMH_BCM_SHADOW_STATUS_DRV4_AGG_BW_ND23'/>"
WRITE #1 "        <register address='0xba402fc' value='0x" DATA.LONG(A:0xa402fc) "' name='RPMH_BCM_SHADOW_STATUS_DRV4_AGG_BW_ND24'/>"
WRITE #1 "        <register address='0xba40300' value='0x" DATA.LONG(A:0xa40300) "' name='RPMH_BCM_SHADOW_STATUS_DRV4_AGG_BW_ND25'/>"
WRITE #1 "        <register address='0xba40304' value='0x" DATA.LONG(A:0xa40304) "' name='RPMH_BCM_SHADOW_STATUS_DRV4_AGG_BW_ND26'/>"
WRITE #1 "        <register address='0xba40308' value='0x" DATA.LONG(A:0xa40308) "' name='RPMH_BCM_SHADOW_STATUS_DRV4_AGG_BW_ND27'/>"
WRITE #1 "        <register address='0xba4030c' value='0x" DATA.LONG(A:0xa4030c) "' name='RPMH_BCM_SHADOW_STATUS_DRV4_AGG_BW_ND28'/>"
WRITE #1 "        <register address='0xba40310' value='0x" DATA.LONG(A:0xa40310) "' name='RPMH_BCM_SHADOW_STATUS_DRV4_AGG_BW_ND29'/>"
WRITE #1 "        <register address='0xba40314' value='0x" DATA.LONG(A:0xa40314) "' name='RPMH_BCM_SHADOW_STATUS_DRV4_AGG_BW_ND30'/>"
WRITE #1 "        <register address='0xba40318' value='0x" DATA.LONG(A:0xa40318) "' name='RPMH_BCM_SHADOW_STATUS_DRV4_AGG_BW_ND31'/>"
WRITE #1 "        <register address='0xba4031c' value='0x" DATA.LONG(A:0xa4031c) "' name='RPMH_BCM_SHADOW_STATUS_DRV4_AGG_BW_ND32'/>"
WRITE #1 "        <register address='0xba40320' value='0x" DATA.LONG(A:0xa40320) "' name='RPMH_BCM_SHADOW_STATUS_DRV4_AGG_BW_ND33'/>"
WRITE #1 "        <register address='0xba40324' value='0x" DATA.LONG(A:0xa40324) "' name='RPMH_BCM_SHADOW_STATUS_DRV4_AGG_BW_ND34'/>"
WRITE #1 "        <register address='0xba40328' value='0x" DATA.LONG(A:0xa40328) "' name='RPMH_BCM_SHADOW_STATUS_DRV4_AGG_BW_ND35'/>"
WRITE #1 "        <register address='0xba4032c' value='0x" DATA.LONG(A:0xa4032c) "' name='RPMH_BCM_SHADOW_STATUS_DRV4_AGG_BW_ND36'/>"
WRITE #1 "        <register address='0xba40330' value='0x" DATA.LONG(A:0xa40330) "' name='RPMH_BCM_SHADOW_STATUS_DRV4_AGG_BW_ND37'/>"
WRITE #1 "        <register address='0xba40334' value='0x" DATA.LONG(A:0xa40334) "' name='RPMH_BCM_SHADOW_STATUS_DRV4_AGG_BW_ND38'/>"
WRITE #1 "        <register address='0xba40338' value='0x" DATA.LONG(A:0xa40338) "' name='RPMH_BCM_SHADOW_STATUS_DRV4_AGG_BW_ND39'/>"
WRITE #1 "        <register address='0xba4033c' value='0x" DATA.LONG(A:0xa4033c) "' name='RPMH_BCM_SHADOW_STATUS_DRV4_AGG_BW_ND40'/>"
WRITE #1 "        <register address='0xba40340' value='0x" DATA.LONG(A:0xa40340) "' name='RPMH_BCM_SHADOW_STATUS_DRV4_AGG_BW_ND41'/>"
WRITE #1 "        <register address='0xba40344' value='0x" DATA.LONG(A:0xa40344) "' name='RPMH_BCM_SHADOW_STATUS_DRV4_AGG_BW_ND42'/>"
WRITE #1 "        <register address='0xba40348' value='0x" DATA.LONG(A:0xa40348) "' name='RPMH_BCM_SHADOW_STATUS_DRV4_AGG_BW_ND43'/>"
WRITE #1 "        <register address='0xba4034c' value='0x" DATA.LONG(A:0xa4034c) "' name='RPMH_BCM_SHADOW_STATUS_DRV4_AGG_BW_ND44'/>"
WRITE #1 "        <register address='0xba40350' value='0x" DATA.LONG(A:0xa40350) "' name='RPMH_BCM_SHADOW_STATUS_DRV4_AGG_BW_ND45'/>"
WRITE #1 "        <register address='0xba40354' value='0x" DATA.LONG(A:0xa40354) "' name='RPMH_BCM_SHADOW_STATUS_DRV4_AGG_BW_ND46'/>"
WRITE #1 "        <register address='0xba40358' value='0x" DATA.LONG(A:0xa40358) "' name='RPMH_BCM_SHADOW_STATUS_DRV4_AGG_BW_ND47'/>"
WRITE #1 "        <register address='0xba5029c' value='0x" DATA.LONG(A:0xa5029c) "' name='RPMH_BCM_SHADOW_STATUS_DRV5_AGG_BW_ND0'/>"
WRITE #1 "        <register address='0xba502a0' value='0x" DATA.LONG(A:0xa502a0) "' name='RPMH_BCM_SHADOW_STATUS_DRV5_AGG_BW_ND1'/>"
WRITE #1 "        <register address='0xba502a4' value='0x" DATA.LONG(A:0xa502a4) "' name='RPMH_BCM_SHADOW_STATUS_DRV5_AGG_BW_ND2'/>"
WRITE #1 "        <register address='0xba502a8' value='0x" DATA.LONG(A:0xa502a8) "' name='RPMH_BCM_SHADOW_STATUS_DRV5_AGG_BW_ND3'/>"
WRITE #1 "        <register address='0xba502ac' value='0x" DATA.LONG(A:0xa502ac) "' name='RPMH_BCM_SHADOW_STATUS_DRV5_AGG_BW_ND4'/>"
WRITE #1 "        <register address='0xba502b0' value='0x" DATA.LONG(A:0xa502b0) "' name='RPMH_BCM_SHADOW_STATUS_DRV5_AGG_BW_ND5'/>"
WRITE #1 "        <register address='0xba502b4' value='0x" DATA.LONG(A:0xa502b4) "' name='RPMH_BCM_SHADOW_STATUS_DRV5_AGG_BW_ND6'/>"
WRITE #1 "        <register address='0xba502b8' value='0x" DATA.LONG(A:0xa502b8) "' name='RPMH_BCM_SHADOW_STATUS_DRV5_AGG_BW_ND7'/>"
WRITE #1 "        <register address='0xba502bc' value='0x" DATA.LONG(A:0xa502bc) "' name='RPMH_BCM_SHADOW_STATUS_DRV5_AGG_BW_ND8'/>"
WRITE #1 "        <register address='0xba502c0' value='0x" DATA.LONG(A:0xa502c0) "' name='RPMH_BCM_SHADOW_STATUS_DRV5_AGG_BW_ND9'/>"
WRITE #1 "        <register address='0xba502c4' value='0x" DATA.LONG(A:0xa502c4) "' name='RPMH_BCM_SHADOW_STATUS_DRV5_AGG_BW_ND10'/>"
WRITE #1 "        <register address='0xba502c8' value='0x" DATA.LONG(A:0xa502c8) "' name='RPMH_BCM_SHADOW_STATUS_DRV5_AGG_BW_ND11'/>"
WRITE #1 "        <register address='0xba502cc' value='0x" DATA.LONG(A:0xa502cc) "' name='RPMH_BCM_SHADOW_STATUS_DRV5_AGG_BW_ND12'/>"
WRITE #1 "        <register address='0xba502d0' value='0x" DATA.LONG(A:0xa502d0) "' name='RPMH_BCM_SHADOW_STATUS_DRV5_AGG_BW_ND13'/>"
WRITE #1 "        <register address='0xba502d4' value='0x" DATA.LONG(A:0xa502d4) "' name='RPMH_BCM_SHADOW_STATUS_DRV5_AGG_BW_ND14'/>"
WRITE #1 "        <register address='0xba502d8' value='0x" DATA.LONG(A:0xa502d8) "' name='RPMH_BCM_SHADOW_STATUS_DRV5_AGG_BW_ND15'/>"
WRITE #1 "        <register address='0xba502dc' value='0x" DATA.LONG(A:0xa502dc) "' name='RPMH_BCM_SHADOW_STATUS_DRV5_AGG_BW_ND16'/>"
WRITE #1 "        <register address='0xba502e0' value='0x" DATA.LONG(A:0xa502e0) "' name='RPMH_BCM_SHADOW_STATUS_DRV5_AGG_BW_ND17'/>"
WRITE #1 "        <register address='0xba502e4' value='0x" DATA.LONG(A:0xa502e4) "' name='RPMH_BCM_SHADOW_STATUS_DRV5_AGG_BW_ND18'/>"
WRITE #1 "        <register address='0xba502e8' value='0x" DATA.LONG(A:0xa502e8) "' name='RPMH_BCM_SHADOW_STATUS_DRV5_AGG_BW_ND19'/>"
WRITE #1 "        <register address='0xba502ec' value='0x" DATA.LONG(A:0xa502ec) "' name='RPMH_BCM_SHADOW_STATUS_DRV5_AGG_BW_ND20'/>"
WRITE #1 "        <register address='0xba502f0' value='0x" DATA.LONG(A:0xa502f0) "' name='RPMH_BCM_SHADOW_STATUS_DRV5_AGG_BW_ND21'/>"
WRITE #1 "        <register address='0xba502f4' value='0x" DATA.LONG(A:0xa502f4) "' name='RPMH_BCM_SHADOW_STATUS_DRV5_AGG_BW_ND22'/>"
WRITE #1 "        <register address='0xba502f8' value='0x" DATA.LONG(A:0xa502f8) "' name='RPMH_BCM_SHADOW_STATUS_DRV5_AGG_BW_ND23'/>"
WRITE #1 "        <register address='0xba502fc' value='0x" DATA.LONG(A:0xa502fc) "' name='RPMH_BCM_SHADOW_STATUS_DRV5_AGG_BW_ND24'/>"
WRITE #1 "        <register address='0xba50300' value='0x" DATA.LONG(A:0xa50300) "' name='RPMH_BCM_SHADOW_STATUS_DRV5_AGG_BW_ND25'/>"
WRITE #1 "        <register address='0xba50304' value='0x" DATA.LONG(A:0xa50304) "' name='RPMH_BCM_SHADOW_STATUS_DRV5_AGG_BW_ND26'/>"
WRITE #1 "        <register address='0xba50308' value='0x" DATA.LONG(A:0xa50308) "' name='RPMH_BCM_SHADOW_STATUS_DRV5_AGG_BW_ND27'/>"
WRITE #1 "        <register address='0xba5030c' value='0x" DATA.LONG(A:0xa5030c) "' name='RPMH_BCM_SHADOW_STATUS_DRV5_AGG_BW_ND28'/>"
WRITE #1 "        <register address='0xba50310' value='0x" DATA.LONG(A:0xa50310) "' name='RPMH_BCM_SHADOW_STATUS_DRV5_AGG_BW_ND29'/>"
WRITE #1 "        <register address='0xba50314' value='0x" DATA.LONG(A:0xa50314) "' name='RPMH_BCM_SHADOW_STATUS_DRV5_AGG_BW_ND30'/>"
WRITE #1 "        <register address='0xba50318' value='0x" DATA.LONG(A:0xa50318) "' name='RPMH_BCM_SHADOW_STATUS_DRV5_AGG_BW_ND31'/>"
WRITE #1 "        <register address='0xba5031c' value='0x" DATA.LONG(A:0xa5031c) "' name='RPMH_BCM_SHADOW_STATUS_DRV5_AGG_BW_ND32'/>"
WRITE #1 "        <register address='0xba50320' value='0x" DATA.LONG(A:0xa50320) "' name='RPMH_BCM_SHADOW_STATUS_DRV5_AGG_BW_ND33'/>"
WRITE #1 "        <register address='0xba50324' value='0x" DATA.LONG(A:0xa50324) "' name='RPMH_BCM_SHADOW_STATUS_DRV5_AGG_BW_ND34'/>"
WRITE #1 "        <register address='0xba50328' value='0x" DATA.LONG(A:0xa50328) "' name='RPMH_BCM_SHADOW_STATUS_DRV5_AGG_BW_ND35'/>"
WRITE #1 "        <register address='0xba5032c' value='0x" DATA.LONG(A:0xa5032c) "' name='RPMH_BCM_SHADOW_STATUS_DRV5_AGG_BW_ND36'/>"
WRITE #1 "        <register address='0xba50330' value='0x" DATA.LONG(A:0xa50330) "' name='RPMH_BCM_SHADOW_STATUS_DRV5_AGG_BW_ND37'/>"
WRITE #1 "        <register address='0xba50334' value='0x" DATA.LONG(A:0xa50334) "' name='RPMH_BCM_SHADOW_STATUS_DRV5_AGG_BW_ND38'/>"
WRITE #1 "        <register address='0xba50338' value='0x" DATA.LONG(A:0xa50338) "' name='RPMH_BCM_SHADOW_STATUS_DRV5_AGG_BW_ND39'/>"
WRITE #1 "        <register address='0xba5033c' value='0x" DATA.LONG(A:0xa5033c) "' name='RPMH_BCM_SHADOW_STATUS_DRV5_AGG_BW_ND40'/>"
WRITE #1 "        <register address='0xba50340' value='0x" DATA.LONG(A:0xa50340) "' name='RPMH_BCM_SHADOW_STATUS_DRV5_AGG_BW_ND41'/>"
WRITE #1 "        <register address='0xba50344' value='0x" DATA.LONG(A:0xa50344) "' name='RPMH_BCM_SHADOW_STATUS_DRV5_AGG_BW_ND42'/>"
WRITE #1 "        <register address='0xba50348' value='0x" DATA.LONG(A:0xa50348) "' name='RPMH_BCM_SHADOW_STATUS_DRV5_AGG_BW_ND43'/>"
WRITE #1 "        <register address='0xba5034c' value='0x" DATA.LONG(A:0xa5034c) "' name='RPMH_BCM_SHADOW_STATUS_DRV5_AGG_BW_ND44'/>"
WRITE #1 "        <register address='0xba50350' value='0x" DATA.LONG(A:0xa50350) "' name='RPMH_BCM_SHADOW_STATUS_DRV5_AGG_BW_ND45'/>"
WRITE #1 "        <register address='0xba50354' value='0x" DATA.LONG(A:0xa50354) "' name='RPMH_BCM_SHADOW_STATUS_DRV5_AGG_BW_ND46'/>"
WRITE #1 "        <register address='0xba50358' value='0x" DATA.LONG(A:0xa50358) "' name='RPMH_BCM_SHADOW_STATUS_DRV5_AGG_BW_ND47'/>"
WRITE #1 "        <register address='0xba6029c' value='0x" DATA.LONG(A:0xa6029c) "' name='RPMH_BCM_SHADOW_STATUS_DRV6_AGG_BW_ND0'/>"
WRITE #1 "        <register address='0xba602a0' value='0x" DATA.LONG(A:0xa602a0) "' name='RPMH_BCM_SHADOW_STATUS_DRV6_AGG_BW_ND1'/>"
WRITE #1 "        <register address='0xba602a4' value='0x" DATA.LONG(A:0xa602a4) "' name='RPMH_BCM_SHADOW_STATUS_DRV6_AGG_BW_ND2'/>"
WRITE #1 "        <register address='0xba602a8' value='0x" DATA.LONG(A:0xa602a8) "' name='RPMH_BCM_SHADOW_STATUS_DRV6_AGG_BW_ND3'/>"
WRITE #1 "        <register address='0xba602ac' value='0x" DATA.LONG(A:0xa602ac) "' name='RPMH_BCM_SHADOW_STATUS_DRV6_AGG_BW_ND4'/>"
WRITE #1 "        <register address='0xba602b0' value='0x" DATA.LONG(A:0xa602b0) "' name='RPMH_BCM_SHADOW_STATUS_DRV6_AGG_BW_ND5'/>"
WRITE #1 "        <register address='0xba602b4' value='0x" DATA.LONG(A:0xa602b4) "' name='RPMH_BCM_SHADOW_STATUS_DRV6_AGG_BW_ND6'/>"
WRITE #1 "        <register address='0xba602b8' value='0x" DATA.LONG(A:0xa602b8) "' name='RPMH_BCM_SHADOW_STATUS_DRV6_AGG_BW_ND7'/>"
WRITE #1 "        <register address='0xba602bc' value='0x" DATA.LONG(A:0xa602bc) "' name='RPMH_BCM_SHADOW_STATUS_DRV6_AGG_BW_ND8'/>"
WRITE #1 "        <register address='0xba602c0' value='0x" DATA.LONG(A:0xa602c0) "' name='RPMH_BCM_SHADOW_STATUS_DRV6_AGG_BW_ND9'/>"
WRITE #1 "        <register address='0xba602c4' value='0x" DATA.LONG(A:0xa602c4) "' name='RPMH_BCM_SHADOW_STATUS_DRV6_AGG_BW_ND10'/>"
WRITE #1 "        <register address='0xba602c8' value='0x" DATA.LONG(A:0xa602c8) "' name='RPMH_BCM_SHADOW_STATUS_DRV6_AGG_BW_ND11'/>"
WRITE #1 "        <register address='0xba602cc' value='0x" DATA.LONG(A:0xa602cc) "' name='RPMH_BCM_SHADOW_STATUS_DRV6_AGG_BW_ND12'/>"
WRITE #1 "        <register address='0xba602d0' value='0x" DATA.LONG(A:0xa602d0) "' name='RPMH_BCM_SHADOW_STATUS_DRV6_AGG_BW_ND13'/>"
WRITE #1 "        <register address='0xba602d4' value='0x" DATA.LONG(A:0xa602d4) "' name='RPMH_BCM_SHADOW_STATUS_DRV6_AGG_BW_ND14'/>"
WRITE #1 "        <register address='0xba602d8' value='0x" DATA.LONG(A:0xa602d8) "' name='RPMH_BCM_SHADOW_STATUS_DRV6_AGG_BW_ND15'/>"
WRITE #1 "        <register address='0xba602dc' value='0x" DATA.LONG(A:0xa602dc) "' name='RPMH_BCM_SHADOW_STATUS_DRV6_AGG_BW_ND16'/>"
WRITE #1 "        <register address='0xba602e0' value='0x" DATA.LONG(A:0xa602e0) "' name='RPMH_BCM_SHADOW_STATUS_DRV6_AGG_BW_ND17'/>"
WRITE #1 "        <register address='0xba602e4' value='0x" DATA.LONG(A:0xa602e4) "' name='RPMH_BCM_SHADOW_STATUS_DRV6_AGG_BW_ND18'/>"
WRITE #1 "        <register address='0xba602e8' value='0x" DATA.LONG(A:0xa602e8) "' name='RPMH_BCM_SHADOW_STATUS_DRV6_AGG_BW_ND19'/>"
WRITE #1 "        <register address='0xba602ec' value='0x" DATA.LONG(A:0xa602ec) "' name='RPMH_BCM_SHADOW_STATUS_DRV6_AGG_BW_ND20'/>"
WRITE #1 "        <register address='0xba602f0' value='0x" DATA.LONG(A:0xa602f0) "' name='RPMH_BCM_SHADOW_STATUS_DRV6_AGG_BW_ND21'/>"
WRITE #1 "        <register address='0xba602f4' value='0x" DATA.LONG(A:0xa602f4) "' name='RPMH_BCM_SHADOW_STATUS_DRV6_AGG_BW_ND22'/>"
WRITE #1 "        <register address='0xba602f8' value='0x" DATA.LONG(A:0xa602f8) "' name='RPMH_BCM_SHADOW_STATUS_DRV6_AGG_BW_ND23'/>"
WRITE #1 "        <register address='0xba602fc' value='0x" DATA.LONG(A:0xa602fc) "' name='RPMH_BCM_SHADOW_STATUS_DRV6_AGG_BW_ND24'/>"
WRITE #1 "        <register address='0xba60300' value='0x" DATA.LONG(A:0xa60300) "' name='RPMH_BCM_SHADOW_STATUS_DRV6_AGG_BW_ND25'/>"
WRITE #1 "        <register address='0xba60304' value='0x" DATA.LONG(A:0xa60304) "' name='RPMH_BCM_SHADOW_STATUS_DRV6_AGG_BW_ND26'/>"
WRITE #1 "        <register address='0xba60308' value='0x" DATA.LONG(A:0xa60308) "' name='RPMH_BCM_SHADOW_STATUS_DRV6_AGG_BW_ND27'/>"
WRITE #1 "        <register address='0xba6030c' value='0x" DATA.LONG(A:0xa6030c) "' name='RPMH_BCM_SHADOW_STATUS_DRV6_AGG_BW_ND28'/>"
WRITE #1 "        <register address='0xba60310' value='0x" DATA.LONG(A:0xa60310) "' name='RPMH_BCM_SHADOW_STATUS_DRV6_AGG_BW_ND29'/>"
WRITE #1 "        <register address='0xba60314' value='0x" DATA.LONG(A:0xa60314) "' name='RPMH_BCM_SHADOW_STATUS_DRV6_AGG_BW_ND30'/>"
WRITE #1 "        <register address='0xba60318' value='0x" DATA.LONG(A:0xa60318) "' name='RPMH_BCM_SHADOW_STATUS_DRV6_AGG_BW_ND31'/>"
WRITE #1 "        <register address='0xba6031c' value='0x" DATA.LONG(A:0xa6031c) "' name='RPMH_BCM_SHADOW_STATUS_DRV6_AGG_BW_ND32'/>"
WRITE #1 "        <register address='0xba60320' value='0x" DATA.LONG(A:0xa60320) "' name='RPMH_BCM_SHADOW_STATUS_DRV6_AGG_BW_ND33'/>"
WRITE #1 "        <register address='0xba60324' value='0x" DATA.LONG(A:0xa60324) "' name='RPMH_BCM_SHADOW_STATUS_DRV6_AGG_BW_ND34'/>"
WRITE #1 "        <register address='0xba60328' value='0x" DATA.LONG(A:0xa60328) "' name='RPMH_BCM_SHADOW_STATUS_DRV6_AGG_BW_ND35'/>"
WRITE #1 "        <register address='0xba6032c' value='0x" DATA.LONG(A:0xa6032c) "' name='RPMH_BCM_SHADOW_STATUS_DRV6_AGG_BW_ND36'/>"
WRITE #1 "        <register address='0xba60330' value='0x" DATA.LONG(A:0xa60330) "' name='RPMH_BCM_SHADOW_STATUS_DRV6_AGG_BW_ND37'/>"
WRITE #1 "        <register address='0xba60334' value='0x" DATA.LONG(A:0xa60334) "' name='RPMH_BCM_SHADOW_STATUS_DRV6_AGG_BW_ND38'/>"
WRITE #1 "        <register address='0xba60338' value='0x" DATA.LONG(A:0xa60338) "' name='RPMH_BCM_SHADOW_STATUS_DRV6_AGG_BW_ND39'/>"
WRITE #1 "        <register address='0xba6033c' value='0x" DATA.LONG(A:0xa6033c) "' name='RPMH_BCM_SHADOW_STATUS_DRV6_AGG_BW_ND40'/>"
WRITE #1 "        <register address='0xba60340' value='0x" DATA.LONG(A:0xa60340) "' name='RPMH_BCM_SHADOW_STATUS_DRV6_AGG_BW_ND41'/>"
WRITE #1 "        <register address='0xba60344' value='0x" DATA.LONG(A:0xa60344) "' name='RPMH_BCM_SHADOW_STATUS_DRV6_AGG_BW_ND42'/>"
WRITE #1 "        <register address='0xba60348' value='0x" DATA.LONG(A:0xa60348) "' name='RPMH_BCM_SHADOW_STATUS_DRV6_AGG_BW_ND43'/>"
WRITE #1 "        <register address='0xba6034c' value='0x" DATA.LONG(A:0xa6034c) "' name='RPMH_BCM_SHADOW_STATUS_DRV6_AGG_BW_ND44'/>"
WRITE #1 "        <register address='0xba60350' value='0x" DATA.LONG(A:0xa60350) "' name='RPMH_BCM_SHADOW_STATUS_DRV6_AGG_BW_ND45'/>"
WRITE #1 "        <register address='0xba60354' value='0x" DATA.LONG(A:0xa60354) "' name='RPMH_BCM_SHADOW_STATUS_DRV6_AGG_BW_ND46'/>"
WRITE #1 "        <register address='0xba60358' value='0x" DATA.LONG(A:0xa60358) "' name='RPMH_BCM_SHADOW_STATUS_DRV6_AGG_BW_ND47'/>"
WRITE #1 "        <register address='0xba7029c' value='0x" DATA.LONG(A:0xa7029c) "' name='RPMH_BCM_SHADOW_STATUS_DRV7_AGG_BW_ND0'/>"
WRITE #1 "        <register address='0xba702a0' value='0x" DATA.LONG(A:0xa702a0) "' name='RPMH_BCM_SHADOW_STATUS_DRV7_AGG_BW_ND1'/>"
WRITE #1 "        <register address='0xba702a4' value='0x" DATA.LONG(A:0xa702a4) "' name='RPMH_BCM_SHADOW_STATUS_DRV7_AGG_BW_ND2'/>"
WRITE #1 "        <register address='0xba702a8' value='0x" DATA.LONG(A:0xa702a8) "' name='RPMH_BCM_SHADOW_STATUS_DRV7_AGG_BW_ND3'/>"
WRITE #1 "        <register address='0xba702ac' value='0x" DATA.LONG(A:0xa702ac) "' name='RPMH_BCM_SHADOW_STATUS_DRV7_AGG_BW_ND4'/>"
WRITE #1 "        <register address='0xba702b0' value='0x" DATA.LONG(A:0xa702b0) "' name='RPMH_BCM_SHADOW_STATUS_DRV7_AGG_BW_ND5'/>"
WRITE #1 "        <register address='0xba702b4' value='0x" DATA.LONG(A:0xa702b4) "' name='RPMH_BCM_SHADOW_STATUS_DRV7_AGG_BW_ND6'/>"
WRITE #1 "        <register address='0xba702b8' value='0x" DATA.LONG(A:0xa702b8) "' name='RPMH_BCM_SHADOW_STATUS_DRV7_AGG_BW_ND7'/>"
WRITE #1 "        <register address='0xba702bc' value='0x" DATA.LONG(A:0xa702bc) "' name='RPMH_BCM_SHADOW_STATUS_DRV7_AGG_BW_ND8'/>"
WRITE #1 "        <register address='0xba702c0' value='0x" DATA.LONG(A:0xa702c0) "' name='RPMH_BCM_SHADOW_STATUS_DRV7_AGG_BW_ND9'/>"
WRITE #1 "        <register address='0xba702c4' value='0x" DATA.LONG(A:0xa702c4) "' name='RPMH_BCM_SHADOW_STATUS_DRV7_AGG_BW_ND10'/>"
WRITE #1 "        <register address='0xba702c8' value='0x" DATA.LONG(A:0xa702c8) "' name='RPMH_BCM_SHADOW_STATUS_DRV7_AGG_BW_ND11'/>"
WRITE #1 "        <register address='0xba702cc' value='0x" DATA.LONG(A:0xa702cc) "' name='RPMH_BCM_SHADOW_STATUS_DRV7_AGG_BW_ND12'/>"
WRITE #1 "        <register address='0xba702d0' value='0x" DATA.LONG(A:0xa702d0) "' name='RPMH_BCM_SHADOW_STATUS_DRV7_AGG_BW_ND13'/>"
WRITE #1 "        <register address='0xba702d4' value='0x" DATA.LONG(A:0xa702d4) "' name='RPMH_BCM_SHADOW_STATUS_DRV7_AGG_BW_ND14'/>"
WRITE #1 "        <register address='0xba702d8' value='0x" DATA.LONG(A:0xa702d8) "' name='RPMH_BCM_SHADOW_STATUS_DRV7_AGG_BW_ND15'/>"
WRITE #1 "        <register address='0xba702dc' value='0x" DATA.LONG(A:0xa702dc) "' name='RPMH_BCM_SHADOW_STATUS_DRV7_AGG_BW_ND16'/>"
WRITE #1 "        <register address='0xba702e0' value='0x" DATA.LONG(A:0xa702e0) "' name='RPMH_BCM_SHADOW_STATUS_DRV7_AGG_BW_ND17'/>"
WRITE #1 "        <register address='0xba702e4' value='0x" DATA.LONG(A:0xa702e4) "' name='RPMH_BCM_SHADOW_STATUS_DRV7_AGG_BW_ND18'/>"
WRITE #1 "        <register address='0xba702e8' value='0x" DATA.LONG(A:0xa702e8) "' name='RPMH_BCM_SHADOW_STATUS_DRV7_AGG_BW_ND19'/>"
WRITE #1 "        <register address='0xba702ec' value='0x" DATA.LONG(A:0xa702ec) "' name='RPMH_BCM_SHADOW_STATUS_DRV7_AGG_BW_ND20'/>"
WRITE #1 "        <register address='0xba702f0' value='0x" DATA.LONG(A:0xa702f0) "' name='RPMH_BCM_SHADOW_STATUS_DRV7_AGG_BW_ND21'/>"
WRITE #1 "        <register address='0xba702f4' value='0x" DATA.LONG(A:0xa702f4) "' name='RPMH_BCM_SHADOW_STATUS_DRV7_AGG_BW_ND22'/>"
WRITE #1 "        <register address='0xba702f8' value='0x" DATA.LONG(A:0xa702f8) "' name='RPMH_BCM_SHADOW_STATUS_DRV7_AGG_BW_ND23'/>"
WRITE #1 "        <register address='0xba702fc' value='0x" DATA.LONG(A:0xa702fc) "' name='RPMH_BCM_SHADOW_STATUS_DRV7_AGG_BW_ND24'/>"
WRITE #1 "        <register address='0xba70300' value='0x" DATA.LONG(A:0xa70300) "' name='RPMH_BCM_SHADOW_STATUS_DRV7_AGG_BW_ND25'/>"
WRITE #1 "        <register address='0xba70304' value='0x" DATA.LONG(A:0xa70304) "' name='RPMH_BCM_SHADOW_STATUS_DRV7_AGG_BW_ND26'/>"
WRITE #1 "        <register address='0xba70308' value='0x" DATA.LONG(A:0xa70308) "' name='RPMH_BCM_SHADOW_STATUS_DRV7_AGG_BW_ND27'/>"
WRITE #1 "        <register address='0xba7030c' value='0x" DATA.LONG(A:0xa7030c) "' name='RPMH_BCM_SHADOW_STATUS_DRV7_AGG_BW_ND28'/>"
WRITE #1 "        <register address='0xba70310' value='0x" DATA.LONG(A:0xa70310) "' name='RPMH_BCM_SHADOW_STATUS_DRV7_AGG_BW_ND29'/>"
WRITE #1 "        <register address='0xba70314' value='0x" DATA.LONG(A:0xa70314) "' name='RPMH_BCM_SHADOW_STATUS_DRV7_AGG_BW_ND30'/>"
WRITE #1 "        <register address='0xba70318' value='0x" DATA.LONG(A:0xa70318) "' name='RPMH_BCM_SHADOW_STATUS_DRV7_AGG_BW_ND31'/>"
WRITE #1 "        <register address='0xba7031c' value='0x" DATA.LONG(A:0xa7031c) "' name='RPMH_BCM_SHADOW_STATUS_DRV7_AGG_BW_ND32'/>"
WRITE #1 "        <register address='0xba70320' value='0x" DATA.LONG(A:0xa70320) "' name='RPMH_BCM_SHADOW_STATUS_DRV7_AGG_BW_ND33'/>"
WRITE #1 "        <register address='0xba70324' value='0x" DATA.LONG(A:0xa70324) "' name='RPMH_BCM_SHADOW_STATUS_DRV7_AGG_BW_ND34'/>"
WRITE #1 "        <register address='0xba70328' value='0x" DATA.LONG(A:0xa70328) "' name='RPMH_BCM_SHADOW_STATUS_DRV7_AGG_BW_ND35'/>"
WRITE #1 "        <register address='0xba7032c' value='0x" DATA.LONG(A:0xa7032c) "' name='RPMH_BCM_SHADOW_STATUS_DRV7_AGG_BW_ND36'/>"
WRITE #1 "        <register address='0xba70330' value='0x" DATA.LONG(A:0xa70330) "' name='RPMH_BCM_SHADOW_STATUS_DRV7_AGG_BW_ND37'/>"
WRITE #1 "        <register address='0xba70334' value='0x" DATA.LONG(A:0xa70334) "' name='RPMH_BCM_SHADOW_STATUS_DRV7_AGG_BW_ND38'/>"
WRITE #1 "        <register address='0xba70338' value='0x" DATA.LONG(A:0xa70338) "' name='RPMH_BCM_SHADOW_STATUS_DRV7_AGG_BW_ND39'/>"
WRITE #1 "        <register address='0xba7033c' value='0x" DATA.LONG(A:0xa7033c) "' name='RPMH_BCM_SHADOW_STATUS_DRV7_AGG_BW_ND40'/>"
WRITE #1 "        <register address='0xba70340' value='0x" DATA.LONG(A:0xa70340) "' name='RPMH_BCM_SHADOW_STATUS_DRV7_AGG_BW_ND41'/>"
WRITE #1 "        <register address='0xba70344' value='0x" DATA.LONG(A:0xa70344) "' name='RPMH_BCM_SHADOW_STATUS_DRV7_AGG_BW_ND42'/>"
WRITE #1 "        <register address='0xba70348' value='0x" DATA.LONG(A:0xa70348) "' name='RPMH_BCM_SHADOW_STATUS_DRV7_AGG_BW_ND43'/>"
WRITE #1 "        <register address='0xba7034c' value='0x" DATA.LONG(A:0xa7034c) "' name='RPMH_BCM_SHADOW_STATUS_DRV7_AGG_BW_ND44'/>"
WRITE #1 "        <register address='0xba70350' value='0x" DATA.LONG(A:0xa70350) "' name='RPMH_BCM_SHADOW_STATUS_DRV7_AGG_BW_ND45'/>"
WRITE #1 "        <register address='0xba70354' value='0x" DATA.LONG(A:0xa70354) "' name='RPMH_BCM_SHADOW_STATUS_DRV7_AGG_BW_ND46'/>"
WRITE #1 "        <register address='0xba70358' value='0x" DATA.LONG(A:0xa70358) "' name='RPMH_BCM_SHADOW_STATUS_DRV7_AGG_BW_ND47'/>"
WRITE #1 "        <register address='0xba8029c' value='0x" DATA.LONG(A:0xa8029c) "' name='RPMH_BCM_SHADOW_STATUS_DRV8_AGG_BW_ND0'/>"
WRITE #1 "        <register address='0xba802a0' value='0x" DATA.LONG(A:0xa802a0) "' name='RPMH_BCM_SHADOW_STATUS_DRV8_AGG_BW_ND1'/>"
WRITE #1 "        <register address='0xba802a4' value='0x" DATA.LONG(A:0xa802a4) "' name='RPMH_BCM_SHADOW_STATUS_DRV8_AGG_BW_ND2'/>"
WRITE #1 "        <register address='0xba802a8' value='0x" DATA.LONG(A:0xa802a8) "' name='RPMH_BCM_SHADOW_STATUS_DRV8_AGG_BW_ND3'/>"
WRITE #1 "        <register address='0xba802ac' value='0x" DATA.LONG(A:0xa802ac) "' name='RPMH_BCM_SHADOW_STATUS_DRV8_AGG_BW_ND4'/>"
WRITE #1 "        <register address='0xba802b0' value='0x" DATA.LONG(A:0xa802b0) "' name='RPMH_BCM_SHADOW_STATUS_DRV8_AGG_BW_ND5'/>"
WRITE #1 "        <register address='0xba802b4' value='0x" DATA.LONG(A:0xa802b4) "' name='RPMH_BCM_SHADOW_STATUS_DRV8_AGG_BW_ND6'/>"
WRITE #1 "        <register address='0xba802b8' value='0x" DATA.LONG(A:0xa802b8) "' name='RPMH_BCM_SHADOW_STATUS_DRV8_AGG_BW_ND7'/>"
WRITE #1 "        <register address='0xba802bc' value='0x" DATA.LONG(A:0xa802bc) "' name='RPMH_BCM_SHADOW_STATUS_DRV8_AGG_BW_ND8'/>"
WRITE #1 "        <register address='0xba802c0' value='0x" DATA.LONG(A:0xa802c0) "' name='RPMH_BCM_SHADOW_STATUS_DRV8_AGG_BW_ND9'/>"
WRITE #1 "        <register address='0xba802c4' value='0x" DATA.LONG(A:0xa802c4) "' name='RPMH_BCM_SHADOW_STATUS_DRV8_AGG_BW_ND10'/>"
WRITE #1 "        <register address='0xba802c8' value='0x" DATA.LONG(A:0xa802c8) "' name='RPMH_BCM_SHADOW_STATUS_DRV8_AGG_BW_ND11'/>"
WRITE #1 "        <register address='0xba802cc' value='0x" DATA.LONG(A:0xa802cc) "' name='RPMH_BCM_SHADOW_STATUS_DRV8_AGG_BW_ND12'/>"
WRITE #1 "        <register address='0xba802d0' value='0x" DATA.LONG(A:0xa802d0) "' name='RPMH_BCM_SHADOW_STATUS_DRV8_AGG_BW_ND13'/>"
WRITE #1 "        <register address='0xba802d4' value='0x" DATA.LONG(A:0xa802d4) "' name='RPMH_BCM_SHADOW_STATUS_DRV8_AGG_BW_ND14'/>"
WRITE #1 "        <register address='0xba802d8' value='0x" DATA.LONG(A:0xa802d8) "' name='RPMH_BCM_SHADOW_STATUS_DRV8_AGG_BW_ND15'/>"
WRITE #1 "        <register address='0xba802dc' value='0x" DATA.LONG(A:0xa802dc) "' name='RPMH_BCM_SHADOW_STATUS_DRV8_AGG_BW_ND16'/>"
WRITE #1 "        <register address='0xba802e0' value='0x" DATA.LONG(A:0xa802e0) "' name='RPMH_BCM_SHADOW_STATUS_DRV8_AGG_BW_ND17'/>"
WRITE #1 "        <register address='0xba802e4' value='0x" DATA.LONG(A:0xa802e4) "' name='RPMH_BCM_SHADOW_STATUS_DRV8_AGG_BW_ND18'/>"
WRITE #1 "        <register address='0xba802e8' value='0x" DATA.LONG(A:0xa802e8) "' name='RPMH_BCM_SHADOW_STATUS_DRV8_AGG_BW_ND19'/>"
WRITE #1 "        <register address='0xba802ec' value='0x" DATA.LONG(A:0xa802ec) "' name='RPMH_BCM_SHADOW_STATUS_DRV8_AGG_BW_ND20'/>"
WRITE #1 "        <register address='0xba802f0' value='0x" DATA.LONG(A:0xa802f0) "' name='RPMH_BCM_SHADOW_STATUS_DRV8_AGG_BW_ND21'/>"
WRITE #1 "        <register address='0xba802f4' value='0x" DATA.LONG(A:0xa802f4) "' name='RPMH_BCM_SHADOW_STATUS_DRV8_AGG_BW_ND22'/>"
WRITE #1 "        <register address='0xba802f8' value='0x" DATA.LONG(A:0xa802f8) "' name='RPMH_BCM_SHADOW_STATUS_DRV8_AGG_BW_ND23'/>"
WRITE #1 "        <register address='0xba802fc' value='0x" DATA.LONG(A:0xa802fc) "' name='RPMH_BCM_SHADOW_STATUS_DRV8_AGG_BW_ND24'/>"
WRITE #1 "        <register address='0xba80300' value='0x" DATA.LONG(A:0xa80300) "' name='RPMH_BCM_SHADOW_STATUS_DRV8_AGG_BW_ND25'/>"
WRITE #1 "        <register address='0xba80304' value='0x" DATA.LONG(A:0xa80304) "' name='RPMH_BCM_SHADOW_STATUS_DRV8_AGG_BW_ND26'/>"
WRITE #1 "        <register address='0xba80308' value='0x" DATA.LONG(A:0xa80308) "' name='RPMH_BCM_SHADOW_STATUS_DRV8_AGG_BW_ND27'/>"
WRITE #1 "        <register address='0xba8030c' value='0x" DATA.LONG(A:0xa8030c) "' name='RPMH_BCM_SHADOW_STATUS_DRV8_AGG_BW_ND28'/>"
WRITE #1 "        <register address='0xba80310' value='0x" DATA.LONG(A:0xa80310) "' name='RPMH_BCM_SHADOW_STATUS_DRV8_AGG_BW_ND29'/>"
WRITE #1 "        <register address='0xba80314' value='0x" DATA.LONG(A:0xa80314) "' name='RPMH_BCM_SHADOW_STATUS_DRV8_AGG_BW_ND30'/>"
WRITE #1 "        <register address='0xba80318' value='0x" DATA.LONG(A:0xa80318) "' name='RPMH_BCM_SHADOW_STATUS_DRV8_AGG_BW_ND31'/>"
WRITE #1 "        <register address='0xba8031c' value='0x" DATA.LONG(A:0xa8031c) "' name='RPMH_BCM_SHADOW_STATUS_DRV8_AGG_BW_ND32'/>"
WRITE #1 "        <register address='0xba80320' value='0x" DATA.LONG(A:0xa80320) "' name='RPMH_BCM_SHADOW_STATUS_DRV8_AGG_BW_ND33'/>"
WRITE #1 "        <register address='0xba80324' value='0x" DATA.LONG(A:0xa80324) "' name='RPMH_BCM_SHADOW_STATUS_DRV8_AGG_BW_ND34'/>"
WRITE #1 "        <register address='0xba80328' value='0x" DATA.LONG(A:0xa80328) "' name='RPMH_BCM_SHADOW_STATUS_DRV8_AGG_BW_ND35'/>"
WRITE #1 "        <register address='0xba8032c' value='0x" DATA.LONG(A:0xa8032c) "' name='RPMH_BCM_SHADOW_STATUS_DRV8_AGG_BW_ND36'/>"
WRITE #1 "        <register address='0xba80330' value='0x" DATA.LONG(A:0xa80330) "' name='RPMH_BCM_SHADOW_STATUS_DRV8_AGG_BW_ND37'/>"
WRITE #1 "        <register address='0xba80334' value='0x" DATA.LONG(A:0xa80334) "' name='RPMH_BCM_SHADOW_STATUS_DRV8_AGG_BW_ND38'/>"
WRITE #1 "        <register address='0xba80338' value='0x" DATA.LONG(A:0xa80338) "' name='RPMH_BCM_SHADOW_STATUS_DRV8_AGG_BW_ND39'/>"
WRITE #1 "        <register address='0xba8033c' value='0x" DATA.LONG(A:0xa8033c) "' name='RPMH_BCM_SHADOW_STATUS_DRV8_AGG_BW_ND40'/>"
WRITE #1 "        <register address='0xba80340' value='0x" DATA.LONG(A:0xa80340) "' name='RPMH_BCM_SHADOW_STATUS_DRV8_AGG_BW_ND41'/>"
WRITE #1 "        <register address='0xba80344' value='0x" DATA.LONG(A:0xa80344) "' name='RPMH_BCM_SHADOW_STATUS_DRV8_AGG_BW_ND42'/>"
WRITE #1 "        <register address='0xba80348' value='0x" DATA.LONG(A:0xa80348) "' name='RPMH_BCM_SHADOW_STATUS_DRV8_AGG_BW_ND43'/>"
WRITE #1 "        <register address='0xba8034c' value='0x" DATA.LONG(A:0xa8034c) "' name='RPMH_BCM_SHADOW_STATUS_DRV8_AGG_BW_ND44'/>"
WRITE #1 "        <register address='0xba80350' value='0x" DATA.LONG(A:0xa80350) "' name='RPMH_BCM_SHADOW_STATUS_DRV8_AGG_BW_ND45'/>"
WRITE #1 "        <register address='0xba80354' value='0x" DATA.LONG(A:0xa80354) "' name='RPMH_BCM_SHADOW_STATUS_DRV8_AGG_BW_ND46'/>"
WRITE #1 "        <register address='0xba80358' value='0x" DATA.LONG(A:0xa80358) "' name='RPMH_BCM_SHADOW_STATUS_DRV8_AGG_BW_ND47'/>"
WRITE #1 "        <register address='0xba9029c' value='0x" DATA.LONG(A:0xa9029c) "' name='RPMH_BCM_SHADOW_STATUS_DRV9_AGG_BW_ND0'/>"
WRITE #1 "        <register address='0xba902a0' value='0x" DATA.LONG(A:0xa902a0) "' name='RPMH_BCM_SHADOW_STATUS_DRV9_AGG_BW_ND1'/>"
WRITE #1 "        <register address='0xba902a4' value='0x" DATA.LONG(A:0xa902a4) "' name='RPMH_BCM_SHADOW_STATUS_DRV9_AGG_BW_ND2'/>"
WRITE #1 "        <register address='0xba902a8' value='0x" DATA.LONG(A:0xa902a8) "' name='RPMH_BCM_SHADOW_STATUS_DRV9_AGG_BW_ND3'/>"
WRITE #1 "        <register address='0xba902ac' value='0x" DATA.LONG(A:0xa902ac) "' name='RPMH_BCM_SHADOW_STATUS_DRV9_AGG_BW_ND4'/>"
WRITE #1 "        <register address='0xba902b0' value='0x" DATA.LONG(A:0xa902b0) "' name='RPMH_BCM_SHADOW_STATUS_DRV9_AGG_BW_ND5'/>"
WRITE #1 "        <register address='0xba902b4' value='0x" DATA.LONG(A:0xa902b4) "' name='RPMH_BCM_SHADOW_STATUS_DRV9_AGG_BW_ND6'/>"
WRITE #1 "        <register address='0xba902b8' value='0x" DATA.LONG(A:0xa902b8) "' name='RPMH_BCM_SHADOW_STATUS_DRV9_AGG_BW_ND7'/>"
WRITE #1 "        <register address='0xba902bc' value='0x" DATA.LONG(A:0xa902bc) "' name='RPMH_BCM_SHADOW_STATUS_DRV9_AGG_BW_ND8'/>"
WRITE #1 "        <register address='0xba902c0' value='0x" DATA.LONG(A:0xa902c0) "' name='RPMH_BCM_SHADOW_STATUS_DRV9_AGG_BW_ND9'/>"
WRITE #1 "        <register address='0xba902c4' value='0x" DATA.LONG(A:0xa902c4) "' name='RPMH_BCM_SHADOW_STATUS_DRV9_AGG_BW_ND10'/>"
WRITE #1 "        <register address='0xba902c8' value='0x" DATA.LONG(A:0xa902c8) "' name='RPMH_BCM_SHADOW_STATUS_DRV9_AGG_BW_ND11'/>"
WRITE #1 "        <register address='0xba902cc' value='0x" DATA.LONG(A:0xa902cc) "' name='RPMH_BCM_SHADOW_STATUS_DRV9_AGG_BW_ND12'/>"
WRITE #1 "        <register address='0xba902d0' value='0x" DATA.LONG(A:0xa902d0) "' name='RPMH_BCM_SHADOW_STATUS_DRV9_AGG_BW_ND13'/>"
WRITE #1 "        <register address='0xba902d4' value='0x" DATA.LONG(A:0xa902d4) "' name='RPMH_BCM_SHADOW_STATUS_DRV9_AGG_BW_ND14'/>"
WRITE #1 "        <register address='0xba902d8' value='0x" DATA.LONG(A:0xa902d8) "' name='RPMH_BCM_SHADOW_STATUS_DRV9_AGG_BW_ND15'/>"
WRITE #1 "        <register address='0xba902dc' value='0x" DATA.LONG(A:0xa902dc) "' name='RPMH_BCM_SHADOW_STATUS_DRV9_AGG_BW_ND16'/>"
WRITE #1 "        <register address='0xba902e0' value='0x" DATA.LONG(A:0xa902e0) "' name='RPMH_BCM_SHADOW_STATUS_DRV9_AGG_BW_ND17'/>"
WRITE #1 "        <register address='0xba902e4' value='0x" DATA.LONG(A:0xa902e4) "' name='RPMH_BCM_SHADOW_STATUS_DRV9_AGG_BW_ND18'/>"
WRITE #1 "        <register address='0xba902e8' value='0x" DATA.LONG(A:0xa902e8) "' name='RPMH_BCM_SHADOW_STATUS_DRV9_AGG_BW_ND19'/>"
WRITE #1 "        <register address='0xba902ec' value='0x" DATA.LONG(A:0xa902ec) "' name='RPMH_BCM_SHADOW_STATUS_DRV9_AGG_BW_ND20'/>"
WRITE #1 "        <register address='0xba902f0' value='0x" DATA.LONG(A:0xa902f0) "' name='RPMH_BCM_SHADOW_STATUS_DRV9_AGG_BW_ND21'/>"
WRITE #1 "        <register address='0xba902f4' value='0x" DATA.LONG(A:0xa902f4) "' name='RPMH_BCM_SHADOW_STATUS_DRV9_AGG_BW_ND22'/>"
WRITE #1 "        <register address='0xba902f8' value='0x" DATA.LONG(A:0xa902f8) "' name='RPMH_BCM_SHADOW_STATUS_DRV9_AGG_BW_ND23'/>"
WRITE #1 "        <register address='0xba902fc' value='0x" DATA.LONG(A:0xa902fc) "' name='RPMH_BCM_SHADOW_STATUS_DRV9_AGG_BW_ND24'/>"
WRITE #1 "        <register address='0xba90300' value='0x" DATA.LONG(A:0xa90300) "' name='RPMH_BCM_SHADOW_STATUS_DRV9_AGG_BW_ND25'/>"
WRITE #1 "        <register address='0xba90304' value='0x" DATA.LONG(A:0xa90304) "' name='RPMH_BCM_SHADOW_STATUS_DRV9_AGG_BW_ND26'/>"
WRITE #1 "        <register address='0xba90308' value='0x" DATA.LONG(A:0xa90308) "' name='RPMH_BCM_SHADOW_STATUS_DRV9_AGG_BW_ND27'/>"
WRITE #1 "        <register address='0xba9030c' value='0x" DATA.LONG(A:0xa9030c) "' name='RPMH_BCM_SHADOW_STATUS_DRV9_AGG_BW_ND28'/>"
WRITE #1 "        <register address='0xba90310' value='0x" DATA.LONG(A:0xa90310) "' name='RPMH_BCM_SHADOW_STATUS_DRV9_AGG_BW_ND29'/>"
WRITE #1 "        <register address='0xba90314' value='0x" DATA.LONG(A:0xa90314) "' name='RPMH_BCM_SHADOW_STATUS_DRV9_AGG_BW_ND30'/>"
WRITE #1 "        <register address='0xba90318' value='0x" DATA.LONG(A:0xa90318) "' name='RPMH_BCM_SHADOW_STATUS_DRV9_AGG_BW_ND31'/>"
WRITE #1 "        <register address='0xba9031c' value='0x" DATA.LONG(A:0xa9031c) "' name='RPMH_BCM_SHADOW_STATUS_DRV9_AGG_BW_ND32'/>"
WRITE #1 "        <register address='0xba90320' value='0x" DATA.LONG(A:0xa90320) "' name='RPMH_BCM_SHADOW_STATUS_DRV9_AGG_BW_ND33'/>"
WRITE #1 "        <register address='0xba90324' value='0x" DATA.LONG(A:0xa90324) "' name='RPMH_BCM_SHADOW_STATUS_DRV9_AGG_BW_ND34'/>"
WRITE #1 "        <register address='0xba90328' value='0x" DATA.LONG(A:0xa90328) "' name='RPMH_BCM_SHADOW_STATUS_DRV9_AGG_BW_ND35'/>"
WRITE #1 "        <register address='0xba9032c' value='0x" DATA.LONG(A:0xa9032c) "' name='RPMH_BCM_SHADOW_STATUS_DRV9_AGG_BW_ND36'/>"
WRITE #1 "        <register address='0xba90330' value='0x" DATA.LONG(A:0xa90330) "' name='RPMH_BCM_SHADOW_STATUS_DRV9_AGG_BW_ND37'/>"
WRITE #1 "        <register address='0xba90334' value='0x" DATA.LONG(A:0xa90334) "' name='RPMH_BCM_SHADOW_STATUS_DRV9_AGG_BW_ND38'/>"
WRITE #1 "        <register address='0xba90338' value='0x" DATA.LONG(A:0xa90338) "' name='RPMH_BCM_SHADOW_STATUS_DRV9_AGG_BW_ND39'/>"
WRITE #1 "        <register address='0xba9033c' value='0x" DATA.LONG(A:0xa9033c) "' name='RPMH_BCM_SHADOW_STATUS_DRV9_AGG_BW_ND40'/>"
WRITE #1 "        <register address='0xba90340' value='0x" DATA.LONG(A:0xa90340) "' name='RPMH_BCM_SHADOW_STATUS_DRV9_AGG_BW_ND41'/>"
WRITE #1 "        <register address='0xba90344' value='0x" DATA.LONG(A:0xa90344) "' name='RPMH_BCM_SHADOW_STATUS_DRV9_AGG_BW_ND42'/>"
WRITE #1 "        <register address='0xba90348' value='0x" DATA.LONG(A:0xa90348) "' name='RPMH_BCM_SHADOW_STATUS_DRV9_AGG_BW_ND43'/>"
WRITE #1 "        <register address='0xba9034c' value='0x" DATA.LONG(A:0xa9034c) "' name='RPMH_BCM_SHADOW_STATUS_DRV9_AGG_BW_ND44'/>"
WRITE #1 "        <register address='0xba90350' value='0x" DATA.LONG(A:0xa90350) "' name='RPMH_BCM_SHADOW_STATUS_DRV9_AGG_BW_ND45'/>"
WRITE #1 "        <register address='0xba90354' value='0x" DATA.LONG(A:0xa90354) "' name='RPMH_BCM_SHADOW_STATUS_DRV9_AGG_BW_ND46'/>"
WRITE #1 "        <register address='0xba90358' value='0x" DATA.LONG(A:0xa90358) "' name='RPMH_BCM_SHADOW_STATUS_DRV9_AGG_BW_ND47'/>"
WRITE #1 "        <register address='0xba0049c' value='0x" DATA.LONG(A:0xa0049c) "' name='RPMH_BCM_SHADOW_STATUS_DRV0_AGG_BW_Z_ND0'/>"
WRITE #1 "        <register address='0xba004a0' value='0x" DATA.LONG(A:0xa004a0) "' name='RPMH_BCM_SHADOW_STATUS_DRV0_AGG_BW_Z_ND1'/>"
WRITE #1 "        <register address='0xba004a4' value='0x" DATA.LONG(A:0xa004a4) "' name='RPMH_BCM_SHADOW_STATUS_DRV0_AGG_BW_Z_ND2'/>"
WRITE #1 "        <register address='0xba004a8' value='0x" DATA.LONG(A:0xa004a8) "' name='RPMH_BCM_SHADOW_STATUS_DRV0_AGG_BW_Z_ND3'/>"
WRITE #1 "        <register address='0xba1049c' value='0x" DATA.LONG(A:0xa1049c) "' name='RPMH_BCM_SHADOW_STATUS_DRV1_AGG_BW_Z_ND0'/>"
WRITE #1 "        <register address='0xba104a0' value='0x" DATA.LONG(A:0xa104a0) "' name='RPMH_BCM_SHADOW_STATUS_DRV1_AGG_BW_Z_ND1'/>"
WRITE #1 "        <register address='0xba104a4' value='0x" DATA.LONG(A:0xa104a4) "' name='RPMH_BCM_SHADOW_STATUS_DRV1_AGG_BW_Z_ND2'/>"
WRITE #1 "        <register address='0xba104a8' value='0x" DATA.LONG(A:0xa104a8) "' name='RPMH_BCM_SHADOW_STATUS_DRV1_AGG_BW_Z_ND3'/>"
WRITE #1 "        <register address='0xba2049c' value='0x" DATA.LONG(A:0xa2049c) "' name='RPMH_BCM_SHADOW_STATUS_DRV2_AGG_BW_Z_ND0'/>"
WRITE #1 "        <register address='0xba204a0' value='0x" DATA.LONG(A:0xa204a0) "' name='RPMH_BCM_SHADOW_STATUS_DRV2_AGG_BW_Z_ND1'/>"
WRITE #1 "        <register address='0xba204a4' value='0x" DATA.LONG(A:0xa204a4) "' name='RPMH_BCM_SHADOW_STATUS_DRV2_AGG_BW_Z_ND2'/>"
WRITE #1 "        <register address='0xba204a8' value='0x" DATA.LONG(A:0xa204a8) "' name='RPMH_BCM_SHADOW_STATUS_DRV2_AGG_BW_Z_ND3'/>"
WRITE #1 "        <register address='0xba3049c' value='0x" DATA.LONG(A:0xa3049c) "' name='RPMH_BCM_SHADOW_STATUS_DRV3_AGG_BW_Z_ND0'/>"
WRITE #1 "        <register address='0xba304a0' value='0x" DATA.LONG(A:0xa304a0) "' name='RPMH_BCM_SHADOW_STATUS_DRV3_AGG_BW_Z_ND1'/>"
WRITE #1 "        <register address='0xba304a4' value='0x" DATA.LONG(A:0xa304a4) "' name='RPMH_BCM_SHADOW_STATUS_DRV3_AGG_BW_Z_ND2'/>"
WRITE #1 "        <register address='0xba304a8' value='0x" DATA.LONG(A:0xa304a8) "' name='RPMH_BCM_SHADOW_STATUS_DRV3_AGG_BW_Z_ND3'/>"
WRITE #1 "        <register address='0xba4049c' value='0x" DATA.LONG(A:0xa4049c) "' name='RPMH_BCM_SHADOW_STATUS_DRV4_AGG_BW_Z_ND0'/>"
WRITE #1 "        <register address='0xba404a0' value='0x" DATA.LONG(A:0xa404a0) "' name='RPMH_BCM_SHADOW_STATUS_DRV4_AGG_BW_Z_ND1'/>"
WRITE #1 "        <register address='0xba404a4' value='0x" DATA.LONG(A:0xa404a4) "' name='RPMH_BCM_SHADOW_STATUS_DRV4_AGG_BW_Z_ND2'/>"
WRITE #1 "        <register address='0xba404a8' value='0x" DATA.LONG(A:0xa404a8) "' name='RPMH_BCM_SHADOW_STATUS_DRV4_AGG_BW_Z_ND3'/>"
WRITE #1 "        <register address='0xba5049c' value='0x" DATA.LONG(A:0xa5049c) "' name='RPMH_BCM_SHADOW_STATUS_DRV5_AGG_BW_Z_ND0'/>"
WRITE #1 "        <register address='0xba504a0' value='0x" DATA.LONG(A:0xa504a0) "' name='RPMH_BCM_SHADOW_STATUS_DRV5_AGG_BW_Z_ND1'/>"
WRITE #1 "        <register address='0xba504a4' value='0x" DATA.LONG(A:0xa504a4) "' name='RPMH_BCM_SHADOW_STATUS_DRV5_AGG_BW_Z_ND2'/>"
WRITE #1 "        <register address='0xba504a8' value='0x" DATA.LONG(A:0xa504a8) "' name='RPMH_BCM_SHADOW_STATUS_DRV5_AGG_BW_Z_ND3'/>"
WRITE #1 "        <register address='0xba6049c' value='0x" DATA.LONG(A:0xa6049c) "' name='RPMH_BCM_SHADOW_STATUS_DRV6_AGG_BW_Z_ND0'/>"
WRITE #1 "        <register address='0xba604a0' value='0x" DATA.LONG(A:0xa604a0) "' name='RPMH_BCM_SHADOW_STATUS_DRV6_AGG_BW_Z_ND1'/>"
WRITE #1 "        <register address='0xba604a4' value='0x" DATA.LONG(A:0xa604a4) "' name='RPMH_BCM_SHADOW_STATUS_DRV6_AGG_BW_Z_ND2'/>"
WRITE #1 "        <register address='0xba604a8' value='0x" DATA.LONG(A:0xa604a8) "' name='RPMH_BCM_SHADOW_STATUS_DRV6_AGG_BW_Z_ND3'/>"
WRITE #1 "        <register address='0xba7049c' value='0x" DATA.LONG(A:0xa7049c) "' name='RPMH_BCM_SHADOW_STATUS_DRV7_AGG_BW_Z_ND0'/>"
WRITE #1 "        <register address='0xba704a0' value='0x" DATA.LONG(A:0xa704a0) "' name='RPMH_BCM_SHADOW_STATUS_DRV7_AGG_BW_Z_ND1'/>"
WRITE #1 "        <register address='0xba704a4' value='0x" DATA.LONG(A:0xa704a4) "' name='RPMH_BCM_SHADOW_STATUS_DRV7_AGG_BW_Z_ND2'/>"
WRITE #1 "        <register address='0xba704a8' value='0x" DATA.LONG(A:0xa704a8) "' name='RPMH_BCM_SHADOW_STATUS_DRV7_AGG_BW_Z_ND3'/>"
WRITE #1 "        <register address='0xba8049c' value='0x" DATA.LONG(A:0xa8049c) "' name='RPMH_BCM_SHADOW_STATUS_DRV8_AGG_BW_Z_ND0'/>"
WRITE #1 "        <register address='0xba804a0' value='0x" DATA.LONG(A:0xa804a0) "' name='RPMH_BCM_SHADOW_STATUS_DRV8_AGG_BW_Z_ND1'/>"
WRITE #1 "        <register address='0xba804a4' value='0x" DATA.LONG(A:0xa804a4) "' name='RPMH_BCM_SHADOW_STATUS_DRV8_AGG_BW_Z_ND2'/>"
WRITE #1 "        <register address='0xba804a8' value='0x" DATA.LONG(A:0xa804a8) "' name='RPMH_BCM_SHADOW_STATUS_DRV8_AGG_BW_Z_ND3'/>"
WRITE #1 "        <register address='0xba9049c' value='0x" DATA.LONG(A:0xa9049c) "' name='RPMH_BCM_SHADOW_STATUS_DRV9_AGG_BW_Z_ND0'/>"
WRITE #1 "        <register address='0xba904a0' value='0x" DATA.LONG(A:0xa904a0) "' name='RPMH_BCM_SHADOW_STATUS_DRV9_AGG_BW_Z_ND1'/>"
WRITE #1 "        <register address='0xba904a4' value='0x" DATA.LONG(A:0xa904a4) "' name='RPMH_BCM_SHADOW_STATUS_DRV9_AGG_BW_Z_ND2'/>"
WRITE #1 "        <register address='0xba904a8' value='0x" DATA.LONG(A:0xa904a8) "' name='RPMH_BCM_SHADOW_STATUS_DRV9_AGG_BW_Z_ND3'/>"
WRITE #1 "        <register address='0xba004ac' value='0x" DATA.LONG(A:0xa004ac) "' name='RPMH_BCM_SHADOW_STATUS_DRV0_BE_CD0'/>"
WRITE #1 "        <register address='0xba004b0' value='0x" DATA.LONG(A:0xa004b0) "' name='RPMH_BCM_SHADOW_STATUS_DRV0_BE_CD1'/>"
WRITE #1 "        <register address='0xba004b4' value='0x" DATA.LONG(A:0xa004b4) "' name='RPMH_BCM_SHADOW_STATUS_DRV0_BE_CD2'/>"
WRITE #1 "        <register address='0xba004b8' value='0x" DATA.LONG(A:0xa004b8) "' name='RPMH_BCM_SHADOW_STATUS_DRV0_BE_CD3'/>"
WRITE #1 "        <register address='0xba004bc' value='0x" DATA.LONG(A:0xa004bc) "' name='RPMH_BCM_SHADOW_STATUS_DRV0_BE_CD4'/>"
WRITE #1 "        <register address='0xba004c0' value='0x" DATA.LONG(A:0xa004c0) "' name='RPMH_BCM_SHADOW_STATUS_DRV0_BE_CD5'/>"
WRITE #1 "        <register address='0xba004c4' value='0x" DATA.LONG(A:0xa004c4) "' name='RPMH_BCM_SHADOW_STATUS_DRV0_BE_CD6'/>"
WRITE #1 "        <register address='0xba004c8' value='0x" DATA.LONG(A:0xa004c8) "' name='RPMH_BCM_SHADOW_STATUS_DRV0_BE_CD7'/>"
WRITE #1 "        <register address='0xba004cc' value='0x" DATA.LONG(A:0xa004cc) "' name='RPMH_BCM_SHADOW_STATUS_DRV0_BE_CD8'/>"
WRITE #1 "        <register address='0xba004d0' value='0x" DATA.LONG(A:0xa004d0) "' name='RPMH_BCM_SHADOW_STATUS_DRV0_BE_CD9'/>"
WRITE #1 "        <register address='0xba004d4' value='0x" DATA.LONG(A:0xa004d4) "' name='RPMH_BCM_SHADOW_STATUS_DRV0_BE_CD10'/>"
WRITE #1 "        <register address='0xba004d8' value='0x" DATA.LONG(A:0xa004d8) "' name='RPMH_BCM_SHADOW_STATUS_DRV0_BE_CD11'/>"
WRITE #1 "        <register address='0xba104ac' value='0x" DATA.LONG(A:0xa104ac) "' name='RPMH_BCM_SHADOW_STATUS_DRV1_BE_CD0'/>"
WRITE #1 "        <register address='0xba104b0' value='0x" DATA.LONG(A:0xa104b0) "' name='RPMH_BCM_SHADOW_STATUS_DRV1_BE_CD1'/>"
WRITE #1 "        <register address='0xba104b4' value='0x" DATA.LONG(A:0xa104b4) "' name='RPMH_BCM_SHADOW_STATUS_DRV1_BE_CD2'/>"
WRITE #1 "        <register address='0xba104b8' value='0x" DATA.LONG(A:0xa104b8) "' name='RPMH_BCM_SHADOW_STATUS_DRV1_BE_CD3'/>"
WRITE #1 "        <register address='0xba104bc' value='0x" DATA.LONG(A:0xa104bc) "' name='RPMH_BCM_SHADOW_STATUS_DRV1_BE_CD4'/>"
WRITE #1 "        <register address='0xba104c0' value='0x" DATA.LONG(A:0xa104c0) "' name='RPMH_BCM_SHADOW_STATUS_DRV1_BE_CD5'/>"
WRITE #1 "        <register address='0xba104c4' value='0x" DATA.LONG(A:0xa104c4) "' name='RPMH_BCM_SHADOW_STATUS_DRV1_BE_CD6'/>"
WRITE #1 "        <register address='0xba104c8' value='0x" DATA.LONG(A:0xa104c8) "' name='RPMH_BCM_SHADOW_STATUS_DRV1_BE_CD7'/>"
WRITE #1 "        <register address='0xba104cc' value='0x" DATA.LONG(A:0xa104cc) "' name='RPMH_BCM_SHADOW_STATUS_DRV1_BE_CD8'/>"
WRITE #1 "        <register address='0xba104d0' value='0x" DATA.LONG(A:0xa104d0) "' name='RPMH_BCM_SHADOW_STATUS_DRV1_BE_CD9'/>"
WRITE #1 "        <register address='0xba104d4' value='0x" DATA.LONG(A:0xa104d4) "' name='RPMH_BCM_SHADOW_STATUS_DRV1_BE_CD10'/>"
WRITE #1 "        <register address='0xba104d8' value='0x" DATA.LONG(A:0xa104d8) "' name='RPMH_BCM_SHADOW_STATUS_DRV1_BE_CD11'/>"
WRITE #1 "        <register address='0xba204ac' value='0x" DATA.LONG(A:0xa204ac) "' name='RPMH_BCM_SHADOW_STATUS_DRV2_BE_CD0'/>"
WRITE #1 "        <register address='0xba204b0' value='0x" DATA.LONG(A:0xa204b0) "' name='RPMH_BCM_SHADOW_STATUS_DRV2_BE_CD1'/>"
WRITE #1 "        <register address='0xba204b4' value='0x" DATA.LONG(A:0xa204b4) "' name='RPMH_BCM_SHADOW_STATUS_DRV2_BE_CD2'/>"
WRITE #1 "        <register address='0xba204b8' value='0x" DATA.LONG(A:0xa204b8) "' name='RPMH_BCM_SHADOW_STATUS_DRV2_BE_CD3'/>"
WRITE #1 "        <register address='0xba204bc' value='0x" DATA.LONG(A:0xa204bc) "' name='RPMH_BCM_SHADOW_STATUS_DRV2_BE_CD4'/>"
WRITE #1 "        <register address='0xba204c0' value='0x" DATA.LONG(A:0xa204c0) "' name='RPMH_BCM_SHADOW_STATUS_DRV2_BE_CD5'/>"
WRITE #1 "        <register address='0xba204c4' value='0x" DATA.LONG(A:0xa204c4) "' name='RPMH_BCM_SHADOW_STATUS_DRV2_BE_CD6'/>"
WRITE #1 "        <register address='0xba204c8' value='0x" DATA.LONG(A:0xa204c8) "' name='RPMH_BCM_SHADOW_STATUS_DRV2_BE_CD7'/>"
WRITE #1 "        <register address='0xba204cc' value='0x" DATA.LONG(A:0xa204cc) "' name='RPMH_BCM_SHADOW_STATUS_DRV2_BE_CD8'/>"
WRITE #1 "        <register address='0xba204d0' value='0x" DATA.LONG(A:0xa204d0) "' name='RPMH_BCM_SHADOW_STATUS_DRV2_BE_CD9'/>"
WRITE #1 "        <register address='0xba204d4' value='0x" DATA.LONG(A:0xa204d4) "' name='RPMH_BCM_SHADOW_STATUS_DRV2_BE_CD10'/>"
WRITE #1 "        <register address='0xba204d8' value='0x" DATA.LONG(A:0xa204d8) "' name='RPMH_BCM_SHADOW_STATUS_DRV2_BE_CD11'/>"
WRITE #1 "        <register address='0xba304ac' value='0x" DATA.LONG(A:0xa304ac) "' name='RPMH_BCM_SHADOW_STATUS_DRV3_BE_CD0'/>"
WRITE #1 "        <register address='0xba304b0' value='0x" DATA.LONG(A:0xa304b0) "' name='RPMH_BCM_SHADOW_STATUS_DRV3_BE_CD1'/>"
WRITE #1 "        <register address='0xba304b4' value='0x" DATA.LONG(A:0xa304b4) "' name='RPMH_BCM_SHADOW_STATUS_DRV3_BE_CD2'/>"
WRITE #1 "        <register address='0xba304b8' value='0x" DATA.LONG(A:0xa304b8) "' name='RPMH_BCM_SHADOW_STATUS_DRV3_BE_CD3'/>"
WRITE #1 "        <register address='0xba304bc' value='0x" DATA.LONG(A:0xa304bc) "' name='RPMH_BCM_SHADOW_STATUS_DRV3_BE_CD4'/>"
WRITE #1 "        <register address='0xba304c0' value='0x" DATA.LONG(A:0xa304c0) "' name='RPMH_BCM_SHADOW_STATUS_DRV3_BE_CD5'/>"
WRITE #1 "        <register address='0xba304c4' value='0x" DATA.LONG(A:0xa304c4) "' name='RPMH_BCM_SHADOW_STATUS_DRV3_BE_CD6'/>"
WRITE #1 "        <register address='0xba304c8' value='0x" DATA.LONG(A:0xa304c8) "' name='RPMH_BCM_SHADOW_STATUS_DRV3_BE_CD7'/>"
WRITE #1 "        <register address='0xba304cc' value='0x" DATA.LONG(A:0xa304cc) "' name='RPMH_BCM_SHADOW_STATUS_DRV3_BE_CD8'/>"
WRITE #1 "        <register address='0xba304d0' value='0x" DATA.LONG(A:0xa304d0) "' name='RPMH_BCM_SHADOW_STATUS_DRV3_BE_CD9'/>"
WRITE #1 "        <register address='0xba304d4' value='0x" DATA.LONG(A:0xa304d4) "' name='RPMH_BCM_SHADOW_STATUS_DRV3_BE_CD10'/>"
WRITE #1 "        <register address='0xba304d8' value='0x" DATA.LONG(A:0xa304d8) "' name='RPMH_BCM_SHADOW_STATUS_DRV3_BE_CD11'/>"
WRITE #1 "        <register address='0xba404ac' value='0x" DATA.LONG(A:0xa404ac) "' name='RPMH_BCM_SHADOW_STATUS_DRV4_BE_CD0'/>"
WRITE #1 "        <register address='0xba404b0' value='0x" DATA.LONG(A:0xa404b0) "' name='RPMH_BCM_SHADOW_STATUS_DRV4_BE_CD1'/>"
WRITE #1 "        <register address='0xba404b4' value='0x" DATA.LONG(A:0xa404b4) "' name='RPMH_BCM_SHADOW_STATUS_DRV4_BE_CD2'/>"
WRITE #1 "        <register address='0xba404b8' value='0x" DATA.LONG(A:0xa404b8) "' name='RPMH_BCM_SHADOW_STATUS_DRV4_BE_CD3'/>"
WRITE #1 "        <register address='0xba404bc' value='0x" DATA.LONG(A:0xa404bc) "' name='RPMH_BCM_SHADOW_STATUS_DRV4_BE_CD4'/>"
WRITE #1 "        <register address='0xba404c0' value='0x" DATA.LONG(A:0xa404c0) "' name='RPMH_BCM_SHADOW_STATUS_DRV4_BE_CD5'/>"
WRITE #1 "        <register address='0xba404c4' value='0x" DATA.LONG(A:0xa404c4) "' name='RPMH_BCM_SHADOW_STATUS_DRV4_BE_CD6'/>"
WRITE #1 "        <register address='0xba404c8' value='0x" DATA.LONG(A:0xa404c8) "' name='RPMH_BCM_SHADOW_STATUS_DRV4_BE_CD7'/>"
WRITE #1 "        <register address='0xba404cc' value='0x" DATA.LONG(A:0xa404cc) "' name='RPMH_BCM_SHADOW_STATUS_DRV4_BE_CD8'/>"
WRITE #1 "        <register address='0xba404d0' value='0x" DATA.LONG(A:0xa404d0) "' name='RPMH_BCM_SHADOW_STATUS_DRV4_BE_CD9'/>"
WRITE #1 "        <register address='0xba404d4' value='0x" DATA.LONG(A:0xa404d4) "' name='RPMH_BCM_SHADOW_STATUS_DRV4_BE_CD10'/>"
WRITE #1 "        <register address='0xba404d8' value='0x" DATA.LONG(A:0xa404d8) "' name='RPMH_BCM_SHADOW_STATUS_DRV4_BE_CD11'/>"
WRITE #1 "        <register address='0xba504ac' value='0x" DATA.LONG(A:0xa504ac) "' name='RPMH_BCM_SHADOW_STATUS_DRV5_BE_CD0'/>"
WRITE #1 "        <register address='0xba504b0' value='0x" DATA.LONG(A:0xa504b0) "' name='RPMH_BCM_SHADOW_STATUS_DRV5_BE_CD1'/>"
WRITE #1 "        <register address='0xba504b4' value='0x" DATA.LONG(A:0xa504b4) "' name='RPMH_BCM_SHADOW_STATUS_DRV5_BE_CD2'/>"
WRITE #1 "        <register address='0xba504b8' value='0x" DATA.LONG(A:0xa504b8) "' name='RPMH_BCM_SHADOW_STATUS_DRV5_BE_CD3'/>"
WRITE #1 "        <register address='0xba504bc' value='0x" DATA.LONG(A:0xa504bc) "' name='RPMH_BCM_SHADOW_STATUS_DRV5_BE_CD4'/>"
WRITE #1 "        <register address='0xba504c0' value='0x" DATA.LONG(A:0xa504c0) "' name='RPMH_BCM_SHADOW_STATUS_DRV5_BE_CD5'/>"
WRITE #1 "        <register address='0xba504c4' value='0x" DATA.LONG(A:0xa504c4) "' name='RPMH_BCM_SHADOW_STATUS_DRV5_BE_CD6'/>"
WRITE #1 "        <register address='0xba504c8' value='0x" DATA.LONG(A:0xa504c8) "' name='RPMH_BCM_SHADOW_STATUS_DRV5_BE_CD7'/>"
WRITE #1 "        <register address='0xba504cc' value='0x" DATA.LONG(A:0xa504cc) "' name='RPMH_BCM_SHADOW_STATUS_DRV5_BE_CD8'/>"
WRITE #1 "        <register address='0xba504d0' value='0x" DATA.LONG(A:0xa504d0) "' name='RPMH_BCM_SHADOW_STATUS_DRV5_BE_CD9'/>"
WRITE #1 "        <register address='0xba504d4' value='0x" DATA.LONG(A:0xa504d4) "' name='RPMH_BCM_SHADOW_STATUS_DRV5_BE_CD10'/>"
WRITE #1 "        <register address='0xba504d8' value='0x" DATA.LONG(A:0xa504d8) "' name='RPMH_BCM_SHADOW_STATUS_DRV5_BE_CD11'/>"
WRITE #1 "        <register address='0xba604ac' value='0x" DATA.LONG(A:0xa604ac) "' name='RPMH_BCM_SHADOW_STATUS_DRV6_BE_CD0'/>"
WRITE #1 "        <register address='0xba604b0' value='0x" DATA.LONG(A:0xa604b0) "' name='RPMH_BCM_SHADOW_STATUS_DRV6_BE_CD1'/>"
WRITE #1 "        <register address='0xba604b4' value='0x" DATA.LONG(A:0xa604b4) "' name='RPMH_BCM_SHADOW_STATUS_DRV6_BE_CD2'/>"
WRITE #1 "        <register address='0xba604b8' value='0x" DATA.LONG(A:0xa604b8) "' name='RPMH_BCM_SHADOW_STATUS_DRV6_BE_CD3'/>"
WRITE #1 "        <register address='0xba604bc' value='0x" DATA.LONG(A:0xa604bc) "' name='RPMH_BCM_SHADOW_STATUS_DRV6_BE_CD4'/>"
WRITE #1 "        <register address='0xba604c0' value='0x" DATA.LONG(A:0xa604c0) "' name='RPMH_BCM_SHADOW_STATUS_DRV6_BE_CD5'/>"
WRITE #1 "        <register address='0xba604c4' value='0x" DATA.LONG(A:0xa604c4) "' name='RPMH_BCM_SHADOW_STATUS_DRV6_BE_CD6'/>"
WRITE #1 "        <register address='0xba604c8' value='0x" DATA.LONG(A:0xa604c8) "' name='RPMH_BCM_SHADOW_STATUS_DRV6_BE_CD7'/>"
WRITE #1 "        <register address='0xba604cc' value='0x" DATA.LONG(A:0xa604cc) "' name='RPMH_BCM_SHADOW_STATUS_DRV6_BE_CD8'/>"
WRITE #1 "        <register address='0xba604d0' value='0x" DATA.LONG(A:0xa604d0) "' name='RPMH_BCM_SHADOW_STATUS_DRV6_BE_CD9'/>"
WRITE #1 "        <register address='0xba604d4' value='0x" DATA.LONG(A:0xa604d4) "' name='RPMH_BCM_SHADOW_STATUS_DRV6_BE_CD10'/>"
WRITE #1 "        <register address='0xba604d8' value='0x" DATA.LONG(A:0xa604d8) "' name='RPMH_BCM_SHADOW_STATUS_DRV6_BE_CD11'/>"
WRITE #1 "        <register address='0xba704ac' value='0x" DATA.LONG(A:0xa704ac) "' name='RPMH_BCM_SHADOW_STATUS_DRV7_BE_CD0'/>"
WRITE #1 "        <register address='0xba704b0' value='0x" DATA.LONG(A:0xa704b0) "' name='RPMH_BCM_SHADOW_STATUS_DRV7_BE_CD1'/>"
WRITE #1 "        <register address='0xba704b4' value='0x" DATA.LONG(A:0xa704b4) "' name='RPMH_BCM_SHADOW_STATUS_DRV7_BE_CD2'/>"
WRITE #1 "        <register address='0xba704b8' value='0x" DATA.LONG(A:0xa704b8) "' name='RPMH_BCM_SHADOW_STATUS_DRV7_BE_CD3'/>"
WRITE #1 "        <register address='0xba704bc' value='0x" DATA.LONG(A:0xa704bc) "' name='RPMH_BCM_SHADOW_STATUS_DRV7_BE_CD4'/>"
WRITE #1 "        <register address='0xba704c0' value='0x" DATA.LONG(A:0xa704c0) "' name='RPMH_BCM_SHADOW_STATUS_DRV7_BE_CD5'/>"
WRITE #1 "        <register address='0xba704c4' value='0x" DATA.LONG(A:0xa704c4) "' name='RPMH_BCM_SHADOW_STATUS_DRV7_BE_CD6'/>"
WRITE #1 "        <register address='0xba704c8' value='0x" DATA.LONG(A:0xa704c8) "' name='RPMH_BCM_SHADOW_STATUS_DRV7_BE_CD7'/>"
WRITE #1 "        <register address='0xba704cc' value='0x" DATA.LONG(A:0xa704cc) "' name='RPMH_BCM_SHADOW_STATUS_DRV7_BE_CD8'/>"
WRITE #1 "        <register address='0xba704d0' value='0x" DATA.LONG(A:0xa704d0) "' name='RPMH_BCM_SHADOW_STATUS_DRV7_BE_CD9'/>"
WRITE #1 "        <register address='0xba704d4' value='0x" DATA.LONG(A:0xa704d4) "' name='RPMH_BCM_SHADOW_STATUS_DRV7_BE_CD10'/>"
WRITE #1 "        <register address='0xba704d8' value='0x" DATA.LONG(A:0xa704d8) "' name='RPMH_BCM_SHADOW_STATUS_DRV7_BE_CD11'/>"
WRITE #1 "        <register address='0xba804ac' value='0x" DATA.LONG(A:0xa804ac) "' name='RPMH_BCM_SHADOW_STATUS_DRV8_BE_CD0'/>"
WRITE #1 "        <register address='0xba804b0' value='0x" DATA.LONG(A:0xa804b0) "' name='RPMH_BCM_SHADOW_STATUS_DRV8_BE_CD1'/>"
WRITE #1 "        <register address='0xba804b4' value='0x" DATA.LONG(A:0xa804b4) "' name='RPMH_BCM_SHADOW_STATUS_DRV8_BE_CD2'/>"
WRITE #1 "        <register address='0xba804b8' value='0x" DATA.LONG(A:0xa804b8) "' name='RPMH_BCM_SHADOW_STATUS_DRV8_BE_CD3'/>"
WRITE #1 "        <register address='0xba804bc' value='0x" DATA.LONG(A:0xa804bc) "' name='RPMH_BCM_SHADOW_STATUS_DRV8_BE_CD4'/>"
WRITE #1 "        <register address='0xba804c0' value='0x" DATA.LONG(A:0xa804c0) "' name='RPMH_BCM_SHADOW_STATUS_DRV8_BE_CD5'/>"
WRITE #1 "        <register address='0xba804c4' value='0x" DATA.LONG(A:0xa804c4) "' name='RPMH_BCM_SHADOW_STATUS_DRV8_BE_CD6'/>"
WRITE #1 "        <register address='0xba804c8' value='0x" DATA.LONG(A:0xa804c8) "' name='RPMH_BCM_SHADOW_STATUS_DRV8_BE_CD7'/>"
WRITE #1 "        <register address='0xba804cc' value='0x" DATA.LONG(A:0xa804cc) "' name='RPMH_BCM_SHADOW_STATUS_DRV8_BE_CD8'/>"
WRITE #1 "        <register address='0xba804d0' value='0x" DATA.LONG(A:0xa804d0) "' name='RPMH_BCM_SHADOW_STATUS_DRV8_BE_CD9'/>"
WRITE #1 "        <register address='0xba804d4' value='0x" DATA.LONG(A:0xa804d4) "' name='RPMH_BCM_SHADOW_STATUS_DRV8_BE_CD10'/>"
WRITE #1 "        <register address='0xba804d8' value='0x" DATA.LONG(A:0xa804d8) "' name='RPMH_BCM_SHADOW_STATUS_DRV8_BE_CD11'/>"
WRITE #1 "        <register address='0xba904ac' value='0x" DATA.LONG(A:0xa904ac) "' name='RPMH_BCM_SHADOW_STATUS_DRV9_BE_CD0'/>"
WRITE #1 "        <register address='0xba904b0' value='0x" DATA.LONG(A:0xa904b0) "' name='RPMH_BCM_SHADOW_STATUS_DRV9_BE_CD1'/>"
WRITE #1 "        <register address='0xba904b4' value='0x" DATA.LONG(A:0xa904b4) "' name='RPMH_BCM_SHADOW_STATUS_DRV9_BE_CD2'/>"
WRITE #1 "        <register address='0xba904b8' value='0x" DATA.LONG(A:0xa904b8) "' name='RPMH_BCM_SHADOW_STATUS_DRV9_BE_CD3'/>"
WRITE #1 "        <register address='0xba904bc' value='0x" DATA.LONG(A:0xa904bc) "' name='RPMH_BCM_SHADOW_STATUS_DRV9_BE_CD4'/>"
WRITE #1 "        <register address='0xba904c0' value='0x" DATA.LONG(A:0xa904c0) "' name='RPMH_BCM_SHADOW_STATUS_DRV9_BE_CD5'/>"
WRITE #1 "        <register address='0xba904c4' value='0x" DATA.LONG(A:0xa904c4) "' name='RPMH_BCM_SHADOW_STATUS_DRV9_BE_CD6'/>"
WRITE #1 "        <register address='0xba904c8' value='0x" DATA.LONG(A:0xa904c8) "' name='RPMH_BCM_SHADOW_STATUS_DRV9_BE_CD7'/>"
WRITE #1 "        <register address='0xba904cc' value='0x" DATA.LONG(A:0xa904cc) "' name='RPMH_BCM_SHADOW_STATUS_DRV9_BE_CD8'/>"
WRITE #1 "        <register address='0xba904d0' value='0x" DATA.LONG(A:0xa904d0) "' name='RPMH_BCM_SHADOW_STATUS_DRV9_BE_CD9'/>"
WRITE #1 "        <register address='0xba904d4' value='0x" DATA.LONG(A:0xa904d4) "' name='RPMH_BCM_SHADOW_STATUS_DRV9_BE_CD10'/>"
WRITE #1 "        <register address='0xba904d8' value='0x" DATA.LONG(A:0xa904d8) "' name='RPMH_BCM_SHADOW_STATUS_DRV9_BE_CD11'/>"
WRITE #1 "        <register address='0xba0052c' value='0x" DATA.LONG(A:0xa0052c) "' name='RPMH_BCM_SHADOW_STATUS_DRV0_BE_SEQ_CD0'/>"
WRITE #1 "        <register address='0xba00530' value='0x" DATA.LONG(A:0xa00530) "' name='RPMH_BCM_SHADOW_STATUS_DRV0_BE_SEQ_CD1'/>"
WRITE #1 "        <register address='0xba00534' value='0x" DATA.LONG(A:0xa00534) "' name='RPMH_BCM_SHADOW_STATUS_DRV0_BE_SEQ_CD2'/>"
WRITE #1 "        <register address='0xba00538' value='0x" DATA.LONG(A:0xa00538) "' name='RPMH_BCM_SHADOW_STATUS_DRV0_BE_SEQ_CD3'/>"
WRITE #1 "        <register address='0xba0053c' value='0x" DATA.LONG(A:0xa0053c) "' name='RPMH_BCM_SHADOW_STATUS_DRV0_BE_SEQ_CD4'/>"
WRITE #1 "        <register address='0xba00540' value='0x" DATA.LONG(A:0xa00540) "' name='RPMH_BCM_SHADOW_STATUS_DRV0_BE_SEQ_CD5'/>"
WRITE #1 "        <register address='0xba00544' value='0x" DATA.LONG(A:0xa00544) "' name='RPMH_BCM_SHADOW_STATUS_DRV0_BE_SEQ_CD6'/>"
WRITE #1 "        <register address='0xba00548' value='0x" DATA.LONG(A:0xa00548) "' name='RPMH_BCM_SHADOW_STATUS_DRV0_BE_SEQ_CD7'/>"
WRITE #1 "        <register address='0xba0054c' value='0x" DATA.LONG(A:0xa0054c) "' name='RPMH_BCM_SHADOW_STATUS_DRV0_BE_SEQ_CD8'/>"
WRITE #1 "        <register address='0xba00550' value='0x" DATA.LONG(A:0xa00550) "' name='RPMH_BCM_SHADOW_STATUS_DRV0_BE_SEQ_CD9'/>"
WRITE #1 "        <register address='0xba00554' value='0x" DATA.LONG(A:0xa00554) "' name='RPMH_BCM_SHADOW_STATUS_DRV0_BE_SEQ_CD10'/>"
WRITE #1 "        <register address='0xba00558' value='0x" DATA.LONG(A:0xa00558) "' name='RPMH_BCM_SHADOW_STATUS_DRV0_BE_SEQ_CD11'/>"
WRITE #1 "        <register address='0xba1052c' value='0x" DATA.LONG(A:0xa1052c) "' name='RPMH_BCM_SHADOW_STATUS_DRV1_BE_SEQ_CD0'/>"
WRITE #1 "        <register address='0xba10530' value='0x" DATA.LONG(A:0xa10530) "' name='RPMH_BCM_SHADOW_STATUS_DRV1_BE_SEQ_CD1'/>"
WRITE #1 "        <register address='0xba10534' value='0x" DATA.LONG(A:0xa10534) "' name='RPMH_BCM_SHADOW_STATUS_DRV1_BE_SEQ_CD2'/>"
WRITE #1 "        <register address='0xba10538' value='0x" DATA.LONG(A:0xa10538) "' name='RPMH_BCM_SHADOW_STATUS_DRV1_BE_SEQ_CD3'/>"
WRITE #1 "        <register address='0xba1053c' value='0x" DATA.LONG(A:0xa1053c) "' name='RPMH_BCM_SHADOW_STATUS_DRV1_BE_SEQ_CD4'/>"
WRITE #1 "        <register address='0xba10540' value='0x" DATA.LONG(A:0xa10540) "' name='RPMH_BCM_SHADOW_STATUS_DRV1_BE_SEQ_CD5'/>"
WRITE #1 "        <register address='0xba10544' value='0x" DATA.LONG(A:0xa10544) "' name='RPMH_BCM_SHADOW_STATUS_DRV1_BE_SEQ_CD6'/>"
WRITE #1 "        <register address='0xba10548' value='0x" DATA.LONG(A:0xa10548) "' name='RPMH_BCM_SHADOW_STATUS_DRV1_BE_SEQ_CD7'/>"
WRITE #1 "        <register address='0xba1054c' value='0x" DATA.LONG(A:0xa1054c) "' name='RPMH_BCM_SHADOW_STATUS_DRV1_BE_SEQ_CD8'/>"
WRITE #1 "        <register address='0xba10550' value='0x" DATA.LONG(A:0xa10550) "' name='RPMH_BCM_SHADOW_STATUS_DRV1_BE_SEQ_CD9'/>"
WRITE #1 "        <register address='0xba10554' value='0x" DATA.LONG(A:0xa10554) "' name='RPMH_BCM_SHADOW_STATUS_DRV1_BE_SEQ_CD10'/>"
WRITE #1 "        <register address='0xba10558' value='0x" DATA.LONG(A:0xa10558) "' name='RPMH_BCM_SHADOW_STATUS_DRV1_BE_SEQ_CD11'/>"
WRITE #1 "        <register address='0xba2052c' value='0x" DATA.LONG(A:0xa2052c) "' name='RPMH_BCM_SHADOW_STATUS_DRV2_BE_SEQ_CD0'/>"
WRITE #1 "        <register address='0xba20530' value='0x" DATA.LONG(A:0xa20530) "' name='RPMH_BCM_SHADOW_STATUS_DRV2_BE_SEQ_CD1'/>"
WRITE #1 "        <register address='0xba20534' value='0x" DATA.LONG(A:0xa20534) "' name='RPMH_BCM_SHADOW_STATUS_DRV2_BE_SEQ_CD2'/>"
WRITE #1 "        <register address='0xba20538' value='0x" DATA.LONG(A:0xa20538) "' name='RPMH_BCM_SHADOW_STATUS_DRV2_BE_SEQ_CD3'/>"
WRITE #1 "        <register address='0xba2053c' value='0x" DATA.LONG(A:0xa2053c) "' name='RPMH_BCM_SHADOW_STATUS_DRV2_BE_SEQ_CD4'/>"
WRITE #1 "        <register address='0xba20540' value='0x" DATA.LONG(A:0xa20540) "' name='RPMH_BCM_SHADOW_STATUS_DRV2_BE_SEQ_CD5'/>"
WRITE #1 "        <register address='0xba20544' value='0x" DATA.LONG(A:0xa20544) "' name='RPMH_BCM_SHADOW_STATUS_DRV2_BE_SEQ_CD6'/>"
WRITE #1 "        <register address='0xba20548' value='0x" DATA.LONG(A:0xa20548) "' name='RPMH_BCM_SHADOW_STATUS_DRV2_BE_SEQ_CD7'/>"
WRITE #1 "        <register address='0xba2054c' value='0x" DATA.LONG(A:0xa2054c) "' name='RPMH_BCM_SHADOW_STATUS_DRV2_BE_SEQ_CD8'/>"
WRITE #1 "        <register address='0xba20550' value='0x" DATA.LONG(A:0xa20550) "' name='RPMH_BCM_SHADOW_STATUS_DRV2_BE_SEQ_CD9'/>"
WRITE #1 "        <register address='0xba20554' value='0x" DATA.LONG(A:0xa20554) "' name='RPMH_BCM_SHADOW_STATUS_DRV2_BE_SEQ_CD10'/>"
WRITE #1 "        <register address='0xba20558' value='0x" DATA.LONG(A:0xa20558) "' name='RPMH_BCM_SHADOW_STATUS_DRV2_BE_SEQ_CD11'/>"
WRITE #1 "        <register address='0xba3052c' value='0x" DATA.LONG(A:0xa3052c) "' name='RPMH_BCM_SHADOW_STATUS_DRV3_BE_SEQ_CD0'/>"
WRITE #1 "        <register address='0xba30530' value='0x" DATA.LONG(A:0xa30530) "' name='RPMH_BCM_SHADOW_STATUS_DRV3_BE_SEQ_CD1'/>"
WRITE #1 "        <register address='0xba30534' value='0x" DATA.LONG(A:0xa30534) "' name='RPMH_BCM_SHADOW_STATUS_DRV3_BE_SEQ_CD2'/>"
WRITE #1 "        <register address='0xba30538' value='0x" DATA.LONG(A:0xa30538) "' name='RPMH_BCM_SHADOW_STATUS_DRV3_BE_SEQ_CD3'/>"
WRITE #1 "        <register address='0xba3053c' value='0x" DATA.LONG(A:0xa3053c) "' name='RPMH_BCM_SHADOW_STATUS_DRV3_BE_SEQ_CD4'/>"
WRITE #1 "        <register address='0xba30540' value='0x" DATA.LONG(A:0xa30540) "' name='RPMH_BCM_SHADOW_STATUS_DRV3_BE_SEQ_CD5'/>"
WRITE #1 "        <register address='0xba30544' value='0x" DATA.LONG(A:0xa30544) "' name='RPMH_BCM_SHADOW_STATUS_DRV3_BE_SEQ_CD6'/>"
WRITE #1 "        <register address='0xba30548' value='0x" DATA.LONG(A:0xa30548) "' name='RPMH_BCM_SHADOW_STATUS_DRV3_BE_SEQ_CD7'/>"
WRITE #1 "        <register address='0xba3054c' value='0x" DATA.LONG(A:0xa3054c) "' name='RPMH_BCM_SHADOW_STATUS_DRV3_BE_SEQ_CD8'/>"
WRITE #1 "        <register address='0xba30550' value='0x" DATA.LONG(A:0xa30550) "' name='RPMH_BCM_SHADOW_STATUS_DRV3_BE_SEQ_CD9'/>"
WRITE #1 "        <register address='0xba30554' value='0x" DATA.LONG(A:0xa30554) "' name='RPMH_BCM_SHADOW_STATUS_DRV3_BE_SEQ_CD10'/>"
WRITE #1 "        <register address='0xba30558' value='0x" DATA.LONG(A:0xa30558) "' name='RPMH_BCM_SHADOW_STATUS_DRV3_BE_SEQ_CD11'/>"
WRITE #1 "        <register address='0xba4052c' value='0x" DATA.LONG(A:0xa4052c) "' name='RPMH_BCM_SHADOW_STATUS_DRV4_BE_SEQ_CD0'/>"
WRITE #1 "        <register address='0xba40530' value='0x" DATA.LONG(A:0xa40530) "' name='RPMH_BCM_SHADOW_STATUS_DRV4_BE_SEQ_CD1'/>"
WRITE #1 "        <register address='0xba40534' value='0x" DATA.LONG(A:0xa40534) "' name='RPMH_BCM_SHADOW_STATUS_DRV4_BE_SEQ_CD2'/>"
WRITE #1 "        <register address='0xba40538' value='0x" DATA.LONG(A:0xa40538) "' name='RPMH_BCM_SHADOW_STATUS_DRV4_BE_SEQ_CD3'/>"
WRITE #1 "        <register address='0xba4053c' value='0x" DATA.LONG(A:0xa4053c) "' name='RPMH_BCM_SHADOW_STATUS_DRV4_BE_SEQ_CD4'/>"
WRITE #1 "        <register address='0xba40540' value='0x" DATA.LONG(A:0xa40540) "' name='RPMH_BCM_SHADOW_STATUS_DRV4_BE_SEQ_CD5'/>"
WRITE #1 "        <register address='0xba40544' value='0x" DATA.LONG(A:0xa40544) "' name='RPMH_BCM_SHADOW_STATUS_DRV4_BE_SEQ_CD6'/>"
WRITE #1 "        <register address='0xba40548' value='0x" DATA.LONG(A:0xa40548) "' name='RPMH_BCM_SHADOW_STATUS_DRV4_BE_SEQ_CD7'/>"
WRITE #1 "        <register address='0xba4054c' value='0x" DATA.LONG(A:0xa4054c) "' name='RPMH_BCM_SHADOW_STATUS_DRV4_BE_SEQ_CD8'/>"
WRITE #1 "        <register address='0xba40550' value='0x" DATA.LONG(A:0xa40550) "' name='RPMH_BCM_SHADOW_STATUS_DRV4_BE_SEQ_CD9'/>"
WRITE #1 "        <register address='0xba40554' value='0x" DATA.LONG(A:0xa40554) "' name='RPMH_BCM_SHADOW_STATUS_DRV4_BE_SEQ_CD10'/>"
WRITE #1 "        <register address='0xba40558' value='0x" DATA.LONG(A:0xa40558) "' name='RPMH_BCM_SHADOW_STATUS_DRV4_BE_SEQ_CD11'/>"
WRITE #1 "        <register address='0xba5052c' value='0x" DATA.LONG(A:0xa5052c) "' name='RPMH_BCM_SHADOW_STATUS_DRV5_BE_SEQ_CD0'/>"
WRITE #1 "        <register address='0xba50530' value='0x" DATA.LONG(A:0xa50530) "' name='RPMH_BCM_SHADOW_STATUS_DRV5_BE_SEQ_CD1'/>"
WRITE #1 "        <register address='0xba50534' value='0x" DATA.LONG(A:0xa50534) "' name='RPMH_BCM_SHADOW_STATUS_DRV5_BE_SEQ_CD2'/>"
WRITE #1 "        <register address='0xba50538' value='0x" DATA.LONG(A:0xa50538) "' name='RPMH_BCM_SHADOW_STATUS_DRV5_BE_SEQ_CD3'/>"
WRITE #1 "        <register address='0xba5053c' value='0x" DATA.LONG(A:0xa5053c) "' name='RPMH_BCM_SHADOW_STATUS_DRV5_BE_SEQ_CD4'/>"
WRITE #1 "        <register address='0xba50540' value='0x" DATA.LONG(A:0xa50540) "' name='RPMH_BCM_SHADOW_STATUS_DRV5_BE_SEQ_CD5'/>"
WRITE #1 "        <register address='0xba50544' value='0x" DATA.LONG(A:0xa50544) "' name='RPMH_BCM_SHADOW_STATUS_DRV5_BE_SEQ_CD6'/>"
WRITE #1 "        <register address='0xba50548' value='0x" DATA.LONG(A:0xa50548) "' name='RPMH_BCM_SHADOW_STATUS_DRV5_BE_SEQ_CD7'/>"
WRITE #1 "        <register address='0xba5054c' value='0x" DATA.LONG(A:0xa5054c) "' name='RPMH_BCM_SHADOW_STATUS_DRV5_BE_SEQ_CD8'/>"
WRITE #1 "        <register address='0xba50550' value='0x" DATA.LONG(A:0xa50550) "' name='RPMH_BCM_SHADOW_STATUS_DRV5_BE_SEQ_CD9'/>"
WRITE #1 "        <register address='0xba50554' value='0x" DATA.LONG(A:0xa50554) "' name='RPMH_BCM_SHADOW_STATUS_DRV5_BE_SEQ_CD10'/>"
WRITE #1 "        <register address='0xba50558' value='0x" DATA.LONG(A:0xa50558) "' name='RPMH_BCM_SHADOW_STATUS_DRV5_BE_SEQ_CD11'/>"
WRITE #1 "        <register address='0xba6052c' value='0x" DATA.LONG(A:0xa6052c) "' name='RPMH_BCM_SHADOW_STATUS_DRV6_BE_SEQ_CD0'/>"
WRITE #1 "        <register address='0xba60530' value='0x" DATA.LONG(A:0xa60530) "' name='RPMH_BCM_SHADOW_STATUS_DRV6_BE_SEQ_CD1'/>"
WRITE #1 "        <register address='0xba60534' value='0x" DATA.LONG(A:0xa60534) "' name='RPMH_BCM_SHADOW_STATUS_DRV6_BE_SEQ_CD2'/>"
WRITE #1 "        <register address='0xba60538' value='0x" DATA.LONG(A:0xa60538) "' name='RPMH_BCM_SHADOW_STATUS_DRV6_BE_SEQ_CD3'/>"
WRITE #1 "        <register address='0xba6053c' value='0x" DATA.LONG(A:0xa6053c) "' name='RPMH_BCM_SHADOW_STATUS_DRV6_BE_SEQ_CD4'/>"
WRITE #1 "        <register address='0xba60540' value='0x" DATA.LONG(A:0xa60540) "' name='RPMH_BCM_SHADOW_STATUS_DRV6_BE_SEQ_CD5'/>"
WRITE #1 "        <register address='0xba60544' value='0x" DATA.LONG(A:0xa60544) "' name='RPMH_BCM_SHADOW_STATUS_DRV6_BE_SEQ_CD6'/>"
WRITE #1 "        <register address='0xba60548' value='0x" DATA.LONG(A:0xa60548) "' name='RPMH_BCM_SHADOW_STATUS_DRV6_BE_SEQ_CD7'/>"
WRITE #1 "        <register address='0xba6054c' value='0x" DATA.LONG(A:0xa6054c) "' name='RPMH_BCM_SHADOW_STATUS_DRV6_BE_SEQ_CD8'/>"
WRITE #1 "        <register address='0xba60550' value='0x" DATA.LONG(A:0xa60550) "' name='RPMH_BCM_SHADOW_STATUS_DRV6_BE_SEQ_CD9'/>"
WRITE #1 "        <register address='0xba60554' value='0x" DATA.LONG(A:0xa60554) "' name='RPMH_BCM_SHADOW_STATUS_DRV6_BE_SEQ_CD10'/>"
WRITE #1 "        <register address='0xba60558' value='0x" DATA.LONG(A:0xa60558) "' name='RPMH_BCM_SHADOW_STATUS_DRV6_BE_SEQ_CD11'/>"
WRITE #1 "        <register address='0xba7052c' value='0x" DATA.LONG(A:0xa7052c) "' name='RPMH_BCM_SHADOW_STATUS_DRV7_BE_SEQ_CD0'/>"
WRITE #1 "        <register address='0xba70530' value='0x" DATA.LONG(A:0xa70530) "' name='RPMH_BCM_SHADOW_STATUS_DRV7_BE_SEQ_CD1'/>"
WRITE #1 "        <register address='0xba70534' value='0x" DATA.LONG(A:0xa70534) "' name='RPMH_BCM_SHADOW_STATUS_DRV7_BE_SEQ_CD2'/>"
WRITE #1 "        <register address='0xba70538' value='0x" DATA.LONG(A:0xa70538) "' name='RPMH_BCM_SHADOW_STATUS_DRV7_BE_SEQ_CD3'/>"
WRITE #1 "        <register address='0xba7053c' value='0x" DATA.LONG(A:0xa7053c) "' name='RPMH_BCM_SHADOW_STATUS_DRV7_BE_SEQ_CD4'/>"
WRITE #1 "        <register address='0xba70540' value='0x" DATA.LONG(A:0xa70540) "' name='RPMH_BCM_SHADOW_STATUS_DRV7_BE_SEQ_CD5'/>"
WRITE #1 "        <register address='0xba70544' value='0x" DATA.LONG(A:0xa70544) "' name='RPMH_BCM_SHADOW_STATUS_DRV7_BE_SEQ_CD6'/>"
WRITE #1 "        <register address='0xba70548' value='0x" DATA.LONG(A:0xa70548) "' name='RPMH_BCM_SHADOW_STATUS_DRV7_BE_SEQ_CD7'/>"
WRITE #1 "        <register address='0xba7054c' value='0x" DATA.LONG(A:0xa7054c) "' name='RPMH_BCM_SHADOW_STATUS_DRV7_BE_SEQ_CD8'/>"
WRITE #1 "        <register address='0xba70550' value='0x" DATA.LONG(A:0xa70550) "' name='RPMH_BCM_SHADOW_STATUS_DRV7_BE_SEQ_CD9'/>"
WRITE #1 "        <register address='0xba70554' value='0x" DATA.LONG(A:0xa70554) "' name='RPMH_BCM_SHADOW_STATUS_DRV7_BE_SEQ_CD10'/>"
WRITE #1 "        <register address='0xba70558' value='0x" DATA.LONG(A:0xa70558) "' name='RPMH_BCM_SHADOW_STATUS_DRV7_BE_SEQ_CD11'/>"
WRITE #1 "        <register address='0xba8052c' value='0x" DATA.LONG(A:0xa8052c) "' name='RPMH_BCM_SHADOW_STATUS_DRV8_BE_SEQ_CD0'/>"
WRITE #1 "        <register address='0xba80530' value='0x" DATA.LONG(A:0xa80530) "' name='RPMH_BCM_SHADOW_STATUS_DRV8_BE_SEQ_CD1'/>"
WRITE #1 "        <register address='0xba80534' value='0x" DATA.LONG(A:0xa80534) "' name='RPMH_BCM_SHADOW_STATUS_DRV8_BE_SEQ_CD2'/>"
WRITE #1 "        <register address='0xba80538' value='0x" DATA.LONG(A:0xa80538) "' name='RPMH_BCM_SHADOW_STATUS_DRV8_BE_SEQ_CD3'/>"
WRITE #1 "        <register address='0xba8053c' value='0x" DATA.LONG(A:0xa8053c) "' name='RPMH_BCM_SHADOW_STATUS_DRV8_BE_SEQ_CD4'/>"
WRITE #1 "        <register address='0xba80540' value='0x" DATA.LONG(A:0xa80540) "' name='RPMH_BCM_SHADOW_STATUS_DRV8_BE_SEQ_CD5'/>"
WRITE #1 "        <register address='0xba80544' value='0x" DATA.LONG(A:0xa80544) "' name='RPMH_BCM_SHADOW_STATUS_DRV8_BE_SEQ_CD6'/>"
WRITE #1 "        <register address='0xba80548' value='0x" DATA.LONG(A:0xa80548) "' name='RPMH_BCM_SHADOW_STATUS_DRV8_BE_SEQ_CD7'/>"
WRITE #1 "        <register address='0xba8054c' value='0x" DATA.LONG(A:0xa8054c) "' name='RPMH_BCM_SHADOW_STATUS_DRV8_BE_SEQ_CD8'/>"
WRITE #1 "        <register address='0xba80550' value='0x" DATA.LONG(A:0xa80550) "' name='RPMH_BCM_SHADOW_STATUS_DRV8_BE_SEQ_CD9'/>"
WRITE #1 "        <register address='0xba80554' value='0x" DATA.LONG(A:0xa80554) "' name='RPMH_BCM_SHADOW_STATUS_DRV8_BE_SEQ_CD10'/>"
WRITE #1 "        <register address='0xba80558' value='0x" DATA.LONG(A:0xa80558) "' name='RPMH_BCM_SHADOW_STATUS_DRV8_BE_SEQ_CD11'/>"
WRITE #1 "        <register address='0xba9052c' value='0x" DATA.LONG(A:0xa9052c) "' name='RPMH_BCM_SHADOW_STATUS_DRV9_BE_SEQ_CD0'/>"
WRITE #1 "        <register address='0xba90530' value='0x" DATA.LONG(A:0xa90530) "' name='RPMH_BCM_SHADOW_STATUS_DRV9_BE_SEQ_CD1'/>"
WRITE #1 "        <register address='0xba90534' value='0x" DATA.LONG(A:0xa90534) "' name='RPMH_BCM_SHADOW_STATUS_DRV9_BE_SEQ_CD2'/>"
WRITE #1 "        <register address='0xba90538' value='0x" DATA.LONG(A:0xa90538) "' name='RPMH_BCM_SHADOW_STATUS_DRV9_BE_SEQ_CD3'/>"
WRITE #1 "        <register address='0xba9053c' value='0x" DATA.LONG(A:0xa9053c) "' name='RPMH_BCM_SHADOW_STATUS_DRV9_BE_SEQ_CD4'/>"
WRITE #1 "        <register address='0xba90540' value='0x" DATA.LONG(A:0xa90540) "' name='RPMH_BCM_SHADOW_STATUS_DRV9_BE_SEQ_CD5'/>"
WRITE #1 "        <register address='0xba90544' value='0x" DATA.LONG(A:0xa90544) "' name='RPMH_BCM_SHADOW_STATUS_DRV9_BE_SEQ_CD6'/>"
WRITE #1 "        <register address='0xba90548' value='0x" DATA.LONG(A:0xa90548) "' name='RPMH_BCM_SHADOW_STATUS_DRV9_BE_SEQ_CD7'/>"
WRITE #1 "        <register address='0xba9054c' value='0x" DATA.LONG(A:0xa9054c) "' name='RPMH_BCM_SHADOW_STATUS_DRV9_BE_SEQ_CD8'/>"
WRITE #1 "        <register address='0xba90550' value='0x" DATA.LONG(A:0xa90550) "' name='RPMH_BCM_SHADOW_STATUS_DRV9_BE_SEQ_CD9'/>"
WRITE #1 "        <register address='0xba90554' value='0x" DATA.LONG(A:0xa90554) "' name='RPMH_BCM_SHADOW_STATUS_DRV9_BE_SEQ_CD10'/>"
WRITE #1 "        <register address='0xba90558' value='0x" DATA.LONG(A:0xa90558) "' name='RPMH_BCM_SHADOW_STATUS_DRV9_BE_SEQ_CD11'/>"
WRITE #1 "        <register address='0xba005ac' value='0x" DATA.LONG(A:0xa005ac) "' name='RPMH_BCM_SHADOW_STATUS_DRV0_BE_CMD_ISSUE_STATUS_CD0'/>"
WRITE #1 "        <register address='0xba005b0' value='0x" DATA.LONG(A:0xa005b0) "' name='RPMH_BCM_SHADOW_STATUS_DRV0_BE_CMD_ISSUE_STATUS_CD1'/>"
WRITE #1 "        <register address='0xba005b4' value='0x" DATA.LONG(A:0xa005b4) "' name='RPMH_BCM_SHADOW_STATUS_DRV0_BE_CMD_ISSUE_STATUS_CD2'/>"
WRITE #1 "        <register address='0xba005b8' value='0x" DATA.LONG(A:0xa005b8) "' name='RPMH_BCM_SHADOW_STATUS_DRV0_BE_CMD_ISSUE_STATUS_CD3'/>"
WRITE #1 "        <register address='0xba005bc' value='0x" DATA.LONG(A:0xa005bc) "' name='RPMH_BCM_SHADOW_STATUS_DRV0_BE_CMD_ISSUE_STATUS_CD4'/>"
WRITE #1 "        <register address='0xba005c0' value='0x" DATA.LONG(A:0xa005c0) "' name='RPMH_BCM_SHADOW_STATUS_DRV0_BE_CMD_ISSUE_STATUS_CD5'/>"
WRITE #1 "        <register address='0xba005c4' value='0x" DATA.LONG(A:0xa005c4) "' name='RPMH_BCM_SHADOW_STATUS_DRV0_BE_CMD_ISSUE_STATUS_CD6'/>"
WRITE #1 "        <register address='0xba005c8' value='0x" DATA.LONG(A:0xa005c8) "' name='RPMH_BCM_SHADOW_STATUS_DRV0_BE_CMD_ISSUE_STATUS_CD7'/>"
WRITE #1 "        <register address='0xba005cc' value='0x" DATA.LONG(A:0xa005cc) "' name='RPMH_BCM_SHADOW_STATUS_DRV0_BE_CMD_ISSUE_STATUS_CD8'/>"
WRITE #1 "        <register address='0xba005d0' value='0x" DATA.LONG(A:0xa005d0) "' name='RPMH_BCM_SHADOW_STATUS_DRV0_BE_CMD_ISSUE_STATUS_CD9'/>"
WRITE #1 "        <register address='0xba005d4' value='0x" DATA.LONG(A:0xa005d4) "' name='RPMH_BCM_SHADOW_STATUS_DRV0_BE_CMD_ISSUE_STATUS_CD10'/>"
WRITE #1 "        <register address='0xba005d8' value='0x" DATA.LONG(A:0xa005d8) "' name='RPMH_BCM_SHADOW_STATUS_DRV0_BE_CMD_ISSUE_STATUS_CD11'/>"
WRITE #1 "        <register address='0xba105ac' value='0x" DATA.LONG(A:0xa105ac) "' name='RPMH_BCM_SHADOW_STATUS_DRV1_BE_CMD_ISSUE_STATUS_CD0'/>"
WRITE #1 "        <register address='0xba105b0' value='0x" DATA.LONG(A:0xa105b0) "' name='RPMH_BCM_SHADOW_STATUS_DRV1_BE_CMD_ISSUE_STATUS_CD1'/>"
WRITE #1 "        <register address='0xba105b4' value='0x" DATA.LONG(A:0xa105b4) "' name='RPMH_BCM_SHADOW_STATUS_DRV1_BE_CMD_ISSUE_STATUS_CD2'/>"
WRITE #1 "        <register address='0xba105b8' value='0x" DATA.LONG(A:0xa105b8) "' name='RPMH_BCM_SHADOW_STATUS_DRV1_BE_CMD_ISSUE_STATUS_CD3'/>"
WRITE #1 "        <register address='0xba105bc' value='0x" DATA.LONG(A:0xa105bc) "' name='RPMH_BCM_SHADOW_STATUS_DRV1_BE_CMD_ISSUE_STATUS_CD4'/>"
WRITE #1 "        <register address='0xba105c0' value='0x" DATA.LONG(A:0xa105c0) "' name='RPMH_BCM_SHADOW_STATUS_DRV1_BE_CMD_ISSUE_STATUS_CD5'/>"
WRITE #1 "        <register address='0xba105c4' value='0x" DATA.LONG(A:0xa105c4) "' name='RPMH_BCM_SHADOW_STATUS_DRV1_BE_CMD_ISSUE_STATUS_CD6'/>"
WRITE #1 "        <register address='0xba105c8' value='0x" DATA.LONG(A:0xa105c8) "' name='RPMH_BCM_SHADOW_STATUS_DRV1_BE_CMD_ISSUE_STATUS_CD7'/>"
WRITE #1 "        <register address='0xba105cc' value='0x" DATA.LONG(A:0xa105cc) "' name='RPMH_BCM_SHADOW_STATUS_DRV1_BE_CMD_ISSUE_STATUS_CD8'/>"
WRITE #1 "        <register address='0xba105d0' value='0x" DATA.LONG(A:0xa105d0) "' name='RPMH_BCM_SHADOW_STATUS_DRV1_BE_CMD_ISSUE_STATUS_CD9'/>"
WRITE #1 "        <register address='0xba105d4' value='0x" DATA.LONG(A:0xa105d4) "' name='RPMH_BCM_SHADOW_STATUS_DRV1_BE_CMD_ISSUE_STATUS_CD10'/>"
WRITE #1 "        <register address='0xba105d8' value='0x" DATA.LONG(A:0xa105d8) "' name='RPMH_BCM_SHADOW_STATUS_DRV1_BE_CMD_ISSUE_STATUS_CD11'/>"
WRITE #1 "        <register address='0xba205ac' value='0x" DATA.LONG(A:0xa205ac) "' name='RPMH_BCM_SHADOW_STATUS_DRV2_BE_CMD_ISSUE_STATUS_CD0'/>"
WRITE #1 "        <register address='0xba205b0' value='0x" DATA.LONG(A:0xa205b0) "' name='RPMH_BCM_SHADOW_STATUS_DRV2_BE_CMD_ISSUE_STATUS_CD1'/>"
WRITE #1 "        <register address='0xba205b4' value='0x" DATA.LONG(A:0xa205b4) "' name='RPMH_BCM_SHADOW_STATUS_DRV2_BE_CMD_ISSUE_STATUS_CD2'/>"
WRITE #1 "        <register address='0xba205b8' value='0x" DATA.LONG(A:0xa205b8) "' name='RPMH_BCM_SHADOW_STATUS_DRV2_BE_CMD_ISSUE_STATUS_CD3'/>"
WRITE #1 "        <register address='0xba205bc' value='0x" DATA.LONG(A:0xa205bc) "' name='RPMH_BCM_SHADOW_STATUS_DRV2_BE_CMD_ISSUE_STATUS_CD4'/>"
WRITE #1 "        <register address='0xba205c0' value='0x" DATA.LONG(A:0xa205c0) "' name='RPMH_BCM_SHADOW_STATUS_DRV2_BE_CMD_ISSUE_STATUS_CD5'/>"
WRITE #1 "        <register address='0xba205c4' value='0x" DATA.LONG(A:0xa205c4) "' name='RPMH_BCM_SHADOW_STATUS_DRV2_BE_CMD_ISSUE_STATUS_CD6'/>"
WRITE #1 "        <register address='0xba205c8' value='0x" DATA.LONG(A:0xa205c8) "' name='RPMH_BCM_SHADOW_STATUS_DRV2_BE_CMD_ISSUE_STATUS_CD7'/>"
WRITE #1 "        <register address='0xba205cc' value='0x" DATA.LONG(A:0xa205cc) "' name='RPMH_BCM_SHADOW_STATUS_DRV2_BE_CMD_ISSUE_STATUS_CD8'/>"
WRITE #1 "        <register address='0xba205d0' value='0x" DATA.LONG(A:0xa205d0) "' name='RPMH_BCM_SHADOW_STATUS_DRV2_BE_CMD_ISSUE_STATUS_CD9'/>"
WRITE #1 "        <register address='0xba205d4' value='0x" DATA.LONG(A:0xa205d4) "' name='RPMH_BCM_SHADOW_STATUS_DRV2_BE_CMD_ISSUE_STATUS_CD10'/>"
WRITE #1 "        <register address='0xba205d8' value='0x" DATA.LONG(A:0xa205d8) "' name='RPMH_BCM_SHADOW_STATUS_DRV2_BE_CMD_ISSUE_STATUS_CD11'/>"
WRITE #1 "        <register address='0xba305ac' value='0x" DATA.LONG(A:0xa305ac) "' name='RPMH_BCM_SHADOW_STATUS_DRV3_BE_CMD_ISSUE_STATUS_CD0'/>"
WRITE #1 "        <register address='0xba305b0' value='0x" DATA.LONG(A:0xa305b0) "' name='RPMH_BCM_SHADOW_STATUS_DRV3_BE_CMD_ISSUE_STATUS_CD1'/>"
WRITE #1 "        <register address='0xba305b4' value='0x" DATA.LONG(A:0xa305b4) "' name='RPMH_BCM_SHADOW_STATUS_DRV3_BE_CMD_ISSUE_STATUS_CD2'/>"
WRITE #1 "        <register address='0xba305b8' value='0x" DATA.LONG(A:0xa305b8) "' name='RPMH_BCM_SHADOW_STATUS_DRV3_BE_CMD_ISSUE_STATUS_CD3'/>"
WRITE #1 "        <register address='0xba305bc' value='0x" DATA.LONG(A:0xa305bc) "' name='RPMH_BCM_SHADOW_STATUS_DRV3_BE_CMD_ISSUE_STATUS_CD4'/>"
WRITE #1 "        <register address='0xba305c0' value='0x" DATA.LONG(A:0xa305c0) "' name='RPMH_BCM_SHADOW_STATUS_DRV3_BE_CMD_ISSUE_STATUS_CD5'/>"
WRITE #1 "        <register address='0xba305c4' value='0x" DATA.LONG(A:0xa305c4) "' name='RPMH_BCM_SHADOW_STATUS_DRV3_BE_CMD_ISSUE_STATUS_CD6'/>"
WRITE #1 "        <register address='0xba305c8' value='0x" DATA.LONG(A:0xa305c8) "' name='RPMH_BCM_SHADOW_STATUS_DRV3_BE_CMD_ISSUE_STATUS_CD7'/>"
WRITE #1 "        <register address='0xba305cc' value='0x" DATA.LONG(A:0xa305cc) "' name='RPMH_BCM_SHADOW_STATUS_DRV3_BE_CMD_ISSUE_STATUS_CD8'/>"
WRITE #1 "        <register address='0xba305d0' value='0x" DATA.LONG(A:0xa305d0) "' name='RPMH_BCM_SHADOW_STATUS_DRV3_BE_CMD_ISSUE_STATUS_CD9'/>"
WRITE #1 "        <register address='0xba305d4' value='0x" DATA.LONG(A:0xa305d4) "' name='RPMH_BCM_SHADOW_STATUS_DRV3_BE_CMD_ISSUE_STATUS_CD10'/>"
WRITE #1 "        <register address='0xba305d8' value='0x" DATA.LONG(A:0xa305d8) "' name='RPMH_BCM_SHADOW_STATUS_DRV3_BE_CMD_ISSUE_STATUS_CD11'/>"
WRITE #1 "        <register address='0xba405ac' value='0x" DATA.LONG(A:0xa405ac) "' name='RPMH_BCM_SHADOW_STATUS_DRV4_BE_CMD_ISSUE_STATUS_CD0'/>"
WRITE #1 "        <register address='0xba405b0' value='0x" DATA.LONG(A:0xa405b0) "' name='RPMH_BCM_SHADOW_STATUS_DRV4_BE_CMD_ISSUE_STATUS_CD1'/>"
WRITE #1 "        <register address='0xba405b4' value='0x" DATA.LONG(A:0xa405b4) "' name='RPMH_BCM_SHADOW_STATUS_DRV4_BE_CMD_ISSUE_STATUS_CD2'/>"
WRITE #1 "        <register address='0xba405b8' value='0x" DATA.LONG(A:0xa405b8) "' name='RPMH_BCM_SHADOW_STATUS_DRV4_BE_CMD_ISSUE_STATUS_CD3'/>"
WRITE #1 "        <register address='0xba405bc' value='0x" DATA.LONG(A:0xa405bc) "' name='RPMH_BCM_SHADOW_STATUS_DRV4_BE_CMD_ISSUE_STATUS_CD4'/>"
WRITE #1 "        <register address='0xba405c0' value='0x" DATA.LONG(A:0xa405c0) "' name='RPMH_BCM_SHADOW_STATUS_DRV4_BE_CMD_ISSUE_STATUS_CD5'/>"
WRITE #1 "        <register address='0xba405c4' value='0x" DATA.LONG(A:0xa405c4) "' name='RPMH_BCM_SHADOW_STATUS_DRV4_BE_CMD_ISSUE_STATUS_CD6'/>"
WRITE #1 "        <register address='0xba405c8' value='0x" DATA.LONG(A:0xa405c8) "' name='RPMH_BCM_SHADOW_STATUS_DRV4_BE_CMD_ISSUE_STATUS_CD7'/>"
WRITE #1 "        <register address='0xba405cc' value='0x" DATA.LONG(A:0xa405cc) "' name='RPMH_BCM_SHADOW_STATUS_DRV4_BE_CMD_ISSUE_STATUS_CD8'/>"
WRITE #1 "        <register address='0xba405d0' value='0x" DATA.LONG(A:0xa405d0) "' name='RPMH_BCM_SHADOW_STATUS_DRV4_BE_CMD_ISSUE_STATUS_CD9'/>"
WRITE #1 "        <register address='0xba405d4' value='0x" DATA.LONG(A:0xa405d4) "' name='RPMH_BCM_SHADOW_STATUS_DRV4_BE_CMD_ISSUE_STATUS_CD10'/>"
WRITE #1 "        <register address='0xba405d8' value='0x" DATA.LONG(A:0xa405d8) "' name='RPMH_BCM_SHADOW_STATUS_DRV4_BE_CMD_ISSUE_STATUS_CD11'/>"
WRITE #1 "        <register address='0xba505ac' value='0x" DATA.LONG(A:0xa505ac) "' name='RPMH_BCM_SHADOW_STATUS_DRV5_BE_CMD_ISSUE_STATUS_CD0'/>"
WRITE #1 "        <register address='0xba505b0' value='0x" DATA.LONG(A:0xa505b0) "' name='RPMH_BCM_SHADOW_STATUS_DRV5_BE_CMD_ISSUE_STATUS_CD1'/>"
WRITE #1 "        <register address='0xba505b4' value='0x" DATA.LONG(A:0xa505b4) "' name='RPMH_BCM_SHADOW_STATUS_DRV5_BE_CMD_ISSUE_STATUS_CD2'/>"
WRITE #1 "        <register address='0xba505b8' value='0x" DATA.LONG(A:0xa505b8) "' name='RPMH_BCM_SHADOW_STATUS_DRV5_BE_CMD_ISSUE_STATUS_CD3'/>"
WRITE #1 "        <register address='0xba505bc' value='0x" DATA.LONG(A:0xa505bc) "' name='RPMH_BCM_SHADOW_STATUS_DRV5_BE_CMD_ISSUE_STATUS_CD4'/>"
WRITE #1 "        <register address='0xba505c0' value='0x" DATA.LONG(A:0xa505c0) "' name='RPMH_BCM_SHADOW_STATUS_DRV5_BE_CMD_ISSUE_STATUS_CD5'/>"
WRITE #1 "        <register address='0xba505c4' value='0x" DATA.LONG(A:0xa505c4) "' name='RPMH_BCM_SHADOW_STATUS_DRV5_BE_CMD_ISSUE_STATUS_CD6'/>"
WRITE #1 "        <register address='0xba505c8' value='0x" DATA.LONG(A:0xa505c8) "' name='RPMH_BCM_SHADOW_STATUS_DRV5_BE_CMD_ISSUE_STATUS_CD7'/>"
WRITE #1 "        <register address='0xba505cc' value='0x" DATA.LONG(A:0xa505cc) "' name='RPMH_BCM_SHADOW_STATUS_DRV5_BE_CMD_ISSUE_STATUS_CD8'/>"
WRITE #1 "        <register address='0xba505d0' value='0x" DATA.LONG(A:0xa505d0) "' name='RPMH_BCM_SHADOW_STATUS_DRV5_BE_CMD_ISSUE_STATUS_CD9'/>"
WRITE #1 "        <register address='0xba505d4' value='0x" DATA.LONG(A:0xa505d4) "' name='RPMH_BCM_SHADOW_STATUS_DRV5_BE_CMD_ISSUE_STATUS_CD10'/>"
WRITE #1 "        <register address='0xba505d8' value='0x" DATA.LONG(A:0xa505d8) "' name='RPMH_BCM_SHADOW_STATUS_DRV5_BE_CMD_ISSUE_STATUS_CD11'/>"
WRITE #1 "        <register address='0xba605ac' value='0x" DATA.LONG(A:0xa605ac) "' name='RPMH_BCM_SHADOW_STATUS_DRV6_BE_CMD_ISSUE_STATUS_CD0'/>"
WRITE #1 "        <register address='0xba605b0' value='0x" DATA.LONG(A:0xa605b0) "' name='RPMH_BCM_SHADOW_STATUS_DRV6_BE_CMD_ISSUE_STATUS_CD1'/>"
WRITE #1 "        <register address='0xba605b4' value='0x" DATA.LONG(A:0xa605b4) "' name='RPMH_BCM_SHADOW_STATUS_DRV6_BE_CMD_ISSUE_STATUS_CD2'/>"
WRITE #1 "        <register address='0xba605b8' value='0x" DATA.LONG(A:0xa605b8) "' name='RPMH_BCM_SHADOW_STATUS_DRV6_BE_CMD_ISSUE_STATUS_CD3'/>"
WRITE #1 "        <register address='0xba605bc' value='0x" DATA.LONG(A:0xa605bc) "' name='RPMH_BCM_SHADOW_STATUS_DRV6_BE_CMD_ISSUE_STATUS_CD4'/>"
WRITE #1 "        <register address='0xba605c0' value='0x" DATA.LONG(A:0xa605c0) "' name='RPMH_BCM_SHADOW_STATUS_DRV6_BE_CMD_ISSUE_STATUS_CD5'/>"
WRITE #1 "        <register address='0xba605c4' value='0x" DATA.LONG(A:0xa605c4) "' name='RPMH_BCM_SHADOW_STATUS_DRV6_BE_CMD_ISSUE_STATUS_CD6'/>"
WRITE #1 "        <register address='0xba605c8' value='0x" DATA.LONG(A:0xa605c8) "' name='RPMH_BCM_SHADOW_STATUS_DRV6_BE_CMD_ISSUE_STATUS_CD7'/>"
WRITE #1 "        <register address='0xba605cc' value='0x" DATA.LONG(A:0xa605cc) "' name='RPMH_BCM_SHADOW_STATUS_DRV6_BE_CMD_ISSUE_STATUS_CD8'/>"
WRITE #1 "        <register address='0xba605d0' value='0x" DATA.LONG(A:0xa605d0) "' name='RPMH_BCM_SHADOW_STATUS_DRV6_BE_CMD_ISSUE_STATUS_CD9'/>"
WRITE #1 "        <register address='0xba605d4' value='0x" DATA.LONG(A:0xa605d4) "' name='RPMH_BCM_SHADOW_STATUS_DRV6_BE_CMD_ISSUE_STATUS_CD10'/>"
WRITE #1 "        <register address='0xba605d8' value='0x" DATA.LONG(A:0xa605d8) "' name='RPMH_BCM_SHADOW_STATUS_DRV6_BE_CMD_ISSUE_STATUS_CD11'/>"
WRITE #1 "        <register address='0xba705ac' value='0x" DATA.LONG(A:0xa705ac) "' name='RPMH_BCM_SHADOW_STATUS_DRV7_BE_CMD_ISSUE_STATUS_CD0'/>"
WRITE #1 "        <register address='0xba705b0' value='0x" DATA.LONG(A:0xa705b0) "' name='RPMH_BCM_SHADOW_STATUS_DRV7_BE_CMD_ISSUE_STATUS_CD1'/>"
WRITE #1 "        <register address='0xba705b4' value='0x" DATA.LONG(A:0xa705b4) "' name='RPMH_BCM_SHADOW_STATUS_DRV7_BE_CMD_ISSUE_STATUS_CD2'/>"
WRITE #1 "        <register address='0xba705b8' value='0x" DATA.LONG(A:0xa705b8) "' name='RPMH_BCM_SHADOW_STATUS_DRV7_BE_CMD_ISSUE_STATUS_CD3'/>"
WRITE #1 "        <register address='0xba705bc' value='0x" DATA.LONG(A:0xa705bc) "' name='RPMH_BCM_SHADOW_STATUS_DRV7_BE_CMD_ISSUE_STATUS_CD4'/>"
WRITE #1 "        <register address='0xba705c0' value='0x" DATA.LONG(A:0xa705c0) "' name='RPMH_BCM_SHADOW_STATUS_DRV7_BE_CMD_ISSUE_STATUS_CD5'/>"
WRITE #1 "        <register address='0xba705c4' value='0x" DATA.LONG(A:0xa705c4) "' name='RPMH_BCM_SHADOW_STATUS_DRV7_BE_CMD_ISSUE_STATUS_CD6'/>"
WRITE #1 "        <register address='0xba705c8' value='0x" DATA.LONG(A:0xa705c8) "' name='RPMH_BCM_SHADOW_STATUS_DRV7_BE_CMD_ISSUE_STATUS_CD7'/>"
WRITE #1 "        <register address='0xba705cc' value='0x" DATA.LONG(A:0xa705cc) "' name='RPMH_BCM_SHADOW_STATUS_DRV7_BE_CMD_ISSUE_STATUS_CD8'/>"
WRITE #1 "        <register address='0xba705d0' value='0x" DATA.LONG(A:0xa705d0) "' name='RPMH_BCM_SHADOW_STATUS_DRV7_BE_CMD_ISSUE_STATUS_CD9'/>"
WRITE #1 "        <register address='0xba705d4' value='0x" DATA.LONG(A:0xa705d4) "' name='RPMH_BCM_SHADOW_STATUS_DRV7_BE_CMD_ISSUE_STATUS_CD10'/>"
WRITE #1 "        <register address='0xba705d8' value='0x" DATA.LONG(A:0xa705d8) "' name='RPMH_BCM_SHADOW_STATUS_DRV7_BE_CMD_ISSUE_STATUS_CD11'/>"
WRITE #1 "        <register address='0xba805ac' value='0x" DATA.LONG(A:0xa805ac) "' name='RPMH_BCM_SHADOW_STATUS_DRV8_BE_CMD_ISSUE_STATUS_CD0'/>"
WRITE #1 "        <register address='0xba805b0' value='0x" DATA.LONG(A:0xa805b0) "' name='RPMH_BCM_SHADOW_STATUS_DRV8_BE_CMD_ISSUE_STATUS_CD1'/>"
WRITE #1 "        <register address='0xba805b4' value='0x" DATA.LONG(A:0xa805b4) "' name='RPMH_BCM_SHADOW_STATUS_DRV8_BE_CMD_ISSUE_STATUS_CD2'/>"
WRITE #1 "        <register address='0xba805b8' value='0x" DATA.LONG(A:0xa805b8) "' name='RPMH_BCM_SHADOW_STATUS_DRV8_BE_CMD_ISSUE_STATUS_CD3'/>"
WRITE #1 "        <register address='0xba805bc' value='0x" DATA.LONG(A:0xa805bc) "' name='RPMH_BCM_SHADOW_STATUS_DRV8_BE_CMD_ISSUE_STATUS_CD4'/>"
WRITE #1 "        <register address='0xba805c0' value='0x" DATA.LONG(A:0xa805c0) "' name='RPMH_BCM_SHADOW_STATUS_DRV8_BE_CMD_ISSUE_STATUS_CD5'/>"
WRITE #1 "        <register address='0xba805c4' value='0x" DATA.LONG(A:0xa805c4) "' name='RPMH_BCM_SHADOW_STATUS_DRV8_BE_CMD_ISSUE_STATUS_CD6'/>"
WRITE #1 "        <register address='0xba805c8' value='0x" DATA.LONG(A:0xa805c8) "' name='RPMH_BCM_SHADOW_STATUS_DRV8_BE_CMD_ISSUE_STATUS_CD7'/>"
WRITE #1 "        <register address='0xba805cc' value='0x" DATA.LONG(A:0xa805cc) "' name='RPMH_BCM_SHADOW_STATUS_DRV8_BE_CMD_ISSUE_STATUS_CD8'/>"
WRITE #1 "        <register address='0xba805d0' value='0x" DATA.LONG(A:0xa805d0) "' name='RPMH_BCM_SHADOW_STATUS_DRV8_BE_CMD_ISSUE_STATUS_CD9'/>"
WRITE #1 "        <register address='0xba805d4' value='0x" DATA.LONG(A:0xa805d4) "' name='RPMH_BCM_SHADOW_STATUS_DRV8_BE_CMD_ISSUE_STATUS_CD10'/>"
WRITE #1 "        <register address='0xba805d8' value='0x" DATA.LONG(A:0xa805d8) "' name='RPMH_BCM_SHADOW_STATUS_DRV8_BE_CMD_ISSUE_STATUS_CD11'/>"
WRITE #1 "        <register address='0xba905ac' value='0x" DATA.LONG(A:0xa905ac) "' name='RPMH_BCM_SHADOW_STATUS_DRV9_BE_CMD_ISSUE_STATUS_CD0'/>"
WRITE #1 "        <register address='0xba905b0' value='0x" DATA.LONG(A:0xa905b0) "' name='RPMH_BCM_SHADOW_STATUS_DRV9_BE_CMD_ISSUE_STATUS_CD1'/>"
WRITE #1 "        <register address='0xba905b4' value='0x" DATA.LONG(A:0xa905b4) "' name='RPMH_BCM_SHADOW_STATUS_DRV9_BE_CMD_ISSUE_STATUS_CD2'/>"
WRITE #1 "        <register address='0xba905b8' value='0x" DATA.LONG(A:0xa905b8) "' name='RPMH_BCM_SHADOW_STATUS_DRV9_BE_CMD_ISSUE_STATUS_CD3'/>"
WRITE #1 "        <register address='0xba905bc' value='0x" DATA.LONG(A:0xa905bc) "' name='RPMH_BCM_SHADOW_STATUS_DRV9_BE_CMD_ISSUE_STATUS_CD4'/>"
WRITE #1 "        <register address='0xba905c0' value='0x" DATA.LONG(A:0xa905c0) "' name='RPMH_BCM_SHADOW_STATUS_DRV9_BE_CMD_ISSUE_STATUS_CD5'/>"
WRITE #1 "        <register address='0xba905c4' value='0x" DATA.LONG(A:0xa905c4) "' name='RPMH_BCM_SHADOW_STATUS_DRV9_BE_CMD_ISSUE_STATUS_CD6'/>"
WRITE #1 "        <register address='0xba905c8' value='0x" DATA.LONG(A:0xa905c8) "' name='RPMH_BCM_SHADOW_STATUS_DRV9_BE_CMD_ISSUE_STATUS_CD7'/>"
WRITE #1 "        <register address='0xba905cc' value='0x" DATA.LONG(A:0xa905cc) "' name='RPMH_BCM_SHADOW_STATUS_DRV9_BE_CMD_ISSUE_STATUS_CD8'/>"
WRITE #1 "        <register address='0xba905d0' value='0x" DATA.LONG(A:0xa905d0) "' name='RPMH_BCM_SHADOW_STATUS_DRV9_BE_CMD_ISSUE_STATUS_CD9'/>"
WRITE #1 "        <register address='0xba905d4' value='0x" DATA.LONG(A:0xa905d4) "' name='RPMH_BCM_SHADOW_STATUS_DRV9_BE_CMD_ISSUE_STATUS_CD10'/>"
WRITE #1 "        <register address='0xba905d8' value='0x" DATA.LONG(A:0xa905d8) "' name='RPMH_BCM_SHADOW_STATUS_DRV9_BE_CMD_ISSUE_STATUS_CD11'/>"
WRITE #1 "        <register address='0xba0062c' value='0x" DATA.LONG(A:0xa0062c) "' name='RPMH_BCM_SHADOW_STATUS_DRV0_BE_CMD_SENT_STATUS_CD0'/>"
WRITE #1 "        <register address='0xba00630' value='0x" DATA.LONG(A:0xa00630) "' name='RPMH_BCM_SHADOW_STATUS_DRV0_BE_CMD_SENT_STATUS_CD1'/>"
WRITE #1 "        <register address='0xba00634' value='0x" DATA.LONG(A:0xa00634) "' name='RPMH_BCM_SHADOW_STATUS_DRV0_BE_CMD_SENT_STATUS_CD2'/>"
WRITE #1 "        <register address='0xba00638' value='0x" DATA.LONG(A:0xa00638) "' name='RPMH_BCM_SHADOW_STATUS_DRV0_BE_CMD_SENT_STATUS_CD3'/>"
WRITE #1 "        <register address='0xba0063c' value='0x" DATA.LONG(A:0xa0063c) "' name='RPMH_BCM_SHADOW_STATUS_DRV0_BE_CMD_SENT_STATUS_CD4'/>"
WRITE #1 "        <register address='0xba00640' value='0x" DATA.LONG(A:0xa00640) "' name='RPMH_BCM_SHADOW_STATUS_DRV0_BE_CMD_SENT_STATUS_CD5'/>"
WRITE #1 "        <register address='0xba00644' value='0x" DATA.LONG(A:0xa00644) "' name='RPMH_BCM_SHADOW_STATUS_DRV0_BE_CMD_SENT_STATUS_CD6'/>"
WRITE #1 "        <register address='0xba00648' value='0x" DATA.LONG(A:0xa00648) "' name='RPMH_BCM_SHADOW_STATUS_DRV0_BE_CMD_SENT_STATUS_CD7'/>"
WRITE #1 "        <register address='0xba0064c' value='0x" DATA.LONG(A:0xa0064c) "' name='RPMH_BCM_SHADOW_STATUS_DRV0_BE_CMD_SENT_STATUS_CD8'/>"
WRITE #1 "        <register address='0xba00650' value='0x" DATA.LONG(A:0xa00650) "' name='RPMH_BCM_SHADOW_STATUS_DRV0_BE_CMD_SENT_STATUS_CD9'/>"
WRITE #1 "        <register address='0xba00654' value='0x" DATA.LONG(A:0xa00654) "' name='RPMH_BCM_SHADOW_STATUS_DRV0_BE_CMD_SENT_STATUS_CD10'/>"
WRITE #1 "        <register address='0xba00658' value='0x" DATA.LONG(A:0xa00658) "' name='RPMH_BCM_SHADOW_STATUS_DRV0_BE_CMD_SENT_STATUS_CD11'/>"
WRITE #1 "        <register address='0xba1062c' value='0x" DATA.LONG(A:0xa1062c) "' name='RPMH_BCM_SHADOW_STATUS_DRV1_BE_CMD_SENT_STATUS_CD0'/>"
WRITE #1 "        <register address='0xba10630' value='0x" DATA.LONG(A:0xa10630) "' name='RPMH_BCM_SHADOW_STATUS_DRV1_BE_CMD_SENT_STATUS_CD1'/>"
WRITE #1 "        <register address='0xba10634' value='0x" DATA.LONG(A:0xa10634) "' name='RPMH_BCM_SHADOW_STATUS_DRV1_BE_CMD_SENT_STATUS_CD2'/>"
WRITE #1 "        <register address='0xba10638' value='0x" DATA.LONG(A:0xa10638) "' name='RPMH_BCM_SHADOW_STATUS_DRV1_BE_CMD_SENT_STATUS_CD3'/>"
WRITE #1 "        <register address='0xba1063c' value='0x" DATA.LONG(A:0xa1063c) "' name='RPMH_BCM_SHADOW_STATUS_DRV1_BE_CMD_SENT_STATUS_CD4'/>"
WRITE #1 "        <register address='0xba10640' value='0x" DATA.LONG(A:0xa10640) "' name='RPMH_BCM_SHADOW_STATUS_DRV1_BE_CMD_SENT_STATUS_CD5'/>"
WRITE #1 "        <register address='0xba10644' value='0x" DATA.LONG(A:0xa10644) "' name='RPMH_BCM_SHADOW_STATUS_DRV1_BE_CMD_SENT_STATUS_CD6'/>"
WRITE #1 "        <register address='0xba10648' value='0x" DATA.LONG(A:0xa10648) "' name='RPMH_BCM_SHADOW_STATUS_DRV1_BE_CMD_SENT_STATUS_CD7'/>"
WRITE #1 "        <register address='0xba1064c' value='0x" DATA.LONG(A:0xa1064c) "' name='RPMH_BCM_SHADOW_STATUS_DRV1_BE_CMD_SENT_STATUS_CD8'/>"
WRITE #1 "        <register address='0xba10650' value='0x" DATA.LONG(A:0xa10650) "' name='RPMH_BCM_SHADOW_STATUS_DRV1_BE_CMD_SENT_STATUS_CD9'/>"
WRITE #1 "        <register address='0xba10654' value='0x" DATA.LONG(A:0xa10654) "' name='RPMH_BCM_SHADOW_STATUS_DRV1_BE_CMD_SENT_STATUS_CD10'/>"
WRITE #1 "        <register address='0xba10658' value='0x" DATA.LONG(A:0xa10658) "' name='RPMH_BCM_SHADOW_STATUS_DRV1_BE_CMD_SENT_STATUS_CD11'/>"
WRITE #1 "        <register address='0xba2062c' value='0x" DATA.LONG(A:0xa2062c) "' name='RPMH_BCM_SHADOW_STATUS_DRV2_BE_CMD_SENT_STATUS_CD0'/>"
WRITE #1 "        <register address='0xba20630' value='0x" DATA.LONG(A:0xa20630) "' name='RPMH_BCM_SHADOW_STATUS_DRV2_BE_CMD_SENT_STATUS_CD1'/>"
WRITE #1 "        <register address='0xba20634' value='0x" DATA.LONG(A:0xa20634) "' name='RPMH_BCM_SHADOW_STATUS_DRV2_BE_CMD_SENT_STATUS_CD2'/>"
WRITE #1 "        <register address='0xba20638' value='0x" DATA.LONG(A:0xa20638) "' name='RPMH_BCM_SHADOW_STATUS_DRV2_BE_CMD_SENT_STATUS_CD3'/>"
WRITE #1 "        <register address='0xba2063c' value='0x" DATA.LONG(A:0xa2063c) "' name='RPMH_BCM_SHADOW_STATUS_DRV2_BE_CMD_SENT_STATUS_CD4'/>"
WRITE #1 "        <register address='0xba20640' value='0x" DATA.LONG(A:0xa20640) "' name='RPMH_BCM_SHADOW_STATUS_DRV2_BE_CMD_SENT_STATUS_CD5'/>"
WRITE #1 "        <register address='0xba20644' value='0x" DATA.LONG(A:0xa20644) "' name='RPMH_BCM_SHADOW_STATUS_DRV2_BE_CMD_SENT_STATUS_CD6'/>"
WRITE #1 "        <register address='0xba20648' value='0x" DATA.LONG(A:0xa20648) "' name='RPMH_BCM_SHADOW_STATUS_DRV2_BE_CMD_SENT_STATUS_CD7'/>"
WRITE #1 "        <register address='0xba2064c' value='0x" DATA.LONG(A:0xa2064c) "' name='RPMH_BCM_SHADOW_STATUS_DRV2_BE_CMD_SENT_STATUS_CD8'/>"
WRITE #1 "        <register address='0xba20650' value='0x" DATA.LONG(A:0xa20650) "' name='RPMH_BCM_SHADOW_STATUS_DRV2_BE_CMD_SENT_STATUS_CD9'/>"
WRITE #1 "        <register address='0xba20654' value='0x" DATA.LONG(A:0xa20654) "' name='RPMH_BCM_SHADOW_STATUS_DRV2_BE_CMD_SENT_STATUS_CD10'/>"
WRITE #1 "        <register address='0xba20658' value='0x" DATA.LONG(A:0xa20658) "' name='RPMH_BCM_SHADOW_STATUS_DRV2_BE_CMD_SENT_STATUS_CD11'/>"
WRITE #1 "        <register address='0xba3062c' value='0x" DATA.LONG(A:0xa3062c) "' name='RPMH_BCM_SHADOW_STATUS_DRV3_BE_CMD_SENT_STATUS_CD0'/>"
WRITE #1 "        <register address='0xba30630' value='0x" DATA.LONG(A:0xa30630) "' name='RPMH_BCM_SHADOW_STATUS_DRV3_BE_CMD_SENT_STATUS_CD1'/>"
WRITE #1 "        <register address='0xba30634' value='0x" DATA.LONG(A:0xa30634) "' name='RPMH_BCM_SHADOW_STATUS_DRV3_BE_CMD_SENT_STATUS_CD2'/>"
WRITE #1 "        <register address='0xba30638' value='0x" DATA.LONG(A:0xa30638) "' name='RPMH_BCM_SHADOW_STATUS_DRV3_BE_CMD_SENT_STATUS_CD3'/>"
WRITE #1 "        <register address='0xba3063c' value='0x" DATA.LONG(A:0xa3063c) "' name='RPMH_BCM_SHADOW_STATUS_DRV3_BE_CMD_SENT_STATUS_CD4'/>"
WRITE #1 "        <register address='0xba30640' value='0x" DATA.LONG(A:0xa30640) "' name='RPMH_BCM_SHADOW_STATUS_DRV3_BE_CMD_SENT_STATUS_CD5'/>"
WRITE #1 "        <register address='0xba30644' value='0x" DATA.LONG(A:0xa30644) "' name='RPMH_BCM_SHADOW_STATUS_DRV3_BE_CMD_SENT_STATUS_CD6'/>"
WRITE #1 "        <register address='0xba30648' value='0x" DATA.LONG(A:0xa30648) "' name='RPMH_BCM_SHADOW_STATUS_DRV3_BE_CMD_SENT_STATUS_CD7'/>"
WRITE #1 "        <register address='0xba3064c' value='0x" DATA.LONG(A:0xa3064c) "' name='RPMH_BCM_SHADOW_STATUS_DRV3_BE_CMD_SENT_STATUS_CD8'/>"
WRITE #1 "        <register address='0xba30650' value='0x" DATA.LONG(A:0xa30650) "' name='RPMH_BCM_SHADOW_STATUS_DRV3_BE_CMD_SENT_STATUS_CD9'/>"
WRITE #1 "        <register address='0xba30654' value='0x" DATA.LONG(A:0xa30654) "' name='RPMH_BCM_SHADOW_STATUS_DRV3_BE_CMD_SENT_STATUS_CD10'/>"
WRITE #1 "        <register address='0xba30658' value='0x" DATA.LONG(A:0xa30658) "' name='RPMH_BCM_SHADOW_STATUS_DRV3_BE_CMD_SENT_STATUS_CD11'/>"
WRITE #1 "        <register address='0xba4062c' value='0x" DATA.LONG(A:0xa4062c) "' name='RPMH_BCM_SHADOW_STATUS_DRV4_BE_CMD_SENT_STATUS_CD0'/>"
WRITE #1 "        <register address='0xba40630' value='0x" DATA.LONG(A:0xa40630) "' name='RPMH_BCM_SHADOW_STATUS_DRV4_BE_CMD_SENT_STATUS_CD1'/>"
WRITE #1 "        <register address='0xba40634' value='0x" DATA.LONG(A:0xa40634) "' name='RPMH_BCM_SHADOW_STATUS_DRV4_BE_CMD_SENT_STATUS_CD2'/>"
WRITE #1 "        <register address='0xba40638' value='0x" DATA.LONG(A:0xa40638) "' name='RPMH_BCM_SHADOW_STATUS_DRV4_BE_CMD_SENT_STATUS_CD3'/>"
WRITE #1 "        <register address='0xba4063c' value='0x" DATA.LONG(A:0xa4063c) "' name='RPMH_BCM_SHADOW_STATUS_DRV4_BE_CMD_SENT_STATUS_CD4'/>"
WRITE #1 "        <register address='0xba40640' value='0x" DATA.LONG(A:0xa40640) "' name='RPMH_BCM_SHADOW_STATUS_DRV4_BE_CMD_SENT_STATUS_CD5'/>"
WRITE #1 "        <register address='0xba40644' value='0x" DATA.LONG(A:0xa40644) "' name='RPMH_BCM_SHADOW_STATUS_DRV4_BE_CMD_SENT_STATUS_CD6'/>"
WRITE #1 "        <register address='0xba40648' value='0x" DATA.LONG(A:0xa40648) "' name='RPMH_BCM_SHADOW_STATUS_DRV4_BE_CMD_SENT_STATUS_CD7'/>"
WRITE #1 "        <register address='0xba4064c' value='0x" DATA.LONG(A:0xa4064c) "' name='RPMH_BCM_SHADOW_STATUS_DRV4_BE_CMD_SENT_STATUS_CD8'/>"
WRITE #1 "        <register address='0xba40650' value='0x" DATA.LONG(A:0xa40650) "' name='RPMH_BCM_SHADOW_STATUS_DRV4_BE_CMD_SENT_STATUS_CD9'/>"
WRITE #1 "        <register address='0xba40654' value='0x" DATA.LONG(A:0xa40654) "' name='RPMH_BCM_SHADOW_STATUS_DRV4_BE_CMD_SENT_STATUS_CD10'/>"
WRITE #1 "        <register address='0xba40658' value='0x" DATA.LONG(A:0xa40658) "' name='RPMH_BCM_SHADOW_STATUS_DRV4_BE_CMD_SENT_STATUS_CD11'/>"
WRITE #1 "        <register address='0xba5062c' value='0x" DATA.LONG(A:0xa5062c) "' name='RPMH_BCM_SHADOW_STATUS_DRV5_BE_CMD_SENT_STATUS_CD0'/>"
WRITE #1 "        <register address='0xba50630' value='0x" DATA.LONG(A:0xa50630) "' name='RPMH_BCM_SHADOW_STATUS_DRV5_BE_CMD_SENT_STATUS_CD1'/>"
WRITE #1 "        <register address='0xba50634' value='0x" DATA.LONG(A:0xa50634) "' name='RPMH_BCM_SHADOW_STATUS_DRV5_BE_CMD_SENT_STATUS_CD2'/>"
WRITE #1 "        <register address='0xba50638' value='0x" DATA.LONG(A:0xa50638) "' name='RPMH_BCM_SHADOW_STATUS_DRV5_BE_CMD_SENT_STATUS_CD3'/>"
WRITE #1 "        <register address='0xba5063c' value='0x" DATA.LONG(A:0xa5063c) "' name='RPMH_BCM_SHADOW_STATUS_DRV5_BE_CMD_SENT_STATUS_CD4'/>"
WRITE #1 "        <register address='0xba50640' value='0x" DATA.LONG(A:0xa50640) "' name='RPMH_BCM_SHADOW_STATUS_DRV5_BE_CMD_SENT_STATUS_CD5'/>"
WRITE #1 "        <register address='0xba50644' value='0x" DATA.LONG(A:0xa50644) "' name='RPMH_BCM_SHADOW_STATUS_DRV5_BE_CMD_SENT_STATUS_CD6'/>"
WRITE #1 "        <register address='0xba50648' value='0x" DATA.LONG(A:0xa50648) "' name='RPMH_BCM_SHADOW_STATUS_DRV5_BE_CMD_SENT_STATUS_CD7'/>"
WRITE #1 "        <register address='0xba5064c' value='0x" DATA.LONG(A:0xa5064c) "' name='RPMH_BCM_SHADOW_STATUS_DRV5_BE_CMD_SENT_STATUS_CD8'/>"
WRITE #1 "        <register address='0xba50650' value='0x" DATA.LONG(A:0xa50650) "' name='RPMH_BCM_SHADOW_STATUS_DRV5_BE_CMD_SENT_STATUS_CD9'/>"
WRITE #1 "        <register address='0xba50654' value='0x" DATA.LONG(A:0xa50654) "' name='RPMH_BCM_SHADOW_STATUS_DRV5_BE_CMD_SENT_STATUS_CD10'/>"
WRITE #1 "        <register address='0xba50658' value='0x" DATA.LONG(A:0xa50658) "' name='RPMH_BCM_SHADOW_STATUS_DRV5_BE_CMD_SENT_STATUS_CD11'/>"
WRITE #1 "        <register address='0xba6062c' value='0x" DATA.LONG(A:0xa6062c) "' name='RPMH_BCM_SHADOW_STATUS_DRV6_BE_CMD_SENT_STATUS_CD0'/>"
WRITE #1 "        <register address='0xba60630' value='0x" DATA.LONG(A:0xa60630) "' name='RPMH_BCM_SHADOW_STATUS_DRV6_BE_CMD_SENT_STATUS_CD1'/>"
WRITE #1 "        <register address='0xba60634' value='0x" DATA.LONG(A:0xa60634) "' name='RPMH_BCM_SHADOW_STATUS_DRV6_BE_CMD_SENT_STATUS_CD2'/>"
WRITE #1 "        <register address='0xba60638' value='0x" DATA.LONG(A:0xa60638) "' name='RPMH_BCM_SHADOW_STATUS_DRV6_BE_CMD_SENT_STATUS_CD3'/>"
WRITE #1 "        <register address='0xba6063c' value='0x" DATA.LONG(A:0xa6063c) "' name='RPMH_BCM_SHADOW_STATUS_DRV6_BE_CMD_SENT_STATUS_CD4'/>"
WRITE #1 "        <register address='0xba60640' value='0x" DATA.LONG(A:0xa60640) "' name='RPMH_BCM_SHADOW_STATUS_DRV6_BE_CMD_SENT_STATUS_CD5'/>"
WRITE #1 "        <register address='0xba60644' value='0x" DATA.LONG(A:0xa60644) "' name='RPMH_BCM_SHADOW_STATUS_DRV6_BE_CMD_SENT_STATUS_CD6'/>"
WRITE #1 "        <register address='0xba60648' value='0x" DATA.LONG(A:0xa60648) "' name='RPMH_BCM_SHADOW_STATUS_DRV6_BE_CMD_SENT_STATUS_CD7'/>"
WRITE #1 "        <register address='0xba6064c' value='0x" DATA.LONG(A:0xa6064c) "' name='RPMH_BCM_SHADOW_STATUS_DRV6_BE_CMD_SENT_STATUS_CD8'/>"
WRITE #1 "        <register address='0xba60650' value='0x" DATA.LONG(A:0xa60650) "' name='RPMH_BCM_SHADOW_STATUS_DRV6_BE_CMD_SENT_STATUS_CD9'/>"
WRITE #1 "        <register address='0xba60654' value='0x" DATA.LONG(A:0xa60654) "' name='RPMH_BCM_SHADOW_STATUS_DRV6_BE_CMD_SENT_STATUS_CD10'/>"
WRITE #1 "        <register address='0xba60658' value='0x" DATA.LONG(A:0xa60658) "' name='RPMH_BCM_SHADOW_STATUS_DRV6_BE_CMD_SENT_STATUS_CD11'/>"
WRITE #1 "        <register address='0xba7062c' value='0x" DATA.LONG(A:0xa7062c) "' name='RPMH_BCM_SHADOW_STATUS_DRV7_BE_CMD_SENT_STATUS_CD0'/>"
WRITE #1 "        <register address='0xba70630' value='0x" DATA.LONG(A:0xa70630) "' name='RPMH_BCM_SHADOW_STATUS_DRV7_BE_CMD_SENT_STATUS_CD1'/>"
WRITE #1 "        <register address='0xba70634' value='0x" DATA.LONG(A:0xa70634) "' name='RPMH_BCM_SHADOW_STATUS_DRV7_BE_CMD_SENT_STATUS_CD2'/>"
WRITE #1 "        <register address='0xba70638' value='0x" DATA.LONG(A:0xa70638) "' name='RPMH_BCM_SHADOW_STATUS_DRV7_BE_CMD_SENT_STATUS_CD3'/>"
WRITE #1 "        <register address='0xba7063c' value='0x" DATA.LONG(A:0xa7063c) "' name='RPMH_BCM_SHADOW_STATUS_DRV7_BE_CMD_SENT_STATUS_CD4'/>"
WRITE #1 "        <register address='0xba70640' value='0x" DATA.LONG(A:0xa70640) "' name='RPMH_BCM_SHADOW_STATUS_DRV7_BE_CMD_SENT_STATUS_CD5'/>"
WRITE #1 "        <register address='0xba70644' value='0x" DATA.LONG(A:0xa70644) "' name='RPMH_BCM_SHADOW_STATUS_DRV7_BE_CMD_SENT_STATUS_CD6'/>"
WRITE #1 "        <register address='0xba70648' value='0x" DATA.LONG(A:0xa70648) "' name='RPMH_BCM_SHADOW_STATUS_DRV7_BE_CMD_SENT_STATUS_CD7'/>"
WRITE #1 "        <register address='0xba7064c' value='0x" DATA.LONG(A:0xa7064c) "' name='RPMH_BCM_SHADOW_STATUS_DRV7_BE_CMD_SENT_STATUS_CD8'/>"
WRITE #1 "        <register address='0xba70650' value='0x" DATA.LONG(A:0xa70650) "' name='RPMH_BCM_SHADOW_STATUS_DRV7_BE_CMD_SENT_STATUS_CD9'/>"
WRITE #1 "        <register address='0xba70654' value='0x" DATA.LONG(A:0xa70654) "' name='RPMH_BCM_SHADOW_STATUS_DRV7_BE_CMD_SENT_STATUS_CD10'/>"
WRITE #1 "        <register address='0xba70658' value='0x" DATA.LONG(A:0xa70658) "' name='RPMH_BCM_SHADOW_STATUS_DRV7_BE_CMD_SENT_STATUS_CD11'/>"
WRITE #1 "        <register address='0xba8062c' value='0x" DATA.LONG(A:0xa8062c) "' name='RPMH_BCM_SHADOW_STATUS_DRV8_BE_CMD_SENT_STATUS_CD0'/>"
WRITE #1 "        <register address='0xba80630' value='0x" DATA.LONG(A:0xa80630) "' name='RPMH_BCM_SHADOW_STATUS_DRV8_BE_CMD_SENT_STATUS_CD1'/>"
WRITE #1 "        <register address='0xba80634' value='0x" DATA.LONG(A:0xa80634) "' name='RPMH_BCM_SHADOW_STATUS_DRV8_BE_CMD_SENT_STATUS_CD2'/>"
WRITE #1 "        <register address='0xba80638' value='0x" DATA.LONG(A:0xa80638) "' name='RPMH_BCM_SHADOW_STATUS_DRV8_BE_CMD_SENT_STATUS_CD3'/>"
WRITE #1 "        <register address='0xba8063c' value='0x" DATA.LONG(A:0xa8063c) "' name='RPMH_BCM_SHADOW_STATUS_DRV8_BE_CMD_SENT_STATUS_CD4'/>"
WRITE #1 "        <register address='0xba80640' value='0x" DATA.LONG(A:0xa80640) "' name='RPMH_BCM_SHADOW_STATUS_DRV8_BE_CMD_SENT_STATUS_CD5'/>"
WRITE #1 "        <register address='0xba80644' value='0x" DATA.LONG(A:0xa80644) "' name='RPMH_BCM_SHADOW_STATUS_DRV8_BE_CMD_SENT_STATUS_CD6'/>"
WRITE #1 "        <register address='0xba80648' value='0x" DATA.LONG(A:0xa80648) "' name='RPMH_BCM_SHADOW_STATUS_DRV8_BE_CMD_SENT_STATUS_CD7'/>"
WRITE #1 "        <register address='0xba8064c' value='0x" DATA.LONG(A:0xa8064c) "' name='RPMH_BCM_SHADOW_STATUS_DRV8_BE_CMD_SENT_STATUS_CD8'/>"
WRITE #1 "        <register address='0xba80650' value='0x" DATA.LONG(A:0xa80650) "' name='RPMH_BCM_SHADOW_STATUS_DRV8_BE_CMD_SENT_STATUS_CD9'/>"
WRITE #1 "        <register address='0xba80654' value='0x" DATA.LONG(A:0xa80654) "' name='RPMH_BCM_SHADOW_STATUS_DRV8_BE_CMD_SENT_STATUS_CD10'/>"
WRITE #1 "        <register address='0xba80658' value='0x" DATA.LONG(A:0xa80658) "' name='RPMH_BCM_SHADOW_STATUS_DRV8_BE_CMD_SENT_STATUS_CD11'/>"
WRITE #1 "        <register address='0xba9062c' value='0x" DATA.LONG(A:0xa9062c) "' name='RPMH_BCM_SHADOW_STATUS_DRV9_BE_CMD_SENT_STATUS_CD0'/>"
WRITE #1 "        <register address='0xba90630' value='0x" DATA.LONG(A:0xa90630) "' name='RPMH_BCM_SHADOW_STATUS_DRV9_BE_CMD_SENT_STATUS_CD1'/>"
WRITE #1 "        <register address='0xba90634' value='0x" DATA.LONG(A:0xa90634) "' name='RPMH_BCM_SHADOW_STATUS_DRV9_BE_CMD_SENT_STATUS_CD2'/>"
WRITE #1 "        <register address='0xba90638' value='0x" DATA.LONG(A:0xa90638) "' name='RPMH_BCM_SHADOW_STATUS_DRV9_BE_CMD_SENT_STATUS_CD3'/>"
WRITE #1 "        <register address='0xba9063c' value='0x" DATA.LONG(A:0xa9063c) "' name='RPMH_BCM_SHADOW_STATUS_DRV9_BE_CMD_SENT_STATUS_CD4'/>"
WRITE #1 "        <register address='0xba90640' value='0x" DATA.LONG(A:0xa90640) "' name='RPMH_BCM_SHADOW_STATUS_DRV9_BE_CMD_SENT_STATUS_CD5'/>"
WRITE #1 "        <register address='0xba90644' value='0x" DATA.LONG(A:0xa90644) "' name='RPMH_BCM_SHADOW_STATUS_DRV9_BE_CMD_SENT_STATUS_CD6'/>"
WRITE #1 "        <register address='0xba90648' value='0x" DATA.LONG(A:0xa90648) "' name='RPMH_BCM_SHADOW_STATUS_DRV9_BE_CMD_SENT_STATUS_CD7'/>"
WRITE #1 "        <register address='0xba9064c' value='0x" DATA.LONG(A:0xa9064c) "' name='RPMH_BCM_SHADOW_STATUS_DRV9_BE_CMD_SENT_STATUS_CD8'/>"
WRITE #1 "        <register address='0xba90650' value='0x" DATA.LONG(A:0xa90650) "' name='RPMH_BCM_SHADOW_STATUS_DRV9_BE_CMD_SENT_STATUS_CD9'/>"
WRITE #1 "        <register address='0xba90654' value='0x" DATA.LONG(A:0xa90654) "' name='RPMH_BCM_SHADOW_STATUS_DRV9_BE_CMD_SENT_STATUS_CD10'/>"
WRITE #1 "        <register address='0xba90658' value='0x" DATA.LONG(A:0xa90658) "' name='RPMH_BCM_SHADOW_STATUS_DRV9_BE_CMD_SENT_STATUS_CD11'/>"
WRITE #1 "        <register address='0xba006ac' value='0x" DATA.LONG(A:0xa006ac) "' name='RPMH_BCM_SHADOW_STATUS_DRV0_BE_CMD_CMPL_STATUS_CD0'/>"
WRITE #1 "        <register address='0xba006b0' value='0x" DATA.LONG(A:0xa006b0) "' name='RPMH_BCM_SHADOW_STATUS_DRV0_BE_CMD_CMPL_STATUS_CD1'/>"
WRITE #1 "        <register address='0xba006b4' value='0x" DATA.LONG(A:0xa006b4) "' name='RPMH_BCM_SHADOW_STATUS_DRV0_BE_CMD_CMPL_STATUS_CD2'/>"
WRITE #1 "        <register address='0xba006b8' value='0x" DATA.LONG(A:0xa006b8) "' name='RPMH_BCM_SHADOW_STATUS_DRV0_BE_CMD_CMPL_STATUS_CD3'/>"
WRITE #1 "        <register address='0xba006bc' value='0x" DATA.LONG(A:0xa006bc) "' name='RPMH_BCM_SHADOW_STATUS_DRV0_BE_CMD_CMPL_STATUS_CD4'/>"
WRITE #1 "        <register address='0xba006c0' value='0x" DATA.LONG(A:0xa006c0) "' name='RPMH_BCM_SHADOW_STATUS_DRV0_BE_CMD_CMPL_STATUS_CD5'/>"
WRITE #1 "        <register address='0xba006c4' value='0x" DATA.LONG(A:0xa006c4) "' name='RPMH_BCM_SHADOW_STATUS_DRV0_BE_CMD_CMPL_STATUS_CD6'/>"
WRITE #1 "        <register address='0xba006c8' value='0x" DATA.LONG(A:0xa006c8) "' name='RPMH_BCM_SHADOW_STATUS_DRV0_BE_CMD_CMPL_STATUS_CD7'/>"
WRITE #1 "        <register address='0xba006cc' value='0x" DATA.LONG(A:0xa006cc) "' name='RPMH_BCM_SHADOW_STATUS_DRV0_BE_CMD_CMPL_STATUS_CD8'/>"
WRITE #1 "        <register address='0xba006d0' value='0x" DATA.LONG(A:0xa006d0) "' name='RPMH_BCM_SHADOW_STATUS_DRV0_BE_CMD_CMPL_STATUS_CD9'/>"
WRITE #1 "        <register address='0xba006d4' value='0x" DATA.LONG(A:0xa006d4) "' name='RPMH_BCM_SHADOW_STATUS_DRV0_BE_CMD_CMPL_STATUS_CD10'/>"
WRITE #1 "        <register address='0xba006d8' value='0x" DATA.LONG(A:0xa006d8) "' name='RPMH_BCM_SHADOW_STATUS_DRV0_BE_CMD_CMPL_STATUS_CD11'/>"
WRITE #1 "        <register address='0xba106ac' value='0x" DATA.LONG(A:0xa106ac) "' name='RPMH_BCM_SHADOW_STATUS_DRV1_BE_CMD_CMPL_STATUS_CD0'/>"
WRITE #1 "        <register address='0xba106b0' value='0x" DATA.LONG(A:0xa106b0) "' name='RPMH_BCM_SHADOW_STATUS_DRV1_BE_CMD_CMPL_STATUS_CD1'/>"
WRITE #1 "        <register address='0xba106b4' value='0x" DATA.LONG(A:0xa106b4) "' name='RPMH_BCM_SHADOW_STATUS_DRV1_BE_CMD_CMPL_STATUS_CD2'/>"
WRITE #1 "        <register address='0xba106b8' value='0x" DATA.LONG(A:0xa106b8) "' name='RPMH_BCM_SHADOW_STATUS_DRV1_BE_CMD_CMPL_STATUS_CD3'/>"
WRITE #1 "        <register address='0xba106bc' value='0x" DATA.LONG(A:0xa106bc) "' name='RPMH_BCM_SHADOW_STATUS_DRV1_BE_CMD_CMPL_STATUS_CD4'/>"
WRITE #1 "        <register address='0xba106c0' value='0x" DATA.LONG(A:0xa106c0) "' name='RPMH_BCM_SHADOW_STATUS_DRV1_BE_CMD_CMPL_STATUS_CD5'/>"
WRITE #1 "        <register address='0xba106c4' value='0x" DATA.LONG(A:0xa106c4) "' name='RPMH_BCM_SHADOW_STATUS_DRV1_BE_CMD_CMPL_STATUS_CD6'/>"
WRITE #1 "        <register address='0xba106c8' value='0x" DATA.LONG(A:0xa106c8) "' name='RPMH_BCM_SHADOW_STATUS_DRV1_BE_CMD_CMPL_STATUS_CD7'/>"
WRITE #1 "        <register address='0xba106cc' value='0x" DATA.LONG(A:0xa106cc) "' name='RPMH_BCM_SHADOW_STATUS_DRV1_BE_CMD_CMPL_STATUS_CD8'/>"
WRITE #1 "        <register address='0xba106d0' value='0x" DATA.LONG(A:0xa106d0) "' name='RPMH_BCM_SHADOW_STATUS_DRV1_BE_CMD_CMPL_STATUS_CD9'/>"
WRITE #1 "        <register address='0xba106d4' value='0x" DATA.LONG(A:0xa106d4) "' name='RPMH_BCM_SHADOW_STATUS_DRV1_BE_CMD_CMPL_STATUS_CD10'/>"
WRITE #1 "        <register address='0xba106d8' value='0x" DATA.LONG(A:0xa106d8) "' name='RPMH_BCM_SHADOW_STATUS_DRV1_BE_CMD_CMPL_STATUS_CD11'/>"
WRITE #1 "        <register address='0xba206ac' value='0x" DATA.LONG(A:0xa206ac) "' name='RPMH_BCM_SHADOW_STATUS_DRV2_BE_CMD_CMPL_STATUS_CD0'/>"
WRITE #1 "        <register address='0xba206b0' value='0x" DATA.LONG(A:0xa206b0) "' name='RPMH_BCM_SHADOW_STATUS_DRV2_BE_CMD_CMPL_STATUS_CD1'/>"
WRITE #1 "        <register address='0xba206b4' value='0x" DATA.LONG(A:0xa206b4) "' name='RPMH_BCM_SHADOW_STATUS_DRV2_BE_CMD_CMPL_STATUS_CD2'/>"
WRITE #1 "        <register address='0xba206b8' value='0x" DATA.LONG(A:0xa206b8) "' name='RPMH_BCM_SHADOW_STATUS_DRV2_BE_CMD_CMPL_STATUS_CD3'/>"
WRITE #1 "        <register address='0xba206bc' value='0x" DATA.LONG(A:0xa206bc) "' name='RPMH_BCM_SHADOW_STATUS_DRV2_BE_CMD_CMPL_STATUS_CD4'/>"
WRITE #1 "        <register address='0xba206c0' value='0x" DATA.LONG(A:0xa206c0) "' name='RPMH_BCM_SHADOW_STATUS_DRV2_BE_CMD_CMPL_STATUS_CD5'/>"
WRITE #1 "        <register address='0xba206c4' value='0x" DATA.LONG(A:0xa206c4) "' name='RPMH_BCM_SHADOW_STATUS_DRV2_BE_CMD_CMPL_STATUS_CD6'/>"
WRITE #1 "        <register address='0xba206c8' value='0x" DATA.LONG(A:0xa206c8) "' name='RPMH_BCM_SHADOW_STATUS_DRV2_BE_CMD_CMPL_STATUS_CD7'/>"
WRITE #1 "        <register address='0xba206cc' value='0x" DATA.LONG(A:0xa206cc) "' name='RPMH_BCM_SHADOW_STATUS_DRV2_BE_CMD_CMPL_STATUS_CD8'/>"
WRITE #1 "        <register address='0xba206d0' value='0x" DATA.LONG(A:0xa206d0) "' name='RPMH_BCM_SHADOW_STATUS_DRV2_BE_CMD_CMPL_STATUS_CD9'/>"
WRITE #1 "        <register address='0xba206d4' value='0x" DATA.LONG(A:0xa206d4) "' name='RPMH_BCM_SHADOW_STATUS_DRV2_BE_CMD_CMPL_STATUS_CD10'/>"
WRITE #1 "        <register address='0xba206d8' value='0x" DATA.LONG(A:0xa206d8) "' name='RPMH_BCM_SHADOW_STATUS_DRV2_BE_CMD_CMPL_STATUS_CD11'/>"
WRITE #1 "        <register address='0xba306ac' value='0x" DATA.LONG(A:0xa306ac) "' name='RPMH_BCM_SHADOW_STATUS_DRV3_BE_CMD_CMPL_STATUS_CD0'/>"
WRITE #1 "        <register address='0xba306b0' value='0x" DATA.LONG(A:0xa306b0) "' name='RPMH_BCM_SHADOW_STATUS_DRV3_BE_CMD_CMPL_STATUS_CD1'/>"
WRITE #1 "        <register address='0xba306b4' value='0x" DATA.LONG(A:0xa306b4) "' name='RPMH_BCM_SHADOW_STATUS_DRV3_BE_CMD_CMPL_STATUS_CD2'/>"
WRITE #1 "        <register address='0xba306b8' value='0x" DATA.LONG(A:0xa306b8) "' name='RPMH_BCM_SHADOW_STATUS_DRV3_BE_CMD_CMPL_STATUS_CD3'/>"
WRITE #1 "        <register address='0xba306bc' value='0x" DATA.LONG(A:0xa306bc) "' name='RPMH_BCM_SHADOW_STATUS_DRV3_BE_CMD_CMPL_STATUS_CD4'/>"
WRITE #1 "        <register address='0xba306c0' value='0x" DATA.LONG(A:0xa306c0) "' name='RPMH_BCM_SHADOW_STATUS_DRV3_BE_CMD_CMPL_STATUS_CD5'/>"
WRITE #1 "        <register address='0xba306c4' value='0x" DATA.LONG(A:0xa306c4) "' name='RPMH_BCM_SHADOW_STATUS_DRV3_BE_CMD_CMPL_STATUS_CD6'/>"
WRITE #1 "        <register address='0xba306c8' value='0x" DATA.LONG(A:0xa306c8) "' name='RPMH_BCM_SHADOW_STATUS_DRV3_BE_CMD_CMPL_STATUS_CD7'/>"
WRITE #1 "        <register address='0xba306cc' value='0x" DATA.LONG(A:0xa306cc) "' name='RPMH_BCM_SHADOW_STATUS_DRV3_BE_CMD_CMPL_STATUS_CD8'/>"
WRITE #1 "        <register address='0xba306d0' value='0x" DATA.LONG(A:0xa306d0) "' name='RPMH_BCM_SHADOW_STATUS_DRV3_BE_CMD_CMPL_STATUS_CD9'/>"
WRITE #1 "        <register address='0xba306d4' value='0x" DATA.LONG(A:0xa306d4) "' name='RPMH_BCM_SHADOW_STATUS_DRV3_BE_CMD_CMPL_STATUS_CD10'/>"
WRITE #1 "        <register address='0xba306d8' value='0x" DATA.LONG(A:0xa306d8) "' name='RPMH_BCM_SHADOW_STATUS_DRV3_BE_CMD_CMPL_STATUS_CD11'/>"
WRITE #1 "        <register address='0xba406ac' value='0x" DATA.LONG(A:0xa406ac) "' name='RPMH_BCM_SHADOW_STATUS_DRV4_BE_CMD_CMPL_STATUS_CD0'/>"
WRITE #1 "        <register address='0xba406b0' value='0x" DATA.LONG(A:0xa406b0) "' name='RPMH_BCM_SHADOW_STATUS_DRV4_BE_CMD_CMPL_STATUS_CD1'/>"
WRITE #1 "        <register address='0xba406b4' value='0x" DATA.LONG(A:0xa406b4) "' name='RPMH_BCM_SHADOW_STATUS_DRV4_BE_CMD_CMPL_STATUS_CD2'/>"
WRITE #1 "        <register address='0xba406b8' value='0x" DATA.LONG(A:0xa406b8) "' name='RPMH_BCM_SHADOW_STATUS_DRV4_BE_CMD_CMPL_STATUS_CD3'/>"
WRITE #1 "        <register address='0xba406bc' value='0x" DATA.LONG(A:0xa406bc) "' name='RPMH_BCM_SHADOW_STATUS_DRV4_BE_CMD_CMPL_STATUS_CD4'/>"
WRITE #1 "        <register address='0xba406c0' value='0x" DATA.LONG(A:0xa406c0) "' name='RPMH_BCM_SHADOW_STATUS_DRV4_BE_CMD_CMPL_STATUS_CD5'/>"
WRITE #1 "        <register address='0xba406c4' value='0x" DATA.LONG(A:0xa406c4) "' name='RPMH_BCM_SHADOW_STATUS_DRV4_BE_CMD_CMPL_STATUS_CD6'/>"
WRITE #1 "        <register address='0xba406c8' value='0x" DATA.LONG(A:0xa406c8) "' name='RPMH_BCM_SHADOW_STATUS_DRV4_BE_CMD_CMPL_STATUS_CD7'/>"
WRITE #1 "        <register address='0xba406cc' value='0x" DATA.LONG(A:0xa406cc) "' name='RPMH_BCM_SHADOW_STATUS_DRV4_BE_CMD_CMPL_STATUS_CD8'/>"
WRITE #1 "        <register address='0xba406d0' value='0x" DATA.LONG(A:0xa406d0) "' name='RPMH_BCM_SHADOW_STATUS_DRV4_BE_CMD_CMPL_STATUS_CD9'/>"
WRITE #1 "        <register address='0xba406d4' value='0x" DATA.LONG(A:0xa406d4) "' name='RPMH_BCM_SHADOW_STATUS_DRV4_BE_CMD_CMPL_STATUS_CD10'/>"
WRITE #1 "        <register address='0xba406d8' value='0x" DATA.LONG(A:0xa406d8) "' name='RPMH_BCM_SHADOW_STATUS_DRV4_BE_CMD_CMPL_STATUS_CD11'/>"
WRITE #1 "        <register address='0xba506ac' value='0x" DATA.LONG(A:0xa506ac) "' name='RPMH_BCM_SHADOW_STATUS_DRV5_BE_CMD_CMPL_STATUS_CD0'/>"
WRITE #1 "        <register address='0xba506b0' value='0x" DATA.LONG(A:0xa506b0) "' name='RPMH_BCM_SHADOW_STATUS_DRV5_BE_CMD_CMPL_STATUS_CD1'/>"
WRITE #1 "        <register address='0xba506b4' value='0x" DATA.LONG(A:0xa506b4) "' name='RPMH_BCM_SHADOW_STATUS_DRV5_BE_CMD_CMPL_STATUS_CD2'/>"
WRITE #1 "        <register address='0xba506b8' value='0x" DATA.LONG(A:0xa506b8) "' name='RPMH_BCM_SHADOW_STATUS_DRV5_BE_CMD_CMPL_STATUS_CD3'/>"
WRITE #1 "        <register address='0xba506bc' value='0x" DATA.LONG(A:0xa506bc) "' name='RPMH_BCM_SHADOW_STATUS_DRV5_BE_CMD_CMPL_STATUS_CD4'/>"
WRITE #1 "        <register address='0xba506c0' value='0x" DATA.LONG(A:0xa506c0) "' name='RPMH_BCM_SHADOW_STATUS_DRV5_BE_CMD_CMPL_STATUS_CD5'/>"
WRITE #1 "        <register address='0xba506c4' value='0x" DATA.LONG(A:0xa506c4) "' name='RPMH_BCM_SHADOW_STATUS_DRV5_BE_CMD_CMPL_STATUS_CD6'/>"
WRITE #1 "        <register address='0xba506c8' value='0x" DATA.LONG(A:0xa506c8) "' name='RPMH_BCM_SHADOW_STATUS_DRV5_BE_CMD_CMPL_STATUS_CD7'/>"
WRITE #1 "        <register address='0xba506cc' value='0x" DATA.LONG(A:0xa506cc) "' name='RPMH_BCM_SHADOW_STATUS_DRV5_BE_CMD_CMPL_STATUS_CD8'/>"
WRITE #1 "        <register address='0xba506d0' value='0x" DATA.LONG(A:0xa506d0) "' name='RPMH_BCM_SHADOW_STATUS_DRV5_BE_CMD_CMPL_STATUS_CD9'/>"
WRITE #1 "        <register address='0xba506d4' value='0x" DATA.LONG(A:0xa506d4) "' name='RPMH_BCM_SHADOW_STATUS_DRV5_BE_CMD_CMPL_STATUS_CD10'/>"
WRITE #1 "        <register address='0xba506d8' value='0x" DATA.LONG(A:0xa506d8) "' name='RPMH_BCM_SHADOW_STATUS_DRV5_BE_CMD_CMPL_STATUS_CD11'/>"
WRITE #1 "        <register address='0xba606ac' value='0x" DATA.LONG(A:0xa606ac) "' name='RPMH_BCM_SHADOW_STATUS_DRV6_BE_CMD_CMPL_STATUS_CD0'/>"
WRITE #1 "        <register address='0xba606b0' value='0x" DATA.LONG(A:0xa606b0) "' name='RPMH_BCM_SHADOW_STATUS_DRV6_BE_CMD_CMPL_STATUS_CD1'/>"
WRITE #1 "        <register address='0xba606b4' value='0x" DATA.LONG(A:0xa606b4) "' name='RPMH_BCM_SHADOW_STATUS_DRV6_BE_CMD_CMPL_STATUS_CD2'/>"
WRITE #1 "        <register address='0xba606b8' value='0x" DATA.LONG(A:0xa606b8) "' name='RPMH_BCM_SHADOW_STATUS_DRV6_BE_CMD_CMPL_STATUS_CD3'/>"
WRITE #1 "        <register address='0xba606bc' value='0x" DATA.LONG(A:0xa606bc) "' name='RPMH_BCM_SHADOW_STATUS_DRV6_BE_CMD_CMPL_STATUS_CD4'/>"
WRITE #1 "        <register address='0xba606c0' value='0x" DATA.LONG(A:0xa606c0) "' name='RPMH_BCM_SHADOW_STATUS_DRV6_BE_CMD_CMPL_STATUS_CD5'/>"
WRITE #1 "        <register address='0xba606c4' value='0x" DATA.LONG(A:0xa606c4) "' name='RPMH_BCM_SHADOW_STATUS_DRV6_BE_CMD_CMPL_STATUS_CD6'/>"
WRITE #1 "        <register address='0xba606c8' value='0x" DATA.LONG(A:0xa606c8) "' name='RPMH_BCM_SHADOW_STATUS_DRV6_BE_CMD_CMPL_STATUS_CD7'/>"
WRITE #1 "        <register address='0xba606cc' value='0x" DATA.LONG(A:0xa606cc) "' name='RPMH_BCM_SHADOW_STATUS_DRV6_BE_CMD_CMPL_STATUS_CD8'/>"
WRITE #1 "        <register address='0xba606d0' value='0x" DATA.LONG(A:0xa606d0) "' name='RPMH_BCM_SHADOW_STATUS_DRV6_BE_CMD_CMPL_STATUS_CD9'/>"
WRITE #1 "        <register address='0xba606d4' value='0x" DATA.LONG(A:0xa606d4) "' name='RPMH_BCM_SHADOW_STATUS_DRV6_BE_CMD_CMPL_STATUS_CD10'/>"
WRITE #1 "        <register address='0xba606d8' value='0x" DATA.LONG(A:0xa606d8) "' name='RPMH_BCM_SHADOW_STATUS_DRV6_BE_CMD_CMPL_STATUS_CD11'/>"
WRITE #1 "        <register address='0xba706ac' value='0x" DATA.LONG(A:0xa706ac) "' name='RPMH_BCM_SHADOW_STATUS_DRV7_BE_CMD_CMPL_STATUS_CD0'/>"
WRITE #1 "        <register address='0xba706b0' value='0x" DATA.LONG(A:0xa706b0) "' name='RPMH_BCM_SHADOW_STATUS_DRV7_BE_CMD_CMPL_STATUS_CD1'/>"
WRITE #1 "        <register address='0xba706b4' value='0x" DATA.LONG(A:0xa706b4) "' name='RPMH_BCM_SHADOW_STATUS_DRV7_BE_CMD_CMPL_STATUS_CD2'/>"
WRITE #1 "        <register address='0xba706b8' value='0x" DATA.LONG(A:0xa706b8) "' name='RPMH_BCM_SHADOW_STATUS_DRV7_BE_CMD_CMPL_STATUS_CD3'/>"
WRITE #1 "        <register address='0xba706bc' value='0x" DATA.LONG(A:0xa706bc) "' name='RPMH_BCM_SHADOW_STATUS_DRV7_BE_CMD_CMPL_STATUS_CD4'/>"
WRITE #1 "        <register address='0xba706c0' value='0x" DATA.LONG(A:0xa706c0) "' name='RPMH_BCM_SHADOW_STATUS_DRV7_BE_CMD_CMPL_STATUS_CD5'/>"
WRITE #1 "        <register address='0xba706c4' value='0x" DATA.LONG(A:0xa706c4) "' name='RPMH_BCM_SHADOW_STATUS_DRV7_BE_CMD_CMPL_STATUS_CD6'/>"
WRITE #1 "        <register address='0xba706c8' value='0x" DATA.LONG(A:0xa706c8) "' name='RPMH_BCM_SHADOW_STATUS_DRV7_BE_CMD_CMPL_STATUS_CD7'/>"
WRITE #1 "        <register address='0xba706cc' value='0x" DATA.LONG(A:0xa706cc) "' name='RPMH_BCM_SHADOW_STATUS_DRV7_BE_CMD_CMPL_STATUS_CD8'/>"
WRITE #1 "        <register address='0xba706d0' value='0x" DATA.LONG(A:0xa706d0) "' name='RPMH_BCM_SHADOW_STATUS_DRV7_BE_CMD_CMPL_STATUS_CD9'/>"
WRITE #1 "        <register address='0xba706d4' value='0x" DATA.LONG(A:0xa706d4) "' name='RPMH_BCM_SHADOW_STATUS_DRV7_BE_CMD_CMPL_STATUS_CD10'/>"
WRITE #1 "        <register address='0xba706d8' value='0x" DATA.LONG(A:0xa706d8) "' name='RPMH_BCM_SHADOW_STATUS_DRV7_BE_CMD_CMPL_STATUS_CD11'/>"
WRITE #1 "        <register address='0xba806ac' value='0x" DATA.LONG(A:0xa806ac) "' name='RPMH_BCM_SHADOW_STATUS_DRV8_BE_CMD_CMPL_STATUS_CD0'/>"
WRITE #1 "        <register address='0xba806b0' value='0x" DATA.LONG(A:0xa806b0) "' name='RPMH_BCM_SHADOW_STATUS_DRV8_BE_CMD_CMPL_STATUS_CD1'/>"
WRITE #1 "        <register address='0xba806b4' value='0x" DATA.LONG(A:0xa806b4) "' name='RPMH_BCM_SHADOW_STATUS_DRV8_BE_CMD_CMPL_STATUS_CD2'/>"
WRITE #1 "        <register address='0xba806b8' value='0x" DATA.LONG(A:0xa806b8) "' name='RPMH_BCM_SHADOW_STATUS_DRV8_BE_CMD_CMPL_STATUS_CD3'/>"
WRITE #1 "        <register address='0xba806bc' value='0x" DATA.LONG(A:0xa806bc) "' name='RPMH_BCM_SHADOW_STATUS_DRV8_BE_CMD_CMPL_STATUS_CD4'/>"
WRITE #1 "        <register address='0xba806c0' value='0x" DATA.LONG(A:0xa806c0) "' name='RPMH_BCM_SHADOW_STATUS_DRV8_BE_CMD_CMPL_STATUS_CD5'/>"
WRITE #1 "        <register address='0xba806c4' value='0x" DATA.LONG(A:0xa806c4) "' name='RPMH_BCM_SHADOW_STATUS_DRV8_BE_CMD_CMPL_STATUS_CD6'/>"
WRITE #1 "        <register address='0xba806c8' value='0x" DATA.LONG(A:0xa806c8) "' name='RPMH_BCM_SHADOW_STATUS_DRV8_BE_CMD_CMPL_STATUS_CD7'/>"
WRITE #1 "        <register address='0xba806cc' value='0x" DATA.LONG(A:0xa806cc) "' name='RPMH_BCM_SHADOW_STATUS_DRV8_BE_CMD_CMPL_STATUS_CD8'/>"
WRITE #1 "        <register address='0xba806d0' value='0x" DATA.LONG(A:0xa806d0) "' name='RPMH_BCM_SHADOW_STATUS_DRV8_BE_CMD_CMPL_STATUS_CD9'/>"
WRITE #1 "        <register address='0xba806d4' value='0x" DATA.LONG(A:0xa806d4) "' name='RPMH_BCM_SHADOW_STATUS_DRV8_BE_CMD_CMPL_STATUS_CD10'/>"
WRITE #1 "        <register address='0xba806d8' value='0x" DATA.LONG(A:0xa806d8) "' name='RPMH_BCM_SHADOW_STATUS_DRV8_BE_CMD_CMPL_STATUS_CD11'/>"
WRITE #1 "        <register address='0xba906ac' value='0x" DATA.LONG(A:0xa906ac) "' name='RPMH_BCM_SHADOW_STATUS_DRV9_BE_CMD_CMPL_STATUS_CD0'/>"
WRITE #1 "        <register address='0xba906b0' value='0x" DATA.LONG(A:0xa906b0) "' name='RPMH_BCM_SHADOW_STATUS_DRV9_BE_CMD_CMPL_STATUS_CD1'/>"
WRITE #1 "        <register address='0xba906b4' value='0x" DATA.LONG(A:0xa906b4) "' name='RPMH_BCM_SHADOW_STATUS_DRV9_BE_CMD_CMPL_STATUS_CD2'/>"
WRITE #1 "        <register address='0xba906b8' value='0x" DATA.LONG(A:0xa906b8) "' name='RPMH_BCM_SHADOW_STATUS_DRV9_BE_CMD_CMPL_STATUS_CD3'/>"
WRITE #1 "        <register address='0xba906bc' value='0x" DATA.LONG(A:0xa906bc) "' name='RPMH_BCM_SHADOW_STATUS_DRV9_BE_CMD_CMPL_STATUS_CD4'/>"
WRITE #1 "        <register address='0xba906c0' value='0x" DATA.LONG(A:0xa906c0) "' name='RPMH_BCM_SHADOW_STATUS_DRV9_BE_CMD_CMPL_STATUS_CD5'/>"
WRITE #1 "        <register address='0xba906c4' value='0x" DATA.LONG(A:0xa906c4) "' name='RPMH_BCM_SHADOW_STATUS_DRV9_BE_CMD_CMPL_STATUS_CD6'/>"
WRITE #1 "        <register address='0xba906c8' value='0x" DATA.LONG(A:0xa906c8) "' name='RPMH_BCM_SHADOW_STATUS_DRV9_BE_CMD_CMPL_STATUS_CD7'/>"
WRITE #1 "        <register address='0xba906cc' value='0x" DATA.LONG(A:0xa906cc) "' name='RPMH_BCM_SHADOW_STATUS_DRV9_BE_CMD_CMPL_STATUS_CD8'/>"
WRITE #1 "        <register address='0xba906d0' value='0x" DATA.LONG(A:0xa906d0) "' name='RPMH_BCM_SHADOW_STATUS_DRV9_BE_CMD_CMPL_STATUS_CD9'/>"
WRITE #1 "        <register address='0xba906d4' value='0x" DATA.LONG(A:0xa906d4) "' name='RPMH_BCM_SHADOW_STATUS_DRV9_BE_CMD_CMPL_STATUS_CD10'/>"
WRITE #1 "        <register address='0xba906d8' value='0x" DATA.LONG(A:0xa906d8) "' name='RPMH_BCM_SHADOW_STATUS_DRV9_BE_CMD_CMPL_STATUS_CD11'/>"
WRITE #1 "        <register address='0xba0072c' value='0x" DATA.LONG(A:0xa0072c) "' name='RPMH_BCM_SHADOW_STATUS_DRV0_BE_TCS_STATUS_CD0'/>"
WRITE #1 "        <register address='0xba00730' value='0x" DATA.LONG(A:0xa00730) "' name='RPMH_BCM_SHADOW_STATUS_DRV0_BE_TCS_STATUS_CD1'/>"
WRITE #1 "        <register address='0xba00734' value='0x" DATA.LONG(A:0xa00734) "' name='RPMH_BCM_SHADOW_STATUS_DRV0_BE_TCS_STATUS_CD2'/>"
WRITE #1 "        <register address='0xba00738' value='0x" DATA.LONG(A:0xa00738) "' name='RPMH_BCM_SHADOW_STATUS_DRV0_BE_TCS_STATUS_CD3'/>"
WRITE #1 "        <register address='0xba0073c' value='0x" DATA.LONG(A:0xa0073c) "' name='RPMH_BCM_SHADOW_STATUS_DRV0_BE_TCS_STATUS_CD4'/>"
WRITE #1 "        <register address='0xba00740' value='0x" DATA.LONG(A:0xa00740) "' name='RPMH_BCM_SHADOW_STATUS_DRV0_BE_TCS_STATUS_CD5'/>"
WRITE #1 "        <register address='0xba00744' value='0x" DATA.LONG(A:0xa00744) "' name='RPMH_BCM_SHADOW_STATUS_DRV0_BE_TCS_STATUS_CD6'/>"
WRITE #1 "        <register address='0xba00748' value='0x" DATA.LONG(A:0xa00748) "' name='RPMH_BCM_SHADOW_STATUS_DRV0_BE_TCS_STATUS_CD7'/>"
WRITE #1 "        <register address='0xba0074c' value='0x" DATA.LONG(A:0xa0074c) "' name='RPMH_BCM_SHADOW_STATUS_DRV0_BE_TCS_STATUS_CD8'/>"
WRITE #1 "        <register address='0xba00750' value='0x" DATA.LONG(A:0xa00750) "' name='RPMH_BCM_SHADOW_STATUS_DRV0_BE_TCS_STATUS_CD9'/>"
WRITE #1 "        <register address='0xba00754' value='0x" DATA.LONG(A:0xa00754) "' name='RPMH_BCM_SHADOW_STATUS_DRV0_BE_TCS_STATUS_CD10'/>"
WRITE #1 "        <register address='0xba00758' value='0x" DATA.LONG(A:0xa00758) "' name='RPMH_BCM_SHADOW_STATUS_DRV0_BE_TCS_STATUS_CD11'/>"
WRITE #1 "        <register address='0xba1072c' value='0x" DATA.LONG(A:0xa1072c) "' name='RPMH_BCM_SHADOW_STATUS_DRV1_BE_TCS_STATUS_CD0'/>"
WRITE #1 "        <register address='0xba10730' value='0x" DATA.LONG(A:0xa10730) "' name='RPMH_BCM_SHADOW_STATUS_DRV1_BE_TCS_STATUS_CD1'/>"
WRITE #1 "        <register address='0xba10734' value='0x" DATA.LONG(A:0xa10734) "' name='RPMH_BCM_SHADOW_STATUS_DRV1_BE_TCS_STATUS_CD2'/>"
WRITE #1 "        <register address='0xba10738' value='0x" DATA.LONG(A:0xa10738) "' name='RPMH_BCM_SHADOW_STATUS_DRV1_BE_TCS_STATUS_CD3'/>"
WRITE #1 "        <register address='0xba1073c' value='0x" DATA.LONG(A:0xa1073c) "' name='RPMH_BCM_SHADOW_STATUS_DRV1_BE_TCS_STATUS_CD4'/>"
WRITE #1 "        <register address='0xba10740' value='0x" DATA.LONG(A:0xa10740) "' name='RPMH_BCM_SHADOW_STATUS_DRV1_BE_TCS_STATUS_CD5'/>"
WRITE #1 "        <register address='0xba10744' value='0x" DATA.LONG(A:0xa10744) "' name='RPMH_BCM_SHADOW_STATUS_DRV1_BE_TCS_STATUS_CD6'/>"
WRITE #1 "        <register address='0xba10748' value='0x" DATA.LONG(A:0xa10748) "' name='RPMH_BCM_SHADOW_STATUS_DRV1_BE_TCS_STATUS_CD7'/>"
WRITE #1 "        <register address='0xba1074c' value='0x" DATA.LONG(A:0xa1074c) "' name='RPMH_BCM_SHADOW_STATUS_DRV1_BE_TCS_STATUS_CD8'/>"
WRITE #1 "        <register address='0xba10750' value='0x" DATA.LONG(A:0xa10750) "' name='RPMH_BCM_SHADOW_STATUS_DRV1_BE_TCS_STATUS_CD9'/>"
WRITE #1 "        <register address='0xba10754' value='0x" DATA.LONG(A:0xa10754) "' name='RPMH_BCM_SHADOW_STATUS_DRV1_BE_TCS_STATUS_CD10'/>"
WRITE #1 "        <register address='0xba10758' value='0x" DATA.LONG(A:0xa10758) "' name='RPMH_BCM_SHADOW_STATUS_DRV1_BE_TCS_STATUS_CD11'/>"
WRITE #1 "        <register address='0xba2072c' value='0x" DATA.LONG(A:0xa2072c) "' name='RPMH_BCM_SHADOW_STATUS_DRV2_BE_TCS_STATUS_CD0'/>"
WRITE #1 "        <register address='0xba20730' value='0x" DATA.LONG(A:0xa20730) "' name='RPMH_BCM_SHADOW_STATUS_DRV2_BE_TCS_STATUS_CD1'/>"
WRITE #1 "        <register address='0xba20734' value='0x" DATA.LONG(A:0xa20734) "' name='RPMH_BCM_SHADOW_STATUS_DRV2_BE_TCS_STATUS_CD2'/>"
WRITE #1 "        <register address='0xba20738' value='0x" DATA.LONG(A:0xa20738) "' name='RPMH_BCM_SHADOW_STATUS_DRV2_BE_TCS_STATUS_CD3'/>"
WRITE #1 "        <register address='0xba2073c' value='0x" DATA.LONG(A:0xa2073c) "' name='RPMH_BCM_SHADOW_STATUS_DRV2_BE_TCS_STATUS_CD4'/>"
WRITE #1 "        <register address='0xba20740' value='0x" DATA.LONG(A:0xa20740) "' name='RPMH_BCM_SHADOW_STATUS_DRV2_BE_TCS_STATUS_CD5'/>"
WRITE #1 "        <register address='0xba20744' value='0x" DATA.LONG(A:0xa20744) "' name='RPMH_BCM_SHADOW_STATUS_DRV2_BE_TCS_STATUS_CD6'/>"
WRITE #1 "        <register address='0xba20748' value='0x" DATA.LONG(A:0xa20748) "' name='RPMH_BCM_SHADOW_STATUS_DRV2_BE_TCS_STATUS_CD7'/>"
WRITE #1 "        <register address='0xba2074c' value='0x" DATA.LONG(A:0xa2074c) "' name='RPMH_BCM_SHADOW_STATUS_DRV2_BE_TCS_STATUS_CD8'/>"
WRITE #1 "        <register address='0xba20750' value='0x" DATA.LONG(A:0xa20750) "' name='RPMH_BCM_SHADOW_STATUS_DRV2_BE_TCS_STATUS_CD9'/>"
WRITE #1 "        <register address='0xba20754' value='0x" DATA.LONG(A:0xa20754) "' name='RPMH_BCM_SHADOW_STATUS_DRV2_BE_TCS_STATUS_CD10'/>"
WRITE #1 "        <register address='0xba20758' value='0x" DATA.LONG(A:0xa20758) "' name='RPMH_BCM_SHADOW_STATUS_DRV2_BE_TCS_STATUS_CD11'/>"
WRITE #1 "        <register address='0xba3072c' value='0x" DATA.LONG(A:0xa3072c) "' name='RPMH_BCM_SHADOW_STATUS_DRV3_BE_TCS_STATUS_CD0'/>"
WRITE #1 "        <register address='0xba30730' value='0x" DATA.LONG(A:0xa30730) "' name='RPMH_BCM_SHADOW_STATUS_DRV3_BE_TCS_STATUS_CD1'/>"
WRITE #1 "        <register address='0xba30734' value='0x" DATA.LONG(A:0xa30734) "' name='RPMH_BCM_SHADOW_STATUS_DRV3_BE_TCS_STATUS_CD2'/>"
WRITE #1 "        <register address='0xba30738' value='0x" DATA.LONG(A:0xa30738) "' name='RPMH_BCM_SHADOW_STATUS_DRV3_BE_TCS_STATUS_CD3'/>"
WRITE #1 "        <register address='0xba3073c' value='0x" DATA.LONG(A:0xa3073c) "' name='RPMH_BCM_SHADOW_STATUS_DRV3_BE_TCS_STATUS_CD4'/>"
WRITE #1 "        <register address='0xba30740' value='0x" DATA.LONG(A:0xa30740) "' name='RPMH_BCM_SHADOW_STATUS_DRV3_BE_TCS_STATUS_CD5'/>"
WRITE #1 "        <register address='0xba30744' value='0x" DATA.LONG(A:0xa30744) "' name='RPMH_BCM_SHADOW_STATUS_DRV3_BE_TCS_STATUS_CD6'/>"
WRITE #1 "        <register address='0xba30748' value='0x" DATA.LONG(A:0xa30748) "' name='RPMH_BCM_SHADOW_STATUS_DRV3_BE_TCS_STATUS_CD7'/>"
WRITE #1 "        <register address='0xba3074c' value='0x" DATA.LONG(A:0xa3074c) "' name='RPMH_BCM_SHADOW_STATUS_DRV3_BE_TCS_STATUS_CD8'/>"
WRITE #1 "        <register address='0xba30750' value='0x" DATA.LONG(A:0xa30750) "' name='RPMH_BCM_SHADOW_STATUS_DRV3_BE_TCS_STATUS_CD9'/>"
WRITE #1 "        <register address='0xba30754' value='0x" DATA.LONG(A:0xa30754) "' name='RPMH_BCM_SHADOW_STATUS_DRV3_BE_TCS_STATUS_CD10'/>"
WRITE #1 "        <register address='0xba30758' value='0x" DATA.LONG(A:0xa30758) "' name='RPMH_BCM_SHADOW_STATUS_DRV3_BE_TCS_STATUS_CD11'/>"
WRITE #1 "        <register address='0xba4072c' value='0x" DATA.LONG(A:0xa4072c) "' name='RPMH_BCM_SHADOW_STATUS_DRV4_BE_TCS_STATUS_CD0'/>"
WRITE #1 "        <register address='0xba40730' value='0x" DATA.LONG(A:0xa40730) "' name='RPMH_BCM_SHADOW_STATUS_DRV4_BE_TCS_STATUS_CD1'/>"
WRITE #1 "        <register address='0xba40734' value='0x" DATA.LONG(A:0xa40734) "' name='RPMH_BCM_SHADOW_STATUS_DRV4_BE_TCS_STATUS_CD2'/>"
WRITE #1 "        <register address='0xba40738' value='0x" DATA.LONG(A:0xa40738) "' name='RPMH_BCM_SHADOW_STATUS_DRV4_BE_TCS_STATUS_CD3'/>"
WRITE #1 "        <register address='0xba4073c' value='0x" DATA.LONG(A:0xa4073c) "' name='RPMH_BCM_SHADOW_STATUS_DRV4_BE_TCS_STATUS_CD4'/>"
WRITE #1 "        <register address='0xba40740' value='0x" DATA.LONG(A:0xa40740) "' name='RPMH_BCM_SHADOW_STATUS_DRV4_BE_TCS_STATUS_CD5'/>"
WRITE #1 "        <register address='0xba40744' value='0x" DATA.LONG(A:0xa40744) "' name='RPMH_BCM_SHADOW_STATUS_DRV4_BE_TCS_STATUS_CD6'/>"
WRITE #1 "        <register address='0xba40748' value='0x" DATA.LONG(A:0xa40748) "' name='RPMH_BCM_SHADOW_STATUS_DRV4_BE_TCS_STATUS_CD7'/>"
WRITE #1 "        <register address='0xba4074c' value='0x" DATA.LONG(A:0xa4074c) "' name='RPMH_BCM_SHADOW_STATUS_DRV4_BE_TCS_STATUS_CD8'/>"
WRITE #1 "        <register address='0xba40750' value='0x" DATA.LONG(A:0xa40750) "' name='RPMH_BCM_SHADOW_STATUS_DRV4_BE_TCS_STATUS_CD9'/>"
WRITE #1 "        <register address='0xba40754' value='0x" DATA.LONG(A:0xa40754) "' name='RPMH_BCM_SHADOW_STATUS_DRV4_BE_TCS_STATUS_CD10'/>"
WRITE #1 "        <register address='0xba40758' value='0x" DATA.LONG(A:0xa40758) "' name='RPMH_BCM_SHADOW_STATUS_DRV4_BE_TCS_STATUS_CD11'/>"
WRITE #1 "        <register address='0xba5072c' value='0x" DATA.LONG(A:0xa5072c) "' name='RPMH_BCM_SHADOW_STATUS_DRV5_BE_TCS_STATUS_CD0'/>"
WRITE #1 "        <register address='0xba50730' value='0x" DATA.LONG(A:0xa50730) "' name='RPMH_BCM_SHADOW_STATUS_DRV5_BE_TCS_STATUS_CD1'/>"
WRITE #1 "        <register address='0xba50734' value='0x" DATA.LONG(A:0xa50734) "' name='RPMH_BCM_SHADOW_STATUS_DRV5_BE_TCS_STATUS_CD2'/>"
WRITE #1 "        <register address='0xba50738' value='0x" DATA.LONG(A:0xa50738) "' name='RPMH_BCM_SHADOW_STATUS_DRV5_BE_TCS_STATUS_CD3'/>"
WRITE #1 "        <register address='0xba5073c' value='0x" DATA.LONG(A:0xa5073c) "' name='RPMH_BCM_SHADOW_STATUS_DRV5_BE_TCS_STATUS_CD4'/>"
WRITE #1 "        <register address='0xba50740' value='0x" DATA.LONG(A:0xa50740) "' name='RPMH_BCM_SHADOW_STATUS_DRV5_BE_TCS_STATUS_CD5'/>"
WRITE #1 "        <register address='0xba50744' value='0x" DATA.LONG(A:0xa50744) "' name='RPMH_BCM_SHADOW_STATUS_DRV5_BE_TCS_STATUS_CD6'/>"
WRITE #1 "        <register address='0xba50748' value='0x" DATA.LONG(A:0xa50748) "' name='RPMH_BCM_SHADOW_STATUS_DRV5_BE_TCS_STATUS_CD7'/>"
WRITE #1 "        <register address='0xba5074c' value='0x" DATA.LONG(A:0xa5074c) "' name='RPMH_BCM_SHADOW_STATUS_DRV5_BE_TCS_STATUS_CD8'/>"
WRITE #1 "        <register address='0xba50750' value='0x" DATA.LONG(A:0xa50750) "' name='RPMH_BCM_SHADOW_STATUS_DRV5_BE_TCS_STATUS_CD9'/>"
WRITE #1 "        <register address='0xba50754' value='0x" DATA.LONG(A:0xa50754) "' name='RPMH_BCM_SHADOW_STATUS_DRV5_BE_TCS_STATUS_CD10'/>"
WRITE #1 "        <register address='0xba50758' value='0x" DATA.LONG(A:0xa50758) "' name='RPMH_BCM_SHADOW_STATUS_DRV5_BE_TCS_STATUS_CD11'/>"
WRITE #1 "        <register address='0xba6072c' value='0x" DATA.LONG(A:0xa6072c) "' name='RPMH_BCM_SHADOW_STATUS_DRV6_BE_TCS_STATUS_CD0'/>"
WRITE #1 "        <register address='0xba60730' value='0x" DATA.LONG(A:0xa60730) "' name='RPMH_BCM_SHADOW_STATUS_DRV6_BE_TCS_STATUS_CD1'/>"
WRITE #1 "        <register address='0xba60734' value='0x" DATA.LONG(A:0xa60734) "' name='RPMH_BCM_SHADOW_STATUS_DRV6_BE_TCS_STATUS_CD2'/>"
WRITE #1 "        <register address='0xba60738' value='0x" DATA.LONG(A:0xa60738) "' name='RPMH_BCM_SHADOW_STATUS_DRV6_BE_TCS_STATUS_CD3'/>"
WRITE #1 "        <register address='0xba6073c' value='0x" DATA.LONG(A:0xa6073c) "' name='RPMH_BCM_SHADOW_STATUS_DRV6_BE_TCS_STATUS_CD4'/>"
WRITE #1 "        <register address='0xba60740' value='0x" DATA.LONG(A:0xa60740) "' name='RPMH_BCM_SHADOW_STATUS_DRV6_BE_TCS_STATUS_CD5'/>"
WRITE #1 "        <register address='0xba60744' value='0x" DATA.LONG(A:0xa60744) "' name='RPMH_BCM_SHADOW_STATUS_DRV6_BE_TCS_STATUS_CD6'/>"
WRITE #1 "        <register address='0xba60748' value='0x" DATA.LONG(A:0xa60748) "' name='RPMH_BCM_SHADOW_STATUS_DRV6_BE_TCS_STATUS_CD7'/>"
WRITE #1 "        <register address='0xba6074c' value='0x" DATA.LONG(A:0xa6074c) "' name='RPMH_BCM_SHADOW_STATUS_DRV6_BE_TCS_STATUS_CD8'/>"
WRITE #1 "        <register address='0xba60750' value='0x" DATA.LONG(A:0xa60750) "' name='RPMH_BCM_SHADOW_STATUS_DRV6_BE_TCS_STATUS_CD9'/>"
WRITE #1 "        <register address='0xba60754' value='0x" DATA.LONG(A:0xa60754) "' name='RPMH_BCM_SHADOW_STATUS_DRV6_BE_TCS_STATUS_CD10'/>"
WRITE #1 "        <register address='0xba60758' value='0x" DATA.LONG(A:0xa60758) "' name='RPMH_BCM_SHADOW_STATUS_DRV6_BE_TCS_STATUS_CD11'/>"
WRITE #1 "        <register address='0xba7072c' value='0x" DATA.LONG(A:0xa7072c) "' name='RPMH_BCM_SHADOW_STATUS_DRV7_BE_TCS_STATUS_CD0'/>"
WRITE #1 "        <register address='0xba70730' value='0x" DATA.LONG(A:0xa70730) "' name='RPMH_BCM_SHADOW_STATUS_DRV7_BE_TCS_STATUS_CD1'/>"
WRITE #1 "        <register address='0xba70734' value='0x" DATA.LONG(A:0xa70734) "' name='RPMH_BCM_SHADOW_STATUS_DRV7_BE_TCS_STATUS_CD2'/>"
WRITE #1 "        <register address='0xba70738' value='0x" DATA.LONG(A:0xa70738) "' name='RPMH_BCM_SHADOW_STATUS_DRV7_BE_TCS_STATUS_CD3'/>"
WRITE #1 "        <register address='0xba7073c' value='0x" DATA.LONG(A:0xa7073c) "' name='RPMH_BCM_SHADOW_STATUS_DRV7_BE_TCS_STATUS_CD4'/>"
WRITE #1 "        <register address='0xba70740' value='0x" DATA.LONG(A:0xa70740) "' name='RPMH_BCM_SHADOW_STATUS_DRV7_BE_TCS_STATUS_CD5'/>"
WRITE #1 "        <register address='0xba70744' value='0x" DATA.LONG(A:0xa70744) "' name='RPMH_BCM_SHADOW_STATUS_DRV7_BE_TCS_STATUS_CD6'/>"
WRITE #1 "        <register address='0xba70748' value='0x" DATA.LONG(A:0xa70748) "' name='RPMH_BCM_SHADOW_STATUS_DRV7_BE_TCS_STATUS_CD7'/>"
WRITE #1 "        <register address='0xba7074c' value='0x" DATA.LONG(A:0xa7074c) "' name='RPMH_BCM_SHADOW_STATUS_DRV7_BE_TCS_STATUS_CD8'/>"
WRITE #1 "        <register address='0xba70750' value='0x" DATA.LONG(A:0xa70750) "' name='RPMH_BCM_SHADOW_STATUS_DRV7_BE_TCS_STATUS_CD9'/>"
WRITE #1 "        <register address='0xba70754' value='0x" DATA.LONG(A:0xa70754) "' name='RPMH_BCM_SHADOW_STATUS_DRV7_BE_TCS_STATUS_CD10'/>"
WRITE #1 "        <register address='0xba70758' value='0x" DATA.LONG(A:0xa70758) "' name='RPMH_BCM_SHADOW_STATUS_DRV7_BE_TCS_STATUS_CD11'/>"
WRITE #1 "        <register address='0xba8072c' value='0x" DATA.LONG(A:0xa8072c) "' name='RPMH_BCM_SHADOW_STATUS_DRV8_BE_TCS_STATUS_CD0'/>"
WRITE #1 "        <register address='0xba80730' value='0x" DATA.LONG(A:0xa80730) "' name='RPMH_BCM_SHADOW_STATUS_DRV8_BE_TCS_STATUS_CD1'/>"
WRITE #1 "        <register address='0xba80734' value='0x" DATA.LONG(A:0xa80734) "' name='RPMH_BCM_SHADOW_STATUS_DRV8_BE_TCS_STATUS_CD2'/>"
WRITE #1 "        <register address='0xba80738' value='0x" DATA.LONG(A:0xa80738) "' name='RPMH_BCM_SHADOW_STATUS_DRV8_BE_TCS_STATUS_CD3'/>"
WRITE #1 "        <register address='0xba8073c' value='0x" DATA.LONG(A:0xa8073c) "' name='RPMH_BCM_SHADOW_STATUS_DRV8_BE_TCS_STATUS_CD4'/>"
WRITE #1 "        <register address='0xba80740' value='0x" DATA.LONG(A:0xa80740) "' name='RPMH_BCM_SHADOW_STATUS_DRV8_BE_TCS_STATUS_CD5'/>"
WRITE #1 "        <register address='0xba80744' value='0x" DATA.LONG(A:0xa80744) "' name='RPMH_BCM_SHADOW_STATUS_DRV8_BE_TCS_STATUS_CD6'/>"
WRITE #1 "        <register address='0xba80748' value='0x" DATA.LONG(A:0xa80748) "' name='RPMH_BCM_SHADOW_STATUS_DRV8_BE_TCS_STATUS_CD7'/>"
WRITE #1 "        <register address='0xba8074c' value='0x" DATA.LONG(A:0xa8074c) "' name='RPMH_BCM_SHADOW_STATUS_DRV8_BE_TCS_STATUS_CD8'/>"
WRITE #1 "        <register address='0xba80750' value='0x" DATA.LONG(A:0xa80750) "' name='RPMH_BCM_SHADOW_STATUS_DRV8_BE_TCS_STATUS_CD9'/>"
WRITE #1 "        <register address='0xba80754' value='0x" DATA.LONG(A:0xa80754) "' name='RPMH_BCM_SHADOW_STATUS_DRV8_BE_TCS_STATUS_CD10'/>"
WRITE #1 "        <register address='0xba80758' value='0x" DATA.LONG(A:0xa80758) "' name='RPMH_BCM_SHADOW_STATUS_DRV8_BE_TCS_STATUS_CD11'/>"
WRITE #1 "        <register address='0xba9072c' value='0x" DATA.LONG(A:0xa9072c) "' name='RPMH_BCM_SHADOW_STATUS_DRV9_BE_TCS_STATUS_CD0'/>"
WRITE #1 "        <register address='0xba90730' value='0x" DATA.LONG(A:0xa90730) "' name='RPMH_BCM_SHADOW_STATUS_DRV9_BE_TCS_STATUS_CD1'/>"
WRITE #1 "        <register address='0xba90734' value='0x" DATA.LONG(A:0xa90734) "' name='RPMH_BCM_SHADOW_STATUS_DRV9_BE_TCS_STATUS_CD2'/>"
WRITE #1 "        <register address='0xba90738' value='0x" DATA.LONG(A:0xa90738) "' name='RPMH_BCM_SHADOW_STATUS_DRV9_BE_TCS_STATUS_CD3'/>"
WRITE #1 "        <register address='0xba9073c' value='0x" DATA.LONG(A:0xa9073c) "' name='RPMH_BCM_SHADOW_STATUS_DRV9_BE_TCS_STATUS_CD4'/>"
WRITE #1 "        <register address='0xba90740' value='0x" DATA.LONG(A:0xa90740) "' name='RPMH_BCM_SHADOW_STATUS_DRV9_BE_TCS_STATUS_CD5'/>"
WRITE #1 "        <register address='0xba90744' value='0x" DATA.LONG(A:0xa90744) "' name='RPMH_BCM_SHADOW_STATUS_DRV9_BE_TCS_STATUS_CD6'/>"
WRITE #1 "        <register address='0xba90748' value='0x" DATA.LONG(A:0xa90748) "' name='RPMH_BCM_SHADOW_STATUS_DRV9_BE_TCS_STATUS_CD7'/>"
WRITE #1 "        <register address='0xba9074c' value='0x" DATA.LONG(A:0xa9074c) "' name='RPMH_BCM_SHADOW_STATUS_DRV9_BE_TCS_STATUS_CD8'/>"
WRITE #1 "        <register address='0xba90750' value='0x" DATA.LONG(A:0xa90750) "' name='RPMH_BCM_SHADOW_STATUS_DRV9_BE_TCS_STATUS_CD9'/>"
WRITE #1 "        <register address='0xba90754' value='0x" DATA.LONG(A:0xa90754) "' name='RPMH_BCM_SHADOW_STATUS_DRV9_BE_TCS_STATUS_CD10'/>"
WRITE #1 "        <register address='0xba90758' value='0x" DATA.LONG(A:0xa90758) "' name='RPMH_BCM_SHADOW_STATUS_DRV9_BE_TCS_STATUS_CD11'/>"
WRITE #1 "        <register address='0xba00834' value='0x" DATA.LONG(A:0xa00834) "' name='RPMH_BCM_SHADOW_STATUS_DRV0_CE_CTT_EMPTY'/>"
WRITE #1 "        <register address='0xba10834' value='0x" DATA.LONG(A:0xa10834) "' name='RPMH_BCM_SHADOW_STATUS_DRV1_CE_CTT_EMPTY'/>"
WRITE #1 "        <register address='0xba20834' value='0x" DATA.LONG(A:0xa20834) "' name='RPMH_BCM_SHADOW_STATUS_DRV2_CE_CTT_EMPTY'/>"
WRITE #1 "        <register address='0xba30834' value='0x" DATA.LONG(A:0xa30834) "' name='RPMH_BCM_SHADOW_STATUS_DRV3_CE_CTT_EMPTY'/>"
WRITE #1 "        <register address='0xba40834' value='0x" DATA.LONG(A:0xa40834) "' name='RPMH_BCM_SHADOW_STATUS_DRV4_CE_CTT_EMPTY'/>"
WRITE #1 "        <register address='0xba50834' value='0x" DATA.LONG(A:0xa50834) "' name='RPMH_BCM_SHADOW_STATUS_DRV5_CE_CTT_EMPTY'/>"
WRITE #1 "        <register address='0xba60834' value='0x" DATA.LONG(A:0xa60834) "' name='RPMH_BCM_SHADOW_STATUS_DRV6_CE_CTT_EMPTY'/>"
WRITE #1 "        <register address='0xba70834' value='0x" DATA.LONG(A:0xa70834) "' name='RPMH_BCM_SHADOW_STATUS_DRV7_CE_CTT_EMPTY'/>"
WRITE #1 "        <register address='0xba80834' value='0x" DATA.LONG(A:0xa80834) "' name='RPMH_BCM_SHADOW_STATUS_DRV8_CE_CTT_EMPTY'/>"
WRITE #1 "        <register address='0xba90834' value='0x" DATA.LONG(A:0xa90834) "' name='RPMH_BCM_SHADOW_STATUS_DRV9_CE_CTT_EMPTY'/>"
WRITE #1 "        <register address='0xba00838' value='0x" DATA.LONG(A:0xa00838) "' name='RPMH_BCM_SHADOW_STATUS_DRV0_BCM'/>"
WRITE #1 "        <register address='0xba10838' value='0x" DATA.LONG(A:0xa10838) "' name='RPMH_BCM_SHADOW_STATUS_DRV1_BCM'/>"
WRITE #1 "        <register address='0xba20838' value='0x" DATA.LONG(A:0xa20838) "' name='RPMH_BCM_SHADOW_STATUS_DRV2_BCM'/>"
WRITE #1 "        <register address='0xba30838' value='0x" DATA.LONG(A:0xa30838) "' name='RPMH_BCM_SHADOW_STATUS_DRV3_BCM'/>"
WRITE #1 "        <register address='0xba40838' value='0x" DATA.LONG(A:0xa40838) "' name='RPMH_BCM_SHADOW_STATUS_DRV4_BCM'/>"
WRITE #1 "        <register address='0xba50838' value='0x" DATA.LONG(A:0xa50838) "' name='RPMH_BCM_SHADOW_STATUS_DRV5_BCM'/>"
WRITE #1 "        <register address='0xba60838' value='0x" DATA.LONG(A:0xa60838) "' name='RPMH_BCM_SHADOW_STATUS_DRV6_BCM'/>"
WRITE #1 "        <register address='0xba70838' value='0x" DATA.LONG(A:0xa70838) "' name='RPMH_BCM_SHADOW_STATUS_DRV7_BCM'/>"
WRITE #1 "        <register address='0xba80838' value='0x" DATA.LONG(A:0xa80838) "' name='RPMH_BCM_SHADOW_STATUS_DRV8_BCM'/>"
WRITE #1 "        <register address='0xba90838' value='0x" DATA.LONG(A:0xa90838) "' name='RPMH_BCM_SHADOW_STATUS_DRV9_BCM'/>"
WRITE #1 "        <register address='0xba0083c' value='0x" DATA.LONG(A:0xa0083c) "' name='RPMH_BCM_SHADOW_STATUS_DRV0_HW_VERSION'/>"
WRITE #1 "        <register address='0xba1083c' value='0x" DATA.LONG(A:0xa1083c) "' name='RPMH_BCM_SHADOW_STATUS_DRV1_HW_VERSION'/>"
WRITE #1 "        <register address='0xba2083c' value='0x" DATA.LONG(A:0xa2083c) "' name='RPMH_BCM_SHADOW_STATUS_DRV2_HW_VERSION'/>"
WRITE #1 "        <register address='0xba3083c' value='0x" DATA.LONG(A:0xa3083c) "' name='RPMH_BCM_SHADOW_STATUS_DRV3_HW_VERSION'/>"
WRITE #1 "        <register address='0xba4083c' value='0x" DATA.LONG(A:0xa4083c) "' name='RPMH_BCM_SHADOW_STATUS_DRV4_HW_VERSION'/>"
WRITE #1 "        <register address='0xba5083c' value='0x" DATA.LONG(A:0xa5083c) "' name='RPMH_BCM_SHADOW_STATUS_DRV5_HW_VERSION'/>"
WRITE #1 "        <register address='0xba6083c' value='0x" DATA.LONG(A:0xa6083c) "' name='RPMH_BCM_SHADOW_STATUS_DRV6_HW_VERSION'/>"
WRITE #1 "        <register address='0xba7083c' value='0x" DATA.LONG(A:0xa7083c) "' name='RPMH_BCM_SHADOW_STATUS_DRV7_HW_VERSION'/>"
WRITE #1 "        <register address='0xba8083c' value='0x" DATA.LONG(A:0xa8083c) "' name='RPMH_BCM_SHADOW_STATUS_DRV8_HW_VERSION'/>"
WRITE #1 "        <register address='0xba9083c' value='0x" DATA.LONG(A:0xa9083c) "' name='RPMH_BCM_SHADOW_STATUS_DRV9_HW_VERSION'/>"
WRITE #1 "        <register address='0xbbe0000' value='0x" DATA.LONG(A:0xbe0000) "' name='RPMH_BCM_ND_CFG_ND0'/>"
WRITE #1 "        <register address='0xbbe0004' value='0x" DATA.LONG(A:0xbe0004) "' name='RPMH_BCM_ND_CFG_ND1'/>"
WRITE #1 "        <register address='0xbbe0008' value='0x" DATA.LONG(A:0xbe0008) "' name='RPMH_BCM_ND_CFG_ND2'/>"
WRITE #1 "        <register address='0xbbe000c' value='0x" DATA.LONG(A:0xbe000c) "' name='RPMH_BCM_ND_CFG_ND3'/>"
WRITE #1 "        <register address='0xbbe0010' value='0x" DATA.LONG(A:0xbe0010) "' name='RPMH_BCM_ND_CFG_ND4'/>"
WRITE #1 "        <register address='0xbbe0014' value='0x" DATA.LONG(A:0xbe0014) "' name='RPMH_BCM_ND_CFG_ND5'/>"
WRITE #1 "        <register address='0xbbe0018' value='0x" DATA.LONG(A:0xbe0018) "' name='RPMH_BCM_ND_CFG_ND6'/>"
WRITE #1 "        <register address='0xbbe001c' value='0x" DATA.LONG(A:0xbe001c) "' name='RPMH_BCM_ND_CFG_ND7'/>"
WRITE #1 "        <register address='0xbbe0020' value='0x" DATA.LONG(A:0xbe0020) "' name='RPMH_BCM_ND_CFG_ND8'/>"
WRITE #1 "        <register address='0xbbe0024' value='0x" DATA.LONG(A:0xbe0024) "' name='RPMH_BCM_ND_CFG_ND9'/>"
WRITE #1 "        <register address='0xbbe0028' value='0x" DATA.LONG(A:0xbe0028) "' name='RPMH_BCM_ND_CFG_ND10'/>"
WRITE #1 "        <register address='0xbbe002c' value='0x" DATA.LONG(A:0xbe002c) "' name='RPMH_BCM_ND_CFG_ND11'/>"
WRITE #1 "        <register address='0xbbe0030' value='0x" DATA.LONG(A:0xbe0030) "' name='RPMH_BCM_ND_CFG_ND12'/>"
WRITE #1 "        <register address='0xbbe0034' value='0x" DATA.LONG(A:0xbe0034) "' name='RPMH_BCM_ND_CFG_ND13'/>"
WRITE #1 "        <register address='0xbbe0038' value='0x" DATA.LONG(A:0xbe0038) "' name='RPMH_BCM_ND_CFG_ND14'/>"
WRITE #1 "        <register address='0xbbe003c' value='0x" DATA.LONG(A:0xbe003c) "' name='RPMH_BCM_ND_CFG_ND15'/>"
WRITE #1 "        <register address='0xbbe0040' value='0x" DATA.LONG(A:0xbe0040) "' name='RPMH_BCM_ND_CFG_ND16'/>"
WRITE #1 "        <register address='0xbbe0044' value='0x" DATA.LONG(A:0xbe0044) "' name='RPMH_BCM_ND_CFG_ND17'/>"
WRITE #1 "        <register address='0xbbe0048' value='0x" DATA.LONG(A:0xbe0048) "' name='RPMH_BCM_ND_CFG_ND18'/>"
WRITE #1 "        <register address='0xbbe004c' value='0x" DATA.LONG(A:0xbe004c) "' name='RPMH_BCM_ND_CFG_ND19'/>"
WRITE #1 "        <register address='0xbbe0050' value='0x" DATA.LONG(A:0xbe0050) "' name='RPMH_BCM_ND_CFG_ND20'/>"
WRITE #1 "        <register address='0xbbe0054' value='0x" DATA.LONG(A:0xbe0054) "' name='RPMH_BCM_ND_CFG_ND21'/>"
WRITE #1 "        <register address='0xbbe0058' value='0x" DATA.LONG(A:0xbe0058) "' name='RPMH_BCM_ND_CFG_ND22'/>"
WRITE #1 "        <register address='0xbbe005c' value='0x" DATA.LONG(A:0xbe005c) "' name='RPMH_BCM_ND_CFG_ND23'/>"
WRITE #1 "        <register address='0xbbe0060' value='0x" DATA.LONG(A:0xbe0060) "' name='RPMH_BCM_ND_CFG_ND24'/>"
WRITE #1 "        <register address='0xbbe0064' value='0x" DATA.LONG(A:0xbe0064) "' name='RPMH_BCM_ND_CFG_ND25'/>"
WRITE #1 "        <register address='0xbbe0068' value='0x" DATA.LONG(A:0xbe0068) "' name='RPMH_BCM_ND_CFG_ND26'/>"
WRITE #1 "        <register address='0xbbe006c' value='0x" DATA.LONG(A:0xbe006c) "' name='RPMH_BCM_ND_CFG_ND27'/>"
WRITE #1 "        <register address='0xbbe0070' value='0x" DATA.LONG(A:0xbe0070) "' name='RPMH_BCM_ND_CFG_ND28'/>"
WRITE #1 "        <register address='0xbbe0074' value='0x" DATA.LONG(A:0xbe0074) "' name='RPMH_BCM_ND_CFG_ND29'/>"
WRITE #1 "        <register address='0xbbe0078' value='0x" DATA.LONG(A:0xbe0078) "' name='RPMH_BCM_ND_CFG_ND30'/>"
WRITE #1 "        <register address='0xbbe007c' value='0x" DATA.LONG(A:0xbe007c) "' name='RPMH_BCM_ND_CFG_ND31'/>"
WRITE #1 "        <register address='0xbbe0080' value='0x" DATA.LONG(A:0xbe0080) "' name='RPMH_BCM_ND_CFG_ND32'/>"
WRITE #1 "        <register address='0xbbe0084' value='0x" DATA.LONG(A:0xbe0084) "' name='RPMH_BCM_ND_CFG_ND33'/>"
WRITE #1 "        <register address='0xbbe0088' value='0x" DATA.LONG(A:0xbe0088) "' name='RPMH_BCM_ND_CFG_ND34'/>"
WRITE #1 "        <register address='0xbbe008c' value='0x" DATA.LONG(A:0xbe008c) "' name='RPMH_BCM_ND_CFG_ND35'/>"
WRITE #1 "        <register address='0xbbe0090' value='0x" DATA.LONG(A:0xbe0090) "' name='RPMH_BCM_ND_CFG_ND36'/>"
WRITE #1 "        <register address='0xbbe0094' value='0x" DATA.LONG(A:0xbe0094) "' name='RPMH_BCM_ND_CFG_ND37'/>"
WRITE #1 "        <register address='0xbbe0098' value='0x" DATA.LONG(A:0xbe0098) "' name='RPMH_BCM_ND_CFG_ND38'/>"
WRITE #1 "        <register address='0xbbe009c' value='0x" DATA.LONG(A:0xbe009c) "' name='RPMH_BCM_ND_CFG_ND39'/>"
WRITE #1 "        <register address='0xbbe00a0' value='0x" DATA.LONG(A:0xbe00a0) "' name='RPMH_BCM_ND_CFG_ND40'/>"
WRITE #1 "        <register address='0xbbe00a4' value='0x" DATA.LONG(A:0xbe00a4) "' name='RPMH_BCM_ND_CFG_ND41'/>"
WRITE #1 "        <register address='0xbbe00a8' value='0x" DATA.LONG(A:0xbe00a8) "' name='RPMH_BCM_ND_CFG_ND42'/>"
WRITE #1 "        <register address='0xbbe00ac' value='0x" DATA.LONG(A:0xbe00ac) "' name='RPMH_BCM_ND_CFG_ND43'/>"
WRITE #1 "        <register address='0xbbe00b0' value='0x" DATA.LONG(A:0xbe00b0) "' name='RPMH_BCM_ND_CFG_ND44'/>"
WRITE #1 "        <register address='0xbbe00b4' value='0x" DATA.LONG(A:0xbe00b4) "' name='RPMH_BCM_ND_CFG_ND45'/>"
WRITE #1 "        <register address='0xbbe00b8' value='0x" DATA.LONG(A:0xbe00b8) "' name='RPMH_BCM_ND_CFG_ND46'/>"
WRITE #1 "        <register address='0xbbe00bc' value='0x" DATA.LONG(A:0xbe00bc) "' name='RPMH_BCM_ND_CFG_ND47'/>"
WRITE #1 "        <register address='0xbbe0200' value='0x" DATA.LONG(A:0xbe0200) "' name='RPMH_BCM_SND_CFG_SND0'/>"
WRITE #1 "        <register address='0xbbe0204' value='0x" DATA.LONG(A:0xbe0204) "' name='RPMH_BCM_SND_CFG_SND1'/>"
WRITE #1 "        <register address='0xbbe0208' value='0x" DATA.LONG(A:0xbe0208) "' name='RPMH_BCM_SND_CFG_SND2'/>"
WRITE #1 "        <register address='0xbbe020c' value='0x" DATA.LONG(A:0xbe020c) "' name='RPMH_BCM_SND_CFG_SND3'/>"
WRITE #1 "        <register address='0xbbe0300' value='0x" DATA.LONG(A:0xbe0300) "' name='RPMH_BCM_SND_LUT_SND0_COL0'/>"
WRITE #1 "        <register address='0xbbe0304' value='0x" DATA.LONG(A:0xbe0304) "' name='RPMH_BCM_SND_LUT_SND0_COL1'/>"
WRITE #1 "        <register address='0xbbe0308' value='0x" DATA.LONG(A:0xbe0308) "' name='RPMH_BCM_SND_LUT_SND0_COL2'/>"
WRITE #1 "        <register address='0xbbe030c' value='0x" DATA.LONG(A:0xbe030c) "' name='RPMH_BCM_SND_LUT_SND0_COL3'/>"
WRITE #1 "        <register address='0xbbe0310' value='0x" DATA.LONG(A:0xbe0310) "' name='RPMH_BCM_SND_LUT_SND1_COL0'/>"
WRITE #1 "        <register address='0xbbe0314' value='0x" DATA.LONG(A:0xbe0314) "' name='RPMH_BCM_SND_LUT_SND1_COL1'/>"
WRITE #1 "        <register address='0xbbe0318' value='0x" DATA.LONG(A:0xbe0318) "' name='RPMH_BCM_SND_LUT_SND1_COL2'/>"
WRITE #1 "        <register address='0xbbe031c' value='0x" DATA.LONG(A:0xbe031c) "' name='RPMH_BCM_SND_LUT_SND1_COL3'/>"
WRITE #1 "        <register address='0xbbe0320' value='0x" DATA.LONG(A:0xbe0320) "' name='RPMH_BCM_SND_LUT_SND2_COL0'/>"
WRITE #1 "        <register address='0xbbe0324' value='0x" DATA.LONG(A:0xbe0324) "' name='RPMH_BCM_SND_LUT_SND2_COL1'/>"
WRITE #1 "        <register address='0xbbe0328' value='0x" DATA.LONG(A:0xbe0328) "' name='RPMH_BCM_SND_LUT_SND2_COL2'/>"
WRITE #1 "        <register address='0xbbe032c' value='0x" DATA.LONG(A:0xbe032c) "' name='RPMH_BCM_SND_LUT_SND2_COL3'/>"
WRITE #1 "        <register address='0xbbe0330' value='0x" DATA.LONG(A:0xbe0330) "' name='RPMH_BCM_SND_LUT_SND3_COL0'/>"
WRITE #1 "        <register address='0xbbe0334' value='0x" DATA.LONG(A:0xbe0334) "' name='RPMH_BCM_SND_LUT_SND3_COL1'/>"
WRITE #1 "        <register address='0xbbe0338' value='0x" DATA.LONG(A:0xbe0338) "' name='RPMH_BCM_SND_LUT_SND3_COL2'/>"
WRITE #1 "        <register address='0xbbe033c' value='0x" DATA.LONG(A:0xbe033c) "' name='RPMH_BCM_SND_LUT_SND3_COL3'/>"
WRITE #1 "        <register address='0xbbe0500' value='0x" DATA.LONG(A:0xbe0500) "' name='RPMH_BCM_SND_LUT_SND0_COL0_CP0'/>"
WRITE #1 "        <register address='0xbbe0504' value='0x" DATA.LONG(A:0xbe0504) "' name='RPMH_BCM_SND_LUT_SND0_COL0_CP1'/>"
WRITE #1 "        <register address='0xbbe0508' value='0x" DATA.LONG(A:0xbe0508) "' name='RPMH_BCM_SND_LUT_SND0_COL0_CP2'/>"
WRITE #1 "        <register address='0xbbe050c' value='0x" DATA.LONG(A:0xbe050c) "' name='RPMH_BCM_SND_LUT_SND0_COL0_CP3'/>"
WRITE #1 "        <register address='0xbbe0510' value='0x" DATA.LONG(A:0xbe0510) "' name='RPMH_BCM_SND_LUT_SND0_COL0_CP4'/>"
WRITE #1 "        <register address='0xbbe0514' value='0x" DATA.LONG(A:0xbe0514) "' name='RPMH_BCM_SND_LUT_SND0_COL0_CP5'/>"
WRITE #1 "        <register address='0xbbe0518' value='0x" DATA.LONG(A:0xbe0518) "' name='RPMH_BCM_SND_LUT_SND0_COL0_CP6'/>"
WRITE #1 "        <register address='0xbbe051c' value='0x" DATA.LONG(A:0xbe051c) "' name='RPMH_BCM_SND_LUT_SND0_COL0_CP7'/>"
WRITE #1 "        <register address='0xbbe0520' value='0x" DATA.LONG(A:0xbe0520) "' name='RPMH_BCM_SND_LUT_SND0_COL0_CP8'/>"
WRITE #1 "        <register address='0xbbe0524' value='0x" DATA.LONG(A:0xbe0524) "' name='RPMH_BCM_SND_LUT_SND0_COL0_CP9'/>"
WRITE #1 "        <register address='0xbbe0528' value='0x" DATA.LONG(A:0xbe0528) "' name='RPMH_BCM_SND_LUT_SND0_COL0_CP10'/>"
WRITE #1 "        <register address='0xbbe052c' value='0x" DATA.LONG(A:0xbe052c) "' name='RPMH_BCM_SND_LUT_SND0_COL0_CP11'/>"
WRITE #1 "        <register address='0xbbe0530' value='0x" DATA.LONG(A:0xbe0530) "' name='RPMH_BCM_SND_LUT_SND0_COL0_CP12'/>"
WRITE #1 "        <register address='0xbbe0534' value='0x" DATA.LONG(A:0xbe0534) "' name='RPMH_BCM_SND_LUT_SND0_COL0_CP13'/>"
WRITE #1 "        <register address='0xbbe0538' value='0x" DATA.LONG(A:0xbe0538) "' name='RPMH_BCM_SND_LUT_SND0_COL0_CP14'/>"
WRITE #1 "        <register address='0xbbe053c' value='0x" DATA.LONG(A:0xbe053c) "' name='RPMH_BCM_SND_LUT_SND0_COL0_CP15'/>"
WRITE #1 "        <register address='0xbbe0540' value='0x" DATA.LONG(A:0xbe0540) "' name='RPMH_BCM_SND_LUT_SND0_COL1_CP0'/>"
WRITE #1 "        <register address='0xbbe0544' value='0x" DATA.LONG(A:0xbe0544) "' name='RPMH_BCM_SND_LUT_SND0_COL1_CP1'/>"
WRITE #1 "        <register address='0xbbe0548' value='0x" DATA.LONG(A:0xbe0548) "' name='RPMH_BCM_SND_LUT_SND0_COL1_CP2'/>"
WRITE #1 "        <register address='0xbbe054c' value='0x" DATA.LONG(A:0xbe054c) "' name='RPMH_BCM_SND_LUT_SND0_COL1_CP3'/>"
WRITE #1 "        <register address='0xbbe0550' value='0x" DATA.LONG(A:0xbe0550) "' name='RPMH_BCM_SND_LUT_SND0_COL1_CP4'/>"
WRITE #1 "        <register address='0xbbe0554' value='0x" DATA.LONG(A:0xbe0554) "' name='RPMH_BCM_SND_LUT_SND0_COL1_CP5'/>"
WRITE #1 "        <register address='0xbbe0558' value='0x" DATA.LONG(A:0xbe0558) "' name='RPMH_BCM_SND_LUT_SND0_COL1_CP6'/>"
WRITE #1 "        <register address='0xbbe055c' value='0x" DATA.LONG(A:0xbe055c) "' name='RPMH_BCM_SND_LUT_SND0_COL1_CP7'/>"
WRITE #1 "        <register address='0xbbe0560' value='0x" DATA.LONG(A:0xbe0560) "' name='RPMH_BCM_SND_LUT_SND0_COL1_CP8'/>"
WRITE #1 "        <register address='0xbbe0564' value='0x" DATA.LONG(A:0xbe0564) "' name='RPMH_BCM_SND_LUT_SND0_COL1_CP9'/>"
WRITE #1 "        <register address='0xbbe0568' value='0x" DATA.LONG(A:0xbe0568) "' name='RPMH_BCM_SND_LUT_SND0_COL1_CP10'/>"
WRITE #1 "        <register address='0xbbe056c' value='0x" DATA.LONG(A:0xbe056c) "' name='RPMH_BCM_SND_LUT_SND0_COL1_CP11'/>"
WRITE #1 "        <register address='0xbbe0570' value='0x" DATA.LONG(A:0xbe0570) "' name='RPMH_BCM_SND_LUT_SND0_COL1_CP12'/>"
WRITE #1 "        <register address='0xbbe0574' value='0x" DATA.LONG(A:0xbe0574) "' name='RPMH_BCM_SND_LUT_SND0_COL1_CP13'/>"
WRITE #1 "        <register address='0xbbe0578' value='0x" DATA.LONG(A:0xbe0578) "' name='RPMH_BCM_SND_LUT_SND0_COL1_CP14'/>"
WRITE #1 "        <register address='0xbbe057c' value='0x" DATA.LONG(A:0xbe057c) "' name='RPMH_BCM_SND_LUT_SND0_COL1_CP15'/>"
WRITE #1 "        <register address='0xbbe0580' value='0x" DATA.LONG(A:0xbe0580) "' name='RPMH_BCM_SND_LUT_SND0_COL2_CP0'/>"
WRITE #1 "        <register address='0xbbe0584' value='0x" DATA.LONG(A:0xbe0584) "' name='RPMH_BCM_SND_LUT_SND0_COL2_CP1'/>"
WRITE #1 "        <register address='0xbbe0588' value='0x" DATA.LONG(A:0xbe0588) "' name='RPMH_BCM_SND_LUT_SND0_COL2_CP2'/>"
WRITE #1 "        <register address='0xbbe058c' value='0x" DATA.LONG(A:0xbe058c) "' name='RPMH_BCM_SND_LUT_SND0_COL2_CP3'/>"
WRITE #1 "        <register address='0xbbe0590' value='0x" DATA.LONG(A:0xbe0590) "' name='RPMH_BCM_SND_LUT_SND0_COL2_CP4'/>"
WRITE #1 "        <register address='0xbbe0594' value='0x" DATA.LONG(A:0xbe0594) "' name='RPMH_BCM_SND_LUT_SND0_COL2_CP5'/>"
WRITE #1 "        <register address='0xbbe0598' value='0x" DATA.LONG(A:0xbe0598) "' name='RPMH_BCM_SND_LUT_SND0_COL2_CP6'/>"
WRITE #1 "        <register address='0xbbe059c' value='0x" DATA.LONG(A:0xbe059c) "' name='RPMH_BCM_SND_LUT_SND0_COL2_CP7'/>"
WRITE #1 "        <register address='0xbbe05a0' value='0x" DATA.LONG(A:0xbe05a0) "' name='RPMH_BCM_SND_LUT_SND0_COL2_CP8'/>"
WRITE #1 "        <register address='0xbbe05a4' value='0x" DATA.LONG(A:0xbe05a4) "' name='RPMH_BCM_SND_LUT_SND0_COL2_CP9'/>"
WRITE #1 "        <register address='0xbbe05a8' value='0x" DATA.LONG(A:0xbe05a8) "' name='RPMH_BCM_SND_LUT_SND0_COL2_CP10'/>"
WRITE #1 "        <register address='0xbbe05ac' value='0x" DATA.LONG(A:0xbe05ac) "' name='RPMH_BCM_SND_LUT_SND0_COL2_CP11'/>"
WRITE #1 "        <register address='0xbbe05b0' value='0x" DATA.LONG(A:0xbe05b0) "' name='RPMH_BCM_SND_LUT_SND0_COL2_CP12'/>"
WRITE #1 "        <register address='0xbbe05b4' value='0x" DATA.LONG(A:0xbe05b4) "' name='RPMH_BCM_SND_LUT_SND0_COL2_CP13'/>"
WRITE #1 "        <register address='0xbbe05b8' value='0x" DATA.LONG(A:0xbe05b8) "' name='RPMH_BCM_SND_LUT_SND0_COL2_CP14'/>"
WRITE #1 "        <register address='0xbbe05bc' value='0x" DATA.LONG(A:0xbe05bc) "' name='RPMH_BCM_SND_LUT_SND0_COL2_CP15'/>"
WRITE #1 "        <register address='0xbbe05c0' value='0x" DATA.LONG(A:0xbe05c0) "' name='RPMH_BCM_SND_LUT_SND0_COL3_CP0'/>"
WRITE #1 "        <register address='0xbbe05c4' value='0x" DATA.LONG(A:0xbe05c4) "' name='RPMH_BCM_SND_LUT_SND0_COL3_CP1'/>"
WRITE #1 "        <register address='0xbbe05c8' value='0x" DATA.LONG(A:0xbe05c8) "' name='RPMH_BCM_SND_LUT_SND0_COL3_CP2'/>"
WRITE #1 "        <register address='0xbbe05cc' value='0x" DATA.LONG(A:0xbe05cc) "' name='RPMH_BCM_SND_LUT_SND0_COL3_CP3'/>"
WRITE #1 "        <register address='0xbbe05d0' value='0x" DATA.LONG(A:0xbe05d0) "' name='RPMH_BCM_SND_LUT_SND0_COL3_CP4'/>"
WRITE #1 "        <register address='0xbbe05d4' value='0x" DATA.LONG(A:0xbe05d4) "' name='RPMH_BCM_SND_LUT_SND0_COL3_CP5'/>"
WRITE #1 "        <register address='0xbbe05d8' value='0x" DATA.LONG(A:0xbe05d8) "' name='RPMH_BCM_SND_LUT_SND0_COL3_CP6'/>"
WRITE #1 "        <register address='0xbbe05dc' value='0x" DATA.LONG(A:0xbe05dc) "' name='RPMH_BCM_SND_LUT_SND0_COL3_CP7'/>"
WRITE #1 "        <register address='0xbbe05e0' value='0x" DATA.LONG(A:0xbe05e0) "' name='RPMH_BCM_SND_LUT_SND0_COL3_CP8'/>"
WRITE #1 "        <register address='0xbbe05e4' value='0x" DATA.LONG(A:0xbe05e4) "' name='RPMH_BCM_SND_LUT_SND0_COL3_CP9'/>"
WRITE #1 "        <register address='0xbbe05e8' value='0x" DATA.LONG(A:0xbe05e8) "' name='RPMH_BCM_SND_LUT_SND0_COL3_CP10'/>"
WRITE #1 "        <register address='0xbbe05ec' value='0x" DATA.LONG(A:0xbe05ec) "' name='RPMH_BCM_SND_LUT_SND0_COL3_CP11'/>"
WRITE #1 "        <register address='0xbbe05f0' value='0x" DATA.LONG(A:0xbe05f0) "' name='RPMH_BCM_SND_LUT_SND0_COL3_CP12'/>"
WRITE #1 "        <register address='0xbbe05f4' value='0x" DATA.LONG(A:0xbe05f4) "' name='RPMH_BCM_SND_LUT_SND0_COL3_CP13'/>"
WRITE #1 "        <register address='0xbbe05f8' value='0x" DATA.LONG(A:0xbe05f8) "' name='RPMH_BCM_SND_LUT_SND0_COL3_CP14'/>"
WRITE #1 "        <register address='0xbbe05fc' value='0x" DATA.LONG(A:0xbe05fc) "' name='RPMH_BCM_SND_LUT_SND0_COL3_CP15'/>"
WRITE #1 "        <register address='0xbbe0600' value='0x" DATA.LONG(A:0xbe0600) "' name='RPMH_BCM_SND_LUT_SND1_COL0_CP0'/>"
WRITE #1 "        <register address='0xbbe0604' value='0x" DATA.LONG(A:0xbe0604) "' name='RPMH_BCM_SND_LUT_SND1_COL0_CP1'/>"
WRITE #1 "        <register address='0xbbe0608' value='0x" DATA.LONG(A:0xbe0608) "' name='RPMH_BCM_SND_LUT_SND1_COL0_CP2'/>"
WRITE #1 "        <register address='0xbbe060c' value='0x" DATA.LONG(A:0xbe060c) "' name='RPMH_BCM_SND_LUT_SND1_COL0_CP3'/>"
WRITE #1 "        <register address='0xbbe0610' value='0x" DATA.LONG(A:0xbe0610) "' name='RPMH_BCM_SND_LUT_SND1_COL0_CP4'/>"
WRITE #1 "        <register address='0xbbe0614' value='0x" DATA.LONG(A:0xbe0614) "' name='RPMH_BCM_SND_LUT_SND1_COL0_CP5'/>"
WRITE #1 "        <register address='0xbbe0618' value='0x" DATA.LONG(A:0xbe0618) "' name='RPMH_BCM_SND_LUT_SND1_COL0_CP6'/>"
WRITE #1 "        <register address='0xbbe061c' value='0x" DATA.LONG(A:0xbe061c) "' name='RPMH_BCM_SND_LUT_SND1_COL0_CP7'/>"
WRITE #1 "        <register address='0xbbe0620' value='0x" DATA.LONG(A:0xbe0620) "' name='RPMH_BCM_SND_LUT_SND1_COL0_CP8'/>"
WRITE #1 "        <register address='0xbbe0624' value='0x" DATA.LONG(A:0xbe0624) "' name='RPMH_BCM_SND_LUT_SND1_COL0_CP9'/>"
WRITE #1 "        <register address='0xbbe0628' value='0x" DATA.LONG(A:0xbe0628) "' name='RPMH_BCM_SND_LUT_SND1_COL0_CP10'/>"
WRITE #1 "        <register address='0xbbe062c' value='0x" DATA.LONG(A:0xbe062c) "' name='RPMH_BCM_SND_LUT_SND1_COL0_CP11'/>"
WRITE #1 "        <register address='0xbbe0630' value='0x" DATA.LONG(A:0xbe0630) "' name='RPMH_BCM_SND_LUT_SND1_COL0_CP12'/>"
WRITE #1 "        <register address='0xbbe0634' value='0x" DATA.LONG(A:0xbe0634) "' name='RPMH_BCM_SND_LUT_SND1_COL0_CP13'/>"
WRITE #1 "        <register address='0xbbe0638' value='0x" DATA.LONG(A:0xbe0638) "' name='RPMH_BCM_SND_LUT_SND1_COL0_CP14'/>"
WRITE #1 "        <register address='0xbbe063c' value='0x" DATA.LONG(A:0xbe063c) "' name='RPMH_BCM_SND_LUT_SND1_COL0_CP15'/>"
WRITE #1 "        <register address='0xbbe0640' value='0x" DATA.LONG(A:0xbe0640) "' name='RPMH_BCM_SND_LUT_SND1_COL1_CP0'/>"
WRITE #1 "        <register address='0xbbe0644' value='0x" DATA.LONG(A:0xbe0644) "' name='RPMH_BCM_SND_LUT_SND1_COL1_CP1'/>"
WRITE #1 "        <register address='0xbbe0648' value='0x" DATA.LONG(A:0xbe0648) "' name='RPMH_BCM_SND_LUT_SND1_COL1_CP2'/>"
WRITE #1 "        <register address='0xbbe064c' value='0x" DATA.LONG(A:0xbe064c) "' name='RPMH_BCM_SND_LUT_SND1_COL1_CP3'/>"
WRITE #1 "        <register address='0xbbe0650' value='0x" DATA.LONG(A:0xbe0650) "' name='RPMH_BCM_SND_LUT_SND1_COL1_CP4'/>"
WRITE #1 "        <register address='0xbbe0654' value='0x" DATA.LONG(A:0xbe0654) "' name='RPMH_BCM_SND_LUT_SND1_COL1_CP5'/>"
WRITE #1 "        <register address='0xbbe0658' value='0x" DATA.LONG(A:0xbe0658) "' name='RPMH_BCM_SND_LUT_SND1_COL1_CP6'/>"
WRITE #1 "        <register address='0xbbe065c' value='0x" DATA.LONG(A:0xbe065c) "' name='RPMH_BCM_SND_LUT_SND1_COL1_CP7'/>"
WRITE #1 "        <register address='0xbbe0660' value='0x" DATA.LONG(A:0xbe0660) "' name='RPMH_BCM_SND_LUT_SND1_COL1_CP8'/>"
WRITE #1 "        <register address='0xbbe0664' value='0x" DATA.LONG(A:0xbe0664) "' name='RPMH_BCM_SND_LUT_SND1_COL1_CP9'/>"
WRITE #1 "        <register address='0xbbe0668' value='0x" DATA.LONG(A:0xbe0668) "' name='RPMH_BCM_SND_LUT_SND1_COL1_CP10'/>"
WRITE #1 "        <register address='0xbbe066c' value='0x" DATA.LONG(A:0xbe066c) "' name='RPMH_BCM_SND_LUT_SND1_COL1_CP11'/>"
WRITE #1 "        <register address='0xbbe0670' value='0x" DATA.LONG(A:0xbe0670) "' name='RPMH_BCM_SND_LUT_SND1_COL1_CP12'/>"
WRITE #1 "        <register address='0xbbe0674' value='0x" DATA.LONG(A:0xbe0674) "' name='RPMH_BCM_SND_LUT_SND1_COL1_CP13'/>"
WRITE #1 "        <register address='0xbbe0678' value='0x" DATA.LONG(A:0xbe0678) "' name='RPMH_BCM_SND_LUT_SND1_COL1_CP14'/>"
WRITE #1 "        <register address='0xbbe067c' value='0x" DATA.LONG(A:0xbe067c) "' name='RPMH_BCM_SND_LUT_SND1_COL1_CP15'/>"
WRITE #1 "        <register address='0xbbe0680' value='0x" DATA.LONG(A:0xbe0680) "' name='RPMH_BCM_SND_LUT_SND1_COL2_CP0'/>"
WRITE #1 "        <register address='0xbbe0684' value='0x" DATA.LONG(A:0xbe0684) "' name='RPMH_BCM_SND_LUT_SND1_COL2_CP1'/>"
WRITE #1 "        <register address='0xbbe0688' value='0x" DATA.LONG(A:0xbe0688) "' name='RPMH_BCM_SND_LUT_SND1_COL2_CP2'/>"
WRITE #1 "        <register address='0xbbe068c' value='0x" DATA.LONG(A:0xbe068c) "' name='RPMH_BCM_SND_LUT_SND1_COL2_CP3'/>"
WRITE #1 "        <register address='0xbbe0690' value='0x" DATA.LONG(A:0xbe0690) "' name='RPMH_BCM_SND_LUT_SND1_COL2_CP4'/>"
WRITE #1 "        <register address='0xbbe0694' value='0x" DATA.LONG(A:0xbe0694) "' name='RPMH_BCM_SND_LUT_SND1_COL2_CP5'/>"
WRITE #1 "        <register address='0xbbe0698' value='0x" DATA.LONG(A:0xbe0698) "' name='RPMH_BCM_SND_LUT_SND1_COL2_CP6'/>"
WRITE #1 "        <register address='0xbbe069c' value='0x" DATA.LONG(A:0xbe069c) "' name='RPMH_BCM_SND_LUT_SND1_COL2_CP7'/>"
WRITE #1 "        <register address='0xbbe06a0' value='0x" DATA.LONG(A:0xbe06a0) "' name='RPMH_BCM_SND_LUT_SND1_COL2_CP8'/>"
WRITE #1 "        <register address='0xbbe06a4' value='0x" DATA.LONG(A:0xbe06a4) "' name='RPMH_BCM_SND_LUT_SND1_COL2_CP9'/>"
WRITE #1 "        <register address='0xbbe06a8' value='0x" DATA.LONG(A:0xbe06a8) "' name='RPMH_BCM_SND_LUT_SND1_COL2_CP10'/>"
WRITE #1 "        <register address='0xbbe06ac' value='0x" DATA.LONG(A:0xbe06ac) "' name='RPMH_BCM_SND_LUT_SND1_COL2_CP11'/>"
WRITE #1 "        <register address='0xbbe06b0' value='0x" DATA.LONG(A:0xbe06b0) "' name='RPMH_BCM_SND_LUT_SND1_COL2_CP12'/>"
WRITE #1 "        <register address='0xbbe06b4' value='0x" DATA.LONG(A:0xbe06b4) "' name='RPMH_BCM_SND_LUT_SND1_COL2_CP13'/>"
WRITE #1 "        <register address='0xbbe06b8' value='0x" DATA.LONG(A:0xbe06b8) "' name='RPMH_BCM_SND_LUT_SND1_COL2_CP14'/>"
WRITE #1 "        <register address='0xbbe06bc' value='0x" DATA.LONG(A:0xbe06bc) "' name='RPMH_BCM_SND_LUT_SND1_COL2_CP15'/>"
WRITE #1 "        <register address='0xbbe06c0' value='0x" DATA.LONG(A:0xbe06c0) "' name='RPMH_BCM_SND_LUT_SND1_COL3_CP0'/>"
WRITE #1 "        <register address='0xbbe06c4' value='0x" DATA.LONG(A:0xbe06c4) "' name='RPMH_BCM_SND_LUT_SND1_COL3_CP1'/>"
WRITE #1 "        <register address='0xbbe06c8' value='0x" DATA.LONG(A:0xbe06c8) "' name='RPMH_BCM_SND_LUT_SND1_COL3_CP2'/>"
WRITE #1 "        <register address='0xbbe06cc' value='0x" DATA.LONG(A:0xbe06cc) "' name='RPMH_BCM_SND_LUT_SND1_COL3_CP3'/>"
WRITE #1 "        <register address='0xbbe06d0' value='0x" DATA.LONG(A:0xbe06d0) "' name='RPMH_BCM_SND_LUT_SND1_COL3_CP4'/>"
WRITE #1 "        <register address='0xbbe06d4' value='0x" DATA.LONG(A:0xbe06d4) "' name='RPMH_BCM_SND_LUT_SND1_COL3_CP5'/>"
WRITE #1 "        <register address='0xbbe06d8' value='0x" DATA.LONG(A:0xbe06d8) "' name='RPMH_BCM_SND_LUT_SND1_COL3_CP6'/>"
WRITE #1 "        <register address='0xbbe06dc' value='0x" DATA.LONG(A:0xbe06dc) "' name='RPMH_BCM_SND_LUT_SND1_COL3_CP7'/>"
WRITE #1 "        <register address='0xbbe06e0' value='0x" DATA.LONG(A:0xbe06e0) "' name='RPMH_BCM_SND_LUT_SND1_COL3_CP8'/>"
WRITE #1 "        <register address='0xbbe06e4' value='0x" DATA.LONG(A:0xbe06e4) "' name='RPMH_BCM_SND_LUT_SND1_COL3_CP9'/>"
WRITE #1 "        <register address='0xbbe06e8' value='0x" DATA.LONG(A:0xbe06e8) "' name='RPMH_BCM_SND_LUT_SND1_COL3_CP10'/>"
WRITE #1 "        <register address='0xbbe06ec' value='0x" DATA.LONG(A:0xbe06ec) "' name='RPMH_BCM_SND_LUT_SND1_COL3_CP11'/>"
WRITE #1 "        <register address='0xbbe06f0' value='0x" DATA.LONG(A:0xbe06f0) "' name='RPMH_BCM_SND_LUT_SND1_COL3_CP12'/>"
WRITE #1 "        <register address='0xbbe06f4' value='0x" DATA.LONG(A:0xbe06f4) "' name='RPMH_BCM_SND_LUT_SND1_COL3_CP13'/>"
WRITE #1 "        <register address='0xbbe06f8' value='0x" DATA.LONG(A:0xbe06f8) "' name='RPMH_BCM_SND_LUT_SND1_COL3_CP14'/>"
WRITE #1 "        <register address='0xbbe06fc' value='0x" DATA.LONG(A:0xbe06fc) "' name='RPMH_BCM_SND_LUT_SND1_COL3_CP15'/>"
WRITE #1 "        <register address='0xbbe0700' value='0x" DATA.LONG(A:0xbe0700) "' name='RPMH_BCM_SND_LUT_SND2_COL0_CP0'/>"
WRITE #1 "        <register address='0xbbe0704' value='0x" DATA.LONG(A:0xbe0704) "' name='RPMH_BCM_SND_LUT_SND2_COL0_CP1'/>"
WRITE #1 "        <register address='0xbbe0708' value='0x" DATA.LONG(A:0xbe0708) "' name='RPMH_BCM_SND_LUT_SND2_COL0_CP2'/>"
WRITE #1 "        <register address='0xbbe070c' value='0x" DATA.LONG(A:0xbe070c) "' name='RPMH_BCM_SND_LUT_SND2_COL0_CP3'/>"
WRITE #1 "        <register address='0xbbe0710' value='0x" DATA.LONG(A:0xbe0710) "' name='RPMH_BCM_SND_LUT_SND2_COL0_CP4'/>"
WRITE #1 "        <register address='0xbbe0714' value='0x" DATA.LONG(A:0xbe0714) "' name='RPMH_BCM_SND_LUT_SND2_COL0_CP5'/>"
WRITE #1 "        <register address='0xbbe0718' value='0x" DATA.LONG(A:0xbe0718) "' name='RPMH_BCM_SND_LUT_SND2_COL0_CP6'/>"
WRITE #1 "        <register address='0xbbe071c' value='0x" DATA.LONG(A:0xbe071c) "' name='RPMH_BCM_SND_LUT_SND2_COL0_CP7'/>"
WRITE #1 "        <register address='0xbbe0720' value='0x" DATA.LONG(A:0xbe0720) "' name='RPMH_BCM_SND_LUT_SND2_COL0_CP8'/>"
WRITE #1 "        <register address='0xbbe0724' value='0x" DATA.LONG(A:0xbe0724) "' name='RPMH_BCM_SND_LUT_SND2_COL0_CP9'/>"
WRITE #1 "        <register address='0xbbe0728' value='0x" DATA.LONG(A:0xbe0728) "' name='RPMH_BCM_SND_LUT_SND2_COL0_CP10'/>"
WRITE #1 "        <register address='0xbbe072c' value='0x" DATA.LONG(A:0xbe072c) "' name='RPMH_BCM_SND_LUT_SND2_COL0_CP11'/>"
WRITE #1 "        <register address='0xbbe0730' value='0x" DATA.LONG(A:0xbe0730) "' name='RPMH_BCM_SND_LUT_SND2_COL0_CP12'/>"
WRITE #1 "        <register address='0xbbe0734' value='0x" DATA.LONG(A:0xbe0734) "' name='RPMH_BCM_SND_LUT_SND2_COL0_CP13'/>"
WRITE #1 "        <register address='0xbbe0738' value='0x" DATA.LONG(A:0xbe0738) "' name='RPMH_BCM_SND_LUT_SND2_COL0_CP14'/>"
WRITE #1 "        <register address='0xbbe073c' value='0x" DATA.LONG(A:0xbe073c) "' name='RPMH_BCM_SND_LUT_SND2_COL0_CP15'/>"
WRITE #1 "        <register address='0xbbe0740' value='0x" DATA.LONG(A:0xbe0740) "' name='RPMH_BCM_SND_LUT_SND2_COL1_CP0'/>"
WRITE #1 "        <register address='0xbbe0744' value='0x" DATA.LONG(A:0xbe0744) "' name='RPMH_BCM_SND_LUT_SND2_COL1_CP1'/>"
WRITE #1 "        <register address='0xbbe0748' value='0x" DATA.LONG(A:0xbe0748) "' name='RPMH_BCM_SND_LUT_SND2_COL1_CP2'/>"
WRITE #1 "        <register address='0xbbe074c' value='0x" DATA.LONG(A:0xbe074c) "' name='RPMH_BCM_SND_LUT_SND2_COL1_CP3'/>"
WRITE #1 "        <register address='0xbbe0750' value='0x" DATA.LONG(A:0xbe0750) "' name='RPMH_BCM_SND_LUT_SND2_COL1_CP4'/>"
WRITE #1 "        <register address='0xbbe0754' value='0x" DATA.LONG(A:0xbe0754) "' name='RPMH_BCM_SND_LUT_SND2_COL1_CP5'/>"
WRITE #1 "        <register address='0xbbe0758' value='0x" DATA.LONG(A:0xbe0758) "' name='RPMH_BCM_SND_LUT_SND2_COL1_CP6'/>"
WRITE #1 "        <register address='0xbbe075c' value='0x" DATA.LONG(A:0xbe075c) "' name='RPMH_BCM_SND_LUT_SND2_COL1_CP7'/>"
WRITE #1 "        <register address='0xbbe0760' value='0x" DATA.LONG(A:0xbe0760) "' name='RPMH_BCM_SND_LUT_SND2_COL1_CP8'/>"
WRITE #1 "        <register address='0xbbe0764' value='0x" DATA.LONG(A:0xbe0764) "' name='RPMH_BCM_SND_LUT_SND2_COL1_CP9'/>"
WRITE #1 "        <register address='0xbbe0768' value='0x" DATA.LONG(A:0xbe0768) "' name='RPMH_BCM_SND_LUT_SND2_COL1_CP10'/>"
WRITE #1 "        <register address='0xbbe076c' value='0x" DATA.LONG(A:0xbe076c) "' name='RPMH_BCM_SND_LUT_SND2_COL1_CP11'/>"
WRITE #1 "        <register address='0xbbe0770' value='0x" DATA.LONG(A:0xbe0770) "' name='RPMH_BCM_SND_LUT_SND2_COL1_CP12'/>"
WRITE #1 "        <register address='0xbbe0774' value='0x" DATA.LONG(A:0xbe0774) "' name='RPMH_BCM_SND_LUT_SND2_COL1_CP13'/>"
WRITE #1 "        <register address='0xbbe0778' value='0x" DATA.LONG(A:0xbe0778) "' name='RPMH_BCM_SND_LUT_SND2_COL1_CP14'/>"
WRITE #1 "        <register address='0xbbe077c' value='0x" DATA.LONG(A:0xbe077c) "' name='RPMH_BCM_SND_LUT_SND2_COL1_CP15'/>"
WRITE #1 "        <register address='0xbbe0780' value='0x" DATA.LONG(A:0xbe0780) "' name='RPMH_BCM_SND_LUT_SND2_COL2_CP0'/>"
WRITE #1 "        <register address='0xbbe0784' value='0x" DATA.LONG(A:0xbe0784) "' name='RPMH_BCM_SND_LUT_SND2_COL2_CP1'/>"
WRITE #1 "        <register address='0xbbe0788' value='0x" DATA.LONG(A:0xbe0788) "' name='RPMH_BCM_SND_LUT_SND2_COL2_CP2'/>"
WRITE #1 "        <register address='0xbbe078c' value='0x" DATA.LONG(A:0xbe078c) "' name='RPMH_BCM_SND_LUT_SND2_COL2_CP3'/>"
WRITE #1 "        <register address='0xbbe0790' value='0x" DATA.LONG(A:0xbe0790) "' name='RPMH_BCM_SND_LUT_SND2_COL2_CP4'/>"
WRITE #1 "        <register address='0xbbe0794' value='0x" DATA.LONG(A:0xbe0794) "' name='RPMH_BCM_SND_LUT_SND2_COL2_CP5'/>"
WRITE #1 "        <register address='0xbbe0798' value='0x" DATA.LONG(A:0xbe0798) "' name='RPMH_BCM_SND_LUT_SND2_COL2_CP6'/>"
WRITE #1 "        <register address='0xbbe079c' value='0x" DATA.LONG(A:0xbe079c) "' name='RPMH_BCM_SND_LUT_SND2_COL2_CP7'/>"
WRITE #1 "        <register address='0xbbe07a0' value='0x" DATA.LONG(A:0xbe07a0) "' name='RPMH_BCM_SND_LUT_SND2_COL2_CP8'/>"
WRITE #1 "        <register address='0xbbe07a4' value='0x" DATA.LONG(A:0xbe07a4) "' name='RPMH_BCM_SND_LUT_SND2_COL2_CP9'/>"
WRITE #1 "        <register address='0xbbe07a8' value='0x" DATA.LONG(A:0xbe07a8) "' name='RPMH_BCM_SND_LUT_SND2_COL2_CP10'/>"
WRITE #1 "        <register address='0xbbe07ac' value='0x" DATA.LONG(A:0xbe07ac) "' name='RPMH_BCM_SND_LUT_SND2_COL2_CP11'/>"
WRITE #1 "        <register address='0xbbe07b0' value='0x" DATA.LONG(A:0xbe07b0) "' name='RPMH_BCM_SND_LUT_SND2_COL2_CP12'/>"
WRITE #1 "        <register address='0xbbe07b4' value='0x" DATA.LONG(A:0xbe07b4) "' name='RPMH_BCM_SND_LUT_SND2_COL2_CP13'/>"
WRITE #1 "        <register address='0xbbe07b8' value='0x" DATA.LONG(A:0xbe07b8) "' name='RPMH_BCM_SND_LUT_SND2_COL2_CP14'/>"
WRITE #1 "        <register address='0xbbe07bc' value='0x" DATA.LONG(A:0xbe07bc) "' name='RPMH_BCM_SND_LUT_SND2_COL2_CP15'/>"
WRITE #1 "        <register address='0xbbe07c0' value='0x" DATA.LONG(A:0xbe07c0) "' name='RPMH_BCM_SND_LUT_SND2_COL3_CP0'/>"
WRITE #1 "        <register address='0xbbe07c4' value='0x" DATA.LONG(A:0xbe07c4) "' name='RPMH_BCM_SND_LUT_SND2_COL3_CP1'/>"
WRITE #1 "        <register address='0xbbe07c8' value='0x" DATA.LONG(A:0xbe07c8) "' name='RPMH_BCM_SND_LUT_SND2_COL3_CP2'/>"
WRITE #1 "        <register address='0xbbe07cc' value='0x" DATA.LONG(A:0xbe07cc) "' name='RPMH_BCM_SND_LUT_SND2_COL3_CP3'/>"
WRITE #1 "        <register address='0xbbe07d0' value='0x" DATA.LONG(A:0xbe07d0) "' name='RPMH_BCM_SND_LUT_SND2_COL3_CP4'/>"
WRITE #1 "        <register address='0xbbe07d4' value='0x" DATA.LONG(A:0xbe07d4) "' name='RPMH_BCM_SND_LUT_SND2_COL3_CP5'/>"
WRITE #1 "        <register address='0xbbe07d8' value='0x" DATA.LONG(A:0xbe07d8) "' name='RPMH_BCM_SND_LUT_SND2_COL3_CP6'/>"
WRITE #1 "        <register address='0xbbe07dc' value='0x" DATA.LONG(A:0xbe07dc) "' name='RPMH_BCM_SND_LUT_SND2_COL3_CP7'/>"
WRITE #1 "        <register address='0xbbe07e0' value='0x" DATA.LONG(A:0xbe07e0) "' name='RPMH_BCM_SND_LUT_SND2_COL3_CP8'/>"
WRITE #1 "        <register address='0xbbe07e4' value='0x" DATA.LONG(A:0xbe07e4) "' name='RPMH_BCM_SND_LUT_SND2_COL3_CP9'/>"
WRITE #1 "        <register address='0xbbe07e8' value='0x" DATA.LONG(A:0xbe07e8) "' name='RPMH_BCM_SND_LUT_SND2_COL3_CP10'/>"
WRITE #1 "        <register address='0xbbe07ec' value='0x" DATA.LONG(A:0xbe07ec) "' name='RPMH_BCM_SND_LUT_SND2_COL3_CP11'/>"
WRITE #1 "        <register address='0xbbe07f0' value='0x" DATA.LONG(A:0xbe07f0) "' name='RPMH_BCM_SND_LUT_SND2_COL3_CP12'/>"
WRITE #1 "        <register address='0xbbe07f4' value='0x" DATA.LONG(A:0xbe07f4) "' name='RPMH_BCM_SND_LUT_SND2_COL3_CP13'/>"
WRITE #1 "        <register address='0xbbe07f8' value='0x" DATA.LONG(A:0xbe07f8) "' name='RPMH_BCM_SND_LUT_SND2_COL3_CP14'/>"
WRITE #1 "        <register address='0xbbe07fc' value='0x" DATA.LONG(A:0xbe07fc) "' name='RPMH_BCM_SND_LUT_SND2_COL3_CP15'/>"
WRITE #1 "        <register address='0xbbe0800' value='0x" DATA.LONG(A:0xbe0800) "' name='RPMH_BCM_SND_LUT_SND3_COL0_CP0'/>"
WRITE #1 "        <register address='0xbbe0804' value='0x" DATA.LONG(A:0xbe0804) "' name='RPMH_BCM_SND_LUT_SND3_COL0_CP1'/>"
WRITE #1 "        <register address='0xbbe0808' value='0x" DATA.LONG(A:0xbe0808) "' name='RPMH_BCM_SND_LUT_SND3_COL0_CP2'/>"
WRITE #1 "        <register address='0xbbe080c' value='0x" DATA.LONG(A:0xbe080c) "' name='RPMH_BCM_SND_LUT_SND3_COL0_CP3'/>"
WRITE #1 "        <register address='0xbbe0810' value='0x" DATA.LONG(A:0xbe0810) "' name='RPMH_BCM_SND_LUT_SND3_COL0_CP4'/>"
WRITE #1 "        <register address='0xbbe0814' value='0x" DATA.LONG(A:0xbe0814) "' name='RPMH_BCM_SND_LUT_SND3_COL0_CP5'/>"
WRITE #1 "        <register address='0xbbe0818' value='0x" DATA.LONG(A:0xbe0818) "' name='RPMH_BCM_SND_LUT_SND3_COL0_CP6'/>"
WRITE #1 "        <register address='0xbbe081c' value='0x" DATA.LONG(A:0xbe081c) "' name='RPMH_BCM_SND_LUT_SND3_COL0_CP7'/>"
WRITE #1 "        <register address='0xbbe0820' value='0x" DATA.LONG(A:0xbe0820) "' name='RPMH_BCM_SND_LUT_SND3_COL0_CP8'/>"
WRITE #1 "        <register address='0xbbe0824' value='0x" DATA.LONG(A:0xbe0824) "' name='RPMH_BCM_SND_LUT_SND3_COL0_CP9'/>"
WRITE #1 "        <register address='0xbbe0828' value='0x" DATA.LONG(A:0xbe0828) "' name='RPMH_BCM_SND_LUT_SND3_COL0_CP10'/>"
WRITE #1 "        <register address='0xbbe082c' value='0x" DATA.LONG(A:0xbe082c) "' name='RPMH_BCM_SND_LUT_SND3_COL0_CP11'/>"
WRITE #1 "        <register address='0xbbe0830' value='0x" DATA.LONG(A:0xbe0830) "' name='RPMH_BCM_SND_LUT_SND3_COL0_CP12'/>"
WRITE #1 "        <register address='0xbbe0834' value='0x" DATA.LONG(A:0xbe0834) "' name='RPMH_BCM_SND_LUT_SND3_COL0_CP13'/>"
WRITE #1 "        <register address='0xbbe0838' value='0x" DATA.LONG(A:0xbe0838) "' name='RPMH_BCM_SND_LUT_SND3_COL0_CP14'/>"
WRITE #1 "        <register address='0xbbe083c' value='0x" DATA.LONG(A:0xbe083c) "' name='RPMH_BCM_SND_LUT_SND3_COL0_CP15'/>"
WRITE #1 "        <register address='0xbbe0840' value='0x" DATA.LONG(A:0xbe0840) "' name='RPMH_BCM_SND_LUT_SND3_COL1_CP0'/>"
WRITE #1 "        <register address='0xbbe0844' value='0x" DATA.LONG(A:0xbe0844) "' name='RPMH_BCM_SND_LUT_SND3_COL1_CP1'/>"
WRITE #1 "        <register address='0xbbe0848' value='0x" DATA.LONG(A:0xbe0848) "' name='RPMH_BCM_SND_LUT_SND3_COL1_CP2'/>"
WRITE #1 "        <register address='0xbbe084c' value='0x" DATA.LONG(A:0xbe084c) "' name='RPMH_BCM_SND_LUT_SND3_COL1_CP3'/>"
WRITE #1 "        <register address='0xbbe0850' value='0x" DATA.LONG(A:0xbe0850) "' name='RPMH_BCM_SND_LUT_SND3_COL1_CP4'/>"
WRITE #1 "        <register address='0xbbe0854' value='0x" DATA.LONG(A:0xbe0854) "' name='RPMH_BCM_SND_LUT_SND3_COL1_CP5'/>"
WRITE #1 "        <register address='0xbbe0858' value='0x" DATA.LONG(A:0xbe0858) "' name='RPMH_BCM_SND_LUT_SND3_COL1_CP6'/>"
WRITE #1 "        <register address='0xbbe085c' value='0x" DATA.LONG(A:0xbe085c) "' name='RPMH_BCM_SND_LUT_SND3_COL1_CP7'/>"
WRITE #1 "        <register address='0xbbe0860' value='0x" DATA.LONG(A:0xbe0860) "' name='RPMH_BCM_SND_LUT_SND3_COL1_CP8'/>"
WRITE #1 "        <register address='0xbbe0864' value='0x" DATA.LONG(A:0xbe0864) "' name='RPMH_BCM_SND_LUT_SND3_COL1_CP9'/>"
WRITE #1 "        <register address='0xbbe0868' value='0x" DATA.LONG(A:0xbe0868) "' name='RPMH_BCM_SND_LUT_SND3_COL1_CP10'/>"
WRITE #1 "        <register address='0xbbe086c' value='0x" DATA.LONG(A:0xbe086c) "' name='RPMH_BCM_SND_LUT_SND3_COL1_CP11'/>"
WRITE #1 "        <register address='0xbbe0870' value='0x" DATA.LONG(A:0xbe0870) "' name='RPMH_BCM_SND_LUT_SND3_COL1_CP12'/>"
WRITE #1 "        <register address='0xbbe0874' value='0x" DATA.LONG(A:0xbe0874) "' name='RPMH_BCM_SND_LUT_SND3_COL1_CP13'/>"
WRITE #1 "        <register address='0xbbe0878' value='0x" DATA.LONG(A:0xbe0878) "' name='RPMH_BCM_SND_LUT_SND3_COL1_CP14'/>"
WRITE #1 "        <register address='0xbbe087c' value='0x" DATA.LONG(A:0xbe087c) "' name='RPMH_BCM_SND_LUT_SND3_COL1_CP15'/>"
WRITE #1 "        <register address='0xbbe0880' value='0x" DATA.LONG(A:0xbe0880) "' name='RPMH_BCM_SND_LUT_SND3_COL2_CP0'/>"
WRITE #1 "        <register address='0xbbe0884' value='0x" DATA.LONG(A:0xbe0884) "' name='RPMH_BCM_SND_LUT_SND3_COL2_CP1'/>"
WRITE #1 "        <register address='0xbbe0888' value='0x" DATA.LONG(A:0xbe0888) "' name='RPMH_BCM_SND_LUT_SND3_COL2_CP2'/>"
WRITE #1 "        <register address='0xbbe088c' value='0x" DATA.LONG(A:0xbe088c) "' name='RPMH_BCM_SND_LUT_SND3_COL2_CP3'/>"
WRITE #1 "        <register address='0xbbe0890' value='0x" DATA.LONG(A:0xbe0890) "' name='RPMH_BCM_SND_LUT_SND3_COL2_CP4'/>"
WRITE #1 "        <register address='0xbbe0894' value='0x" DATA.LONG(A:0xbe0894) "' name='RPMH_BCM_SND_LUT_SND3_COL2_CP5'/>"
WRITE #1 "        <register address='0xbbe0898' value='0x" DATA.LONG(A:0xbe0898) "' name='RPMH_BCM_SND_LUT_SND3_COL2_CP6'/>"
WRITE #1 "        <register address='0xbbe089c' value='0x" DATA.LONG(A:0xbe089c) "' name='RPMH_BCM_SND_LUT_SND3_COL2_CP7'/>"
WRITE #1 "        <register address='0xbbe08a0' value='0x" DATA.LONG(A:0xbe08a0) "' name='RPMH_BCM_SND_LUT_SND3_COL2_CP8'/>"
WRITE #1 "        <register address='0xbbe08a4' value='0x" DATA.LONG(A:0xbe08a4) "' name='RPMH_BCM_SND_LUT_SND3_COL2_CP9'/>"
WRITE #1 "        <register address='0xbbe08a8' value='0x" DATA.LONG(A:0xbe08a8) "' name='RPMH_BCM_SND_LUT_SND3_COL2_CP10'/>"
WRITE #1 "        <register address='0xbbe08ac' value='0x" DATA.LONG(A:0xbe08ac) "' name='RPMH_BCM_SND_LUT_SND3_COL2_CP11'/>"
WRITE #1 "        <register address='0xbbe08b0' value='0x" DATA.LONG(A:0xbe08b0) "' name='RPMH_BCM_SND_LUT_SND3_COL2_CP12'/>"
WRITE #1 "        <register address='0xbbe08b4' value='0x" DATA.LONG(A:0xbe08b4) "' name='RPMH_BCM_SND_LUT_SND3_COL2_CP13'/>"
WRITE #1 "        <register address='0xbbe08b8' value='0x" DATA.LONG(A:0xbe08b8) "' name='RPMH_BCM_SND_LUT_SND3_COL2_CP14'/>"
WRITE #1 "        <register address='0xbbe08bc' value='0x" DATA.LONG(A:0xbe08bc) "' name='RPMH_BCM_SND_LUT_SND3_COL2_CP15'/>"
WRITE #1 "        <register address='0xbbe08c0' value='0x" DATA.LONG(A:0xbe08c0) "' name='RPMH_BCM_SND_LUT_SND3_COL3_CP0'/>"
WRITE #1 "        <register address='0xbbe08c4' value='0x" DATA.LONG(A:0xbe08c4) "' name='RPMH_BCM_SND_LUT_SND3_COL3_CP1'/>"
WRITE #1 "        <register address='0xbbe08c8' value='0x" DATA.LONG(A:0xbe08c8) "' name='RPMH_BCM_SND_LUT_SND3_COL3_CP2'/>"
WRITE #1 "        <register address='0xbbe08cc' value='0x" DATA.LONG(A:0xbe08cc) "' name='RPMH_BCM_SND_LUT_SND3_COL3_CP3'/>"
WRITE #1 "        <register address='0xbbe08d0' value='0x" DATA.LONG(A:0xbe08d0) "' name='RPMH_BCM_SND_LUT_SND3_COL3_CP4'/>"
WRITE #1 "        <register address='0xbbe08d4' value='0x" DATA.LONG(A:0xbe08d4) "' name='RPMH_BCM_SND_LUT_SND3_COL3_CP5'/>"
WRITE #1 "        <register address='0xbbe08d8' value='0x" DATA.LONG(A:0xbe08d8) "' name='RPMH_BCM_SND_LUT_SND3_COL3_CP6'/>"
WRITE #1 "        <register address='0xbbe08dc' value='0x" DATA.LONG(A:0xbe08dc) "' name='RPMH_BCM_SND_LUT_SND3_COL3_CP7'/>"
WRITE #1 "        <register address='0xbbe08e0' value='0x" DATA.LONG(A:0xbe08e0) "' name='RPMH_BCM_SND_LUT_SND3_COL3_CP8'/>"
WRITE #1 "        <register address='0xbbe08e4' value='0x" DATA.LONG(A:0xbe08e4) "' name='RPMH_BCM_SND_LUT_SND3_COL3_CP9'/>"
WRITE #1 "        <register address='0xbbe08e8' value='0x" DATA.LONG(A:0xbe08e8) "' name='RPMH_BCM_SND_LUT_SND3_COL3_CP10'/>"
WRITE #1 "        <register address='0xbbe08ec' value='0x" DATA.LONG(A:0xbe08ec) "' name='RPMH_BCM_SND_LUT_SND3_COL3_CP11'/>"
WRITE #1 "        <register address='0xbbe08f0' value='0x" DATA.LONG(A:0xbe08f0) "' name='RPMH_BCM_SND_LUT_SND3_COL3_CP12'/>"
WRITE #1 "        <register address='0xbbe08f4' value='0x" DATA.LONG(A:0xbe08f4) "' name='RPMH_BCM_SND_LUT_SND3_COL3_CP13'/>"
WRITE #1 "        <register address='0xbbe08f8' value='0x" DATA.LONG(A:0xbe08f8) "' name='RPMH_BCM_SND_LUT_SND3_COL3_CP14'/>"
WRITE #1 "        <register address='0xbbe08fc' value='0x" DATA.LONG(A:0xbe08fc) "' name='RPMH_BCM_SND_LUT_SND3_COL3_CP15'/>"
WRITE #1 "        <register address='0xbbe3000' value='0x" DATA.LONG(A:0xbe3000) "' name='RPMH_BCM_CD_CFG_CD0'/>"
WRITE #1 "        <register address='0xbbe3004' value='0x" DATA.LONG(A:0xbe3004) "' name='RPMH_BCM_CD_CFG_CD1'/>"
WRITE #1 "        <register address='0xbbe3008' value='0x" DATA.LONG(A:0xbe3008) "' name='RPMH_BCM_CD_CFG_CD2'/>"
WRITE #1 "        <register address='0xbbe300c' value='0x" DATA.LONG(A:0xbe300c) "' name='RPMH_BCM_CD_CFG_CD3'/>"
WRITE #1 "        <register address='0xbbe3010' value='0x" DATA.LONG(A:0xbe3010) "' name='RPMH_BCM_CD_CFG_CD4'/>"
WRITE #1 "        <register address='0xbbe3014' value='0x" DATA.LONG(A:0xbe3014) "' name='RPMH_BCM_CD_CFG_CD5'/>"
WRITE #1 "        <register address='0xbbe3018' value='0x" DATA.LONG(A:0xbe3018) "' name='RPMH_BCM_CD_CFG_CD6'/>"
WRITE #1 "        <register address='0xbbe301c' value='0x" DATA.LONG(A:0xbe301c) "' name='RPMH_BCM_CD_CFG_CD7'/>"
WRITE #1 "        <register address='0xbbe3020' value='0x" DATA.LONG(A:0xbe3020) "' name='RPMH_BCM_CD_CFG_CD8'/>"
WRITE #1 "        <register address='0xbbe3024' value='0x" DATA.LONG(A:0xbe3024) "' name='RPMH_BCM_CD_CFG_CD9'/>"
WRITE #1 "        <register address='0xbbe3028' value='0x" DATA.LONG(A:0xbe3028) "' name='RPMH_BCM_CD_CFG_CD10'/>"
WRITE #1 "        <register address='0xbbe302c' value='0x" DATA.LONG(A:0xbe302c) "' name='RPMH_BCM_CD_CFG_CD11'/>"
WRITE #1 "        <register address='0xbbe3080' value='0x" DATA.LONG(A:0xbe3080) "' name='RPMH_BCM_CD_CFG_ENABLE_CD0'/>"
WRITE #1 "        <register address='0xbbe3084' value='0x" DATA.LONG(A:0xbe3084) "' name='RPMH_BCM_CD_CFG_ENABLE_CD1'/>"
WRITE #1 "        <register address='0xbbe3088' value='0x" DATA.LONG(A:0xbe3088) "' name='RPMH_BCM_CD_CFG_ENABLE_CD2'/>"
WRITE #1 "        <register address='0xbbe308c' value='0x" DATA.LONG(A:0xbe308c) "' name='RPMH_BCM_CD_CFG_ENABLE_CD3'/>"
WRITE #1 "        <register address='0xbbe3090' value='0x" DATA.LONG(A:0xbe3090) "' name='RPMH_BCM_CD_CFG_ENABLE_CD4'/>"
WRITE #1 "        <register address='0xbbe3094' value='0x" DATA.LONG(A:0xbe3094) "' name='RPMH_BCM_CD_CFG_ENABLE_CD5'/>"
WRITE #1 "        <register address='0xbbe3098' value='0x" DATA.LONG(A:0xbe3098) "' name='RPMH_BCM_CD_CFG_ENABLE_CD6'/>"
WRITE #1 "        <register address='0xbbe309c' value='0x" DATA.LONG(A:0xbe309c) "' name='RPMH_BCM_CD_CFG_ENABLE_CD7'/>"
WRITE #1 "        <register address='0xbbe30a0' value='0x" DATA.LONG(A:0xbe30a0) "' name='RPMH_BCM_CD_CFG_ENABLE_CD8'/>"
WRITE #1 "        <register address='0xbbe30a4' value='0x" DATA.LONG(A:0xbe30a4) "' name='RPMH_BCM_CD_CFG_ENABLE_CD9'/>"
WRITE #1 "        <register address='0xbbe30a8' value='0x" DATA.LONG(A:0xbe30a8) "' name='RPMH_BCM_CD_CFG_ENABLE_CD10'/>"
WRITE #1 "        <register address='0xbbe30ac' value='0x" DATA.LONG(A:0xbe30ac) "' name='RPMH_BCM_CD_CFG_ENABLE_CD11'/>"
WRITE #1 "        <register address='0xbbe3200' value='0x" DATA.LONG(A:0xbe3200) "' name='RPMH_BCM_CD_CFG_CD0_AU_INPUT0'/>"
WRITE #1 "        <register address='0xbbe3204' value='0x" DATA.LONG(A:0xbe3204) "' name='RPMH_BCM_CD_CFG_CD0_AU_INPUT1'/>"
WRITE #1 "        <register address='0xbbe3208' value='0x" DATA.LONG(A:0xbe3208) "' name='RPMH_BCM_CD_CFG_CD0_AU_INPUT2'/>"
WRITE #1 "        <register address='0xbbe320c' value='0x" DATA.LONG(A:0xbe320c) "' name='RPMH_BCM_CD_CFG_CD0_AU_INPUT3'/>"
WRITE #1 "        <register address='0xbbe3210' value='0x" DATA.LONG(A:0xbe3210) "' name='RPMH_BCM_CD_CFG_CD0_AU_INPUT4'/>"
WRITE #1 "        <register address='0xbbe3214' value='0x" DATA.LONG(A:0xbe3214) "' name='RPMH_BCM_CD_CFG_CD0_AU_INPUT5'/>"
WRITE #1 "        <register address='0xbbe3218' value='0x" DATA.LONG(A:0xbe3218) "' name='RPMH_BCM_CD_CFG_CD0_AU_INPUT6'/>"
WRITE #1 "        <register address='0xbbe321c' value='0x" DATA.LONG(A:0xbe321c) "' name='RPMH_BCM_CD_CFG_CD0_AU_INPUT7'/>"
WRITE #1 "        <register address='0xbbe3220' value='0x" DATA.LONG(A:0xbe3220) "' name='RPMH_BCM_CD_CFG_CD0_AU_INPUT8'/>"
WRITE #1 "        <register address='0xbbe3224' value='0x" DATA.LONG(A:0xbe3224) "' name='RPMH_BCM_CD_CFG_CD0_AU_INPUT9'/>"
WRITE #1 "        <register address='0xbbe3228' value='0x" DATA.LONG(A:0xbe3228) "' name='RPMH_BCM_CD_CFG_CD0_AU_INPUT10'/>"
WRITE #1 "        <register address='0xbbe322c' value='0x" DATA.LONG(A:0xbe322c) "' name='RPMH_BCM_CD_CFG_CD0_AU_INPUT11'/>"
WRITE #1 "        <register address='0xbbe3230' value='0x" DATA.LONG(A:0xbe3230) "' name='RPMH_BCM_CD_CFG_CD0_AU_INPUT12'/>"
WRITE #1 "        <register address='0xbbe3234' value='0x" DATA.LONG(A:0xbe3234) "' name='RPMH_BCM_CD_CFG_CD0_AU_INPUT13'/>"
WRITE #1 "        <register address='0xbbe3238' value='0x" DATA.LONG(A:0xbe3238) "' name='RPMH_BCM_CD_CFG_CD0_AU_INPUT14'/>"
WRITE #1 "        <register address='0xbbe323c' value='0x" DATA.LONG(A:0xbe323c) "' name='RPMH_BCM_CD_CFG_CD0_AU_INPUT15'/>"
WRITE #1 "        <register address='0xbbe3240' value='0x" DATA.LONG(A:0xbe3240) "' name='RPMH_BCM_CD_CFG_CD1_AU_INPUT0'/>"
WRITE #1 "        <register address='0xbbe3244' value='0x" DATA.LONG(A:0xbe3244) "' name='RPMH_BCM_CD_CFG_CD1_AU_INPUT1'/>"
WRITE #1 "        <register address='0xbbe3248' value='0x" DATA.LONG(A:0xbe3248) "' name='RPMH_BCM_CD_CFG_CD1_AU_INPUT2'/>"
WRITE #1 "        <register address='0xbbe324c' value='0x" DATA.LONG(A:0xbe324c) "' name='RPMH_BCM_CD_CFG_CD1_AU_INPUT3'/>"
WRITE #1 "        <register address='0xbbe3250' value='0x" DATA.LONG(A:0xbe3250) "' name='RPMH_BCM_CD_CFG_CD1_AU_INPUT4'/>"
WRITE #1 "        <register address='0xbbe3254' value='0x" DATA.LONG(A:0xbe3254) "' name='RPMH_BCM_CD_CFG_CD1_AU_INPUT5'/>"
WRITE #1 "        <register address='0xbbe3258' value='0x" DATA.LONG(A:0xbe3258) "' name='RPMH_BCM_CD_CFG_CD1_AU_INPUT6'/>"
WRITE #1 "        <register address='0xbbe325c' value='0x" DATA.LONG(A:0xbe325c) "' name='RPMH_BCM_CD_CFG_CD1_AU_INPUT7'/>"
WRITE #1 "        <register address='0xbbe3260' value='0x" DATA.LONG(A:0xbe3260) "' name='RPMH_BCM_CD_CFG_CD1_AU_INPUT8'/>"
WRITE #1 "        <register address='0xbbe3264' value='0x" DATA.LONG(A:0xbe3264) "' name='RPMH_BCM_CD_CFG_CD1_AU_INPUT9'/>"
WRITE #1 "        <register address='0xbbe3268' value='0x" DATA.LONG(A:0xbe3268) "' name='RPMH_BCM_CD_CFG_CD1_AU_INPUT10'/>"
WRITE #1 "        <register address='0xbbe326c' value='0x" DATA.LONG(A:0xbe326c) "' name='RPMH_BCM_CD_CFG_CD1_AU_INPUT11'/>"
WRITE #1 "        <register address='0xbbe3270' value='0x" DATA.LONG(A:0xbe3270) "' name='RPMH_BCM_CD_CFG_CD1_AU_INPUT12'/>"
WRITE #1 "        <register address='0xbbe3274' value='0x" DATA.LONG(A:0xbe3274) "' name='RPMH_BCM_CD_CFG_CD1_AU_INPUT13'/>"
WRITE #1 "        <register address='0xbbe3278' value='0x" DATA.LONG(A:0xbe3278) "' name='RPMH_BCM_CD_CFG_CD1_AU_INPUT14'/>"
WRITE #1 "        <register address='0xbbe327c' value='0x" DATA.LONG(A:0xbe327c) "' name='RPMH_BCM_CD_CFG_CD1_AU_INPUT15'/>"
WRITE #1 "        <register address='0xbbe3280' value='0x" DATA.LONG(A:0xbe3280) "' name='RPMH_BCM_CD_CFG_CD2_AU_INPUT0'/>"
WRITE #1 "        <register address='0xbbe3284' value='0x" DATA.LONG(A:0xbe3284) "' name='RPMH_BCM_CD_CFG_CD2_AU_INPUT1'/>"
WRITE #1 "        <register address='0xbbe3288' value='0x" DATA.LONG(A:0xbe3288) "' name='RPMH_BCM_CD_CFG_CD2_AU_INPUT2'/>"
WRITE #1 "        <register address='0xbbe328c' value='0x" DATA.LONG(A:0xbe328c) "' name='RPMH_BCM_CD_CFG_CD2_AU_INPUT3'/>"
WRITE #1 "        <register address='0xbbe3290' value='0x" DATA.LONG(A:0xbe3290) "' name='RPMH_BCM_CD_CFG_CD2_AU_INPUT4'/>"
WRITE #1 "        <register address='0xbbe3294' value='0x" DATA.LONG(A:0xbe3294) "' name='RPMH_BCM_CD_CFG_CD2_AU_INPUT5'/>"
WRITE #1 "        <register address='0xbbe3298' value='0x" DATA.LONG(A:0xbe3298) "' name='RPMH_BCM_CD_CFG_CD2_AU_INPUT6'/>"
WRITE #1 "        <register address='0xbbe329c' value='0x" DATA.LONG(A:0xbe329c) "' name='RPMH_BCM_CD_CFG_CD2_AU_INPUT7'/>"
WRITE #1 "        <register address='0xbbe32a0' value='0x" DATA.LONG(A:0xbe32a0) "' name='RPMH_BCM_CD_CFG_CD2_AU_INPUT8'/>"
WRITE #1 "        <register address='0xbbe32a4' value='0x" DATA.LONG(A:0xbe32a4) "' name='RPMH_BCM_CD_CFG_CD2_AU_INPUT9'/>"
WRITE #1 "        <register address='0xbbe32a8' value='0x" DATA.LONG(A:0xbe32a8) "' name='RPMH_BCM_CD_CFG_CD2_AU_INPUT10'/>"
WRITE #1 "        <register address='0xbbe32ac' value='0x" DATA.LONG(A:0xbe32ac) "' name='RPMH_BCM_CD_CFG_CD2_AU_INPUT11'/>"
WRITE #1 "        <register address='0xbbe32b0' value='0x" DATA.LONG(A:0xbe32b0) "' name='RPMH_BCM_CD_CFG_CD2_AU_INPUT12'/>"
WRITE #1 "        <register address='0xbbe32b4' value='0x" DATA.LONG(A:0xbe32b4) "' name='RPMH_BCM_CD_CFG_CD2_AU_INPUT13'/>"
WRITE #1 "        <register address='0xbbe32b8' value='0x" DATA.LONG(A:0xbe32b8) "' name='RPMH_BCM_CD_CFG_CD2_AU_INPUT14'/>"
WRITE #1 "        <register address='0xbbe32bc' value='0x" DATA.LONG(A:0xbe32bc) "' name='RPMH_BCM_CD_CFG_CD2_AU_INPUT15'/>"
WRITE #1 "        <register address='0xbbe32c0' value='0x" DATA.LONG(A:0xbe32c0) "' name='RPMH_BCM_CD_CFG_CD3_AU_INPUT0'/>"
WRITE #1 "        <register address='0xbbe32c4' value='0x" DATA.LONG(A:0xbe32c4) "' name='RPMH_BCM_CD_CFG_CD3_AU_INPUT1'/>"
WRITE #1 "        <register address='0xbbe32c8' value='0x" DATA.LONG(A:0xbe32c8) "' name='RPMH_BCM_CD_CFG_CD3_AU_INPUT2'/>"
WRITE #1 "        <register address='0xbbe32cc' value='0x" DATA.LONG(A:0xbe32cc) "' name='RPMH_BCM_CD_CFG_CD3_AU_INPUT3'/>"
WRITE #1 "        <register address='0xbbe32d0' value='0x" DATA.LONG(A:0xbe32d0) "' name='RPMH_BCM_CD_CFG_CD3_AU_INPUT4'/>"
WRITE #1 "        <register address='0xbbe32d4' value='0x" DATA.LONG(A:0xbe32d4) "' name='RPMH_BCM_CD_CFG_CD3_AU_INPUT5'/>"
WRITE #1 "        <register address='0xbbe32d8' value='0x" DATA.LONG(A:0xbe32d8) "' name='RPMH_BCM_CD_CFG_CD3_AU_INPUT6'/>"
WRITE #1 "        <register address='0xbbe32dc' value='0x" DATA.LONG(A:0xbe32dc) "' name='RPMH_BCM_CD_CFG_CD3_AU_INPUT7'/>"
WRITE #1 "        <register address='0xbbe32e0' value='0x" DATA.LONG(A:0xbe32e0) "' name='RPMH_BCM_CD_CFG_CD3_AU_INPUT8'/>"
WRITE #1 "        <register address='0xbbe32e4' value='0x" DATA.LONG(A:0xbe32e4) "' name='RPMH_BCM_CD_CFG_CD3_AU_INPUT9'/>"
WRITE #1 "        <register address='0xbbe32e8' value='0x" DATA.LONG(A:0xbe32e8) "' name='RPMH_BCM_CD_CFG_CD3_AU_INPUT10'/>"
WRITE #1 "        <register address='0xbbe32ec' value='0x" DATA.LONG(A:0xbe32ec) "' name='RPMH_BCM_CD_CFG_CD3_AU_INPUT11'/>"
WRITE #1 "        <register address='0xbbe32f0' value='0x" DATA.LONG(A:0xbe32f0) "' name='RPMH_BCM_CD_CFG_CD3_AU_INPUT12'/>"
WRITE #1 "        <register address='0xbbe32f4' value='0x" DATA.LONG(A:0xbe32f4) "' name='RPMH_BCM_CD_CFG_CD3_AU_INPUT13'/>"
WRITE #1 "        <register address='0xbbe32f8' value='0x" DATA.LONG(A:0xbe32f8) "' name='RPMH_BCM_CD_CFG_CD3_AU_INPUT14'/>"
WRITE #1 "        <register address='0xbbe32fc' value='0x" DATA.LONG(A:0xbe32fc) "' name='RPMH_BCM_CD_CFG_CD3_AU_INPUT15'/>"
WRITE #1 "        <register address='0xbbe3300' value='0x" DATA.LONG(A:0xbe3300) "' name='RPMH_BCM_CD_CFG_CD4_AU_INPUT0'/>"
WRITE #1 "        <register address='0xbbe3304' value='0x" DATA.LONG(A:0xbe3304) "' name='RPMH_BCM_CD_CFG_CD4_AU_INPUT1'/>"
WRITE #1 "        <register address='0xbbe3308' value='0x" DATA.LONG(A:0xbe3308) "' name='RPMH_BCM_CD_CFG_CD4_AU_INPUT2'/>"
WRITE #1 "        <register address='0xbbe330c' value='0x" DATA.LONG(A:0xbe330c) "' name='RPMH_BCM_CD_CFG_CD4_AU_INPUT3'/>"
WRITE #1 "        <register address='0xbbe3310' value='0x" DATA.LONG(A:0xbe3310) "' name='RPMH_BCM_CD_CFG_CD4_AU_INPUT4'/>"
WRITE #1 "        <register address='0xbbe3314' value='0x" DATA.LONG(A:0xbe3314) "' name='RPMH_BCM_CD_CFG_CD4_AU_INPUT5'/>"
WRITE #1 "        <register address='0xbbe3318' value='0x" DATA.LONG(A:0xbe3318) "' name='RPMH_BCM_CD_CFG_CD4_AU_INPUT6'/>"
WRITE #1 "        <register address='0xbbe331c' value='0x" DATA.LONG(A:0xbe331c) "' name='RPMH_BCM_CD_CFG_CD4_AU_INPUT7'/>"
WRITE #1 "        <register address='0xbbe3320' value='0x" DATA.LONG(A:0xbe3320) "' name='RPMH_BCM_CD_CFG_CD4_AU_INPUT8'/>"
WRITE #1 "        <register address='0xbbe3324' value='0x" DATA.LONG(A:0xbe3324) "' name='RPMH_BCM_CD_CFG_CD4_AU_INPUT9'/>"
WRITE #1 "        <register address='0xbbe3328' value='0x" DATA.LONG(A:0xbe3328) "' name='RPMH_BCM_CD_CFG_CD4_AU_INPUT10'/>"
WRITE #1 "        <register address='0xbbe332c' value='0x" DATA.LONG(A:0xbe332c) "' name='RPMH_BCM_CD_CFG_CD4_AU_INPUT11'/>"
WRITE #1 "        <register address='0xbbe3330' value='0x" DATA.LONG(A:0xbe3330) "' name='RPMH_BCM_CD_CFG_CD4_AU_INPUT12'/>"
WRITE #1 "        <register address='0xbbe3334' value='0x" DATA.LONG(A:0xbe3334) "' name='RPMH_BCM_CD_CFG_CD4_AU_INPUT13'/>"
WRITE #1 "        <register address='0xbbe3338' value='0x" DATA.LONG(A:0xbe3338) "' name='RPMH_BCM_CD_CFG_CD4_AU_INPUT14'/>"
WRITE #1 "        <register address='0xbbe333c' value='0x" DATA.LONG(A:0xbe333c) "' name='RPMH_BCM_CD_CFG_CD4_AU_INPUT15'/>"
WRITE #1 "        <register address='0xbbe3340' value='0x" DATA.LONG(A:0xbe3340) "' name='RPMH_BCM_CD_CFG_CD5_AU_INPUT0'/>"
WRITE #1 "        <register address='0xbbe3344' value='0x" DATA.LONG(A:0xbe3344) "' name='RPMH_BCM_CD_CFG_CD5_AU_INPUT1'/>"
WRITE #1 "        <register address='0xbbe3348' value='0x" DATA.LONG(A:0xbe3348) "' name='RPMH_BCM_CD_CFG_CD5_AU_INPUT2'/>"
WRITE #1 "        <register address='0xbbe334c' value='0x" DATA.LONG(A:0xbe334c) "' name='RPMH_BCM_CD_CFG_CD5_AU_INPUT3'/>"
WRITE #1 "        <register address='0xbbe3350' value='0x" DATA.LONG(A:0xbe3350) "' name='RPMH_BCM_CD_CFG_CD5_AU_INPUT4'/>"
WRITE #1 "        <register address='0xbbe3354' value='0x" DATA.LONG(A:0xbe3354) "' name='RPMH_BCM_CD_CFG_CD5_AU_INPUT5'/>"
WRITE #1 "        <register address='0xbbe3358' value='0x" DATA.LONG(A:0xbe3358) "' name='RPMH_BCM_CD_CFG_CD5_AU_INPUT6'/>"
WRITE #1 "        <register address='0xbbe335c' value='0x" DATA.LONG(A:0xbe335c) "' name='RPMH_BCM_CD_CFG_CD5_AU_INPUT7'/>"
WRITE #1 "        <register address='0xbbe3360' value='0x" DATA.LONG(A:0xbe3360) "' name='RPMH_BCM_CD_CFG_CD5_AU_INPUT8'/>"
WRITE #1 "        <register address='0xbbe3364' value='0x" DATA.LONG(A:0xbe3364) "' name='RPMH_BCM_CD_CFG_CD5_AU_INPUT9'/>"
WRITE #1 "        <register address='0xbbe3368' value='0x" DATA.LONG(A:0xbe3368) "' name='RPMH_BCM_CD_CFG_CD5_AU_INPUT10'/>"
WRITE #1 "        <register address='0xbbe336c' value='0x" DATA.LONG(A:0xbe336c) "' name='RPMH_BCM_CD_CFG_CD5_AU_INPUT11'/>"
WRITE #1 "        <register address='0xbbe3370' value='0x" DATA.LONG(A:0xbe3370) "' name='RPMH_BCM_CD_CFG_CD5_AU_INPUT12'/>"
WRITE #1 "        <register address='0xbbe3374' value='0x" DATA.LONG(A:0xbe3374) "' name='RPMH_BCM_CD_CFG_CD5_AU_INPUT13'/>"
WRITE #1 "        <register address='0xbbe3378' value='0x" DATA.LONG(A:0xbe3378) "' name='RPMH_BCM_CD_CFG_CD5_AU_INPUT14'/>"
WRITE #1 "        <register address='0xbbe337c' value='0x" DATA.LONG(A:0xbe337c) "' name='RPMH_BCM_CD_CFG_CD5_AU_INPUT15'/>"
WRITE #1 "        <register address='0xbbe3380' value='0x" DATA.LONG(A:0xbe3380) "' name='RPMH_BCM_CD_CFG_CD6_AU_INPUT0'/>"
WRITE #1 "        <register address='0xbbe3384' value='0x" DATA.LONG(A:0xbe3384) "' name='RPMH_BCM_CD_CFG_CD6_AU_INPUT1'/>"
WRITE #1 "        <register address='0xbbe3388' value='0x" DATA.LONG(A:0xbe3388) "' name='RPMH_BCM_CD_CFG_CD6_AU_INPUT2'/>"
WRITE #1 "        <register address='0xbbe338c' value='0x" DATA.LONG(A:0xbe338c) "' name='RPMH_BCM_CD_CFG_CD6_AU_INPUT3'/>"
WRITE #1 "        <register address='0xbbe3390' value='0x" DATA.LONG(A:0xbe3390) "' name='RPMH_BCM_CD_CFG_CD6_AU_INPUT4'/>"
WRITE #1 "        <register address='0xbbe3394' value='0x" DATA.LONG(A:0xbe3394) "' name='RPMH_BCM_CD_CFG_CD6_AU_INPUT5'/>"
WRITE #1 "        <register address='0xbbe3398' value='0x" DATA.LONG(A:0xbe3398) "' name='RPMH_BCM_CD_CFG_CD6_AU_INPUT6'/>"
WRITE #1 "        <register address='0xbbe339c' value='0x" DATA.LONG(A:0xbe339c) "' name='RPMH_BCM_CD_CFG_CD6_AU_INPUT7'/>"
WRITE #1 "        <register address='0xbbe33a0' value='0x" DATA.LONG(A:0xbe33a0) "' name='RPMH_BCM_CD_CFG_CD6_AU_INPUT8'/>"
WRITE #1 "        <register address='0xbbe33a4' value='0x" DATA.LONG(A:0xbe33a4) "' name='RPMH_BCM_CD_CFG_CD6_AU_INPUT9'/>"
WRITE #1 "        <register address='0xbbe33a8' value='0x" DATA.LONG(A:0xbe33a8) "' name='RPMH_BCM_CD_CFG_CD6_AU_INPUT10'/>"
WRITE #1 "        <register address='0xbbe33ac' value='0x" DATA.LONG(A:0xbe33ac) "' name='RPMH_BCM_CD_CFG_CD6_AU_INPUT11'/>"
WRITE #1 "        <register address='0xbbe33b0' value='0x" DATA.LONG(A:0xbe33b0) "' name='RPMH_BCM_CD_CFG_CD6_AU_INPUT12'/>"
WRITE #1 "        <register address='0xbbe33b4' value='0x" DATA.LONG(A:0xbe33b4) "' name='RPMH_BCM_CD_CFG_CD6_AU_INPUT13'/>"
WRITE #1 "        <register address='0xbbe33b8' value='0x" DATA.LONG(A:0xbe33b8) "' name='RPMH_BCM_CD_CFG_CD6_AU_INPUT14'/>"
WRITE #1 "        <register address='0xbbe33bc' value='0x" DATA.LONG(A:0xbe33bc) "' name='RPMH_BCM_CD_CFG_CD6_AU_INPUT15'/>"
WRITE #1 "        <register address='0xbbe33c0' value='0x" DATA.LONG(A:0xbe33c0) "' name='RPMH_BCM_CD_CFG_CD7_AU_INPUT0'/>"
WRITE #1 "        <register address='0xbbe33c4' value='0x" DATA.LONG(A:0xbe33c4) "' name='RPMH_BCM_CD_CFG_CD7_AU_INPUT1'/>"
WRITE #1 "        <register address='0xbbe33c8' value='0x" DATA.LONG(A:0xbe33c8) "' name='RPMH_BCM_CD_CFG_CD7_AU_INPUT2'/>"
WRITE #1 "        <register address='0xbbe33cc' value='0x" DATA.LONG(A:0xbe33cc) "' name='RPMH_BCM_CD_CFG_CD7_AU_INPUT3'/>"
WRITE #1 "        <register address='0xbbe33d0' value='0x" DATA.LONG(A:0xbe33d0) "' name='RPMH_BCM_CD_CFG_CD7_AU_INPUT4'/>"
WRITE #1 "        <register address='0xbbe33d4' value='0x" DATA.LONG(A:0xbe33d4) "' name='RPMH_BCM_CD_CFG_CD7_AU_INPUT5'/>"
WRITE #1 "        <register address='0xbbe33d8' value='0x" DATA.LONG(A:0xbe33d8) "' name='RPMH_BCM_CD_CFG_CD7_AU_INPUT6'/>"
WRITE #1 "        <register address='0xbbe33dc' value='0x" DATA.LONG(A:0xbe33dc) "' name='RPMH_BCM_CD_CFG_CD7_AU_INPUT7'/>"
WRITE #1 "        <register address='0xbbe33e0' value='0x" DATA.LONG(A:0xbe33e0) "' name='RPMH_BCM_CD_CFG_CD7_AU_INPUT8'/>"
WRITE #1 "        <register address='0xbbe33e4' value='0x" DATA.LONG(A:0xbe33e4) "' name='RPMH_BCM_CD_CFG_CD7_AU_INPUT9'/>"
WRITE #1 "        <register address='0xbbe33e8' value='0x" DATA.LONG(A:0xbe33e8) "' name='RPMH_BCM_CD_CFG_CD7_AU_INPUT10'/>"
WRITE #1 "        <register address='0xbbe33ec' value='0x" DATA.LONG(A:0xbe33ec) "' name='RPMH_BCM_CD_CFG_CD7_AU_INPUT11'/>"
WRITE #1 "        <register address='0xbbe33f0' value='0x" DATA.LONG(A:0xbe33f0) "' name='RPMH_BCM_CD_CFG_CD7_AU_INPUT12'/>"
WRITE #1 "        <register address='0xbbe33f4' value='0x" DATA.LONG(A:0xbe33f4) "' name='RPMH_BCM_CD_CFG_CD7_AU_INPUT13'/>"
WRITE #1 "        <register address='0xbbe33f8' value='0x" DATA.LONG(A:0xbe33f8) "' name='RPMH_BCM_CD_CFG_CD7_AU_INPUT14'/>"
WRITE #1 "        <register address='0xbbe33fc' value='0x" DATA.LONG(A:0xbe33fc) "' name='RPMH_BCM_CD_CFG_CD7_AU_INPUT15'/>"
WRITE #1 "        <register address='0xbbe3400' value='0x" DATA.LONG(A:0xbe3400) "' name='RPMH_BCM_CD_CFG_CD8_AU_INPUT0'/>"
WRITE #1 "        <register address='0xbbe3404' value='0x" DATA.LONG(A:0xbe3404) "' name='RPMH_BCM_CD_CFG_CD8_AU_INPUT1'/>"
WRITE #1 "        <register address='0xbbe3408' value='0x" DATA.LONG(A:0xbe3408) "' name='RPMH_BCM_CD_CFG_CD8_AU_INPUT2'/>"
WRITE #1 "        <register address='0xbbe340c' value='0x" DATA.LONG(A:0xbe340c) "' name='RPMH_BCM_CD_CFG_CD8_AU_INPUT3'/>"
WRITE #1 "        <register address='0xbbe3410' value='0x" DATA.LONG(A:0xbe3410) "' name='RPMH_BCM_CD_CFG_CD8_AU_INPUT4'/>"
WRITE #1 "        <register address='0xbbe3414' value='0x" DATA.LONG(A:0xbe3414) "' name='RPMH_BCM_CD_CFG_CD8_AU_INPUT5'/>"
WRITE #1 "        <register address='0xbbe3418' value='0x" DATA.LONG(A:0xbe3418) "' name='RPMH_BCM_CD_CFG_CD8_AU_INPUT6'/>"
WRITE #1 "        <register address='0xbbe341c' value='0x" DATA.LONG(A:0xbe341c) "' name='RPMH_BCM_CD_CFG_CD8_AU_INPUT7'/>"
WRITE #1 "        <register address='0xbbe3420' value='0x" DATA.LONG(A:0xbe3420) "' name='RPMH_BCM_CD_CFG_CD8_AU_INPUT8'/>"
WRITE #1 "        <register address='0xbbe3424' value='0x" DATA.LONG(A:0xbe3424) "' name='RPMH_BCM_CD_CFG_CD8_AU_INPUT9'/>"
WRITE #1 "        <register address='0xbbe3428' value='0x" DATA.LONG(A:0xbe3428) "' name='RPMH_BCM_CD_CFG_CD8_AU_INPUT10'/>"
WRITE #1 "        <register address='0xbbe342c' value='0x" DATA.LONG(A:0xbe342c) "' name='RPMH_BCM_CD_CFG_CD8_AU_INPUT11'/>"
WRITE #1 "        <register address='0xbbe3430' value='0x" DATA.LONG(A:0xbe3430) "' name='RPMH_BCM_CD_CFG_CD8_AU_INPUT12'/>"
WRITE #1 "        <register address='0xbbe3434' value='0x" DATA.LONG(A:0xbe3434) "' name='RPMH_BCM_CD_CFG_CD8_AU_INPUT13'/>"
WRITE #1 "        <register address='0xbbe3438' value='0x" DATA.LONG(A:0xbe3438) "' name='RPMH_BCM_CD_CFG_CD8_AU_INPUT14'/>"
WRITE #1 "        <register address='0xbbe343c' value='0x" DATA.LONG(A:0xbe343c) "' name='RPMH_BCM_CD_CFG_CD8_AU_INPUT15'/>"
WRITE #1 "        <register address='0xbbe3440' value='0x" DATA.LONG(A:0xbe3440) "' name='RPMH_BCM_CD_CFG_CD9_AU_INPUT0'/>"
WRITE #1 "        <register address='0xbbe3444' value='0x" DATA.LONG(A:0xbe3444) "' name='RPMH_BCM_CD_CFG_CD9_AU_INPUT1'/>"
WRITE #1 "        <register address='0xbbe3448' value='0x" DATA.LONG(A:0xbe3448) "' name='RPMH_BCM_CD_CFG_CD9_AU_INPUT2'/>"
WRITE #1 "        <register address='0xbbe344c' value='0x" DATA.LONG(A:0xbe344c) "' name='RPMH_BCM_CD_CFG_CD9_AU_INPUT3'/>"
WRITE #1 "        <register address='0xbbe3450' value='0x" DATA.LONG(A:0xbe3450) "' name='RPMH_BCM_CD_CFG_CD9_AU_INPUT4'/>"
WRITE #1 "        <register address='0xbbe3454' value='0x" DATA.LONG(A:0xbe3454) "' name='RPMH_BCM_CD_CFG_CD9_AU_INPUT5'/>"
WRITE #1 "        <register address='0xbbe3458' value='0x" DATA.LONG(A:0xbe3458) "' name='RPMH_BCM_CD_CFG_CD9_AU_INPUT6'/>"
WRITE #1 "        <register address='0xbbe345c' value='0x" DATA.LONG(A:0xbe345c) "' name='RPMH_BCM_CD_CFG_CD9_AU_INPUT7'/>"
WRITE #1 "        <register address='0xbbe3460' value='0x" DATA.LONG(A:0xbe3460) "' name='RPMH_BCM_CD_CFG_CD9_AU_INPUT8'/>"
WRITE #1 "        <register address='0xbbe3464' value='0x" DATA.LONG(A:0xbe3464) "' name='RPMH_BCM_CD_CFG_CD9_AU_INPUT9'/>"
WRITE #1 "        <register address='0xbbe3468' value='0x" DATA.LONG(A:0xbe3468) "' name='RPMH_BCM_CD_CFG_CD9_AU_INPUT10'/>"
WRITE #1 "        <register address='0xbbe346c' value='0x" DATA.LONG(A:0xbe346c) "' name='RPMH_BCM_CD_CFG_CD9_AU_INPUT11'/>"
WRITE #1 "        <register address='0xbbe3470' value='0x" DATA.LONG(A:0xbe3470) "' name='RPMH_BCM_CD_CFG_CD9_AU_INPUT12'/>"
WRITE #1 "        <register address='0xbbe3474' value='0x" DATA.LONG(A:0xbe3474) "' name='RPMH_BCM_CD_CFG_CD9_AU_INPUT13'/>"
WRITE #1 "        <register address='0xbbe3478' value='0x" DATA.LONG(A:0xbe3478) "' name='RPMH_BCM_CD_CFG_CD9_AU_INPUT14'/>"
WRITE #1 "        <register address='0xbbe347c' value='0x" DATA.LONG(A:0xbe347c) "' name='RPMH_BCM_CD_CFG_CD9_AU_INPUT15'/>"
WRITE #1 "        <register address='0xbbe3480' value='0x" DATA.LONG(A:0xbe3480) "' name='RPMH_BCM_CD_CFG_CD10_AU_INPUT0'/>"
WRITE #1 "        <register address='0xbbe3484' value='0x" DATA.LONG(A:0xbe3484) "' name='RPMH_BCM_CD_CFG_CD10_AU_INPUT1'/>"
WRITE #1 "        <register address='0xbbe3488' value='0x" DATA.LONG(A:0xbe3488) "' name='RPMH_BCM_CD_CFG_CD10_AU_INPUT2'/>"
WRITE #1 "        <register address='0xbbe348c' value='0x" DATA.LONG(A:0xbe348c) "' name='RPMH_BCM_CD_CFG_CD10_AU_INPUT3'/>"
WRITE #1 "        <register address='0xbbe3490' value='0x" DATA.LONG(A:0xbe3490) "' name='RPMH_BCM_CD_CFG_CD10_AU_INPUT4'/>"
WRITE #1 "        <register address='0xbbe3494' value='0x" DATA.LONG(A:0xbe3494) "' name='RPMH_BCM_CD_CFG_CD10_AU_INPUT5'/>"
WRITE #1 "        <register address='0xbbe3498' value='0x" DATA.LONG(A:0xbe3498) "' name='RPMH_BCM_CD_CFG_CD10_AU_INPUT6'/>"
WRITE #1 "        <register address='0xbbe349c' value='0x" DATA.LONG(A:0xbe349c) "' name='RPMH_BCM_CD_CFG_CD10_AU_INPUT7'/>"
WRITE #1 "        <register address='0xbbe34a0' value='0x" DATA.LONG(A:0xbe34a0) "' name='RPMH_BCM_CD_CFG_CD10_AU_INPUT8'/>"
WRITE #1 "        <register address='0xbbe34a4' value='0x" DATA.LONG(A:0xbe34a4) "' name='RPMH_BCM_CD_CFG_CD10_AU_INPUT9'/>"
WRITE #1 "        <register address='0xbbe34a8' value='0x" DATA.LONG(A:0xbe34a8) "' name='RPMH_BCM_CD_CFG_CD10_AU_INPUT10'/>"
WRITE #1 "        <register address='0xbbe34ac' value='0x" DATA.LONG(A:0xbe34ac) "' name='RPMH_BCM_CD_CFG_CD10_AU_INPUT11'/>"
WRITE #1 "        <register address='0xbbe34b0' value='0x" DATA.LONG(A:0xbe34b0) "' name='RPMH_BCM_CD_CFG_CD10_AU_INPUT12'/>"
WRITE #1 "        <register address='0xbbe34b4' value='0x" DATA.LONG(A:0xbe34b4) "' name='RPMH_BCM_CD_CFG_CD10_AU_INPUT13'/>"
WRITE #1 "        <register address='0xbbe34b8' value='0x" DATA.LONG(A:0xbe34b8) "' name='RPMH_BCM_CD_CFG_CD10_AU_INPUT14'/>"
WRITE #1 "        <register address='0xbbe34bc' value='0x" DATA.LONG(A:0xbe34bc) "' name='RPMH_BCM_CD_CFG_CD10_AU_INPUT15'/>"
WRITE #1 "        <register address='0xbbe34c0' value='0x" DATA.LONG(A:0xbe34c0) "' name='RPMH_BCM_CD_CFG_CD11_AU_INPUT0'/>"
WRITE #1 "        <register address='0xbbe34c4' value='0x" DATA.LONG(A:0xbe34c4) "' name='RPMH_BCM_CD_CFG_CD11_AU_INPUT1'/>"
WRITE #1 "        <register address='0xbbe34c8' value='0x" DATA.LONG(A:0xbe34c8) "' name='RPMH_BCM_CD_CFG_CD11_AU_INPUT2'/>"
WRITE #1 "        <register address='0xbbe34cc' value='0x" DATA.LONG(A:0xbe34cc) "' name='RPMH_BCM_CD_CFG_CD11_AU_INPUT3'/>"
WRITE #1 "        <register address='0xbbe34d0' value='0x" DATA.LONG(A:0xbe34d0) "' name='RPMH_BCM_CD_CFG_CD11_AU_INPUT4'/>"
WRITE #1 "        <register address='0xbbe34d4' value='0x" DATA.LONG(A:0xbe34d4) "' name='RPMH_BCM_CD_CFG_CD11_AU_INPUT5'/>"
WRITE #1 "        <register address='0xbbe34d8' value='0x" DATA.LONG(A:0xbe34d8) "' name='RPMH_BCM_CD_CFG_CD11_AU_INPUT6'/>"
WRITE #1 "        <register address='0xbbe34dc' value='0x" DATA.LONG(A:0xbe34dc) "' name='RPMH_BCM_CD_CFG_CD11_AU_INPUT7'/>"
WRITE #1 "        <register address='0xbbe34e0' value='0x" DATA.LONG(A:0xbe34e0) "' name='RPMH_BCM_CD_CFG_CD11_AU_INPUT8'/>"
WRITE #1 "        <register address='0xbbe34e4' value='0x" DATA.LONG(A:0xbe34e4) "' name='RPMH_BCM_CD_CFG_CD11_AU_INPUT9'/>"
WRITE #1 "        <register address='0xbbe34e8' value='0x" DATA.LONG(A:0xbe34e8) "' name='RPMH_BCM_CD_CFG_CD11_AU_INPUT10'/>"
WRITE #1 "        <register address='0xbbe34ec' value='0x" DATA.LONG(A:0xbe34ec) "' name='RPMH_BCM_CD_CFG_CD11_AU_INPUT11'/>"
WRITE #1 "        <register address='0xbbe34f0' value='0x" DATA.LONG(A:0xbe34f0) "' name='RPMH_BCM_CD_CFG_CD11_AU_INPUT12'/>"
WRITE #1 "        <register address='0xbbe34f4' value='0x" DATA.LONG(A:0xbe34f4) "' name='RPMH_BCM_CD_CFG_CD11_AU_INPUT13'/>"
WRITE #1 "        <register address='0xbbe34f8' value='0x" DATA.LONG(A:0xbe34f8) "' name='RPMH_BCM_CD_CFG_CD11_AU_INPUT14'/>"
WRITE #1 "        <register address='0xbbe34fc' value='0x" DATA.LONG(A:0xbe34fc) "' name='RPMH_BCM_CD_CFG_CD11_AU_INPUT15'/>"
WRITE #1 "        <register address='0xbbe3800' value='0x" DATA.LONG(A:0xbe3800) "' name='RPMH_BCM_CD_TH_CD0_CP0'/>"
WRITE #1 "        <register address='0xbbe3804' value='0x" DATA.LONG(A:0xbe3804) "' name='RPMH_BCM_CD_TH_CD0_CP1'/>"
WRITE #1 "        <register address='0xbbe3808' value='0x" DATA.LONG(A:0xbe3808) "' name='RPMH_BCM_CD_TH_CD0_CP2'/>"
WRITE #1 "        <register address='0xbbe380c' value='0x" DATA.LONG(A:0xbe380c) "' name='RPMH_BCM_CD_TH_CD0_CP3'/>"
WRITE #1 "        <register address='0xbbe3810' value='0x" DATA.LONG(A:0xbe3810) "' name='RPMH_BCM_CD_TH_CD0_CP4'/>"
WRITE #1 "        <register address='0xbbe3814' value='0x" DATA.LONG(A:0xbe3814) "' name='RPMH_BCM_CD_TH_CD0_CP5'/>"
WRITE #1 "        <register address='0xbbe3818' value='0x" DATA.LONG(A:0xbe3818) "' name='RPMH_BCM_CD_TH_CD0_CP6'/>"
WRITE #1 "        <register address='0xbbe381c' value='0x" DATA.LONG(A:0xbe381c) "' name='RPMH_BCM_CD_TH_CD0_CP7'/>"
WRITE #1 "        <register address='0xbbe3820' value='0x" DATA.LONG(A:0xbe3820) "' name='RPMH_BCM_CD_TH_CD0_CP8'/>"
WRITE #1 "        <register address='0xbbe3824' value='0x" DATA.LONG(A:0xbe3824) "' name='RPMH_BCM_CD_TH_CD0_CP9'/>"
WRITE #1 "        <register address='0xbbe3828' value='0x" DATA.LONG(A:0xbe3828) "' name='RPMH_BCM_CD_TH_CD0_CP10'/>"
WRITE #1 "        <register address='0xbbe382c' value='0x" DATA.LONG(A:0xbe382c) "' name='RPMH_BCM_CD_TH_CD0_CP11'/>"
WRITE #1 "        <register address='0xbbe3830' value='0x" DATA.LONG(A:0xbe3830) "' name='RPMH_BCM_CD_TH_CD0_CP12'/>"
WRITE #1 "        <register address='0xbbe3834' value='0x" DATA.LONG(A:0xbe3834) "' name='RPMH_BCM_CD_TH_CD0_CP13'/>"
WRITE #1 "        <register address='0xbbe3838' value='0x" DATA.LONG(A:0xbe3838) "' name='RPMH_BCM_CD_TH_CD0_CP14'/>"
WRITE #1 "        <register address='0xbbe383c' value='0x" DATA.LONG(A:0xbe383c) "' name='RPMH_BCM_CD_TH_CD0_CP15'/>"
WRITE #1 "        <register address='0xbbe3840' value='0x" DATA.LONG(A:0xbe3840) "' name='RPMH_BCM_CD_TH_CD1_CP0'/>"
WRITE #1 "        <register address='0xbbe3844' value='0x" DATA.LONG(A:0xbe3844) "' name='RPMH_BCM_CD_TH_CD1_CP1'/>"
WRITE #1 "        <register address='0xbbe3848' value='0x" DATA.LONG(A:0xbe3848) "' name='RPMH_BCM_CD_TH_CD1_CP2'/>"
WRITE #1 "        <register address='0xbbe384c' value='0x" DATA.LONG(A:0xbe384c) "' name='RPMH_BCM_CD_TH_CD1_CP3'/>"
WRITE #1 "        <register address='0xbbe3850' value='0x" DATA.LONG(A:0xbe3850) "' name='RPMH_BCM_CD_TH_CD1_CP4'/>"
WRITE #1 "        <register address='0xbbe3854' value='0x" DATA.LONG(A:0xbe3854) "' name='RPMH_BCM_CD_TH_CD1_CP5'/>"
WRITE #1 "        <register address='0xbbe3858' value='0x" DATA.LONG(A:0xbe3858) "' name='RPMH_BCM_CD_TH_CD1_CP6'/>"
WRITE #1 "        <register address='0xbbe385c' value='0x" DATA.LONG(A:0xbe385c) "' name='RPMH_BCM_CD_TH_CD1_CP7'/>"
WRITE #1 "        <register address='0xbbe3860' value='0x" DATA.LONG(A:0xbe3860) "' name='RPMH_BCM_CD_TH_CD1_CP8'/>"
WRITE #1 "        <register address='0xbbe3864' value='0x" DATA.LONG(A:0xbe3864) "' name='RPMH_BCM_CD_TH_CD1_CP9'/>"
WRITE #1 "        <register address='0xbbe3868' value='0x" DATA.LONG(A:0xbe3868) "' name='RPMH_BCM_CD_TH_CD1_CP10'/>"
WRITE #1 "        <register address='0xbbe386c' value='0x" DATA.LONG(A:0xbe386c) "' name='RPMH_BCM_CD_TH_CD1_CP11'/>"
WRITE #1 "        <register address='0xbbe3870' value='0x" DATA.LONG(A:0xbe3870) "' name='RPMH_BCM_CD_TH_CD1_CP12'/>"
WRITE #1 "        <register address='0xbbe3874' value='0x" DATA.LONG(A:0xbe3874) "' name='RPMH_BCM_CD_TH_CD1_CP13'/>"
WRITE #1 "        <register address='0xbbe3878' value='0x" DATA.LONG(A:0xbe3878) "' name='RPMH_BCM_CD_TH_CD1_CP14'/>"
WRITE #1 "        <register address='0xbbe387c' value='0x" DATA.LONG(A:0xbe387c) "' name='RPMH_BCM_CD_TH_CD1_CP15'/>"
WRITE #1 "        <register address='0xbbe3880' value='0x" DATA.LONG(A:0xbe3880) "' name='RPMH_BCM_CD_TH_CD2_CP0'/>"
WRITE #1 "        <register address='0xbbe3884' value='0x" DATA.LONG(A:0xbe3884) "' name='RPMH_BCM_CD_TH_CD2_CP1'/>"
WRITE #1 "        <register address='0xbbe3888' value='0x" DATA.LONG(A:0xbe3888) "' name='RPMH_BCM_CD_TH_CD2_CP2'/>"
WRITE #1 "        <register address='0xbbe388c' value='0x" DATA.LONG(A:0xbe388c) "' name='RPMH_BCM_CD_TH_CD2_CP3'/>"
WRITE #1 "        <register address='0xbbe3890' value='0x" DATA.LONG(A:0xbe3890) "' name='RPMH_BCM_CD_TH_CD2_CP4'/>"
WRITE #1 "        <register address='0xbbe3894' value='0x" DATA.LONG(A:0xbe3894) "' name='RPMH_BCM_CD_TH_CD2_CP5'/>"
WRITE #1 "        <register address='0xbbe3898' value='0x" DATA.LONG(A:0xbe3898) "' name='RPMH_BCM_CD_TH_CD2_CP6'/>"
WRITE #1 "        <register address='0xbbe389c' value='0x" DATA.LONG(A:0xbe389c) "' name='RPMH_BCM_CD_TH_CD2_CP7'/>"
WRITE #1 "        <register address='0xbbe38c0' value='0x" DATA.LONG(A:0xbe38c0) "' name='RPMH_BCM_CD_TH_CD3_CP0'/>"
WRITE #1 "        <register address='0xbbe38c4' value='0x" DATA.LONG(A:0xbe38c4) "' name='RPMH_BCM_CD_TH_CD3_CP1'/>"
WRITE #1 "        <register address='0xbbe38c8' value='0x" DATA.LONG(A:0xbe38c8) "' name='RPMH_BCM_CD_TH_CD3_CP2'/>"
WRITE #1 "        <register address='0xbbe38cc' value='0x" DATA.LONG(A:0xbe38cc) "' name='RPMH_BCM_CD_TH_CD3_CP3'/>"
WRITE #1 "        <register address='0xbbe38d0' value='0x" DATA.LONG(A:0xbe38d0) "' name='RPMH_BCM_CD_TH_CD3_CP4'/>"
WRITE #1 "        <register address='0xbbe38d4' value='0x" DATA.LONG(A:0xbe38d4) "' name='RPMH_BCM_CD_TH_CD3_CP5'/>"
WRITE #1 "        <register address='0xbbe38d8' value='0x" DATA.LONG(A:0xbe38d8) "' name='RPMH_BCM_CD_TH_CD3_CP6'/>"
WRITE #1 "        <register address='0xbbe38dc' value='0x" DATA.LONG(A:0xbe38dc) "' name='RPMH_BCM_CD_TH_CD3_CP7'/>"
WRITE #1 "        <register address='0xbbe3900' value='0x" DATA.LONG(A:0xbe3900) "' name='RPMH_BCM_CD_TH_CD4_CP0'/>"
WRITE #1 "        <register address='0xbbe3904' value='0x" DATA.LONG(A:0xbe3904) "' name='RPMH_BCM_CD_TH_CD4_CP1'/>"
WRITE #1 "        <register address='0xbbe3908' value='0x" DATA.LONG(A:0xbe3908) "' name='RPMH_BCM_CD_TH_CD4_CP2'/>"
WRITE #1 "        <register address='0xbbe390c' value='0x" DATA.LONG(A:0xbe390c) "' name='RPMH_BCM_CD_TH_CD4_CP3'/>"
WRITE #1 "        <register address='0xbbe3910' value='0x" DATA.LONG(A:0xbe3910) "' name='RPMH_BCM_CD_TH_CD4_CP4'/>"
WRITE #1 "        <register address='0xbbe3914' value='0x" DATA.LONG(A:0xbe3914) "' name='RPMH_BCM_CD_TH_CD4_CP5'/>"
WRITE #1 "        <register address='0xbbe3918' value='0x" DATA.LONG(A:0xbe3918) "' name='RPMH_BCM_CD_TH_CD4_CP6'/>"
WRITE #1 "        <register address='0xbbe391c' value='0x" DATA.LONG(A:0xbe391c) "' name='RPMH_BCM_CD_TH_CD4_CP7'/>"
WRITE #1 "        <register address='0xbbe3940' value='0x" DATA.LONG(A:0xbe3940) "' name='RPMH_BCM_CD_TH_CD5_CP0'/>"
WRITE #1 "        <register address='0xbbe3944' value='0x" DATA.LONG(A:0xbe3944) "' name='RPMH_BCM_CD_TH_CD5_CP1'/>"
WRITE #1 "        <register address='0xbbe3948' value='0x" DATA.LONG(A:0xbe3948) "' name='RPMH_BCM_CD_TH_CD5_CP2'/>"
WRITE #1 "        <register address='0xbbe394c' value='0x" DATA.LONG(A:0xbe394c) "' name='RPMH_BCM_CD_TH_CD5_CP3'/>"
WRITE #1 "        <register address='0xbbe3950' value='0x" DATA.LONG(A:0xbe3950) "' name='RPMH_BCM_CD_TH_CD5_CP4'/>"
WRITE #1 "        <register address='0xbbe3954' value='0x" DATA.LONG(A:0xbe3954) "' name='RPMH_BCM_CD_TH_CD5_CP5'/>"
WRITE #1 "        <register address='0xbbe3958' value='0x" DATA.LONG(A:0xbe3958) "' name='RPMH_BCM_CD_TH_CD5_CP6'/>"
WRITE #1 "        <register address='0xbbe395c' value='0x" DATA.LONG(A:0xbe395c) "' name='RPMH_BCM_CD_TH_CD5_CP7'/>"
WRITE #1 "        <register address='0xbbe3980' value='0x" DATA.LONG(A:0xbe3980) "' name='RPMH_BCM_CD_TH_CD6_CP0'/>"
WRITE #1 "        <register address='0xbbe3984' value='0x" DATA.LONG(A:0xbe3984) "' name='RPMH_BCM_CD_TH_CD6_CP1'/>"
WRITE #1 "        <register address='0xbbe3988' value='0x" DATA.LONG(A:0xbe3988) "' name='RPMH_BCM_CD_TH_CD6_CP2'/>"
WRITE #1 "        <register address='0xbbe398c' value='0x" DATA.LONG(A:0xbe398c) "' name='RPMH_BCM_CD_TH_CD6_CP3'/>"
WRITE #1 "        <register address='0xbbe3990' value='0x" DATA.LONG(A:0xbe3990) "' name='RPMH_BCM_CD_TH_CD6_CP4'/>"
WRITE #1 "        <register address='0xbbe3994' value='0x" DATA.LONG(A:0xbe3994) "' name='RPMH_BCM_CD_TH_CD6_CP5'/>"
WRITE #1 "        <register address='0xbbe3998' value='0x" DATA.LONG(A:0xbe3998) "' name='RPMH_BCM_CD_TH_CD6_CP6'/>"
WRITE #1 "        <register address='0xbbe399c' value='0x" DATA.LONG(A:0xbe399c) "' name='RPMH_BCM_CD_TH_CD6_CP7'/>"
WRITE #1 "        <register address='0xbbe39c0' value='0x" DATA.LONG(A:0xbe39c0) "' name='RPMH_BCM_CD_TH_CD7_CP0'/>"
WRITE #1 "        <register address='0xbbe39c4' value='0x" DATA.LONG(A:0xbe39c4) "' name='RPMH_BCM_CD_TH_CD7_CP1'/>"
WRITE #1 "        <register address='0xbbe39c8' value='0x" DATA.LONG(A:0xbe39c8) "' name='RPMH_BCM_CD_TH_CD7_CP2'/>"
WRITE #1 "        <register address='0xbbe39cc' value='0x" DATA.LONG(A:0xbe39cc) "' name='RPMH_BCM_CD_TH_CD7_CP3'/>"
WRITE #1 "        <register address='0xbbe39d0' value='0x" DATA.LONG(A:0xbe39d0) "' name='RPMH_BCM_CD_TH_CD7_CP4'/>"
WRITE #1 "        <register address='0xbbe39d4' value='0x" DATA.LONG(A:0xbe39d4) "' name='RPMH_BCM_CD_TH_CD7_CP5'/>"
WRITE #1 "        <register address='0xbbe39d8' value='0x" DATA.LONG(A:0xbe39d8) "' name='RPMH_BCM_CD_TH_CD7_CP6'/>"
WRITE #1 "        <register address='0xbbe39dc' value='0x" DATA.LONG(A:0xbe39dc) "' name='RPMH_BCM_CD_TH_CD7_CP7'/>"
WRITE #1 "        <register address='0xbbe3a00' value='0x" DATA.LONG(A:0xbe3a00) "' name='RPMH_BCM_CD_TH_CD8_CP0'/>"
WRITE #1 "        <register address='0xbbe3a04' value='0x" DATA.LONG(A:0xbe3a04) "' name='RPMH_BCM_CD_TH_CD8_CP1'/>"
WRITE #1 "        <register address='0xbbe3a08' value='0x" DATA.LONG(A:0xbe3a08) "' name='RPMH_BCM_CD_TH_CD8_CP2'/>"
WRITE #1 "        <register address='0xbbe3a0c' value='0x" DATA.LONG(A:0xbe3a0c) "' name='RPMH_BCM_CD_TH_CD8_CP3'/>"
WRITE #1 "        <register address='0xbbe3a10' value='0x" DATA.LONG(A:0xbe3a10) "' name='RPMH_BCM_CD_TH_CD8_CP4'/>"
WRITE #1 "        <register address='0xbbe3a14' value='0x" DATA.LONG(A:0xbe3a14) "' name='RPMH_BCM_CD_TH_CD8_CP5'/>"
WRITE #1 "        <register address='0xbbe3a18' value='0x" DATA.LONG(A:0xbe3a18) "' name='RPMH_BCM_CD_TH_CD8_CP6'/>"
WRITE #1 "        <register address='0xbbe3a1c' value='0x" DATA.LONG(A:0xbe3a1c) "' name='RPMH_BCM_CD_TH_CD8_CP7'/>"
WRITE #1 "        <register address='0xbbe3a20' value='0x" DATA.LONG(A:0xbe3a20) "' name='RPMH_BCM_CD_TH_CD8_CP8'/>"
WRITE #1 "        <register address='0xbbe3a24' value='0x" DATA.LONG(A:0xbe3a24) "' name='RPMH_BCM_CD_TH_CD8_CP9'/>"
WRITE #1 "        <register address='0xbbe3a28' value='0x" DATA.LONG(A:0xbe3a28) "' name='RPMH_BCM_CD_TH_CD8_CP10'/>"
WRITE #1 "        <register address='0xbbe3a2c' value='0x" DATA.LONG(A:0xbe3a2c) "' name='RPMH_BCM_CD_TH_CD8_CP11'/>"
WRITE #1 "        <register address='0xbbe3a30' value='0x" DATA.LONG(A:0xbe3a30) "' name='RPMH_BCM_CD_TH_CD8_CP12'/>"
WRITE #1 "        <register address='0xbbe3a34' value='0x" DATA.LONG(A:0xbe3a34) "' name='RPMH_BCM_CD_TH_CD8_CP13'/>"
WRITE #1 "        <register address='0xbbe3a38' value='0x" DATA.LONG(A:0xbe3a38) "' name='RPMH_BCM_CD_TH_CD8_CP14'/>"
WRITE #1 "        <register address='0xbbe3a3c' value='0x" DATA.LONG(A:0xbe3a3c) "' name='RPMH_BCM_CD_TH_CD8_CP15'/>"
WRITE #1 "        <register address='0xbbe3a40' value='0x" DATA.LONG(A:0xbe3a40) "' name='RPMH_BCM_CD_TH_CD9_CP0'/>"
WRITE #1 "        <register address='0xbbe3a44' value='0x" DATA.LONG(A:0xbe3a44) "' name='RPMH_BCM_CD_TH_CD9_CP1'/>"
WRITE #1 "        <register address='0xbbe3a48' value='0x" DATA.LONG(A:0xbe3a48) "' name='RPMH_BCM_CD_TH_CD9_CP2'/>"
WRITE #1 "        <register address='0xbbe3a4c' value='0x" DATA.LONG(A:0xbe3a4c) "' name='RPMH_BCM_CD_TH_CD9_CP3'/>"
WRITE #1 "        <register address='0xbbe3a50' value='0x" DATA.LONG(A:0xbe3a50) "' name='RPMH_BCM_CD_TH_CD9_CP4'/>"
WRITE #1 "        <register address='0xbbe3a54' value='0x" DATA.LONG(A:0xbe3a54) "' name='RPMH_BCM_CD_TH_CD9_CP5'/>"
WRITE #1 "        <register address='0xbbe3a58' value='0x" DATA.LONG(A:0xbe3a58) "' name='RPMH_BCM_CD_TH_CD9_CP6'/>"
WRITE #1 "        <register address='0xbbe3a5c' value='0x" DATA.LONG(A:0xbe3a5c) "' name='RPMH_BCM_CD_TH_CD9_CP7'/>"
WRITE #1 "        <register address='0xbbe3a60' value='0x" DATA.LONG(A:0xbe3a60) "' name='RPMH_BCM_CD_TH_CD9_CP8'/>"
WRITE #1 "        <register address='0xbbe3a64' value='0x" DATA.LONG(A:0xbe3a64) "' name='RPMH_BCM_CD_TH_CD9_CP9'/>"
WRITE #1 "        <register address='0xbbe3a68' value='0x" DATA.LONG(A:0xbe3a68) "' name='RPMH_BCM_CD_TH_CD9_CP10'/>"
WRITE #1 "        <register address='0xbbe3a6c' value='0x" DATA.LONG(A:0xbe3a6c) "' name='RPMH_BCM_CD_TH_CD9_CP11'/>"
WRITE #1 "        <register address='0xbbe3a70' value='0x" DATA.LONG(A:0xbe3a70) "' name='RPMH_BCM_CD_TH_CD9_CP12'/>"
WRITE #1 "        <register address='0xbbe3a74' value='0x" DATA.LONG(A:0xbe3a74) "' name='RPMH_BCM_CD_TH_CD9_CP13'/>"
WRITE #1 "        <register address='0xbbe3a78' value='0x" DATA.LONG(A:0xbe3a78) "' name='RPMH_BCM_CD_TH_CD9_CP14'/>"
WRITE #1 "        <register address='0xbbe3a7c' value='0x" DATA.LONG(A:0xbe3a7c) "' name='RPMH_BCM_CD_TH_CD9_CP15'/>"
WRITE #1 "        <register address='0xbbe3a80' value='0x" DATA.LONG(A:0xbe3a80) "' name='RPMH_BCM_CD_TH_CD10_CP0'/>"
WRITE #1 "        <register address='0xbbe3a84' value='0x" DATA.LONG(A:0xbe3a84) "' name='RPMH_BCM_CD_TH_CD10_CP1'/>"
WRITE #1 "        <register address='0xbbe3a88' value='0x" DATA.LONG(A:0xbe3a88) "' name='RPMH_BCM_CD_TH_CD10_CP2'/>"
WRITE #1 "        <register address='0xbbe3a8c' value='0x" DATA.LONG(A:0xbe3a8c) "' name='RPMH_BCM_CD_TH_CD10_CP3'/>"
WRITE #1 "        <register address='0xbbe3a90' value='0x" DATA.LONG(A:0xbe3a90) "' name='RPMH_BCM_CD_TH_CD10_CP4'/>"
WRITE #1 "        <register address='0xbbe3a94' value='0x" DATA.LONG(A:0xbe3a94) "' name='RPMH_BCM_CD_TH_CD10_CP5'/>"
WRITE #1 "        <register address='0xbbe3a98' value='0x" DATA.LONG(A:0xbe3a98) "' name='RPMH_BCM_CD_TH_CD10_CP6'/>"
WRITE #1 "        <register address='0xbbe3a9c' value='0x" DATA.LONG(A:0xbe3a9c) "' name='RPMH_BCM_CD_TH_CD10_CP7'/>"
WRITE #1 "        <register address='0xbbe3aa0' value='0x" DATA.LONG(A:0xbe3aa0) "' name='RPMH_BCM_CD_TH_CD10_CP8'/>"
WRITE #1 "        <register address='0xbbe3aa4' value='0x" DATA.LONG(A:0xbe3aa4) "' name='RPMH_BCM_CD_TH_CD10_CP9'/>"
WRITE #1 "        <register address='0xbbe3aa8' value='0x" DATA.LONG(A:0xbe3aa8) "' name='RPMH_BCM_CD_TH_CD10_CP10'/>"
WRITE #1 "        <register address='0xbbe3aac' value='0x" DATA.LONG(A:0xbe3aac) "' name='RPMH_BCM_CD_TH_CD10_CP11'/>"
WRITE #1 "        <register address='0xbbe3ab0' value='0x" DATA.LONG(A:0xbe3ab0) "' name='RPMH_BCM_CD_TH_CD10_CP12'/>"
WRITE #1 "        <register address='0xbbe3ab4' value='0x" DATA.LONG(A:0xbe3ab4) "' name='RPMH_BCM_CD_TH_CD10_CP13'/>"
WRITE #1 "        <register address='0xbbe3ab8' value='0x" DATA.LONG(A:0xbe3ab8) "' name='RPMH_BCM_CD_TH_CD10_CP14'/>"
WRITE #1 "        <register address='0xbbe3abc' value='0x" DATA.LONG(A:0xbe3abc) "' name='RPMH_BCM_CD_TH_CD10_CP15'/>"
WRITE #1 "        <register address='0xbbe3ac0' value='0x" DATA.LONG(A:0xbe3ac0) "' name='RPMH_BCM_CD_TH_CD11_CP0'/>"
WRITE #1 "        <register address='0xbbe3ac4' value='0x" DATA.LONG(A:0xbe3ac4) "' name='RPMH_BCM_CD_TH_CD11_CP1'/>"
WRITE #1 "        <register address='0xbbe3ac8' value='0x" DATA.LONG(A:0xbe3ac8) "' name='RPMH_BCM_CD_TH_CD11_CP2'/>"
WRITE #1 "        <register address='0xbbe3acc' value='0x" DATA.LONG(A:0xbe3acc) "' name='RPMH_BCM_CD_TH_CD11_CP3'/>"
WRITE #1 "        <register address='0xbbe3ad0' value='0x" DATA.LONG(A:0xbe3ad0) "' name='RPMH_BCM_CD_TH_CD11_CP4'/>"
WRITE #1 "        <register address='0xbbe3ad4' value='0x" DATA.LONG(A:0xbe3ad4) "' name='RPMH_BCM_CD_TH_CD11_CP5'/>"
WRITE #1 "        <register address='0xbbe3ad8' value='0x" DATA.LONG(A:0xbe3ad8) "' name='RPMH_BCM_CD_TH_CD11_CP6'/>"
WRITE #1 "        <register address='0xbbe3adc' value='0x" DATA.LONG(A:0xbe3adc) "' name='RPMH_BCM_CD_TH_CD11_CP7'/>"
WRITE #1 "        <register address='0xbbe4080' value='0x" DATA.LONG(A:0xbe4080) "' name='RPMH_BCM_SEQ_CFG_HW_START_ADDR_CD0'/>"
WRITE #1 "        <register address='0xbbe4084' value='0x" DATA.LONG(A:0xbe4084) "' name='RPMH_BCM_SEQ_CFG_HW_START_ADDR_CD1'/>"
WRITE #1 "        <register address='0xbbe4088' value='0x" DATA.LONG(A:0xbe4088) "' name='RPMH_BCM_SEQ_CFG_HW_START_ADDR_CD2'/>"
WRITE #1 "        <register address='0xbbe408c' value='0x" DATA.LONG(A:0xbe408c) "' name='RPMH_BCM_SEQ_CFG_HW_START_ADDR_CD3'/>"
WRITE #1 "        <register address='0xbbe4090' value='0x" DATA.LONG(A:0xbe4090) "' name='RPMH_BCM_SEQ_CFG_HW_START_ADDR_CD4'/>"
WRITE #1 "        <register address='0xbbe4094' value='0x" DATA.LONG(A:0xbe4094) "' name='RPMH_BCM_SEQ_CFG_HW_START_ADDR_CD5'/>"
WRITE #1 "        <register address='0xbbe4098' value='0x" DATA.LONG(A:0xbe4098) "' name='RPMH_BCM_SEQ_CFG_HW_START_ADDR_CD6'/>"
WRITE #1 "        <register address='0xbbe409c' value='0x" DATA.LONG(A:0xbe409c) "' name='RPMH_BCM_SEQ_CFG_HW_START_ADDR_CD7'/>"
WRITE #1 "        <register address='0xbbe40a0' value='0x" DATA.LONG(A:0xbe40a0) "' name='RPMH_BCM_SEQ_CFG_HW_START_ADDR_CD8'/>"
WRITE #1 "        <register address='0xbbe40a4' value='0x" DATA.LONG(A:0xbe40a4) "' name='RPMH_BCM_SEQ_CFG_HW_START_ADDR_CD9'/>"
WRITE #1 "        <register address='0xbbe40a8' value='0x" DATA.LONG(A:0xbe40a8) "' name='RPMH_BCM_SEQ_CFG_HW_START_ADDR_CD10'/>"
WRITE #1 "        <register address='0xbbe40ac' value='0x" DATA.LONG(A:0xbe40ac) "' name='RPMH_BCM_SEQ_CFG_HW_START_ADDR_CD11'/>"
WRITE #1 "        <register address='0xbbe4100' value='0x" DATA.LONG(A:0xbe4100) "' name='RPMH_BCM_SEQ_CFG_SW_START_ADDR_CD0'/>"
WRITE #1 "        <register address='0xbbe4104' value='0x" DATA.LONG(A:0xbe4104) "' name='RPMH_BCM_SEQ_CFG_SW_START_ADDR_CD1'/>"
WRITE #1 "        <register address='0xbbe4108' value='0x" DATA.LONG(A:0xbe4108) "' name='RPMH_BCM_SEQ_CFG_SW_START_ADDR_CD2'/>"
WRITE #1 "        <register address='0xbbe410c' value='0x" DATA.LONG(A:0xbe410c) "' name='RPMH_BCM_SEQ_CFG_SW_START_ADDR_CD3'/>"
WRITE #1 "        <register address='0xbbe4110' value='0x" DATA.LONG(A:0xbe4110) "' name='RPMH_BCM_SEQ_CFG_SW_START_ADDR_CD4'/>"
WRITE #1 "        <register address='0xbbe4114' value='0x" DATA.LONG(A:0xbe4114) "' name='RPMH_BCM_SEQ_CFG_SW_START_ADDR_CD5'/>"
WRITE #1 "        <register address='0xbbe4118' value='0x" DATA.LONG(A:0xbe4118) "' name='RPMH_BCM_SEQ_CFG_SW_START_ADDR_CD6'/>"
WRITE #1 "        <register address='0xbbe411c' value='0x" DATA.LONG(A:0xbe411c) "' name='RPMH_BCM_SEQ_CFG_SW_START_ADDR_CD7'/>"
WRITE #1 "        <register address='0xbbe4120' value='0x" DATA.LONG(A:0xbe4120) "' name='RPMH_BCM_SEQ_CFG_SW_START_ADDR_CD8'/>"
WRITE #1 "        <register address='0xbbe4124' value='0x" DATA.LONG(A:0xbe4124) "' name='RPMH_BCM_SEQ_CFG_SW_START_ADDR_CD9'/>"
WRITE #1 "        <register address='0xbbe4128' value='0x" DATA.LONG(A:0xbe4128) "' name='RPMH_BCM_SEQ_CFG_SW_START_ADDR_CD10'/>"
WRITE #1 "        <register address='0xbbe412c' value='0x" DATA.LONG(A:0xbe412c) "' name='RPMH_BCM_SEQ_CFG_SW_START_ADDR_CD11'/>"
WRITE #1 "        <register address='0xbbe4180' value='0x" DATA.LONG(A:0xbe4180) "' name='RPMH_BCM_SEQ_CFG_BRANCH_ADDR_CD0_BR0'/>"
WRITE #1 "        <register address='0xbbe4184' value='0x" DATA.LONG(A:0xbe4184) "' name='RPMH_BCM_SEQ_CFG_BRANCH_ADDR_CD0_BR1'/>"
WRITE #1 "        <register address='0xbbe4188' value='0x" DATA.LONG(A:0xbe4188) "' name='RPMH_BCM_SEQ_CFG_BRANCH_ADDR_CD0_BR2'/>"
WRITE #1 "        <register address='0xbbe418c' value='0x" DATA.LONG(A:0xbe418c) "' name='RPMH_BCM_SEQ_CFG_BRANCH_ADDR_CD0_BR3'/>"
WRITE #1 "        <register address='0xbbe4190' value='0x" DATA.LONG(A:0xbe4190) "' name='RPMH_BCM_SEQ_CFG_BRANCH_ADDR_CD0_BR4'/>"
WRITE #1 "        <register address='0xbbe4194' value='0x" DATA.LONG(A:0xbe4194) "' name='RPMH_BCM_SEQ_CFG_BRANCH_ADDR_CD0_BR5'/>"
WRITE #1 "        <register address='0xbbe4198' value='0x" DATA.LONG(A:0xbe4198) "' name='RPMH_BCM_SEQ_CFG_BRANCH_ADDR_CD0_BR6'/>"
WRITE #1 "        <register address='0xbbe419c' value='0x" DATA.LONG(A:0xbe419c) "' name='RPMH_BCM_SEQ_CFG_BRANCH_ADDR_CD0_BR7'/>"
WRITE #1 "        <register address='0xbbe41a0' value='0x" DATA.LONG(A:0xbe41a0) "' name='RPMH_BCM_SEQ_CFG_BRANCH_ADDR_CD0_BR8'/>"
WRITE #1 "        <register address='0xbbe41a4' value='0x" DATA.LONG(A:0xbe41a4) "' name='RPMH_BCM_SEQ_CFG_BRANCH_ADDR_CD0_BR9'/>"
WRITE #1 "        <register address='0xbbe41a8' value='0x" DATA.LONG(A:0xbe41a8) "' name='RPMH_BCM_SEQ_CFG_BRANCH_ADDR_CD0_BR10'/>"
WRITE #1 "        <register address='0xbbe41ac' value='0x" DATA.LONG(A:0xbe41ac) "' name='RPMH_BCM_SEQ_CFG_BRANCH_ADDR_CD0_BR11'/>"
WRITE #1 "        <register address='0xbbe41b0' value='0x" DATA.LONG(A:0xbe41b0) "' name='RPMH_BCM_SEQ_CFG_BRANCH_ADDR_CD0_BR12'/>"
WRITE #1 "        <register address='0xbbe41b4' value='0x" DATA.LONG(A:0xbe41b4) "' name='RPMH_BCM_SEQ_CFG_BRANCH_ADDR_CD0_BR13'/>"
WRITE #1 "        <register address='0xbbe41b8' value='0x" DATA.LONG(A:0xbe41b8) "' name='RPMH_BCM_SEQ_CFG_BRANCH_ADDR_CD0_BR14'/>"
WRITE #1 "        <register address='0xbbe41bc' value='0x" DATA.LONG(A:0xbe41bc) "' name='RPMH_BCM_SEQ_CFG_BRANCH_ADDR_CD0_BR15'/>"
WRITE #1 "        <register address='0xbbe41c0' value='0x" DATA.LONG(A:0xbe41c0) "' name='RPMH_BCM_SEQ_CFG_BRANCH_ADDR_CD0_BR16'/>"
WRITE #1 "        <register address='0xbbe41c4' value='0x" DATA.LONG(A:0xbe41c4) "' name='RPMH_BCM_SEQ_CFG_BRANCH_ADDR_CD0_BR17'/>"
WRITE #1 "        <register address='0xbbe41c8' value='0x" DATA.LONG(A:0xbe41c8) "' name='RPMH_BCM_SEQ_CFG_BRANCH_ADDR_CD0_BR18'/>"
WRITE #1 "        <register address='0xbbe41cc' value='0x" DATA.LONG(A:0xbe41cc) "' name='RPMH_BCM_SEQ_CFG_BRANCH_ADDR_CD0_BR19'/>"
WRITE #1 "        <register address='0xbbe41d0' value='0x" DATA.LONG(A:0xbe41d0) "' name='RPMH_BCM_SEQ_CFG_BRANCH_ADDR_CD0_BR20'/>"
WRITE #1 "        <register address='0xbbe41d4' value='0x" DATA.LONG(A:0xbe41d4) "' name='RPMH_BCM_SEQ_CFG_BRANCH_ADDR_CD0_BR21'/>"
WRITE #1 "        <register address='0xbbe41d8' value='0x" DATA.LONG(A:0xbe41d8) "' name='RPMH_BCM_SEQ_CFG_BRANCH_ADDR_CD0_BR22'/>"
WRITE #1 "        <register address='0xbbe41dc' value='0x" DATA.LONG(A:0xbe41dc) "' name='RPMH_BCM_SEQ_CFG_BRANCH_ADDR_CD0_BR23'/>"
WRITE #1 "        <register address='0xbbe41e0' value='0x" DATA.LONG(A:0xbe41e0) "' name='RPMH_BCM_SEQ_CFG_BRANCH_ADDR_CD0_BR24'/>"
WRITE #1 "        <register address='0xbbe41e4' value='0x" DATA.LONG(A:0xbe41e4) "' name='RPMH_BCM_SEQ_CFG_BRANCH_ADDR_CD0_BR25'/>"
WRITE #1 "        <register address='0xbbe41e8' value='0x" DATA.LONG(A:0xbe41e8) "' name='RPMH_BCM_SEQ_CFG_BRANCH_ADDR_CD0_BR26'/>"
WRITE #1 "        <register address='0xbbe41ec' value='0x" DATA.LONG(A:0xbe41ec) "' name='RPMH_BCM_SEQ_CFG_BRANCH_ADDR_CD0_BR27'/>"
WRITE #1 "        <register address='0xbbe41f0' value='0x" DATA.LONG(A:0xbe41f0) "' name='RPMH_BCM_SEQ_CFG_BRANCH_ADDR_CD0_BR28'/>"
WRITE #1 "        <register address='0xbbe41f4' value='0x" DATA.LONG(A:0xbe41f4) "' name='RPMH_BCM_SEQ_CFG_BRANCH_ADDR_CD0_BR29'/>"
WRITE #1 "        <register address='0xbbe41f8' value='0x" DATA.LONG(A:0xbe41f8) "' name='RPMH_BCM_SEQ_CFG_BRANCH_ADDR_CD0_BR30'/>"
WRITE #1 "        <register address='0xbbe41fc' value='0x" DATA.LONG(A:0xbe41fc) "' name='RPMH_BCM_SEQ_CFG_BRANCH_ADDR_CD0_BR31'/>"
WRITE #1 "        <register address='0xbbe4200' value='0x" DATA.LONG(A:0xbe4200) "' name='RPMH_BCM_SEQ_CFG_BRANCH_ADDR_CD1_BR0'/>"
WRITE #1 "        <register address='0xbbe4204' value='0x" DATA.LONG(A:0xbe4204) "' name='RPMH_BCM_SEQ_CFG_BRANCH_ADDR_CD1_BR1'/>"
WRITE #1 "        <register address='0xbbe4208' value='0x" DATA.LONG(A:0xbe4208) "' name='RPMH_BCM_SEQ_CFG_BRANCH_ADDR_CD1_BR2'/>"
WRITE #1 "        <register address='0xbbe420c' value='0x" DATA.LONG(A:0xbe420c) "' name='RPMH_BCM_SEQ_CFG_BRANCH_ADDR_CD1_BR3'/>"
WRITE #1 "        <register address='0xbbe4210' value='0x" DATA.LONG(A:0xbe4210) "' name='RPMH_BCM_SEQ_CFG_BRANCH_ADDR_CD1_BR4'/>"
WRITE #1 "        <register address='0xbbe4214' value='0x" DATA.LONG(A:0xbe4214) "' name='RPMH_BCM_SEQ_CFG_BRANCH_ADDR_CD1_BR5'/>"
WRITE #1 "        <register address='0xbbe4218' value='0x" DATA.LONG(A:0xbe4218) "' name='RPMH_BCM_SEQ_CFG_BRANCH_ADDR_CD1_BR6'/>"
WRITE #1 "        <register address='0xbbe421c' value='0x" DATA.LONG(A:0xbe421c) "' name='RPMH_BCM_SEQ_CFG_BRANCH_ADDR_CD1_BR7'/>"
WRITE #1 "        <register address='0xbbe4220' value='0x" DATA.LONG(A:0xbe4220) "' name='RPMH_BCM_SEQ_CFG_BRANCH_ADDR_CD1_BR8'/>"
WRITE #1 "        <register address='0xbbe4224' value='0x" DATA.LONG(A:0xbe4224) "' name='RPMH_BCM_SEQ_CFG_BRANCH_ADDR_CD1_BR9'/>"
WRITE #1 "        <register address='0xbbe4228' value='0x" DATA.LONG(A:0xbe4228) "' name='RPMH_BCM_SEQ_CFG_BRANCH_ADDR_CD1_BR10'/>"
WRITE #1 "        <register address='0xbbe422c' value='0x" DATA.LONG(A:0xbe422c) "' name='RPMH_BCM_SEQ_CFG_BRANCH_ADDR_CD1_BR11'/>"
WRITE #1 "        <register address='0xbbe4230' value='0x" DATA.LONG(A:0xbe4230) "' name='RPMH_BCM_SEQ_CFG_BRANCH_ADDR_CD1_BR12'/>"
WRITE #1 "        <register address='0xbbe4234' value='0x" DATA.LONG(A:0xbe4234) "' name='RPMH_BCM_SEQ_CFG_BRANCH_ADDR_CD1_BR13'/>"
WRITE #1 "        <register address='0xbbe4238' value='0x" DATA.LONG(A:0xbe4238) "' name='RPMH_BCM_SEQ_CFG_BRANCH_ADDR_CD1_BR14'/>"
WRITE #1 "        <register address='0xbbe423c' value='0x" DATA.LONG(A:0xbe423c) "' name='RPMH_BCM_SEQ_CFG_BRANCH_ADDR_CD1_BR15'/>"
WRITE #1 "        <register address='0xbbe4240' value='0x" DATA.LONG(A:0xbe4240) "' name='RPMH_BCM_SEQ_CFG_BRANCH_ADDR_CD1_BR16'/>"
WRITE #1 "        <register address='0xbbe4244' value='0x" DATA.LONG(A:0xbe4244) "' name='RPMH_BCM_SEQ_CFG_BRANCH_ADDR_CD1_BR17'/>"
WRITE #1 "        <register address='0xbbe4248' value='0x" DATA.LONG(A:0xbe4248) "' name='RPMH_BCM_SEQ_CFG_BRANCH_ADDR_CD1_BR18'/>"
WRITE #1 "        <register address='0xbbe424c' value='0x" DATA.LONG(A:0xbe424c) "' name='RPMH_BCM_SEQ_CFG_BRANCH_ADDR_CD1_BR19'/>"
WRITE #1 "        <register address='0xbbe4250' value='0x" DATA.LONG(A:0xbe4250) "' name='RPMH_BCM_SEQ_CFG_BRANCH_ADDR_CD1_BR20'/>"
WRITE #1 "        <register address='0xbbe4254' value='0x" DATA.LONG(A:0xbe4254) "' name='RPMH_BCM_SEQ_CFG_BRANCH_ADDR_CD1_BR21'/>"
WRITE #1 "        <register address='0xbbe4258' value='0x" DATA.LONG(A:0xbe4258) "' name='RPMH_BCM_SEQ_CFG_BRANCH_ADDR_CD1_BR22'/>"
WRITE #1 "        <register address='0xbbe425c' value='0x" DATA.LONG(A:0xbe425c) "' name='RPMH_BCM_SEQ_CFG_BRANCH_ADDR_CD1_BR23'/>"
WRITE #1 "        <register address='0xbbe4260' value='0x" DATA.LONG(A:0xbe4260) "' name='RPMH_BCM_SEQ_CFG_BRANCH_ADDR_CD1_BR24'/>"
WRITE #1 "        <register address='0xbbe4264' value='0x" DATA.LONG(A:0xbe4264) "' name='RPMH_BCM_SEQ_CFG_BRANCH_ADDR_CD1_BR25'/>"
WRITE #1 "        <register address='0xbbe4268' value='0x" DATA.LONG(A:0xbe4268) "' name='RPMH_BCM_SEQ_CFG_BRANCH_ADDR_CD1_BR26'/>"
WRITE #1 "        <register address='0xbbe426c' value='0x" DATA.LONG(A:0xbe426c) "' name='RPMH_BCM_SEQ_CFG_BRANCH_ADDR_CD1_BR27'/>"
WRITE #1 "        <register address='0xbbe4270' value='0x" DATA.LONG(A:0xbe4270) "' name='RPMH_BCM_SEQ_CFG_BRANCH_ADDR_CD1_BR28'/>"
WRITE #1 "        <register address='0xbbe4274' value='0x" DATA.LONG(A:0xbe4274) "' name='RPMH_BCM_SEQ_CFG_BRANCH_ADDR_CD1_BR29'/>"
WRITE #1 "        <register address='0xbbe4278' value='0x" DATA.LONG(A:0xbe4278) "' name='RPMH_BCM_SEQ_CFG_BRANCH_ADDR_CD1_BR30'/>"
WRITE #1 "        <register address='0xbbe427c' value='0x" DATA.LONG(A:0xbe427c) "' name='RPMH_BCM_SEQ_CFG_BRANCH_ADDR_CD1_BR31'/>"
WRITE #1 "        <register address='0xbbe4280' value='0x" DATA.LONG(A:0xbe4280) "' name='RPMH_BCM_SEQ_CFG_BRANCH_ADDR_CD2_BR0'/>"
WRITE #1 "        <register address='0xbbe4284' value='0x" DATA.LONG(A:0xbe4284) "' name='RPMH_BCM_SEQ_CFG_BRANCH_ADDR_CD2_BR1'/>"
WRITE #1 "        <register address='0xbbe4288' value='0x" DATA.LONG(A:0xbe4288) "' name='RPMH_BCM_SEQ_CFG_BRANCH_ADDR_CD2_BR2'/>"
WRITE #1 "        <register address='0xbbe428c' value='0x" DATA.LONG(A:0xbe428c) "' name='RPMH_BCM_SEQ_CFG_BRANCH_ADDR_CD2_BR3'/>"
WRITE #1 "        <register address='0xbbe4290' value='0x" DATA.LONG(A:0xbe4290) "' name='RPMH_BCM_SEQ_CFG_BRANCH_ADDR_CD2_BR4'/>"
WRITE #1 "        <register address='0xbbe4294' value='0x" DATA.LONG(A:0xbe4294) "' name='RPMH_BCM_SEQ_CFG_BRANCH_ADDR_CD2_BR5'/>"
WRITE #1 "        <register address='0xbbe4298' value='0x" DATA.LONG(A:0xbe4298) "' name='RPMH_BCM_SEQ_CFG_BRANCH_ADDR_CD2_BR6'/>"
WRITE #1 "        <register address='0xbbe429c' value='0x" DATA.LONG(A:0xbe429c) "' name='RPMH_BCM_SEQ_CFG_BRANCH_ADDR_CD2_BR7'/>"
WRITE #1 "        <register address='0xbbe42a0' value='0x" DATA.LONG(A:0xbe42a0) "' name='RPMH_BCM_SEQ_CFG_BRANCH_ADDR_CD2_BR8'/>"
WRITE #1 "        <register address='0xbbe42a4' value='0x" DATA.LONG(A:0xbe42a4) "' name='RPMH_BCM_SEQ_CFG_BRANCH_ADDR_CD2_BR9'/>"
WRITE #1 "        <register address='0xbbe42a8' value='0x" DATA.LONG(A:0xbe42a8) "' name='RPMH_BCM_SEQ_CFG_BRANCH_ADDR_CD2_BR10'/>"
WRITE #1 "        <register address='0xbbe42ac' value='0x" DATA.LONG(A:0xbe42ac) "' name='RPMH_BCM_SEQ_CFG_BRANCH_ADDR_CD2_BR11'/>"
WRITE #1 "        <register address='0xbbe42b0' value='0x" DATA.LONG(A:0xbe42b0) "' name='RPMH_BCM_SEQ_CFG_BRANCH_ADDR_CD2_BR12'/>"
WRITE #1 "        <register address='0xbbe42b4' value='0x" DATA.LONG(A:0xbe42b4) "' name='RPMH_BCM_SEQ_CFG_BRANCH_ADDR_CD2_BR13'/>"
WRITE #1 "        <register address='0xbbe42b8' value='0x" DATA.LONG(A:0xbe42b8) "' name='RPMH_BCM_SEQ_CFG_BRANCH_ADDR_CD2_BR14'/>"
WRITE #1 "        <register address='0xbbe42bc' value='0x" DATA.LONG(A:0xbe42bc) "' name='RPMH_BCM_SEQ_CFG_BRANCH_ADDR_CD2_BR15'/>"
WRITE #1 "        <register address='0xbbe42c0' value='0x" DATA.LONG(A:0xbe42c0) "' name='RPMH_BCM_SEQ_CFG_BRANCH_ADDR_CD2_BR16'/>"
WRITE #1 "        <register address='0xbbe42c4' value='0x" DATA.LONG(A:0xbe42c4) "' name='RPMH_BCM_SEQ_CFG_BRANCH_ADDR_CD2_BR17'/>"
WRITE #1 "        <register address='0xbbe42c8' value='0x" DATA.LONG(A:0xbe42c8) "' name='RPMH_BCM_SEQ_CFG_BRANCH_ADDR_CD2_BR18'/>"
WRITE #1 "        <register address='0xbbe42cc' value='0x" DATA.LONG(A:0xbe42cc) "' name='RPMH_BCM_SEQ_CFG_BRANCH_ADDR_CD2_BR19'/>"
WRITE #1 "        <register address='0xbbe42d0' value='0x" DATA.LONG(A:0xbe42d0) "' name='RPMH_BCM_SEQ_CFG_BRANCH_ADDR_CD2_BR20'/>"
WRITE #1 "        <register address='0xbbe42d4' value='0x" DATA.LONG(A:0xbe42d4) "' name='RPMH_BCM_SEQ_CFG_BRANCH_ADDR_CD2_BR21'/>"
WRITE #1 "        <register address='0xbbe42d8' value='0x" DATA.LONG(A:0xbe42d8) "' name='RPMH_BCM_SEQ_CFG_BRANCH_ADDR_CD2_BR22'/>"
WRITE #1 "        <register address='0xbbe42dc' value='0x" DATA.LONG(A:0xbe42dc) "' name='RPMH_BCM_SEQ_CFG_BRANCH_ADDR_CD2_BR23'/>"
WRITE #1 "        <register address='0xbbe42e0' value='0x" DATA.LONG(A:0xbe42e0) "' name='RPMH_BCM_SEQ_CFG_BRANCH_ADDR_CD2_BR24'/>"
WRITE #1 "        <register address='0xbbe42e4' value='0x" DATA.LONG(A:0xbe42e4) "' name='RPMH_BCM_SEQ_CFG_BRANCH_ADDR_CD2_BR25'/>"
WRITE #1 "        <register address='0xbbe42e8' value='0x" DATA.LONG(A:0xbe42e8) "' name='RPMH_BCM_SEQ_CFG_BRANCH_ADDR_CD2_BR26'/>"
WRITE #1 "        <register address='0xbbe42ec' value='0x" DATA.LONG(A:0xbe42ec) "' name='RPMH_BCM_SEQ_CFG_BRANCH_ADDR_CD2_BR27'/>"
WRITE #1 "        <register address='0xbbe42f0' value='0x" DATA.LONG(A:0xbe42f0) "' name='RPMH_BCM_SEQ_CFG_BRANCH_ADDR_CD2_BR28'/>"
WRITE #1 "        <register address='0xbbe42f4' value='0x" DATA.LONG(A:0xbe42f4) "' name='RPMH_BCM_SEQ_CFG_BRANCH_ADDR_CD2_BR29'/>"
WRITE #1 "        <register address='0xbbe42f8' value='0x" DATA.LONG(A:0xbe42f8) "' name='RPMH_BCM_SEQ_CFG_BRANCH_ADDR_CD2_BR30'/>"
WRITE #1 "        <register address='0xbbe42fc' value='0x" DATA.LONG(A:0xbe42fc) "' name='RPMH_BCM_SEQ_CFG_BRANCH_ADDR_CD2_BR31'/>"
WRITE #1 "        <register address='0xbbe4300' value='0x" DATA.LONG(A:0xbe4300) "' name='RPMH_BCM_SEQ_CFG_BRANCH_ADDR_CD3_BR0'/>"
WRITE #1 "        <register address='0xbbe4304' value='0x" DATA.LONG(A:0xbe4304) "' name='RPMH_BCM_SEQ_CFG_BRANCH_ADDR_CD3_BR1'/>"
WRITE #1 "        <register address='0xbbe4308' value='0x" DATA.LONG(A:0xbe4308) "' name='RPMH_BCM_SEQ_CFG_BRANCH_ADDR_CD3_BR2'/>"
WRITE #1 "        <register address='0xbbe430c' value='0x" DATA.LONG(A:0xbe430c) "' name='RPMH_BCM_SEQ_CFG_BRANCH_ADDR_CD3_BR3'/>"
WRITE #1 "        <register address='0xbbe4310' value='0x" DATA.LONG(A:0xbe4310) "' name='RPMH_BCM_SEQ_CFG_BRANCH_ADDR_CD3_BR4'/>"
WRITE #1 "        <register address='0xbbe4314' value='0x" DATA.LONG(A:0xbe4314) "' name='RPMH_BCM_SEQ_CFG_BRANCH_ADDR_CD3_BR5'/>"
WRITE #1 "        <register address='0xbbe4318' value='0x" DATA.LONG(A:0xbe4318) "' name='RPMH_BCM_SEQ_CFG_BRANCH_ADDR_CD3_BR6'/>"
WRITE #1 "        <register address='0xbbe431c' value='0x" DATA.LONG(A:0xbe431c) "' name='RPMH_BCM_SEQ_CFG_BRANCH_ADDR_CD3_BR7'/>"
WRITE #1 "        <register address='0xbbe4320' value='0x" DATA.LONG(A:0xbe4320) "' name='RPMH_BCM_SEQ_CFG_BRANCH_ADDR_CD3_BR8'/>"
WRITE #1 "        <register address='0xbbe4324' value='0x" DATA.LONG(A:0xbe4324) "' name='RPMH_BCM_SEQ_CFG_BRANCH_ADDR_CD3_BR9'/>"
WRITE #1 "        <register address='0xbbe4328' value='0x" DATA.LONG(A:0xbe4328) "' name='RPMH_BCM_SEQ_CFG_BRANCH_ADDR_CD3_BR10'/>"
WRITE #1 "        <register address='0xbbe432c' value='0x" DATA.LONG(A:0xbe432c) "' name='RPMH_BCM_SEQ_CFG_BRANCH_ADDR_CD3_BR11'/>"
WRITE #1 "        <register address='0xbbe4330' value='0x" DATA.LONG(A:0xbe4330) "' name='RPMH_BCM_SEQ_CFG_BRANCH_ADDR_CD3_BR12'/>"
WRITE #1 "        <register address='0xbbe4334' value='0x" DATA.LONG(A:0xbe4334) "' name='RPMH_BCM_SEQ_CFG_BRANCH_ADDR_CD3_BR13'/>"
WRITE #1 "        <register address='0xbbe4338' value='0x" DATA.LONG(A:0xbe4338) "' name='RPMH_BCM_SEQ_CFG_BRANCH_ADDR_CD3_BR14'/>"
WRITE #1 "        <register address='0xbbe433c' value='0x" DATA.LONG(A:0xbe433c) "' name='RPMH_BCM_SEQ_CFG_BRANCH_ADDR_CD3_BR15'/>"
WRITE #1 "        <register address='0xbbe4340' value='0x" DATA.LONG(A:0xbe4340) "' name='RPMH_BCM_SEQ_CFG_BRANCH_ADDR_CD3_BR16'/>"
WRITE #1 "        <register address='0xbbe4344' value='0x" DATA.LONG(A:0xbe4344) "' name='RPMH_BCM_SEQ_CFG_BRANCH_ADDR_CD3_BR17'/>"
WRITE #1 "        <register address='0xbbe4348' value='0x" DATA.LONG(A:0xbe4348) "' name='RPMH_BCM_SEQ_CFG_BRANCH_ADDR_CD3_BR18'/>"
WRITE #1 "        <register address='0xbbe434c' value='0x" DATA.LONG(A:0xbe434c) "' name='RPMH_BCM_SEQ_CFG_BRANCH_ADDR_CD3_BR19'/>"
WRITE #1 "        <register address='0xbbe4350' value='0x" DATA.LONG(A:0xbe4350) "' name='RPMH_BCM_SEQ_CFG_BRANCH_ADDR_CD3_BR20'/>"
WRITE #1 "        <register address='0xbbe4354' value='0x" DATA.LONG(A:0xbe4354) "' name='RPMH_BCM_SEQ_CFG_BRANCH_ADDR_CD3_BR21'/>"
WRITE #1 "        <register address='0xbbe4358' value='0x" DATA.LONG(A:0xbe4358) "' name='RPMH_BCM_SEQ_CFG_BRANCH_ADDR_CD3_BR22'/>"
WRITE #1 "        <register address='0xbbe435c' value='0x" DATA.LONG(A:0xbe435c) "' name='RPMH_BCM_SEQ_CFG_BRANCH_ADDR_CD3_BR23'/>"
WRITE #1 "        <register address='0xbbe4360' value='0x" DATA.LONG(A:0xbe4360) "' name='RPMH_BCM_SEQ_CFG_BRANCH_ADDR_CD3_BR24'/>"
WRITE #1 "        <register address='0xbbe4364' value='0x" DATA.LONG(A:0xbe4364) "' name='RPMH_BCM_SEQ_CFG_BRANCH_ADDR_CD3_BR25'/>"
WRITE #1 "        <register address='0xbbe4368' value='0x" DATA.LONG(A:0xbe4368) "' name='RPMH_BCM_SEQ_CFG_BRANCH_ADDR_CD3_BR26'/>"
WRITE #1 "        <register address='0xbbe436c' value='0x" DATA.LONG(A:0xbe436c) "' name='RPMH_BCM_SEQ_CFG_BRANCH_ADDR_CD3_BR27'/>"
WRITE #1 "        <register address='0xbbe4370' value='0x" DATA.LONG(A:0xbe4370) "' name='RPMH_BCM_SEQ_CFG_BRANCH_ADDR_CD3_BR28'/>"
WRITE #1 "        <register address='0xbbe4374' value='0x" DATA.LONG(A:0xbe4374) "' name='RPMH_BCM_SEQ_CFG_BRANCH_ADDR_CD3_BR29'/>"
WRITE #1 "        <register address='0xbbe4378' value='0x" DATA.LONG(A:0xbe4378) "' name='RPMH_BCM_SEQ_CFG_BRANCH_ADDR_CD3_BR30'/>"
WRITE #1 "        <register address='0xbbe437c' value='0x" DATA.LONG(A:0xbe437c) "' name='RPMH_BCM_SEQ_CFG_BRANCH_ADDR_CD3_BR31'/>"
WRITE #1 "        <register address='0xbbe4380' value='0x" DATA.LONG(A:0xbe4380) "' name='RPMH_BCM_SEQ_CFG_BRANCH_ADDR_CD4_BR0'/>"
WRITE #1 "        <register address='0xbbe4384' value='0x" DATA.LONG(A:0xbe4384) "' name='RPMH_BCM_SEQ_CFG_BRANCH_ADDR_CD4_BR1'/>"
WRITE #1 "        <register address='0xbbe4388' value='0x" DATA.LONG(A:0xbe4388) "' name='RPMH_BCM_SEQ_CFG_BRANCH_ADDR_CD4_BR2'/>"
WRITE #1 "        <register address='0xbbe438c' value='0x" DATA.LONG(A:0xbe438c) "' name='RPMH_BCM_SEQ_CFG_BRANCH_ADDR_CD4_BR3'/>"
WRITE #1 "        <register address='0xbbe4390' value='0x" DATA.LONG(A:0xbe4390) "' name='RPMH_BCM_SEQ_CFG_BRANCH_ADDR_CD4_BR4'/>"
WRITE #1 "        <register address='0xbbe4394' value='0x" DATA.LONG(A:0xbe4394) "' name='RPMH_BCM_SEQ_CFG_BRANCH_ADDR_CD4_BR5'/>"
WRITE #1 "        <register address='0xbbe4398' value='0x" DATA.LONG(A:0xbe4398) "' name='RPMH_BCM_SEQ_CFG_BRANCH_ADDR_CD4_BR6'/>"
WRITE #1 "        <register address='0xbbe439c' value='0x" DATA.LONG(A:0xbe439c) "' name='RPMH_BCM_SEQ_CFG_BRANCH_ADDR_CD4_BR7'/>"
WRITE #1 "        <register address='0xbbe43a0' value='0x" DATA.LONG(A:0xbe43a0) "' name='RPMH_BCM_SEQ_CFG_BRANCH_ADDR_CD4_BR8'/>"
WRITE #1 "        <register address='0xbbe43a4' value='0x" DATA.LONG(A:0xbe43a4) "' name='RPMH_BCM_SEQ_CFG_BRANCH_ADDR_CD4_BR9'/>"
WRITE #1 "        <register address='0xbbe43a8' value='0x" DATA.LONG(A:0xbe43a8) "' name='RPMH_BCM_SEQ_CFG_BRANCH_ADDR_CD4_BR10'/>"
WRITE #1 "        <register address='0xbbe43ac' value='0x" DATA.LONG(A:0xbe43ac) "' name='RPMH_BCM_SEQ_CFG_BRANCH_ADDR_CD4_BR11'/>"
WRITE #1 "        <register address='0xbbe43b0' value='0x" DATA.LONG(A:0xbe43b0) "' name='RPMH_BCM_SEQ_CFG_BRANCH_ADDR_CD4_BR12'/>"
WRITE #1 "        <register address='0xbbe43b4' value='0x" DATA.LONG(A:0xbe43b4) "' name='RPMH_BCM_SEQ_CFG_BRANCH_ADDR_CD4_BR13'/>"
WRITE #1 "        <register address='0xbbe43b8' value='0x" DATA.LONG(A:0xbe43b8) "' name='RPMH_BCM_SEQ_CFG_BRANCH_ADDR_CD4_BR14'/>"
WRITE #1 "        <register address='0xbbe43bc' value='0x" DATA.LONG(A:0xbe43bc) "' name='RPMH_BCM_SEQ_CFG_BRANCH_ADDR_CD4_BR15'/>"
WRITE #1 "        <register address='0xbbe43c0' value='0x" DATA.LONG(A:0xbe43c0) "' name='RPMH_BCM_SEQ_CFG_BRANCH_ADDR_CD4_BR16'/>"
WRITE #1 "        <register address='0xbbe43c4' value='0x" DATA.LONG(A:0xbe43c4) "' name='RPMH_BCM_SEQ_CFG_BRANCH_ADDR_CD4_BR17'/>"
WRITE #1 "        <register address='0xbbe43c8' value='0x" DATA.LONG(A:0xbe43c8) "' name='RPMH_BCM_SEQ_CFG_BRANCH_ADDR_CD4_BR18'/>"
WRITE #1 "        <register address='0xbbe43cc' value='0x" DATA.LONG(A:0xbe43cc) "' name='RPMH_BCM_SEQ_CFG_BRANCH_ADDR_CD4_BR19'/>"
WRITE #1 "        <register address='0xbbe43d0' value='0x" DATA.LONG(A:0xbe43d0) "' name='RPMH_BCM_SEQ_CFG_BRANCH_ADDR_CD4_BR20'/>"
WRITE #1 "        <register address='0xbbe43d4' value='0x" DATA.LONG(A:0xbe43d4) "' name='RPMH_BCM_SEQ_CFG_BRANCH_ADDR_CD4_BR21'/>"
WRITE #1 "        <register address='0xbbe43d8' value='0x" DATA.LONG(A:0xbe43d8) "' name='RPMH_BCM_SEQ_CFG_BRANCH_ADDR_CD4_BR22'/>"
WRITE #1 "        <register address='0xbbe43dc' value='0x" DATA.LONG(A:0xbe43dc) "' name='RPMH_BCM_SEQ_CFG_BRANCH_ADDR_CD4_BR23'/>"
WRITE #1 "        <register address='0xbbe43e0' value='0x" DATA.LONG(A:0xbe43e0) "' name='RPMH_BCM_SEQ_CFG_BRANCH_ADDR_CD4_BR24'/>"
WRITE #1 "        <register address='0xbbe43e4' value='0x" DATA.LONG(A:0xbe43e4) "' name='RPMH_BCM_SEQ_CFG_BRANCH_ADDR_CD4_BR25'/>"
WRITE #1 "        <register address='0xbbe43e8' value='0x" DATA.LONG(A:0xbe43e8) "' name='RPMH_BCM_SEQ_CFG_BRANCH_ADDR_CD4_BR26'/>"
WRITE #1 "        <register address='0xbbe43ec' value='0x" DATA.LONG(A:0xbe43ec) "' name='RPMH_BCM_SEQ_CFG_BRANCH_ADDR_CD4_BR27'/>"
WRITE #1 "        <register address='0xbbe43f0' value='0x" DATA.LONG(A:0xbe43f0) "' name='RPMH_BCM_SEQ_CFG_BRANCH_ADDR_CD4_BR28'/>"
WRITE #1 "        <register address='0xbbe43f4' value='0x" DATA.LONG(A:0xbe43f4) "' name='RPMH_BCM_SEQ_CFG_BRANCH_ADDR_CD4_BR29'/>"
WRITE #1 "        <register address='0xbbe43f8' value='0x" DATA.LONG(A:0xbe43f8) "' name='RPMH_BCM_SEQ_CFG_BRANCH_ADDR_CD4_BR30'/>"
WRITE #1 "        <register address='0xbbe43fc' value='0x" DATA.LONG(A:0xbe43fc) "' name='RPMH_BCM_SEQ_CFG_BRANCH_ADDR_CD4_BR31'/>"
WRITE #1 "        <register address='0xbbe4400' value='0x" DATA.LONG(A:0xbe4400) "' name='RPMH_BCM_SEQ_CFG_BRANCH_ADDR_CD5_BR0'/>"
WRITE #1 "        <register address='0xbbe4404' value='0x" DATA.LONG(A:0xbe4404) "' name='RPMH_BCM_SEQ_CFG_BRANCH_ADDR_CD5_BR1'/>"
WRITE #1 "        <register address='0xbbe4408' value='0x" DATA.LONG(A:0xbe4408) "' name='RPMH_BCM_SEQ_CFG_BRANCH_ADDR_CD5_BR2'/>"
WRITE #1 "        <register address='0xbbe440c' value='0x" DATA.LONG(A:0xbe440c) "' name='RPMH_BCM_SEQ_CFG_BRANCH_ADDR_CD5_BR3'/>"
WRITE #1 "        <register address='0xbbe4410' value='0x" DATA.LONG(A:0xbe4410) "' name='RPMH_BCM_SEQ_CFG_BRANCH_ADDR_CD5_BR4'/>"
WRITE #1 "        <register address='0xbbe4414' value='0x" DATA.LONG(A:0xbe4414) "' name='RPMH_BCM_SEQ_CFG_BRANCH_ADDR_CD5_BR5'/>"
WRITE #1 "        <register address='0xbbe4418' value='0x" DATA.LONG(A:0xbe4418) "' name='RPMH_BCM_SEQ_CFG_BRANCH_ADDR_CD5_BR6'/>"
WRITE #1 "        <register address='0xbbe441c' value='0x" DATA.LONG(A:0xbe441c) "' name='RPMH_BCM_SEQ_CFG_BRANCH_ADDR_CD5_BR7'/>"
WRITE #1 "        <register address='0xbbe4420' value='0x" DATA.LONG(A:0xbe4420) "' name='RPMH_BCM_SEQ_CFG_BRANCH_ADDR_CD5_BR8'/>"
WRITE #1 "        <register address='0xbbe4424' value='0x" DATA.LONG(A:0xbe4424) "' name='RPMH_BCM_SEQ_CFG_BRANCH_ADDR_CD5_BR9'/>"
WRITE #1 "        <register address='0xbbe4428' value='0x" DATA.LONG(A:0xbe4428) "' name='RPMH_BCM_SEQ_CFG_BRANCH_ADDR_CD5_BR10'/>"
WRITE #1 "        <register address='0xbbe442c' value='0x" DATA.LONG(A:0xbe442c) "' name='RPMH_BCM_SEQ_CFG_BRANCH_ADDR_CD5_BR11'/>"
WRITE #1 "        <register address='0xbbe4430' value='0x" DATA.LONG(A:0xbe4430) "' name='RPMH_BCM_SEQ_CFG_BRANCH_ADDR_CD5_BR12'/>"
WRITE #1 "        <register address='0xbbe4434' value='0x" DATA.LONG(A:0xbe4434) "' name='RPMH_BCM_SEQ_CFG_BRANCH_ADDR_CD5_BR13'/>"
WRITE #1 "        <register address='0xbbe4438' value='0x" DATA.LONG(A:0xbe4438) "' name='RPMH_BCM_SEQ_CFG_BRANCH_ADDR_CD5_BR14'/>"
WRITE #1 "        <register address='0xbbe443c' value='0x" DATA.LONG(A:0xbe443c) "' name='RPMH_BCM_SEQ_CFG_BRANCH_ADDR_CD5_BR15'/>"
WRITE #1 "        <register address='0xbbe4440' value='0x" DATA.LONG(A:0xbe4440) "' name='RPMH_BCM_SEQ_CFG_BRANCH_ADDR_CD5_BR16'/>"
WRITE #1 "        <register address='0xbbe4444' value='0x" DATA.LONG(A:0xbe4444) "' name='RPMH_BCM_SEQ_CFG_BRANCH_ADDR_CD5_BR17'/>"
WRITE #1 "        <register address='0xbbe4448' value='0x" DATA.LONG(A:0xbe4448) "' name='RPMH_BCM_SEQ_CFG_BRANCH_ADDR_CD5_BR18'/>"
WRITE #1 "        <register address='0xbbe444c' value='0x" DATA.LONG(A:0xbe444c) "' name='RPMH_BCM_SEQ_CFG_BRANCH_ADDR_CD5_BR19'/>"
WRITE #1 "        <register address='0xbbe4450' value='0x" DATA.LONG(A:0xbe4450) "' name='RPMH_BCM_SEQ_CFG_BRANCH_ADDR_CD5_BR20'/>"
WRITE #1 "        <register address='0xbbe4454' value='0x" DATA.LONG(A:0xbe4454) "' name='RPMH_BCM_SEQ_CFG_BRANCH_ADDR_CD5_BR21'/>"
WRITE #1 "        <register address='0xbbe4458' value='0x" DATA.LONG(A:0xbe4458) "' name='RPMH_BCM_SEQ_CFG_BRANCH_ADDR_CD5_BR22'/>"
WRITE #1 "        <register address='0xbbe445c' value='0x" DATA.LONG(A:0xbe445c) "' name='RPMH_BCM_SEQ_CFG_BRANCH_ADDR_CD5_BR23'/>"
WRITE #1 "        <register address='0xbbe4460' value='0x" DATA.LONG(A:0xbe4460) "' name='RPMH_BCM_SEQ_CFG_BRANCH_ADDR_CD5_BR24'/>"
WRITE #1 "        <register address='0xbbe4464' value='0x" DATA.LONG(A:0xbe4464) "' name='RPMH_BCM_SEQ_CFG_BRANCH_ADDR_CD5_BR25'/>"
WRITE #1 "        <register address='0xbbe4468' value='0x" DATA.LONG(A:0xbe4468) "' name='RPMH_BCM_SEQ_CFG_BRANCH_ADDR_CD5_BR26'/>"
WRITE #1 "        <register address='0xbbe446c' value='0x" DATA.LONG(A:0xbe446c) "' name='RPMH_BCM_SEQ_CFG_BRANCH_ADDR_CD5_BR27'/>"
WRITE #1 "        <register address='0xbbe4470' value='0x" DATA.LONG(A:0xbe4470) "' name='RPMH_BCM_SEQ_CFG_BRANCH_ADDR_CD5_BR28'/>"
WRITE #1 "        <register address='0xbbe4474' value='0x" DATA.LONG(A:0xbe4474) "' name='RPMH_BCM_SEQ_CFG_BRANCH_ADDR_CD5_BR29'/>"
WRITE #1 "        <register address='0xbbe4478' value='0x" DATA.LONG(A:0xbe4478) "' name='RPMH_BCM_SEQ_CFG_BRANCH_ADDR_CD5_BR30'/>"
WRITE #1 "        <register address='0xbbe447c' value='0x" DATA.LONG(A:0xbe447c) "' name='RPMH_BCM_SEQ_CFG_BRANCH_ADDR_CD5_BR31'/>"
WRITE #1 "        <register address='0xbbe4480' value='0x" DATA.LONG(A:0xbe4480) "' name='RPMH_BCM_SEQ_CFG_BRANCH_ADDR_CD6_BR0'/>"
WRITE #1 "        <register address='0xbbe4484' value='0x" DATA.LONG(A:0xbe4484) "' name='RPMH_BCM_SEQ_CFG_BRANCH_ADDR_CD6_BR1'/>"
WRITE #1 "        <register address='0xbbe4488' value='0x" DATA.LONG(A:0xbe4488) "' name='RPMH_BCM_SEQ_CFG_BRANCH_ADDR_CD6_BR2'/>"
WRITE #1 "        <register address='0xbbe448c' value='0x" DATA.LONG(A:0xbe448c) "' name='RPMH_BCM_SEQ_CFG_BRANCH_ADDR_CD6_BR3'/>"
WRITE #1 "        <register address='0xbbe4490' value='0x" DATA.LONG(A:0xbe4490) "' name='RPMH_BCM_SEQ_CFG_BRANCH_ADDR_CD6_BR4'/>"
WRITE #1 "        <register address='0xbbe4494' value='0x" DATA.LONG(A:0xbe4494) "' name='RPMH_BCM_SEQ_CFG_BRANCH_ADDR_CD6_BR5'/>"
WRITE #1 "        <register address='0xbbe4498' value='0x" DATA.LONG(A:0xbe4498) "' name='RPMH_BCM_SEQ_CFG_BRANCH_ADDR_CD6_BR6'/>"
WRITE #1 "        <register address='0xbbe449c' value='0x" DATA.LONG(A:0xbe449c) "' name='RPMH_BCM_SEQ_CFG_BRANCH_ADDR_CD6_BR7'/>"
WRITE #1 "        <register address='0xbbe44a0' value='0x" DATA.LONG(A:0xbe44a0) "' name='RPMH_BCM_SEQ_CFG_BRANCH_ADDR_CD6_BR8'/>"
WRITE #1 "        <register address='0xbbe44a4' value='0x" DATA.LONG(A:0xbe44a4) "' name='RPMH_BCM_SEQ_CFG_BRANCH_ADDR_CD6_BR9'/>"
WRITE #1 "        <register address='0xbbe44a8' value='0x" DATA.LONG(A:0xbe44a8) "' name='RPMH_BCM_SEQ_CFG_BRANCH_ADDR_CD6_BR10'/>"
WRITE #1 "        <register address='0xbbe44ac' value='0x" DATA.LONG(A:0xbe44ac) "' name='RPMH_BCM_SEQ_CFG_BRANCH_ADDR_CD6_BR11'/>"
WRITE #1 "        <register address='0xbbe44b0' value='0x" DATA.LONG(A:0xbe44b0) "' name='RPMH_BCM_SEQ_CFG_BRANCH_ADDR_CD6_BR12'/>"
WRITE #1 "        <register address='0xbbe44b4' value='0x" DATA.LONG(A:0xbe44b4) "' name='RPMH_BCM_SEQ_CFG_BRANCH_ADDR_CD6_BR13'/>"
WRITE #1 "        <register address='0xbbe44b8' value='0x" DATA.LONG(A:0xbe44b8) "' name='RPMH_BCM_SEQ_CFG_BRANCH_ADDR_CD6_BR14'/>"
WRITE #1 "        <register address='0xbbe44bc' value='0x" DATA.LONG(A:0xbe44bc) "' name='RPMH_BCM_SEQ_CFG_BRANCH_ADDR_CD6_BR15'/>"
WRITE #1 "        <register address='0xbbe44c0' value='0x" DATA.LONG(A:0xbe44c0) "' name='RPMH_BCM_SEQ_CFG_BRANCH_ADDR_CD6_BR16'/>"
WRITE #1 "        <register address='0xbbe44c4' value='0x" DATA.LONG(A:0xbe44c4) "' name='RPMH_BCM_SEQ_CFG_BRANCH_ADDR_CD6_BR17'/>"
WRITE #1 "        <register address='0xbbe44c8' value='0x" DATA.LONG(A:0xbe44c8) "' name='RPMH_BCM_SEQ_CFG_BRANCH_ADDR_CD6_BR18'/>"
WRITE #1 "        <register address='0xbbe44cc' value='0x" DATA.LONG(A:0xbe44cc) "' name='RPMH_BCM_SEQ_CFG_BRANCH_ADDR_CD6_BR19'/>"
WRITE #1 "        <register address='0xbbe44d0' value='0x" DATA.LONG(A:0xbe44d0) "' name='RPMH_BCM_SEQ_CFG_BRANCH_ADDR_CD6_BR20'/>"
WRITE #1 "        <register address='0xbbe44d4' value='0x" DATA.LONG(A:0xbe44d4) "' name='RPMH_BCM_SEQ_CFG_BRANCH_ADDR_CD6_BR21'/>"
WRITE #1 "        <register address='0xbbe44d8' value='0x" DATA.LONG(A:0xbe44d8) "' name='RPMH_BCM_SEQ_CFG_BRANCH_ADDR_CD6_BR22'/>"
WRITE #1 "        <register address='0xbbe44dc' value='0x" DATA.LONG(A:0xbe44dc) "' name='RPMH_BCM_SEQ_CFG_BRANCH_ADDR_CD6_BR23'/>"
WRITE #1 "        <register address='0xbbe44e0' value='0x" DATA.LONG(A:0xbe44e0) "' name='RPMH_BCM_SEQ_CFG_BRANCH_ADDR_CD6_BR24'/>"
WRITE #1 "        <register address='0xbbe44e4' value='0x" DATA.LONG(A:0xbe44e4) "' name='RPMH_BCM_SEQ_CFG_BRANCH_ADDR_CD6_BR25'/>"
WRITE #1 "        <register address='0xbbe44e8' value='0x" DATA.LONG(A:0xbe44e8) "' name='RPMH_BCM_SEQ_CFG_BRANCH_ADDR_CD6_BR26'/>"
WRITE #1 "        <register address='0xbbe44ec' value='0x" DATA.LONG(A:0xbe44ec) "' name='RPMH_BCM_SEQ_CFG_BRANCH_ADDR_CD6_BR27'/>"
WRITE #1 "        <register address='0xbbe44f0' value='0x" DATA.LONG(A:0xbe44f0) "' name='RPMH_BCM_SEQ_CFG_BRANCH_ADDR_CD6_BR28'/>"
WRITE #1 "        <register address='0xbbe44f4' value='0x" DATA.LONG(A:0xbe44f4) "' name='RPMH_BCM_SEQ_CFG_BRANCH_ADDR_CD6_BR29'/>"
WRITE #1 "        <register address='0xbbe44f8' value='0x" DATA.LONG(A:0xbe44f8) "' name='RPMH_BCM_SEQ_CFG_BRANCH_ADDR_CD6_BR30'/>"
WRITE #1 "        <register address='0xbbe44fc' value='0x" DATA.LONG(A:0xbe44fc) "' name='RPMH_BCM_SEQ_CFG_BRANCH_ADDR_CD6_BR31'/>"
WRITE #1 "        <register address='0xbbe4500' value='0x" DATA.LONG(A:0xbe4500) "' name='RPMH_BCM_SEQ_CFG_BRANCH_ADDR_CD7_BR0'/>"
WRITE #1 "        <register address='0xbbe4504' value='0x" DATA.LONG(A:0xbe4504) "' name='RPMH_BCM_SEQ_CFG_BRANCH_ADDR_CD7_BR1'/>"
WRITE #1 "        <register address='0xbbe4508' value='0x" DATA.LONG(A:0xbe4508) "' name='RPMH_BCM_SEQ_CFG_BRANCH_ADDR_CD7_BR2'/>"
WRITE #1 "        <register address='0xbbe450c' value='0x" DATA.LONG(A:0xbe450c) "' name='RPMH_BCM_SEQ_CFG_BRANCH_ADDR_CD7_BR3'/>"
WRITE #1 "        <register address='0xbbe4510' value='0x" DATA.LONG(A:0xbe4510) "' name='RPMH_BCM_SEQ_CFG_BRANCH_ADDR_CD7_BR4'/>"
WRITE #1 "        <register address='0xbbe4514' value='0x" DATA.LONG(A:0xbe4514) "' name='RPMH_BCM_SEQ_CFG_BRANCH_ADDR_CD7_BR5'/>"
WRITE #1 "        <register address='0xbbe4518' value='0x" DATA.LONG(A:0xbe4518) "' name='RPMH_BCM_SEQ_CFG_BRANCH_ADDR_CD7_BR6'/>"
WRITE #1 "        <register address='0xbbe451c' value='0x" DATA.LONG(A:0xbe451c) "' name='RPMH_BCM_SEQ_CFG_BRANCH_ADDR_CD7_BR7'/>"
WRITE #1 "        <register address='0xbbe4520' value='0x" DATA.LONG(A:0xbe4520) "' name='RPMH_BCM_SEQ_CFG_BRANCH_ADDR_CD7_BR8'/>"
WRITE #1 "        <register address='0xbbe4524' value='0x" DATA.LONG(A:0xbe4524) "' name='RPMH_BCM_SEQ_CFG_BRANCH_ADDR_CD7_BR9'/>"
WRITE #1 "        <register address='0xbbe4528' value='0x" DATA.LONG(A:0xbe4528) "' name='RPMH_BCM_SEQ_CFG_BRANCH_ADDR_CD7_BR10'/>"
WRITE #1 "        <register address='0xbbe452c' value='0x" DATA.LONG(A:0xbe452c) "' name='RPMH_BCM_SEQ_CFG_BRANCH_ADDR_CD7_BR11'/>"
WRITE #1 "        <register address='0xbbe4530' value='0x" DATA.LONG(A:0xbe4530) "' name='RPMH_BCM_SEQ_CFG_BRANCH_ADDR_CD7_BR12'/>"
WRITE #1 "        <register address='0xbbe4534' value='0x" DATA.LONG(A:0xbe4534) "' name='RPMH_BCM_SEQ_CFG_BRANCH_ADDR_CD7_BR13'/>"
WRITE #1 "        <register address='0xbbe4538' value='0x" DATA.LONG(A:0xbe4538) "' name='RPMH_BCM_SEQ_CFG_BRANCH_ADDR_CD7_BR14'/>"
WRITE #1 "        <register address='0xbbe453c' value='0x" DATA.LONG(A:0xbe453c) "' name='RPMH_BCM_SEQ_CFG_BRANCH_ADDR_CD7_BR15'/>"
WRITE #1 "        <register address='0xbbe4540' value='0x" DATA.LONG(A:0xbe4540) "' name='RPMH_BCM_SEQ_CFG_BRANCH_ADDR_CD7_BR16'/>"
WRITE #1 "        <register address='0xbbe4544' value='0x" DATA.LONG(A:0xbe4544) "' name='RPMH_BCM_SEQ_CFG_BRANCH_ADDR_CD7_BR17'/>"
WRITE #1 "        <register address='0xbbe4548' value='0x" DATA.LONG(A:0xbe4548) "' name='RPMH_BCM_SEQ_CFG_BRANCH_ADDR_CD7_BR18'/>"
WRITE #1 "        <register address='0xbbe454c' value='0x" DATA.LONG(A:0xbe454c) "' name='RPMH_BCM_SEQ_CFG_BRANCH_ADDR_CD7_BR19'/>"
WRITE #1 "        <register address='0xbbe4550' value='0x" DATA.LONG(A:0xbe4550) "' name='RPMH_BCM_SEQ_CFG_BRANCH_ADDR_CD7_BR20'/>"
WRITE #1 "        <register address='0xbbe4554' value='0x" DATA.LONG(A:0xbe4554) "' name='RPMH_BCM_SEQ_CFG_BRANCH_ADDR_CD7_BR21'/>"
WRITE #1 "        <register address='0xbbe4558' value='0x" DATA.LONG(A:0xbe4558) "' name='RPMH_BCM_SEQ_CFG_BRANCH_ADDR_CD7_BR22'/>"
WRITE #1 "        <register address='0xbbe455c' value='0x" DATA.LONG(A:0xbe455c) "' name='RPMH_BCM_SEQ_CFG_BRANCH_ADDR_CD7_BR23'/>"
WRITE #1 "        <register address='0xbbe4560' value='0x" DATA.LONG(A:0xbe4560) "' name='RPMH_BCM_SEQ_CFG_BRANCH_ADDR_CD7_BR24'/>"
WRITE #1 "        <register address='0xbbe4564' value='0x" DATA.LONG(A:0xbe4564) "' name='RPMH_BCM_SEQ_CFG_BRANCH_ADDR_CD7_BR25'/>"
WRITE #1 "        <register address='0xbbe4568' value='0x" DATA.LONG(A:0xbe4568) "' name='RPMH_BCM_SEQ_CFG_BRANCH_ADDR_CD7_BR26'/>"
WRITE #1 "        <register address='0xbbe456c' value='0x" DATA.LONG(A:0xbe456c) "' name='RPMH_BCM_SEQ_CFG_BRANCH_ADDR_CD7_BR27'/>"
WRITE #1 "        <register address='0xbbe4570' value='0x" DATA.LONG(A:0xbe4570) "' name='RPMH_BCM_SEQ_CFG_BRANCH_ADDR_CD7_BR28'/>"
WRITE #1 "        <register address='0xbbe4574' value='0x" DATA.LONG(A:0xbe4574) "' name='RPMH_BCM_SEQ_CFG_BRANCH_ADDR_CD7_BR29'/>"
WRITE #1 "        <register address='0xbbe4578' value='0x" DATA.LONG(A:0xbe4578) "' name='RPMH_BCM_SEQ_CFG_BRANCH_ADDR_CD7_BR30'/>"
WRITE #1 "        <register address='0xbbe457c' value='0x" DATA.LONG(A:0xbe457c) "' name='RPMH_BCM_SEQ_CFG_BRANCH_ADDR_CD7_BR31'/>"
WRITE #1 "        <register address='0xbbe4580' value='0x" DATA.LONG(A:0xbe4580) "' name='RPMH_BCM_SEQ_CFG_BRANCH_ADDR_CD8_BR0'/>"
WRITE #1 "        <register address='0xbbe4584' value='0x" DATA.LONG(A:0xbe4584) "' name='RPMH_BCM_SEQ_CFG_BRANCH_ADDR_CD8_BR1'/>"
WRITE #1 "        <register address='0xbbe4588' value='0x" DATA.LONG(A:0xbe4588) "' name='RPMH_BCM_SEQ_CFG_BRANCH_ADDR_CD8_BR2'/>"
WRITE #1 "        <register address='0xbbe458c' value='0x" DATA.LONG(A:0xbe458c) "' name='RPMH_BCM_SEQ_CFG_BRANCH_ADDR_CD8_BR3'/>"
WRITE #1 "        <register address='0xbbe4590' value='0x" DATA.LONG(A:0xbe4590) "' name='RPMH_BCM_SEQ_CFG_BRANCH_ADDR_CD8_BR4'/>"
WRITE #1 "        <register address='0xbbe4594' value='0x" DATA.LONG(A:0xbe4594) "' name='RPMH_BCM_SEQ_CFG_BRANCH_ADDR_CD8_BR5'/>"
WRITE #1 "        <register address='0xbbe4598' value='0x" DATA.LONG(A:0xbe4598) "' name='RPMH_BCM_SEQ_CFG_BRANCH_ADDR_CD8_BR6'/>"
WRITE #1 "        <register address='0xbbe459c' value='0x" DATA.LONG(A:0xbe459c) "' name='RPMH_BCM_SEQ_CFG_BRANCH_ADDR_CD8_BR7'/>"
WRITE #1 "        <register address='0xbbe45a0' value='0x" DATA.LONG(A:0xbe45a0) "' name='RPMH_BCM_SEQ_CFG_BRANCH_ADDR_CD8_BR8'/>"
WRITE #1 "        <register address='0xbbe45a4' value='0x" DATA.LONG(A:0xbe45a4) "' name='RPMH_BCM_SEQ_CFG_BRANCH_ADDR_CD8_BR9'/>"
WRITE #1 "        <register address='0xbbe45a8' value='0x" DATA.LONG(A:0xbe45a8) "' name='RPMH_BCM_SEQ_CFG_BRANCH_ADDR_CD8_BR10'/>"
WRITE #1 "        <register address='0xbbe45ac' value='0x" DATA.LONG(A:0xbe45ac) "' name='RPMH_BCM_SEQ_CFG_BRANCH_ADDR_CD8_BR11'/>"
WRITE #1 "        <register address='0xbbe45b0' value='0x" DATA.LONG(A:0xbe45b0) "' name='RPMH_BCM_SEQ_CFG_BRANCH_ADDR_CD8_BR12'/>"
WRITE #1 "        <register address='0xbbe45b4' value='0x" DATA.LONG(A:0xbe45b4) "' name='RPMH_BCM_SEQ_CFG_BRANCH_ADDR_CD8_BR13'/>"
WRITE #1 "        <register address='0xbbe45b8' value='0x" DATA.LONG(A:0xbe45b8) "' name='RPMH_BCM_SEQ_CFG_BRANCH_ADDR_CD8_BR14'/>"
WRITE #1 "        <register address='0xbbe45bc' value='0x" DATA.LONG(A:0xbe45bc) "' name='RPMH_BCM_SEQ_CFG_BRANCH_ADDR_CD8_BR15'/>"
WRITE #1 "        <register address='0xbbe45c0' value='0x" DATA.LONG(A:0xbe45c0) "' name='RPMH_BCM_SEQ_CFG_BRANCH_ADDR_CD8_BR16'/>"
WRITE #1 "        <register address='0xbbe45c4' value='0x" DATA.LONG(A:0xbe45c4) "' name='RPMH_BCM_SEQ_CFG_BRANCH_ADDR_CD8_BR17'/>"
WRITE #1 "        <register address='0xbbe45c8' value='0x" DATA.LONG(A:0xbe45c8) "' name='RPMH_BCM_SEQ_CFG_BRANCH_ADDR_CD8_BR18'/>"
WRITE #1 "        <register address='0xbbe45cc' value='0x" DATA.LONG(A:0xbe45cc) "' name='RPMH_BCM_SEQ_CFG_BRANCH_ADDR_CD8_BR19'/>"
WRITE #1 "        <register address='0xbbe45d0' value='0x" DATA.LONG(A:0xbe45d0) "' name='RPMH_BCM_SEQ_CFG_BRANCH_ADDR_CD8_BR20'/>"
WRITE #1 "        <register address='0xbbe45d4' value='0x" DATA.LONG(A:0xbe45d4) "' name='RPMH_BCM_SEQ_CFG_BRANCH_ADDR_CD8_BR21'/>"
WRITE #1 "        <register address='0xbbe45d8' value='0x" DATA.LONG(A:0xbe45d8) "' name='RPMH_BCM_SEQ_CFG_BRANCH_ADDR_CD8_BR22'/>"
WRITE #1 "        <register address='0xbbe45dc' value='0x" DATA.LONG(A:0xbe45dc) "' name='RPMH_BCM_SEQ_CFG_BRANCH_ADDR_CD8_BR23'/>"
WRITE #1 "        <register address='0xbbe45e0' value='0x" DATA.LONG(A:0xbe45e0) "' name='RPMH_BCM_SEQ_CFG_BRANCH_ADDR_CD8_BR24'/>"
WRITE #1 "        <register address='0xbbe45e4' value='0x" DATA.LONG(A:0xbe45e4) "' name='RPMH_BCM_SEQ_CFG_BRANCH_ADDR_CD8_BR25'/>"
WRITE #1 "        <register address='0xbbe45e8' value='0x" DATA.LONG(A:0xbe45e8) "' name='RPMH_BCM_SEQ_CFG_BRANCH_ADDR_CD8_BR26'/>"
WRITE #1 "        <register address='0xbbe45ec' value='0x" DATA.LONG(A:0xbe45ec) "' name='RPMH_BCM_SEQ_CFG_BRANCH_ADDR_CD8_BR27'/>"
WRITE #1 "        <register address='0xbbe45f0' value='0x" DATA.LONG(A:0xbe45f0) "' name='RPMH_BCM_SEQ_CFG_BRANCH_ADDR_CD8_BR28'/>"
WRITE #1 "        <register address='0xbbe45f4' value='0x" DATA.LONG(A:0xbe45f4) "' name='RPMH_BCM_SEQ_CFG_BRANCH_ADDR_CD8_BR29'/>"
WRITE #1 "        <register address='0xbbe45f8' value='0x" DATA.LONG(A:0xbe45f8) "' name='RPMH_BCM_SEQ_CFG_BRANCH_ADDR_CD8_BR30'/>"
WRITE #1 "        <register address='0xbbe45fc' value='0x" DATA.LONG(A:0xbe45fc) "' name='RPMH_BCM_SEQ_CFG_BRANCH_ADDR_CD8_BR31'/>"
WRITE #1 "        <register address='0xbbe4600' value='0x" DATA.LONG(A:0xbe4600) "' name='RPMH_BCM_SEQ_CFG_BRANCH_ADDR_CD9_BR0'/>"
WRITE #1 "        <register address='0xbbe4604' value='0x" DATA.LONG(A:0xbe4604) "' name='RPMH_BCM_SEQ_CFG_BRANCH_ADDR_CD9_BR1'/>"
WRITE #1 "        <register address='0xbbe4608' value='0x" DATA.LONG(A:0xbe4608) "' name='RPMH_BCM_SEQ_CFG_BRANCH_ADDR_CD9_BR2'/>"
WRITE #1 "        <register address='0xbbe460c' value='0x" DATA.LONG(A:0xbe460c) "' name='RPMH_BCM_SEQ_CFG_BRANCH_ADDR_CD9_BR3'/>"
WRITE #1 "        <register address='0xbbe4610' value='0x" DATA.LONG(A:0xbe4610) "' name='RPMH_BCM_SEQ_CFG_BRANCH_ADDR_CD9_BR4'/>"
WRITE #1 "        <register address='0xbbe4614' value='0x" DATA.LONG(A:0xbe4614) "' name='RPMH_BCM_SEQ_CFG_BRANCH_ADDR_CD9_BR5'/>"
WRITE #1 "        <register address='0xbbe4618' value='0x" DATA.LONG(A:0xbe4618) "' name='RPMH_BCM_SEQ_CFG_BRANCH_ADDR_CD9_BR6'/>"
WRITE #1 "        <register address='0xbbe461c' value='0x" DATA.LONG(A:0xbe461c) "' name='RPMH_BCM_SEQ_CFG_BRANCH_ADDR_CD9_BR7'/>"
WRITE #1 "        <register address='0xbbe4620' value='0x" DATA.LONG(A:0xbe4620) "' name='RPMH_BCM_SEQ_CFG_BRANCH_ADDR_CD9_BR8'/>"
WRITE #1 "        <register address='0xbbe4624' value='0x" DATA.LONG(A:0xbe4624) "' name='RPMH_BCM_SEQ_CFG_BRANCH_ADDR_CD9_BR9'/>"
WRITE #1 "        <register address='0xbbe4628' value='0x" DATA.LONG(A:0xbe4628) "' name='RPMH_BCM_SEQ_CFG_BRANCH_ADDR_CD9_BR10'/>"
WRITE #1 "        <register address='0xbbe462c' value='0x" DATA.LONG(A:0xbe462c) "' name='RPMH_BCM_SEQ_CFG_BRANCH_ADDR_CD9_BR11'/>"
WRITE #1 "        <register address='0xbbe4630' value='0x" DATA.LONG(A:0xbe4630) "' name='RPMH_BCM_SEQ_CFG_BRANCH_ADDR_CD9_BR12'/>"
WRITE #1 "        <register address='0xbbe4634' value='0x" DATA.LONG(A:0xbe4634) "' name='RPMH_BCM_SEQ_CFG_BRANCH_ADDR_CD9_BR13'/>"
WRITE #1 "        <register address='0xbbe4638' value='0x" DATA.LONG(A:0xbe4638) "' name='RPMH_BCM_SEQ_CFG_BRANCH_ADDR_CD9_BR14'/>"
WRITE #1 "        <register address='0xbbe463c' value='0x" DATA.LONG(A:0xbe463c) "' name='RPMH_BCM_SEQ_CFG_BRANCH_ADDR_CD9_BR15'/>"
WRITE #1 "        <register address='0xbbe4640' value='0x" DATA.LONG(A:0xbe4640) "' name='RPMH_BCM_SEQ_CFG_BRANCH_ADDR_CD9_BR16'/>"
WRITE #1 "        <register address='0xbbe4644' value='0x" DATA.LONG(A:0xbe4644) "' name='RPMH_BCM_SEQ_CFG_BRANCH_ADDR_CD9_BR17'/>"
WRITE #1 "        <register address='0xbbe4648' value='0x" DATA.LONG(A:0xbe4648) "' name='RPMH_BCM_SEQ_CFG_BRANCH_ADDR_CD9_BR18'/>"
WRITE #1 "        <register address='0xbbe464c' value='0x" DATA.LONG(A:0xbe464c) "' name='RPMH_BCM_SEQ_CFG_BRANCH_ADDR_CD9_BR19'/>"
WRITE #1 "        <register address='0xbbe4650' value='0x" DATA.LONG(A:0xbe4650) "' name='RPMH_BCM_SEQ_CFG_BRANCH_ADDR_CD9_BR20'/>"
WRITE #1 "        <register address='0xbbe4654' value='0x" DATA.LONG(A:0xbe4654) "' name='RPMH_BCM_SEQ_CFG_BRANCH_ADDR_CD9_BR21'/>"
WRITE #1 "        <register address='0xbbe4658' value='0x" DATA.LONG(A:0xbe4658) "' name='RPMH_BCM_SEQ_CFG_BRANCH_ADDR_CD9_BR22'/>"
WRITE #1 "        <register address='0xbbe465c' value='0x" DATA.LONG(A:0xbe465c) "' name='RPMH_BCM_SEQ_CFG_BRANCH_ADDR_CD9_BR23'/>"
WRITE #1 "        <register address='0xbbe4660' value='0x" DATA.LONG(A:0xbe4660) "' name='RPMH_BCM_SEQ_CFG_BRANCH_ADDR_CD9_BR24'/>"
WRITE #1 "        <register address='0xbbe4664' value='0x" DATA.LONG(A:0xbe4664) "' name='RPMH_BCM_SEQ_CFG_BRANCH_ADDR_CD9_BR25'/>"
WRITE #1 "        <register address='0xbbe4668' value='0x" DATA.LONG(A:0xbe4668) "' name='RPMH_BCM_SEQ_CFG_BRANCH_ADDR_CD9_BR26'/>"
WRITE #1 "        <register address='0xbbe466c' value='0x" DATA.LONG(A:0xbe466c) "' name='RPMH_BCM_SEQ_CFG_BRANCH_ADDR_CD9_BR27'/>"
WRITE #1 "        <register address='0xbbe4670' value='0x" DATA.LONG(A:0xbe4670) "' name='RPMH_BCM_SEQ_CFG_BRANCH_ADDR_CD9_BR28'/>"
WRITE #1 "        <register address='0xbbe4674' value='0x" DATA.LONG(A:0xbe4674) "' name='RPMH_BCM_SEQ_CFG_BRANCH_ADDR_CD9_BR29'/>"
WRITE #1 "        <register address='0xbbe4678' value='0x" DATA.LONG(A:0xbe4678) "' name='RPMH_BCM_SEQ_CFG_BRANCH_ADDR_CD9_BR30'/>"
WRITE #1 "        <register address='0xbbe467c' value='0x" DATA.LONG(A:0xbe467c) "' name='RPMH_BCM_SEQ_CFG_BRANCH_ADDR_CD9_BR31'/>"
WRITE #1 "        <register address='0xbbe4680' value='0x" DATA.LONG(A:0xbe4680) "' name='RPMH_BCM_SEQ_CFG_BRANCH_ADDR_CD10_BR0'/>"
WRITE #1 "        <register address='0xbbe4684' value='0x" DATA.LONG(A:0xbe4684) "' name='RPMH_BCM_SEQ_CFG_BRANCH_ADDR_CD10_BR1'/>"
WRITE #1 "        <register address='0xbbe4688' value='0x" DATA.LONG(A:0xbe4688) "' name='RPMH_BCM_SEQ_CFG_BRANCH_ADDR_CD10_BR2'/>"
WRITE #1 "        <register address='0xbbe468c' value='0x" DATA.LONG(A:0xbe468c) "' name='RPMH_BCM_SEQ_CFG_BRANCH_ADDR_CD10_BR3'/>"
WRITE #1 "        <register address='0xbbe4690' value='0x" DATA.LONG(A:0xbe4690) "' name='RPMH_BCM_SEQ_CFG_BRANCH_ADDR_CD10_BR4'/>"
WRITE #1 "        <register address='0xbbe4694' value='0x" DATA.LONG(A:0xbe4694) "' name='RPMH_BCM_SEQ_CFG_BRANCH_ADDR_CD10_BR5'/>"
WRITE #1 "        <register address='0xbbe4698' value='0x" DATA.LONG(A:0xbe4698) "' name='RPMH_BCM_SEQ_CFG_BRANCH_ADDR_CD10_BR6'/>"
WRITE #1 "        <register address='0xbbe469c' value='0x" DATA.LONG(A:0xbe469c) "' name='RPMH_BCM_SEQ_CFG_BRANCH_ADDR_CD10_BR7'/>"
WRITE #1 "        <register address='0xbbe46a0' value='0x" DATA.LONG(A:0xbe46a0) "' name='RPMH_BCM_SEQ_CFG_BRANCH_ADDR_CD10_BR8'/>"
WRITE #1 "        <register address='0xbbe46a4' value='0x" DATA.LONG(A:0xbe46a4) "' name='RPMH_BCM_SEQ_CFG_BRANCH_ADDR_CD10_BR9'/>"
WRITE #1 "        <register address='0xbbe46a8' value='0x" DATA.LONG(A:0xbe46a8) "' name='RPMH_BCM_SEQ_CFG_BRANCH_ADDR_CD10_BR10'/>"
WRITE #1 "        <register address='0xbbe46ac' value='0x" DATA.LONG(A:0xbe46ac) "' name='RPMH_BCM_SEQ_CFG_BRANCH_ADDR_CD10_BR11'/>"
WRITE #1 "        <register address='0xbbe46b0' value='0x" DATA.LONG(A:0xbe46b0) "' name='RPMH_BCM_SEQ_CFG_BRANCH_ADDR_CD10_BR12'/>"
WRITE #1 "        <register address='0xbbe46b4' value='0x" DATA.LONG(A:0xbe46b4) "' name='RPMH_BCM_SEQ_CFG_BRANCH_ADDR_CD10_BR13'/>"
WRITE #1 "        <register address='0xbbe46b8' value='0x" DATA.LONG(A:0xbe46b8) "' name='RPMH_BCM_SEQ_CFG_BRANCH_ADDR_CD10_BR14'/>"
WRITE #1 "        <register address='0xbbe46bc' value='0x" DATA.LONG(A:0xbe46bc) "' name='RPMH_BCM_SEQ_CFG_BRANCH_ADDR_CD10_BR15'/>"
WRITE #1 "        <register address='0xbbe46c0' value='0x" DATA.LONG(A:0xbe46c0) "' name='RPMH_BCM_SEQ_CFG_BRANCH_ADDR_CD10_BR16'/>"
WRITE #1 "        <register address='0xbbe46c4' value='0x" DATA.LONG(A:0xbe46c4) "' name='RPMH_BCM_SEQ_CFG_BRANCH_ADDR_CD10_BR17'/>"
WRITE #1 "        <register address='0xbbe46c8' value='0x" DATA.LONG(A:0xbe46c8) "' name='RPMH_BCM_SEQ_CFG_BRANCH_ADDR_CD10_BR18'/>"
WRITE #1 "        <register address='0xbbe46cc' value='0x" DATA.LONG(A:0xbe46cc) "' name='RPMH_BCM_SEQ_CFG_BRANCH_ADDR_CD10_BR19'/>"
WRITE #1 "        <register address='0xbbe46d0' value='0x" DATA.LONG(A:0xbe46d0) "' name='RPMH_BCM_SEQ_CFG_BRANCH_ADDR_CD10_BR20'/>"
WRITE #1 "        <register address='0xbbe46d4' value='0x" DATA.LONG(A:0xbe46d4) "' name='RPMH_BCM_SEQ_CFG_BRANCH_ADDR_CD10_BR21'/>"
WRITE #1 "        <register address='0xbbe46d8' value='0x" DATA.LONG(A:0xbe46d8) "' name='RPMH_BCM_SEQ_CFG_BRANCH_ADDR_CD10_BR22'/>"
WRITE #1 "        <register address='0xbbe46dc' value='0x" DATA.LONG(A:0xbe46dc) "' name='RPMH_BCM_SEQ_CFG_BRANCH_ADDR_CD10_BR23'/>"
WRITE #1 "        <register address='0xbbe46e0' value='0x" DATA.LONG(A:0xbe46e0) "' name='RPMH_BCM_SEQ_CFG_BRANCH_ADDR_CD10_BR24'/>"
WRITE #1 "        <register address='0xbbe46e4' value='0x" DATA.LONG(A:0xbe46e4) "' name='RPMH_BCM_SEQ_CFG_BRANCH_ADDR_CD10_BR25'/>"
WRITE #1 "        <register address='0xbbe46e8' value='0x" DATA.LONG(A:0xbe46e8) "' name='RPMH_BCM_SEQ_CFG_BRANCH_ADDR_CD10_BR26'/>"
WRITE #1 "        <register address='0xbbe46ec' value='0x" DATA.LONG(A:0xbe46ec) "' name='RPMH_BCM_SEQ_CFG_BRANCH_ADDR_CD10_BR27'/>"
WRITE #1 "        <register address='0xbbe46f0' value='0x" DATA.LONG(A:0xbe46f0) "' name='RPMH_BCM_SEQ_CFG_BRANCH_ADDR_CD10_BR28'/>"
WRITE #1 "        <register address='0xbbe46f4' value='0x" DATA.LONG(A:0xbe46f4) "' name='RPMH_BCM_SEQ_CFG_BRANCH_ADDR_CD10_BR29'/>"
WRITE #1 "        <register address='0xbbe46f8' value='0x" DATA.LONG(A:0xbe46f8) "' name='RPMH_BCM_SEQ_CFG_BRANCH_ADDR_CD10_BR30'/>"
WRITE #1 "        <register address='0xbbe46fc' value='0x" DATA.LONG(A:0xbe46fc) "' name='RPMH_BCM_SEQ_CFG_BRANCH_ADDR_CD10_BR31'/>"
WRITE #1 "        <register address='0xbbe4700' value='0x" DATA.LONG(A:0xbe4700) "' name='RPMH_BCM_SEQ_CFG_BRANCH_ADDR_CD11_BR0'/>"
WRITE #1 "        <register address='0xbbe4704' value='0x" DATA.LONG(A:0xbe4704) "' name='RPMH_BCM_SEQ_CFG_BRANCH_ADDR_CD11_BR1'/>"
WRITE #1 "        <register address='0xbbe4708' value='0x" DATA.LONG(A:0xbe4708) "' name='RPMH_BCM_SEQ_CFG_BRANCH_ADDR_CD11_BR2'/>"
WRITE #1 "        <register address='0xbbe470c' value='0x" DATA.LONG(A:0xbe470c) "' name='RPMH_BCM_SEQ_CFG_BRANCH_ADDR_CD11_BR3'/>"
WRITE #1 "        <register address='0xbbe4710' value='0x" DATA.LONG(A:0xbe4710) "' name='RPMH_BCM_SEQ_CFG_BRANCH_ADDR_CD11_BR4'/>"
WRITE #1 "        <register address='0xbbe4714' value='0x" DATA.LONG(A:0xbe4714) "' name='RPMH_BCM_SEQ_CFG_BRANCH_ADDR_CD11_BR5'/>"
WRITE #1 "        <register address='0xbbe4718' value='0x" DATA.LONG(A:0xbe4718) "' name='RPMH_BCM_SEQ_CFG_BRANCH_ADDR_CD11_BR6'/>"
WRITE #1 "        <register address='0xbbe471c' value='0x" DATA.LONG(A:0xbe471c) "' name='RPMH_BCM_SEQ_CFG_BRANCH_ADDR_CD11_BR7'/>"
WRITE #1 "        <register address='0xbbe4720' value='0x" DATA.LONG(A:0xbe4720) "' name='RPMH_BCM_SEQ_CFG_BRANCH_ADDR_CD11_BR8'/>"
WRITE #1 "        <register address='0xbbe4724' value='0x" DATA.LONG(A:0xbe4724) "' name='RPMH_BCM_SEQ_CFG_BRANCH_ADDR_CD11_BR9'/>"
WRITE #1 "        <register address='0xbbe4728' value='0x" DATA.LONG(A:0xbe4728) "' name='RPMH_BCM_SEQ_CFG_BRANCH_ADDR_CD11_BR10'/>"
WRITE #1 "        <register address='0xbbe472c' value='0x" DATA.LONG(A:0xbe472c) "' name='RPMH_BCM_SEQ_CFG_BRANCH_ADDR_CD11_BR11'/>"
WRITE #1 "        <register address='0xbbe4730' value='0x" DATA.LONG(A:0xbe4730) "' name='RPMH_BCM_SEQ_CFG_BRANCH_ADDR_CD11_BR12'/>"
WRITE #1 "        <register address='0xbbe4734' value='0x" DATA.LONG(A:0xbe4734) "' name='RPMH_BCM_SEQ_CFG_BRANCH_ADDR_CD11_BR13'/>"
WRITE #1 "        <register address='0xbbe4738' value='0x" DATA.LONG(A:0xbe4738) "' name='RPMH_BCM_SEQ_CFG_BRANCH_ADDR_CD11_BR14'/>"
WRITE #1 "        <register address='0xbbe473c' value='0x" DATA.LONG(A:0xbe473c) "' name='RPMH_BCM_SEQ_CFG_BRANCH_ADDR_CD11_BR15'/>"
WRITE #1 "        <register address='0xbbe4740' value='0x" DATA.LONG(A:0xbe4740) "' name='RPMH_BCM_SEQ_CFG_BRANCH_ADDR_CD11_BR16'/>"
WRITE #1 "        <register address='0xbbe4744' value='0x" DATA.LONG(A:0xbe4744) "' name='RPMH_BCM_SEQ_CFG_BRANCH_ADDR_CD11_BR17'/>"
WRITE #1 "        <register address='0xbbe4748' value='0x" DATA.LONG(A:0xbe4748) "' name='RPMH_BCM_SEQ_CFG_BRANCH_ADDR_CD11_BR18'/>"
WRITE #1 "        <register address='0xbbe474c' value='0x" DATA.LONG(A:0xbe474c) "' name='RPMH_BCM_SEQ_CFG_BRANCH_ADDR_CD11_BR19'/>"
WRITE #1 "        <register address='0xbbe4750' value='0x" DATA.LONG(A:0xbe4750) "' name='RPMH_BCM_SEQ_CFG_BRANCH_ADDR_CD11_BR20'/>"
WRITE #1 "        <register address='0xbbe4754' value='0x" DATA.LONG(A:0xbe4754) "' name='RPMH_BCM_SEQ_CFG_BRANCH_ADDR_CD11_BR21'/>"
WRITE #1 "        <register address='0xbbe4758' value='0x" DATA.LONG(A:0xbe4758) "' name='RPMH_BCM_SEQ_CFG_BRANCH_ADDR_CD11_BR22'/>"
WRITE #1 "        <register address='0xbbe475c' value='0x" DATA.LONG(A:0xbe475c) "' name='RPMH_BCM_SEQ_CFG_BRANCH_ADDR_CD11_BR23'/>"
WRITE #1 "        <register address='0xbbe4760' value='0x" DATA.LONG(A:0xbe4760) "' name='RPMH_BCM_SEQ_CFG_BRANCH_ADDR_CD11_BR24'/>"
WRITE #1 "        <register address='0xbbe4764' value='0x" DATA.LONG(A:0xbe4764) "' name='RPMH_BCM_SEQ_CFG_BRANCH_ADDR_CD11_BR25'/>"
WRITE #1 "        <register address='0xbbe4768' value='0x" DATA.LONG(A:0xbe4768) "' name='RPMH_BCM_SEQ_CFG_BRANCH_ADDR_CD11_BR26'/>"
WRITE #1 "        <register address='0xbbe476c' value='0x" DATA.LONG(A:0xbe476c) "' name='RPMH_BCM_SEQ_CFG_BRANCH_ADDR_CD11_BR27'/>"
WRITE #1 "        <register address='0xbbe4770' value='0x" DATA.LONG(A:0xbe4770) "' name='RPMH_BCM_SEQ_CFG_BRANCH_ADDR_CD11_BR28'/>"
WRITE #1 "        <register address='0xbbe4774' value='0x" DATA.LONG(A:0xbe4774) "' name='RPMH_BCM_SEQ_CFG_BRANCH_ADDR_CD11_BR29'/>"
WRITE #1 "        <register address='0xbbe4778' value='0x" DATA.LONG(A:0xbe4778) "' name='RPMH_BCM_SEQ_CFG_BRANCH_ADDR_CD11_BR30'/>"
WRITE #1 "        <register address='0xbbe477c' value='0x" DATA.LONG(A:0xbe477c) "' name='RPMH_BCM_SEQ_CFG_BRANCH_ADDR_CD11_BR31'/>"
WRITE #1 "        <register address='0xbbe4980' value='0x" DATA.LONG(A:0xbe4980) "' name='RPMH_BCM_SEQ_CFG_DELAY_CD0_DLY0'/>"
WRITE #1 "        <register address='0xbbe4984' value='0x" DATA.LONG(A:0xbe4984) "' name='RPMH_BCM_SEQ_CFG_DELAY_CD0_DLY1'/>"
WRITE #1 "        <register address='0xbbe4988' value='0x" DATA.LONG(A:0xbe4988) "' name='RPMH_BCM_SEQ_CFG_DELAY_CD0_DLY2'/>"
WRITE #1 "        <register address='0xbbe498c' value='0x" DATA.LONG(A:0xbe498c) "' name='RPMH_BCM_SEQ_CFG_DELAY_CD0_DLY3'/>"
WRITE #1 "        <register address='0xbbe4990' value='0x" DATA.LONG(A:0xbe4990) "' name='RPMH_BCM_SEQ_CFG_DELAY_CD1_DLY0'/>"
WRITE #1 "        <register address='0xbbe4994' value='0x" DATA.LONG(A:0xbe4994) "' name='RPMH_BCM_SEQ_CFG_DELAY_CD1_DLY1'/>"
WRITE #1 "        <register address='0xbbe4998' value='0x" DATA.LONG(A:0xbe4998) "' name='RPMH_BCM_SEQ_CFG_DELAY_CD1_DLY2'/>"
WRITE #1 "        <register address='0xbbe499c' value='0x" DATA.LONG(A:0xbe499c) "' name='RPMH_BCM_SEQ_CFG_DELAY_CD1_DLY3'/>"
WRITE #1 "        <register address='0xbbe49a0' value='0x" DATA.LONG(A:0xbe49a0) "' name='RPMH_BCM_SEQ_CFG_DELAY_CD2_DLY0'/>"
WRITE #1 "        <register address='0xbbe49a4' value='0x" DATA.LONG(A:0xbe49a4) "' name='RPMH_BCM_SEQ_CFG_DELAY_CD2_DLY1'/>"
WRITE #1 "        <register address='0xbbe49a8' value='0x" DATA.LONG(A:0xbe49a8) "' name='RPMH_BCM_SEQ_CFG_DELAY_CD2_DLY2'/>"
WRITE #1 "        <register address='0xbbe49ac' value='0x" DATA.LONG(A:0xbe49ac) "' name='RPMH_BCM_SEQ_CFG_DELAY_CD2_DLY3'/>"
WRITE #1 "        <register address='0xbbe49b0' value='0x" DATA.LONG(A:0xbe49b0) "' name='RPMH_BCM_SEQ_CFG_DELAY_CD3_DLY0'/>"
WRITE #1 "        <register address='0xbbe49b4' value='0x" DATA.LONG(A:0xbe49b4) "' name='RPMH_BCM_SEQ_CFG_DELAY_CD3_DLY1'/>"
WRITE #1 "        <register address='0xbbe49b8' value='0x" DATA.LONG(A:0xbe49b8) "' name='RPMH_BCM_SEQ_CFG_DELAY_CD3_DLY2'/>"
WRITE #1 "        <register address='0xbbe49bc' value='0x" DATA.LONG(A:0xbe49bc) "' name='RPMH_BCM_SEQ_CFG_DELAY_CD3_DLY3'/>"
WRITE #1 "        <register address='0xbbe49c0' value='0x" DATA.LONG(A:0xbe49c0) "' name='RPMH_BCM_SEQ_CFG_DELAY_CD4_DLY0'/>"
WRITE #1 "        <register address='0xbbe49c4' value='0x" DATA.LONG(A:0xbe49c4) "' name='RPMH_BCM_SEQ_CFG_DELAY_CD4_DLY1'/>"
WRITE #1 "        <register address='0xbbe49c8' value='0x" DATA.LONG(A:0xbe49c8) "' name='RPMH_BCM_SEQ_CFG_DELAY_CD4_DLY2'/>"
WRITE #1 "        <register address='0xbbe49cc' value='0x" DATA.LONG(A:0xbe49cc) "' name='RPMH_BCM_SEQ_CFG_DELAY_CD4_DLY3'/>"
WRITE #1 "        <register address='0xbbe49d0' value='0x" DATA.LONG(A:0xbe49d0) "' name='RPMH_BCM_SEQ_CFG_DELAY_CD5_DLY0'/>"
WRITE #1 "        <register address='0xbbe49d4' value='0x" DATA.LONG(A:0xbe49d4) "' name='RPMH_BCM_SEQ_CFG_DELAY_CD5_DLY1'/>"
WRITE #1 "        <register address='0xbbe49d8' value='0x" DATA.LONG(A:0xbe49d8) "' name='RPMH_BCM_SEQ_CFG_DELAY_CD5_DLY2'/>"
WRITE #1 "        <register address='0xbbe49dc' value='0x" DATA.LONG(A:0xbe49dc) "' name='RPMH_BCM_SEQ_CFG_DELAY_CD5_DLY3'/>"
WRITE #1 "        <register address='0xbbe49e0' value='0x" DATA.LONG(A:0xbe49e0) "' name='RPMH_BCM_SEQ_CFG_DELAY_CD6_DLY0'/>"
WRITE #1 "        <register address='0xbbe49e4' value='0x" DATA.LONG(A:0xbe49e4) "' name='RPMH_BCM_SEQ_CFG_DELAY_CD6_DLY1'/>"
WRITE #1 "        <register address='0xbbe49e8' value='0x" DATA.LONG(A:0xbe49e8) "' name='RPMH_BCM_SEQ_CFG_DELAY_CD6_DLY2'/>"
WRITE #1 "        <register address='0xbbe49ec' value='0x" DATA.LONG(A:0xbe49ec) "' name='RPMH_BCM_SEQ_CFG_DELAY_CD6_DLY3'/>"
WRITE #1 "        <register address='0xbbe49f0' value='0x" DATA.LONG(A:0xbe49f0) "' name='RPMH_BCM_SEQ_CFG_DELAY_CD7_DLY0'/>"
WRITE #1 "        <register address='0xbbe49f4' value='0x" DATA.LONG(A:0xbe49f4) "' name='RPMH_BCM_SEQ_CFG_DELAY_CD7_DLY1'/>"
WRITE #1 "        <register address='0xbbe49f8' value='0x" DATA.LONG(A:0xbe49f8) "' name='RPMH_BCM_SEQ_CFG_DELAY_CD7_DLY2'/>"
WRITE #1 "        <register address='0xbbe49fc' value='0x" DATA.LONG(A:0xbe49fc) "' name='RPMH_BCM_SEQ_CFG_DELAY_CD7_DLY3'/>"
WRITE #1 "        <register address='0xbbe4a00' value='0x" DATA.LONG(A:0xbe4a00) "' name='RPMH_BCM_SEQ_CFG_DELAY_CD8_DLY0'/>"
WRITE #1 "        <register address='0xbbe4a04' value='0x" DATA.LONG(A:0xbe4a04) "' name='RPMH_BCM_SEQ_CFG_DELAY_CD8_DLY1'/>"
WRITE #1 "        <register address='0xbbe4a08' value='0x" DATA.LONG(A:0xbe4a08) "' name='RPMH_BCM_SEQ_CFG_DELAY_CD8_DLY2'/>"
WRITE #1 "        <register address='0xbbe4a0c' value='0x" DATA.LONG(A:0xbe4a0c) "' name='RPMH_BCM_SEQ_CFG_DELAY_CD8_DLY3'/>"
WRITE #1 "        <register address='0xbbe4a10' value='0x" DATA.LONG(A:0xbe4a10) "' name='RPMH_BCM_SEQ_CFG_DELAY_CD9_DLY0'/>"
WRITE #1 "        <register address='0xbbe4a14' value='0x" DATA.LONG(A:0xbe4a14) "' name='RPMH_BCM_SEQ_CFG_DELAY_CD9_DLY1'/>"
WRITE #1 "        <register address='0xbbe4a18' value='0x" DATA.LONG(A:0xbe4a18) "' name='RPMH_BCM_SEQ_CFG_DELAY_CD9_DLY2'/>"
WRITE #1 "        <register address='0xbbe4a1c' value='0x" DATA.LONG(A:0xbe4a1c) "' name='RPMH_BCM_SEQ_CFG_DELAY_CD9_DLY3'/>"
WRITE #1 "        <register address='0xbbe4a20' value='0x" DATA.LONG(A:0xbe4a20) "' name='RPMH_BCM_SEQ_CFG_DELAY_CD10_DLY0'/>"
WRITE #1 "        <register address='0xbbe4a24' value='0x" DATA.LONG(A:0xbe4a24) "' name='RPMH_BCM_SEQ_CFG_DELAY_CD10_DLY1'/>"
WRITE #1 "        <register address='0xbbe4a28' value='0x" DATA.LONG(A:0xbe4a28) "' name='RPMH_BCM_SEQ_CFG_DELAY_CD10_DLY2'/>"
WRITE #1 "        <register address='0xbbe4a2c' value='0x" DATA.LONG(A:0xbe4a2c) "' name='RPMH_BCM_SEQ_CFG_DELAY_CD10_DLY3'/>"
WRITE #1 "        <register address='0xbbe4a30' value='0x" DATA.LONG(A:0xbe4a30) "' name='RPMH_BCM_SEQ_CFG_DELAY_CD11_DLY0'/>"
WRITE #1 "        <register address='0xbbe4a34' value='0x" DATA.LONG(A:0xbe4a34) "' name='RPMH_BCM_SEQ_CFG_DELAY_CD11_DLY1'/>"
WRITE #1 "        <register address='0xbbe4a38' value='0x" DATA.LONG(A:0xbe4a38) "' name='RPMH_BCM_SEQ_CFG_DELAY_CD11_DLY2'/>"
WRITE #1 "        <register address='0xbbe4a3c' value='0x" DATA.LONG(A:0xbe4a3c) "' name='RPMH_BCM_SEQ_CFG_DELAY_CD11_DLY3'/>"
WRITE #1 "        <register address='0xbbe4b80' value='0x" DATA.LONG(A:0xbe4b80) "' name='RPMH_BCM_SEQ_CFG_BR_EVENT'/>"
WRITE #1 "        <register address='0xbbe5400' value='0x" DATA.LONG(A:0xbe5400) "' name='RPMH_BCM_TCS_CFG_CD0'/>"
WRITE #1 "        <register address='0xbbe5404' value='0x" DATA.LONG(A:0xbe5404) "' name='RPMH_BCM_TCS_CFG_CD1'/>"
WRITE #1 "        <register address='0xbbe5408' value='0x" DATA.LONG(A:0xbe5408) "' name='RPMH_BCM_TCS_CFG_CD2'/>"
WRITE #1 "        <register address='0xbbe540c' value='0x" DATA.LONG(A:0xbe540c) "' name='RPMH_BCM_TCS_CFG_CD3'/>"
WRITE #1 "        <register address='0xbbe5410' value='0x" DATA.LONG(A:0xbe5410) "' name='RPMH_BCM_TCS_CFG_CD4'/>"
WRITE #1 "        <register address='0xbbe5414' value='0x" DATA.LONG(A:0xbe5414) "' name='RPMH_BCM_TCS_CFG_CD5'/>"
WRITE #1 "        <register address='0xbbe5418' value='0x" DATA.LONG(A:0xbe5418) "' name='RPMH_BCM_TCS_CFG_CD6'/>"
WRITE #1 "        <register address='0xbbe541c' value='0x" DATA.LONG(A:0xbe541c) "' name='RPMH_BCM_TCS_CFG_CD7'/>"
WRITE #1 "        <register address='0xbbe5420' value='0x" DATA.LONG(A:0xbe5420) "' name='RPMH_BCM_TCS_CFG_CD8'/>"
WRITE #1 "        <register address='0xbbe5424' value='0x" DATA.LONG(A:0xbe5424) "' name='RPMH_BCM_TCS_CFG_CD9'/>"
WRITE #1 "        <register address='0xbbe5428' value='0x" DATA.LONG(A:0xbe5428) "' name='RPMH_BCM_TCS_CFG_CD10'/>"
WRITE #1 "        <register address='0xbbe542c' value='0x" DATA.LONG(A:0xbe542c) "' name='RPMH_BCM_TCS_CFG_CD11'/>"
WRITE #1 "        <register address='0xbbe5480' value='0x" DATA.LONG(A:0xbe5480) "' name='RPMH_BCM_TCS_CFG_VOTE_ADDR_CD0_CMD0'/>"
WRITE #1 "        <register address='0xbbe5484' value='0x" DATA.LONG(A:0xbe5484) "' name='RPMH_BCM_TCS_CFG_VOTE_ADDR_CD0_CMD1'/>"
WRITE #1 "        <register address='0xbbe5488' value='0x" DATA.LONG(A:0xbe5488) "' name='RPMH_BCM_TCS_CFG_VOTE_ADDR_CD0_CMD2'/>"
WRITE #1 "        <register address='0xbbe548c' value='0x" DATA.LONG(A:0xbe548c) "' name='RPMH_BCM_TCS_CFG_VOTE_ADDR_CD1_CMD0'/>"
WRITE #1 "        <register address='0xbbe5490' value='0x" DATA.LONG(A:0xbe5490) "' name='RPMH_BCM_TCS_CFG_VOTE_ADDR_CD1_CMD1'/>"
WRITE #1 "        <register address='0xbbe5494' value='0x" DATA.LONG(A:0xbe5494) "' name='RPMH_BCM_TCS_CFG_VOTE_ADDR_CD1_CMD2'/>"
WRITE #1 "        <register address='0xbbe5498' value='0x" DATA.LONG(A:0xbe5498) "' name='RPMH_BCM_TCS_CFG_VOTE_ADDR_CD2_CMD0'/>"
WRITE #1 "        <register address='0xbbe549c' value='0x" DATA.LONG(A:0xbe549c) "' name='RPMH_BCM_TCS_CFG_VOTE_ADDR_CD2_CMD1'/>"
WRITE #1 "        <register address='0xbbe54a0' value='0x" DATA.LONG(A:0xbe54a0) "' name='RPMH_BCM_TCS_CFG_VOTE_ADDR_CD2_CMD2'/>"
WRITE #1 "        <register address='0xbbe54a4' value='0x" DATA.LONG(A:0xbe54a4) "' name='RPMH_BCM_TCS_CFG_VOTE_ADDR_CD3_CMD0'/>"
WRITE #1 "        <register address='0xbbe54a8' value='0x" DATA.LONG(A:0xbe54a8) "' name='RPMH_BCM_TCS_CFG_VOTE_ADDR_CD3_CMD1'/>"
WRITE #1 "        <register address='0xbbe54ac' value='0x" DATA.LONG(A:0xbe54ac) "' name='RPMH_BCM_TCS_CFG_VOTE_ADDR_CD3_CMD2'/>"
WRITE #1 "        <register address='0xbbe54b0' value='0x" DATA.LONG(A:0xbe54b0) "' name='RPMH_BCM_TCS_CFG_VOTE_ADDR_CD4_CMD0'/>"
WRITE #1 "        <register address='0xbbe54b4' value='0x" DATA.LONG(A:0xbe54b4) "' name='RPMH_BCM_TCS_CFG_VOTE_ADDR_CD4_CMD1'/>"
WRITE #1 "        <register address='0xbbe54b8' value='0x" DATA.LONG(A:0xbe54b8) "' name='RPMH_BCM_TCS_CFG_VOTE_ADDR_CD4_CMD2'/>"
WRITE #1 "        <register address='0xbbe54bc' value='0x" DATA.LONG(A:0xbe54bc) "' name='RPMH_BCM_TCS_CFG_VOTE_ADDR_CD5_CMD0'/>"
WRITE #1 "        <register address='0xbbe54c0' value='0x" DATA.LONG(A:0xbe54c0) "' name='RPMH_BCM_TCS_CFG_VOTE_ADDR_CD5_CMD1'/>"
WRITE #1 "        <register address='0xbbe54c4' value='0x" DATA.LONG(A:0xbe54c4) "' name='RPMH_BCM_TCS_CFG_VOTE_ADDR_CD5_CMD2'/>"
WRITE #1 "        <register address='0xbbe54c8' value='0x" DATA.LONG(A:0xbe54c8) "' name='RPMH_BCM_TCS_CFG_VOTE_ADDR_CD6_CMD0'/>"
WRITE #1 "        <register address='0xbbe54cc' value='0x" DATA.LONG(A:0xbe54cc) "' name='RPMH_BCM_TCS_CFG_VOTE_ADDR_CD6_CMD1'/>"
WRITE #1 "        <register address='0xbbe54d0' value='0x" DATA.LONG(A:0xbe54d0) "' name='RPMH_BCM_TCS_CFG_VOTE_ADDR_CD6_CMD2'/>"
WRITE #1 "        <register address='0xbbe54d4' value='0x" DATA.LONG(A:0xbe54d4) "' name='RPMH_BCM_TCS_CFG_VOTE_ADDR_CD7_CMD0'/>"
WRITE #1 "        <register address='0xbbe54d8' value='0x" DATA.LONG(A:0xbe54d8) "' name='RPMH_BCM_TCS_CFG_VOTE_ADDR_CD7_CMD1'/>"
WRITE #1 "        <register address='0xbbe54dc' value='0x" DATA.LONG(A:0xbe54dc) "' name='RPMH_BCM_TCS_CFG_VOTE_ADDR_CD7_CMD2'/>"
WRITE #1 "        <register address='0xbbe54e0' value='0x" DATA.LONG(A:0xbe54e0) "' name='RPMH_BCM_TCS_CFG_VOTE_ADDR_CD8_CMD0'/>"
WRITE #1 "        <register address='0xbbe54e4' value='0x" DATA.LONG(A:0xbe54e4) "' name='RPMH_BCM_TCS_CFG_VOTE_ADDR_CD8_CMD1'/>"
WRITE #1 "        <register address='0xbbe54e8' value='0x" DATA.LONG(A:0xbe54e8) "' name='RPMH_BCM_TCS_CFG_VOTE_ADDR_CD8_CMD2'/>"
WRITE #1 "        <register address='0xbbe54ec' value='0x" DATA.LONG(A:0xbe54ec) "' name='RPMH_BCM_TCS_CFG_VOTE_ADDR_CD9_CMD0'/>"
WRITE #1 "        <register address='0xbbe54f0' value='0x" DATA.LONG(A:0xbe54f0) "' name='RPMH_BCM_TCS_CFG_VOTE_ADDR_CD9_CMD1'/>"
WRITE #1 "        <register address='0xbbe54f4' value='0x" DATA.LONG(A:0xbe54f4) "' name='RPMH_BCM_TCS_CFG_VOTE_ADDR_CD9_CMD2'/>"
WRITE #1 "        <register address='0xbbe54f8' value='0x" DATA.LONG(A:0xbe54f8) "' name='RPMH_BCM_TCS_CFG_VOTE_ADDR_CD10_CMD0'/>"
WRITE #1 "        <register address='0xbbe54fc' value='0x" DATA.LONG(A:0xbe54fc) "' name='RPMH_BCM_TCS_CFG_VOTE_ADDR_CD10_CMD1'/>"
WRITE #1 "        <register address='0xbbe5500' value='0x" DATA.LONG(A:0xbe5500) "' name='RPMH_BCM_TCS_CFG_VOTE_ADDR_CD10_CMD2'/>"
WRITE #1 "        <register address='0xbbe5504' value='0x" DATA.LONG(A:0xbe5504) "' name='RPMH_BCM_TCS_CFG_VOTE_ADDR_CD11_CMD0'/>"
WRITE #1 "        <register address='0xbbe5508' value='0x" DATA.LONG(A:0xbe5508) "' name='RPMH_BCM_TCS_CFG_VOTE_ADDR_CD11_CMD1'/>"
WRITE #1 "        <register address='0xbbe550c' value='0x" DATA.LONG(A:0xbe550c) "' name='RPMH_BCM_TCS_CFG_VOTE_ADDR_CD11_CMD2'/>"
WRITE #1 "        <register address='0xbbe5680' value='0x" DATA.LONG(A:0xbe5680) "' name='RPMH_BCM_TCS_CFG_VOTE_DATA_CD0_CP0'/>"
WRITE #1 "        <register address='0xbbe5684' value='0x" DATA.LONG(A:0xbe5684) "' name='RPMH_BCM_TCS_CFG_VOTE_DATA_CD0_CP1'/>"
WRITE #1 "        <register address='0xbbe5688' value='0x" DATA.LONG(A:0xbe5688) "' name='RPMH_BCM_TCS_CFG_VOTE_DATA_CD0_CP2'/>"
WRITE #1 "        <register address='0xbbe568c' value='0x" DATA.LONG(A:0xbe568c) "' name='RPMH_BCM_TCS_CFG_VOTE_DATA_CD0_CP3'/>"
WRITE #1 "        <register address='0xbbe5690' value='0x" DATA.LONG(A:0xbe5690) "' name='RPMH_BCM_TCS_CFG_VOTE_DATA_CD0_CP4'/>"
WRITE #1 "        <register address='0xbbe5694' value='0x" DATA.LONG(A:0xbe5694) "' name='RPMH_BCM_TCS_CFG_VOTE_DATA_CD0_CP5'/>"
WRITE #1 "        <register address='0xbbe5698' value='0x" DATA.LONG(A:0xbe5698) "' name='RPMH_BCM_TCS_CFG_VOTE_DATA_CD0_CP6'/>"
WRITE #1 "        <register address='0xbbe569c' value='0x" DATA.LONG(A:0xbe569c) "' name='RPMH_BCM_TCS_CFG_VOTE_DATA_CD0_CP7'/>"
WRITE #1 "        <register address='0xbbe56a0' value='0x" DATA.LONG(A:0xbe56a0) "' name='RPMH_BCM_TCS_CFG_VOTE_DATA_CD0_CP8'/>"
WRITE #1 "        <register address='0xbbe56a4' value='0x" DATA.LONG(A:0xbe56a4) "' name='RPMH_BCM_TCS_CFG_VOTE_DATA_CD0_CP9'/>"
WRITE #1 "        <register address='0xbbe56a8' value='0x" DATA.LONG(A:0xbe56a8) "' name='RPMH_BCM_TCS_CFG_VOTE_DATA_CD0_CP10'/>"
WRITE #1 "        <register address='0xbbe56ac' value='0x" DATA.LONG(A:0xbe56ac) "' name='RPMH_BCM_TCS_CFG_VOTE_DATA_CD0_CP11'/>"
WRITE #1 "        <register address='0xbbe56b0' value='0x" DATA.LONG(A:0xbe56b0) "' name='RPMH_BCM_TCS_CFG_VOTE_DATA_CD0_CP12'/>"
WRITE #1 "        <register address='0xbbe56b4' value='0x" DATA.LONG(A:0xbe56b4) "' name='RPMH_BCM_TCS_CFG_VOTE_DATA_CD0_CP13'/>"
WRITE #1 "        <register address='0xbbe56b8' value='0x" DATA.LONG(A:0xbe56b8) "' name='RPMH_BCM_TCS_CFG_VOTE_DATA_CD0_CP14'/>"
WRITE #1 "        <register address='0xbbe56bc' value='0x" DATA.LONG(A:0xbe56bc) "' name='RPMH_BCM_TCS_CFG_VOTE_DATA_CD0_CP15'/>"
WRITE #1 "        <register address='0xbbe56c0' value='0x" DATA.LONG(A:0xbe56c0) "' name='RPMH_BCM_TCS_CFG_VOTE_DATA_CD1_CP0'/>"
WRITE #1 "        <register address='0xbbe56c4' value='0x" DATA.LONG(A:0xbe56c4) "' name='RPMH_BCM_TCS_CFG_VOTE_DATA_CD1_CP1'/>"
WRITE #1 "        <register address='0xbbe56c8' value='0x" DATA.LONG(A:0xbe56c8) "' name='RPMH_BCM_TCS_CFG_VOTE_DATA_CD1_CP2'/>"
WRITE #1 "        <register address='0xbbe56cc' value='0x" DATA.LONG(A:0xbe56cc) "' name='RPMH_BCM_TCS_CFG_VOTE_DATA_CD1_CP3'/>"
WRITE #1 "        <register address='0xbbe56d0' value='0x" DATA.LONG(A:0xbe56d0) "' name='RPMH_BCM_TCS_CFG_VOTE_DATA_CD1_CP4'/>"
WRITE #1 "        <register address='0xbbe56d4' value='0x" DATA.LONG(A:0xbe56d4) "' name='RPMH_BCM_TCS_CFG_VOTE_DATA_CD1_CP5'/>"
WRITE #1 "        <register address='0xbbe56d8' value='0x" DATA.LONG(A:0xbe56d8) "' name='RPMH_BCM_TCS_CFG_VOTE_DATA_CD1_CP6'/>"
WRITE #1 "        <register address='0xbbe56dc' value='0x" DATA.LONG(A:0xbe56dc) "' name='RPMH_BCM_TCS_CFG_VOTE_DATA_CD1_CP7'/>"
WRITE #1 "        <register address='0xbbe56e0' value='0x" DATA.LONG(A:0xbe56e0) "' name='RPMH_BCM_TCS_CFG_VOTE_DATA_CD1_CP8'/>"
WRITE #1 "        <register address='0xbbe56e4' value='0x" DATA.LONG(A:0xbe56e4) "' name='RPMH_BCM_TCS_CFG_VOTE_DATA_CD1_CP9'/>"
WRITE #1 "        <register address='0xbbe56e8' value='0x" DATA.LONG(A:0xbe56e8) "' name='RPMH_BCM_TCS_CFG_VOTE_DATA_CD1_CP10'/>"
WRITE #1 "        <register address='0xbbe56ec' value='0x" DATA.LONG(A:0xbe56ec) "' name='RPMH_BCM_TCS_CFG_VOTE_DATA_CD1_CP11'/>"
WRITE #1 "        <register address='0xbbe56f0' value='0x" DATA.LONG(A:0xbe56f0) "' name='RPMH_BCM_TCS_CFG_VOTE_DATA_CD1_CP12'/>"
WRITE #1 "        <register address='0xbbe56f4' value='0x" DATA.LONG(A:0xbe56f4) "' name='RPMH_BCM_TCS_CFG_VOTE_DATA_CD1_CP13'/>"
WRITE #1 "        <register address='0xbbe56f8' value='0x" DATA.LONG(A:0xbe56f8) "' name='RPMH_BCM_TCS_CFG_VOTE_DATA_CD1_CP14'/>"
WRITE #1 "        <register address='0xbbe56fc' value='0x" DATA.LONG(A:0xbe56fc) "' name='RPMH_BCM_TCS_CFG_VOTE_DATA_CD1_CP15'/>"
WRITE #1 "        <register address='0xbbe5700' value='0x" DATA.LONG(A:0xbe5700) "' name='RPMH_BCM_TCS_CFG_VOTE_DATA_CD2_CP0'/>"
WRITE #1 "        <register address='0xbbe5704' value='0x" DATA.LONG(A:0xbe5704) "' name='RPMH_BCM_TCS_CFG_VOTE_DATA_CD2_CP1'/>"
WRITE #1 "        <register address='0xbbe5708' value='0x" DATA.LONG(A:0xbe5708) "' name='RPMH_BCM_TCS_CFG_VOTE_DATA_CD2_CP2'/>"
WRITE #1 "        <register address='0xbbe570c' value='0x" DATA.LONG(A:0xbe570c) "' name='RPMH_BCM_TCS_CFG_VOTE_DATA_CD2_CP3'/>"
WRITE #1 "        <register address='0xbbe5710' value='0x" DATA.LONG(A:0xbe5710) "' name='RPMH_BCM_TCS_CFG_VOTE_DATA_CD2_CP4'/>"
WRITE #1 "        <register address='0xbbe5714' value='0x" DATA.LONG(A:0xbe5714) "' name='RPMH_BCM_TCS_CFG_VOTE_DATA_CD2_CP5'/>"
WRITE #1 "        <register address='0xbbe5718' value='0x" DATA.LONG(A:0xbe5718) "' name='RPMH_BCM_TCS_CFG_VOTE_DATA_CD2_CP6'/>"
WRITE #1 "        <register address='0xbbe571c' value='0x" DATA.LONG(A:0xbe571c) "' name='RPMH_BCM_TCS_CFG_VOTE_DATA_CD2_CP7'/>"
WRITE #1 "        <register address='0xbbe5740' value='0x" DATA.LONG(A:0xbe5740) "' name='RPMH_BCM_TCS_CFG_VOTE_DATA_CD3_CP0'/>"
WRITE #1 "        <register address='0xbbe5744' value='0x" DATA.LONG(A:0xbe5744) "' name='RPMH_BCM_TCS_CFG_VOTE_DATA_CD3_CP1'/>"
WRITE #1 "        <register address='0xbbe5748' value='0x" DATA.LONG(A:0xbe5748) "' name='RPMH_BCM_TCS_CFG_VOTE_DATA_CD3_CP2'/>"
WRITE #1 "        <register address='0xbbe574c' value='0x" DATA.LONG(A:0xbe574c) "' name='RPMH_BCM_TCS_CFG_VOTE_DATA_CD3_CP3'/>"
WRITE #1 "        <register address='0xbbe5750' value='0x" DATA.LONG(A:0xbe5750) "' name='RPMH_BCM_TCS_CFG_VOTE_DATA_CD3_CP4'/>"
WRITE #1 "        <register address='0xbbe5754' value='0x" DATA.LONG(A:0xbe5754) "' name='RPMH_BCM_TCS_CFG_VOTE_DATA_CD3_CP5'/>"
WRITE #1 "        <register address='0xbbe5758' value='0x" DATA.LONG(A:0xbe5758) "' name='RPMH_BCM_TCS_CFG_VOTE_DATA_CD3_CP6'/>"
WRITE #1 "        <register address='0xbbe575c' value='0x" DATA.LONG(A:0xbe575c) "' name='RPMH_BCM_TCS_CFG_VOTE_DATA_CD3_CP7'/>"
WRITE #1 "        <register address='0xbbe5780' value='0x" DATA.LONG(A:0xbe5780) "' name='RPMH_BCM_TCS_CFG_VOTE_DATA_CD4_CP0'/>"
WRITE #1 "        <register address='0xbbe5784' value='0x" DATA.LONG(A:0xbe5784) "' name='RPMH_BCM_TCS_CFG_VOTE_DATA_CD4_CP1'/>"
WRITE #1 "        <register address='0xbbe5788' value='0x" DATA.LONG(A:0xbe5788) "' name='RPMH_BCM_TCS_CFG_VOTE_DATA_CD4_CP2'/>"
WRITE #1 "        <register address='0xbbe578c' value='0x" DATA.LONG(A:0xbe578c) "' name='RPMH_BCM_TCS_CFG_VOTE_DATA_CD4_CP3'/>"
WRITE #1 "        <register address='0xbbe5790' value='0x" DATA.LONG(A:0xbe5790) "' name='RPMH_BCM_TCS_CFG_VOTE_DATA_CD4_CP4'/>"
WRITE #1 "        <register address='0xbbe5794' value='0x" DATA.LONG(A:0xbe5794) "' name='RPMH_BCM_TCS_CFG_VOTE_DATA_CD4_CP5'/>"
WRITE #1 "        <register address='0xbbe5798' value='0x" DATA.LONG(A:0xbe5798) "' name='RPMH_BCM_TCS_CFG_VOTE_DATA_CD4_CP6'/>"
WRITE #1 "        <register address='0xbbe579c' value='0x" DATA.LONG(A:0xbe579c) "' name='RPMH_BCM_TCS_CFG_VOTE_DATA_CD4_CP7'/>"
WRITE #1 "        <register address='0xbbe57c0' value='0x" DATA.LONG(A:0xbe57c0) "' name='RPMH_BCM_TCS_CFG_VOTE_DATA_CD5_CP0'/>"
WRITE #1 "        <register address='0xbbe57c4' value='0x" DATA.LONG(A:0xbe57c4) "' name='RPMH_BCM_TCS_CFG_VOTE_DATA_CD5_CP1'/>"
WRITE #1 "        <register address='0xbbe57c8' value='0x" DATA.LONG(A:0xbe57c8) "' name='RPMH_BCM_TCS_CFG_VOTE_DATA_CD5_CP2'/>"
WRITE #1 "        <register address='0xbbe57cc' value='0x" DATA.LONG(A:0xbe57cc) "' name='RPMH_BCM_TCS_CFG_VOTE_DATA_CD5_CP3'/>"
WRITE #1 "        <register address='0xbbe57d0' value='0x" DATA.LONG(A:0xbe57d0) "' name='RPMH_BCM_TCS_CFG_VOTE_DATA_CD5_CP4'/>"
WRITE #1 "        <register address='0xbbe57d4' value='0x" DATA.LONG(A:0xbe57d4) "' name='RPMH_BCM_TCS_CFG_VOTE_DATA_CD5_CP5'/>"
WRITE #1 "        <register address='0xbbe57d8' value='0x" DATA.LONG(A:0xbe57d8) "' name='RPMH_BCM_TCS_CFG_VOTE_DATA_CD5_CP6'/>"
WRITE #1 "        <register address='0xbbe57dc' value='0x" DATA.LONG(A:0xbe57dc) "' name='RPMH_BCM_TCS_CFG_VOTE_DATA_CD5_CP7'/>"
WRITE #1 "        <register address='0xbbe5800' value='0x" DATA.LONG(A:0xbe5800) "' name='RPMH_BCM_TCS_CFG_VOTE_DATA_CD6_CP0'/>"
WRITE #1 "        <register address='0xbbe5804' value='0x" DATA.LONG(A:0xbe5804) "' name='RPMH_BCM_TCS_CFG_VOTE_DATA_CD6_CP1'/>"
WRITE #1 "        <register address='0xbbe5808' value='0x" DATA.LONG(A:0xbe5808) "' name='RPMH_BCM_TCS_CFG_VOTE_DATA_CD6_CP2'/>"
WRITE #1 "        <register address='0xbbe580c' value='0x" DATA.LONG(A:0xbe580c) "' name='RPMH_BCM_TCS_CFG_VOTE_DATA_CD6_CP3'/>"
WRITE #1 "        <register address='0xbbe5810' value='0x" DATA.LONG(A:0xbe5810) "' name='RPMH_BCM_TCS_CFG_VOTE_DATA_CD6_CP4'/>"
WRITE #1 "        <register address='0xbbe5814' value='0x" DATA.LONG(A:0xbe5814) "' name='RPMH_BCM_TCS_CFG_VOTE_DATA_CD6_CP5'/>"
WRITE #1 "        <register address='0xbbe5818' value='0x" DATA.LONG(A:0xbe5818) "' name='RPMH_BCM_TCS_CFG_VOTE_DATA_CD6_CP6'/>"
WRITE #1 "        <register address='0xbbe581c' value='0x" DATA.LONG(A:0xbe581c) "' name='RPMH_BCM_TCS_CFG_VOTE_DATA_CD6_CP7'/>"
WRITE #1 "        <register address='0xbbe5840' value='0x" DATA.LONG(A:0xbe5840) "' name='RPMH_BCM_TCS_CFG_VOTE_DATA_CD7_CP0'/>"
WRITE #1 "        <register address='0xbbe5844' value='0x" DATA.LONG(A:0xbe5844) "' name='RPMH_BCM_TCS_CFG_VOTE_DATA_CD7_CP1'/>"
WRITE #1 "        <register address='0xbbe5848' value='0x" DATA.LONG(A:0xbe5848) "' name='RPMH_BCM_TCS_CFG_VOTE_DATA_CD7_CP2'/>"
WRITE #1 "        <register address='0xbbe584c' value='0x" DATA.LONG(A:0xbe584c) "' name='RPMH_BCM_TCS_CFG_VOTE_DATA_CD7_CP3'/>"
WRITE #1 "        <register address='0xbbe5850' value='0x" DATA.LONG(A:0xbe5850) "' name='RPMH_BCM_TCS_CFG_VOTE_DATA_CD7_CP4'/>"
WRITE #1 "        <register address='0xbbe5854' value='0x" DATA.LONG(A:0xbe5854) "' name='RPMH_BCM_TCS_CFG_VOTE_DATA_CD7_CP5'/>"
WRITE #1 "        <register address='0xbbe5858' value='0x" DATA.LONG(A:0xbe5858) "' name='RPMH_BCM_TCS_CFG_VOTE_DATA_CD7_CP6'/>"
WRITE #1 "        <register address='0xbbe585c' value='0x" DATA.LONG(A:0xbe585c) "' name='RPMH_BCM_TCS_CFG_VOTE_DATA_CD7_CP7'/>"
WRITE #1 "        <register address='0xbbe5880' value='0x" DATA.LONG(A:0xbe5880) "' name='RPMH_BCM_TCS_CFG_VOTE_DATA_CD8_CP0'/>"
WRITE #1 "        <register address='0xbbe5884' value='0x" DATA.LONG(A:0xbe5884) "' name='RPMH_BCM_TCS_CFG_VOTE_DATA_CD8_CP1'/>"
WRITE #1 "        <register address='0xbbe5888' value='0x" DATA.LONG(A:0xbe5888) "' name='RPMH_BCM_TCS_CFG_VOTE_DATA_CD8_CP2'/>"
WRITE #1 "        <register address='0xbbe588c' value='0x" DATA.LONG(A:0xbe588c) "' name='RPMH_BCM_TCS_CFG_VOTE_DATA_CD8_CP3'/>"
WRITE #1 "        <register address='0xbbe5890' value='0x" DATA.LONG(A:0xbe5890) "' name='RPMH_BCM_TCS_CFG_VOTE_DATA_CD8_CP4'/>"
WRITE #1 "        <register address='0xbbe5894' value='0x" DATA.LONG(A:0xbe5894) "' name='RPMH_BCM_TCS_CFG_VOTE_DATA_CD8_CP5'/>"
WRITE #1 "        <register address='0xbbe5898' value='0x" DATA.LONG(A:0xbe5898) "' name='RPMH_BCM_TCS_CFG_VOTE_DATA_CD8_CP6'/>"
WRITE #1 "        <register address='0xbbe589c' value='0x" DATA.LONG(A:0xbe589c) "' name='RPMH_BCM_TCS_CFG_VOTE_DATA_CD8_CP7'/>"
WRITE #1 "        <register address='0xbbe58a0' value='0x" DATA.LONG(A:0xbe58a0) "' name='RPMH_BCM_TCS_CFG_VOTE_DATA_CD8_CP8'/>"
WRITE #1 "        <register address='0xbbe58a4' value='0x" DATA.LONG(A:0xbe58a4) "' name='RPMH_BCM_TCS_CFG_VOTE_DATA_CD8_CP9'/>"
WRITE #1 "        <register address='0xbbe58a8' value='0x" DATA.LONG(A:0xbe58a8) "' name='RPMH_BCM_TCS_CFG_VOTE_DATA_CD8_CP10'/>"
WRITE #1 "        <register address='0xbbe58ac' value='0x" DATA.LONG(A:0xbe58ac) "' name='RPMH_BCM_TCS_CFG_VOTE_DATA_CD8_CP11'/>"
WRITE #1 "        <register address='0xbbe58b0' value='0x" DATA.LONG(A:0xbe58b0) "' name='RPMH_BCM_TCS_CFG_VOTE_DATA_CD8_CP12'/>"
WRITE #1 "        <register address='0xbbe58b4' value='0x" DATA.LONG(A:0xbe58b4) "' name='RPMH_BCM_TCS_CFG_VOTE_DATA_CD8_CP13'/>"
WRITE #1 "        <register address='0xbbe58b8' value='0x" DATA.LONG(A:0xbe58b8) "' name='RPMH_BCM_TCS_CFG_VOTE_DATA_CD8_CP14'/>"
WRITE #1 "        <register address='0xbbe58bc' value='0x" DATA.LONG(A:0xbe58bc) "' name='RPMH_BCM_TCS_CFG_VOTE_DATA_CD8_CP15'/>"
WRITE #1 "        <register address='0xbbe58c0' value='0x" DATA.LONG(A:0xbe58c0) "' name='RPMH_BCM_TCS_CFG_VOTE_DATA_CD9_CP0'/>"
WRITE #1 "        <register address='0xbbe58c4' value='0x" DATA.LONG(A:0xbe58c4) "' name='RPMH_BCM_TCS_CFG_VOTE_DATA_CD9_CP1'/>"
WRITE #1 "        <register address='0xbbe58c8' value='0x" DATA.LONG(A:0xbe58c8) "' name='RPMH_BCM_TCS_CFG_VOTE_DATA_CD9_CP2'/>"
WRITE #1 "        <register address='0xbbe58cc' value='0x" DATA.LONG(A:0xbe58cc) "' name='RPMH_BCM_TCS_CFG_VOTE_DATA_CD9_CP3'/>"
WRITE #1 "        <register address='0xbbe58d0' value='0x" DATA.LONG(A:0xbe58d0) "' name='RPMH_BCM_TCS_CFG_VOTE_DATA_CD9_CP4'/>"
WRITE #1 "        <register address='0xbbe58d4' value='0x" DATA.LONG(A:0xbe58d4) "' name='RPMH_BCM_TCS_CFG_VOTE_DATA_CD9_CP5'/>"
WRITE #1 "        <register address='0xbbe58d8' value='0x" DATA.LONG(A:0xbe58d8) "' name='RPMH_BCM_TCS_CFG_VOTE_DATA_CD9_CP6'/>"
WRITE #1 "        <register address='0xbbe58dc' value='0x" DATA.LONG(A:0xbe58dc) "' name='RPMH_BCM_TCS_CFG_VOTE_DATA_CD9_CP7'/>"
WRITE #1 "        <register address='0xbbe58e0' value='0x" DATA.LONG(A:0xbe58e0) "' name='RPMH_BCM_TCS_CFG_VOTE_DATA_CD9_CP8'/>"
WRITE #1 "        <register address='0xbbe58e4' value='0x" DATA.LONG(A:0xbe58e4) "' name='RPMH_BCM_TCS_CFG_VOTE_DATA_CD9_CP9'/>"
WRITE #1 "        <register address='0xbbe58e8' value='0x" DATA.LONG(A:0xbe58e8) "' name='RPMH_BCM_TCS_CFG_VOTE_DATA_CD9_CP10'/>"
WRITE #1 "        <register address='0xbbe58ec' value='0x" DATA.LONG(A:0xbe58ec) "' name='RPMH_BCM_TCS_CFG_VOTE_DATA_CD9_CP11'/>"
WRITE #1 "        <register address='0xbbe58f0' value='0x" DATA.LONG(A:0xbe58f0) "' name='RPMH_BCM_TCS_CFG_VOTE_DATA_CD9_CP12'/>"
WRITE #1 "        <register address='0xbbe58f4' value='0x" DATA.LONG(A:0xbe58f4) "' name='RPMH_BCM_TCS_CFG_VOTE_DATA_CD9_CP13'/>"
WRITE #1 "        <register address='0xbbe58f8' value='0x" DATA.LONG(A:0xbe58f8) "' name='RPMH_BCM_TCS_CFG_VOTE_DATA_CD9_CP14'/>"
WRITE #1 "        <register address='0xbbe58fc' value='0x" DATA.LONG(A:0xbe58fc) "' name='RPMH_BCM_TCS_CFG_VOTE_DATA_CD9_CP15'/>"
WRITE #1 "        <register address='0xbbe5900' value='0x" DATA.LONG(A:0xbe5900) "' name='RPMH_BCM_TCS_CFG_VOTE_DATA_CD10_CP0'/>"
WRITE #1 "        <register address='0xbbe5904' value='0x" DATA.LONG(A:0xbe5904) "' name='RPMH_BCM_TCS_CFG_VOTE_DATA_CD10_CP1'/>"
WRITE #1 "        <register address='0xbbe5908' value='0x" DATA.LONG(A:0xbe5908) "' name='RPMH_BCM_TCS_CFG_VOTE_DATA_CD10_CP2'/>"
WRITE #1 "        <register address='0xbbe590c' value='0x" DATA.LONG(A:0xbe590c) "' name='RPMH_BCM_TCS_CFG_VOTE_DATA_CD10_CP3'/>"
WRITE #1 "        <register address='0xbbe5910' value='0x" DATA.LONG(A:0xbe5910) "' name='RPMH_BCM_TCS_CFG_VOTE_DATA_CD10_CP4'/>"
WRITE #1 "        <register address='0xbbe5914' value='0x" DATA.LONG(A:0xbe5914) "' name='RPMH_BCM_TCS_CFG_VOTE_DATA_CD10_CP5'/>"
WRITE #1 "        <register address='0xbbe5918' value='0x" DATA.LONG(A:0xbe5918) "' name='RPMH_BCM_TCS_CFG_VOTE_DATA_CD10_CP6'/>"
WRITE #1 "        <register address='0xbbe591c' value='0x" DATA.LONG(A:0xbe591c) "' name='RPMH_BCM_TCS_CFG_VOTE_DATA_CD10_CP7'/>"
WRITE #1 "        <register address='0xbbe5920' value='0x" DATA.LONG(A:0xbe5920) "' name='RPMH_BCM_TCS_CFG_VOTE_DATA_CD10_CP8'/>"
WRITE #1 "        <register address='0xbbe5924' value='0x" DATA.LONG(A:0xbe5924) "' name='RPMH_BCM_TCS_CFG_VOTE_DATA_CD10_CP9'/>"
WRITE #1 "        <register address='0xbbe5928' value='0x" DATA.LONG(A:0xbe5928) "' name='RPMH_BCM_TCS_CFG_VOTE_DATA_CD10_CP10'/>"
WRITE #1 "        <register address='0xbbe592c' value='0x" DATA.LONG(A:0xbe592c) "' name='RPMH_BCM_TCS_CFG_VOTE_DATA_CD10_CP11'/>"
WRITE #1 "        <register address='0xbbe5930' value='0x" DATA.LONG(A:0xbe5930) "' name='RPMH_BCM_TCS_CFG_VOTE_DATA_CD10_CP12'/>"
WRITE #1 "        <register address='0xbbe5934' value='0x" DATA.LONG(A:0xbe5934) "' name='RPMH_BCM_TCS_CFG_VOTE_DATA_CD10_CP13'/>"
WRITE #1 "        <register address='0xbbe5938' value='0x" DATA.LONG(A:0xbe5938) "' name='RPMH_BCM_TCS_CFG_VOTE_DATA_CD10_CP14'/>"
WRITE #1 "        <register address='0xbbe593c' value='0x" DATA.LONG(A:0xbe593c) "' name='RPMH_BCM_TCS_CFG_VOTE_DATA_CD10_CP15'/>"
WRITE #1 "        <register address='0xbbe5940' value='0x" DATA.LONG(A:0xbe5940) "' name='RPMH_BCM_TCS_CFG_VOTE_DATA_CD11_CP0'/>"
WRITE #1 "        <register address='0xbbe5944' value='0x" DATA.LONG(A:0xbe5944) "' name='RPMH_BCM_TCS_CFG_VOTE_DATA_CD11_CP1'/>"
WRITE #1 "        <register address='0xbbe5948' value='0x" DATA.LONG(A:0xbe5948) "' name='RPMH_BCM_TCS_CFG_VOTE_DATA_CD11_CP2'/>"
WRITE #1 "        <register address='0xbbe594c' value='0x" DATA.LONG(A:0xbe594c) "' name='RPMH_BCM_TCS_CFG_VOTE_DATA_CD11_CP3'/>"
WRITE #1 "        <register address='0xbbe5950' value='0x" DATA.LONG(A:0xbe5950) "' name='RPMH_BCM_TCS_CFG_VOTE_DATA_CD11_CP4'/>"
WRITE #1 "        <register address='0xbbe5954' value='0x" DATA.LONG(A:0xbe5954) "' name='RPMH_BCM_TCS_CFG_VOTE_DATA_CD11_CP5'/>"
WRITE #1 "        <register address='0xbbe5958' value='0x" DATA.LONG(A:0xbe5958) "' name='RPMH_BCM_TCS_CFG_VOTE_DATA_CD11_CP6'/>"
WRITE #1 "        <register address='0xbbe595c' value='0x" DATA.LONG(A:0xbe595c) "' name='RPMH_BCM_TCS_CFG_VOTE_DATA_CD11_CP7'/>"
WRITE #1 "        <register address='0xbbe5e80' value='0x" DATA.LONG(A:0xbe5e80) "' name='RPMH_BCM_TCS_VOTE_RESP_BACK'/>"
WRITE #1 "        <register address='0xbbe6800' value='0x" DATA.LONG(A:0xbe6800) "' name='RPMH_BCM_ALGO_ADDR0'/>"
WRITE #1 "        <register address='0xbbe6804' value='0x" DATA.LONG(A:0xbe6804) "' name='RPMH_BCM_ALGO_ADDR1'/>"
WRITE #1 "        <register address='0xbbe6808' value='0x" DATA.LONG(A:0xbe6808) "' name='RPMH_BCM_ALGO_ADDR2'/>"
WRITE #1 "        <register address='0xbbe680c' value='0x" DATA.LONG(A:0xbe680c) "' name='RPMH_BCM_ALGO_ADDR3'/>"
WRITE #1 "        <register address='0xbbe6810' value='0x" DATA.LONG(A:0xbe6810) "' name='RPMH_BCM_ALGO_ADDR4'/>"
WRITE #1 "        <register address='0xbbe6814' value='0x" DATA.LONG(A:0xbe6814) "' name='RPMH_BCM_ALGO_ADDR5'/>"
WRITE #1 "        <register address='0xbbe6818' value='0x" DATA.LONG(A:0xbe6818) "' name='RPMH_BCM_ALGO_ADDR6'/>"
WRITE #1 "        <register address='0xbbe681c' value='0x" DATA.LONG(A:0xbe681c) "' name='RPMH_BCM_ALGO_ADDR7'/>"
WRITE #1 "        <register address='0xbbe6820' value='0x" DATA.LONG(A:0xbe6820) "' name='RPMH_BCM_ALGO_ADDR8'/>"
WRITE #1 "        <register address='0xbbe6824' value='0x" DATA.LONG(A:0xbe6824) "' name='RPMH_BCM_ALGO_ADDR9'/>"
WRITE #1 "        <register address='0xbbe6828' value='0x" DATA.LONG(A:0xbe6828) "' name='RPMH_BCM_ALGO_ADDR10'/>"
WRITE #1 "        <register address='0xbbe682c' value='0x" DATA.LONG(A:0xbe682c) "' name='RPMH_BCM_ALGO_ADDR11'/>"
WRITE #1 "        <register address='0xbbe6830' value='0x" DATA.LONG(A:0xbe6830) "' name='RPMH_BCM_ALGO_ADDR12'/>"
WRITE #1 "        <register address='0xbbe6834' value='0x" DATA.LONG(A:0xbe6834) "' name='RPMH_BCM_ALGO_ADDR13'/>"
WRITE #1 "        <register address='0xbbe6838' value='0x" DATA.LONG(A:0xbe6838) "' name='RPMH_BCM_ALGO_ADDR14'/>"
WRITE #1 "        <register address='0xbbe683c' value='0x" DATA.LONG(A:0xbe683c) "' name='RPMH_BCM_ALGO_ADDR15'/>"
WRITE #1 "        <register address='0xbbe6840' value='0x" DATA.LONG(A:0xbe6840) "' name='RPMH_BCM_ALGO_ADDR16'/>"
WRITE #1 "        <register address='0xbbe6844' value='0x" DATA.LONG(A:0xbe6844) "' name='RPMH_BCM_ALGO_ADDR17'/>"
WRITE #1 "        <register address='0xbbe6848' value='0x" DATA.LONG(A:0xbe6848) "' name='RPMH_BCM_ALGO_ADDR18'/>"
WRITE #1 "        <register address='0xbbe684c' value='0x" DATA.LONG(A:0xbe684c) "' name='RPMH_BCM_ALGO_ADDR19'/>"
WRITE #1 "        <register address='0xbbe6850' value='0x" DATA.LONG(A:0xbe6850) "' name='RPMH_BCM_ALGO_ADDR20'/>"
WRITE #1 "        <register address='0xbbe6854' value='0x" DATA.LONG(A:0xbe6854) "' name='RPMH_BCM_ALGO_ADDR21'/>"
WRITE #1 "        <register address='0xbbe6858' value='0x" DATA.LONG(A:0xbe6858) "' name='RPMH_BCM_ALGO_ADDR22'/>"
WRITE #1 "        <register address='0xbbe685c' value='0x" DATA.LONG(A:0xbe685c) "' name='RPMH_BCM_ALGO_ADDR23'/>"
WRITE #1 "        <register address='0xbbe6860' value='0x" DATA.LONG(A:0xbe6860) "' name='RPMH_BCM_ALGO_ADDR24'/>"
WRITE #1 "        <register address='0xbbe6864' value='0x" DATA.LONG(A:0xbe6864) "' name='RPMH_BCM_ALGO_ADDR25'/>"
WRITE #1 "        <register address='0xbbe6868' value='0x" DATA.LONG(A:0xbe6868) "' name='RPMH_BCM_ALGO_ADDR26'/>"
WRITE #1 "        <register address='0xbbe686c' value='0x" DATA.LONG(A:0xbe686c) "' name='RPMH_BCM_ALGO_ADDR27'/>"
WRITE #1 "        <register address='0xbbe6870' value='0x" DATA.LONG(A:0xbe6870) "' name='RPMH_BCM_ALGO_ADDR28'/>"
WRITE #1 "        <register address='0xbbe6874' value='0x" DATA.LONG(A:0xbe6874) "' name='RPMH_BCM_ALGO_ADDR29'/>"
WRITE #1 "        <register address='0xbbe6878' value='0x" DATA.LONG(A:0xbe6878) "' name='RPMH_BCM_ALGO_ADDR30'/>"
WRITE #1 "        <register address='0xbbe687c' value='0x" DATA.LONG(A:0xbe687c) "' name='RPMH_BCM_ALGO_ADDR31'/>"
WRITE #1 "        <register address='0xbbe6900' value='0x" DATA.LONG(A:0xbe6900) "' name='RPMH_BCM_AU_CFG_SCALAR0'/>"
WRITE #1 "        <register address='0xbbe6904' value='0x" DATA.LONG(A:0xbe6904) "' name='RPMH_BCM_AU_CFG_SCALAR1'/>"
WRITE #1 "        <register address='0xbbe6908' value='0x" DATA.LONG(A:0xbe6908) "' name='RPMH_BCM_AU_CFG_SCALAR2'/>"
WRITE #1 "        <register address='0xbbe690c' value='0x" DATA.LONG(A:0xbe690c) "' name='RPMH_BCM_AU_CFG_SCALAR3'/>"
WRITE #1 "        <register address='0xbbe6910' value='0x" DATA.LONG(A:0xbe6910) "' name='RPMH_BCM_AU_CFG_SCALAR4'/>"
WRITE #1 "        <register address='0xbbe6914' value='0x" DATA.LONG(A:0xbe6914) "' name='RPMH_BCM_AU_CFG_SCALAR5'/>"
WRITE #1 "        <register address='0xbbe6918' value='0x" DATA.LONG(A:0xbe6918) "' name='RPMH_BCM_AU_CFG_SCALAR6'/>"
WRITE #1 "        <register address='0xbbe691c' value='0x" DATA.LONG(A:0xbe691c) "' name='RPMH_BCM_AU_CFG_SCALAR7'/>"
WRITE #1 "        <register address='0xbbe6920' value='0x" DATA.LONG(A:0xbe6920) "' name='RPMH_BCM_AU_CFG_SCALAR8'/>"
WRITE #1 "        <register address='0xbbe6924' value='0x" DATA.LONG(A:0xbe6924) "' name='RPMH_BCM_AU_CFG_SCALAR9'/>"
WRITE #1 "        <register address='0xbbe6928' value='0x" DATA.LONG(A:0xbe6928) "' name='RPMH_BCM_AU_CFG_SCALAR10'/>"
WRITE #1 "        <register address='0xbbe692c' value='0x" DATA.LONG(A:0xbe692c) "' name='RPMH_BCM_AU_CFG_SCALAR11'/>"
WRITE #1 "        <register address='0xbbe6930' value='0x" DATA.LONG(A:0xbe6930) "' name='RPMH_BCM_AU_CFG_SCALAR12'/>"
WRITE #1 "        <register address='0xbbe6934' value='0x" DATA.LONG(A:0xbe6934) "' name='RPMH_BCM_AU_CFG_SCALAR13'/>"
WRITE #1 "        <register address='0xbbe6938' value='0x" DATA.LONG(A:0xbe6938) "' name='RPMH_BCM_AU_CFG_SCALAR14'/>"
WRITE #1 "        <register address='0xbbe693c' value='0x" DATA.LONG(A:0xbe693c) "' name='RPMH_BCM_AU_CFG_SCALAR15'/>"
WRITE #1 "        <register address='0xbbe6940' value='0x" DATA.LONG(A:0xbe6940) "' name='RPMH_BCM_AU_CFG_SCALAR16'/>"
WRITE #1 "        <register address='0xbbe6944' value='0x" DATA.LONG(A:0xbe6944) "' name='RPMH_BCM_AU_CFG_SCALAR17'/>"
WRITE #1 "        <register address='0xbbe6948' value='0x" DATA.LONG(A:0xbe6948) "' name='RPMH_BCM_AU_CFG_SCALAR18'/>"
WRITE #1 "        <register address='0xbbe694c' value='0x" DATA.LONG(A:0xbe694c) "' name='RPMH_BCM_AU_CFG_SCALAR19'/>"
WRITE #1 "        <register address='0xbbe6950' value='0x" DATA.LONG(A:0xbe6950) "' name='RPMH_BCM_AU_CFG_SCALAR20'/>"
WRITE #1 "        <register address='0xbbe6954' value='0x" DATA.LONG(A:0xbe6954) "' name='RPMH_BCM_AU_CFG_SCALAR21'/>"
WRITE #1 "        <register address='0xbbe6958' value='0x" DATA.LONG(A:0xbe6958) "' name='RPMH_BCM_AU_CFG_SCALAR22'/>"
WRITE #1 "        <register address='0xbbe695c' value='0x" DATA.LONG(A:0xbe695c) "' name='RPMH_BCM_AU_CFG_SCALAR23'/>"
WRITE #1 "        <register address='0xbbe6960' value='0x" DATA.LONG(A:0xbe6960) "' name='RPMH_BCM_AU_CFG_SCALAR24'/>"
WRITE #1 "        <register address='0xbbe6964' value='0x" DATA.LONG(A:0xbe6964) "' name='RPMH_BCM_AU_CFG_SCALAR25'/>"
WRITE #1 "        <register address='0xbbe6968' value='0x" DATA.LONG(A:0xbe6968) "' name='RPMH_BCM_AU_CFG_SCALAR26'/>"
WRITE #1 "        <register address='0xbbe696c' value='0x" DATA.LONG(A:0xbe696c) "' name='RPMH_BCM_AU_CFG_SCALAR27'/>"
WRITE #1 "        <register address='0xbbe6970' value='0x" DATA.LONG(A:0xbe6970) "' name='RPMH_BCM_AU_CFG_SCALAR28'/>"
WRITE #1 "        <register address='0xbbe6974' value='0x" DATA.LONG(A:0xbe6974) "' name='RPMH_BCM_AU_CFG_SCALAR29'/>"
WRITE #1 "        <register address='0xbbe6978' value='0x" DATA.LONG(A:0xbe6978) "' name='RPMH_BCM_AU_CFG_SCALAR30'/>"
WRITE #1 "        <register address='0xbbe697c' value='0x" DATA.LONG(A:0xbe697c) "' name='RPMH_BCM_AU_CFG_SCALAR31'/>"
WRITE #1 "        <register address='0xbbe6980' value='0x" DATA.LONG(A:0xbe6980) "' name='RPMH_BCM_AU_CFG_SCALAR_FORMAT'/>"
WRITE #1 "        <register address='0xbbe7000' value='0x" DATA.LONG(A:0xbe7000) "' name='RPMH_BCM_BCM_CFG_BCM_EN'/>"
WRITE #1 "        <register address='0xbbe7004' value='0x" DATA.LONG(A:0xbe7004) "' name='RPMH_BCM_BCM_CFG_SLV_ID_FOR_RESP'/>"
WRITE #1 "        <register address='0xbbe7008' value='0x" DATA.LONG(A:0xbe7008) "' name='RPMH_BCM_BCM_CFG_DRV_ID_FOR_ARC_VOTE'/>"
WRITE #1 "        <register address='0xbbe7088' value='0x" DATA.LONG(A:0xbe7088) "' name='RPMH_BCM_BCM_CFG_DRV_ID_FOR_VRM_VOTE'/>"
WRITE #1 "        <register address='0xbbe708c' value='0x" DATA.LONG(A:0xbe708c) "' name='RPMH_BCM_BCM_CFG_DRV0'/>"
WRITE #1 "        <register address='0xbbe7090' value='0x" DATA.LONG(A:0xbe7090) "' name='RPMH_BCM_BCM_CFG_DRV1'/>"
WRITE #1 "        <register address='0xbbe7094' value='0x" DATA.LONG(A:0xbe7094) "' name='RPMH_BCM_BCM_CFG_DRV2'/>"
WRITE #1 "        <register address='0xbbe7098' value='0x" DATA.LONG(A:0xbe7098) "' name='RPMH_BCM_BCM_CFG_DRV3'/>"
WRITE #1 "        <register address='0xbbe709c' value='0x" DATA.LONG(A:0xbe709c) "' name='RPMH_BCM_BCM_CFG_DRV4'/>"
WRITE #1 "        <register address='0xbbe70a0' value='0x" DATA.LONG(A:0xbe70a0) "' name='RPMH_BCM_BCM_CFG_DRV5'/>"
WRITE #1 "        <register address='0xbbe70a4' value='0x" DATA.LONG(A:0xbe70a4) "' name='RPMH_BCM_BCM_CFG_DRV6'/>"
WRITE #1 "        <register address='0xbbe70a8' value='0x" DATA.LONG(A:0xbe70a8) "' name='RPMH_BCM_BCM_CFG_DRV7'/>"
WRITE #1 "        <register address='0xbbe70ac' value='0x" DATA.LONG(A:0xbe70ac) "' name='RPMH_BCM_BCM_CFG_DRV8'/>"
WRITE #1 "        <register address='0xbbe70b0' value='0x" DATA.LONG(A:0xbe70b0) "' name='RPMH_BCM_BCM_CFG_DRV9'/>"
WRITE #1 "        <register address='0xbbe710c' value='0x" DATA.LONG(A:0xbe710c) "' name='RPMH_BCM_BCM_CFG_DEBUG_BUS'/>"
WRITE #1 "        <register address='0xbbe7110' value='0x" DATA.LONG(A:0xbe7110) "' name='RPMH_BCM_BCM_CFG_ARCH_CG_DISABLE'/>"
WRITE #1 "        <register address='0xbbf0000' value='0x" DATA.LONG(A:0xbf0000) "' name='RPMH_BCM_STATUS_FE_AGG_FSM'/>"
WRITE #1 "        <register address='0xbbf0004' value='0x" DATA.LONG(A:0xbf0004) "' name='RPMH_BCM_STATUS_FE_CD0'/>"
WRITE #1 "        <register address='0xbbf0008' value='0x" DATA.LONG(A:0xbf0008) "' name='RPMH_BCM_STATUS_FE_CD1'/>"
WRITE #1 "        <register address='0xbbf000c' value='0x" DATA.LONG(A:0xbf000c) "' name='RPMH_BCM_STATUS_FE_CD2'/>"
WRITE #1 "        <register address='0xbbf0010' value='0x" DATA.LONG(A:0xbf0010) "' name='RPMH_BCM_STATUS_FE_CD3'/>"
WRITE #1 "        <register address='0xbbf0014' value='0x" DATA.LONG(A:0xbf0014) "' name='RPMH_BCM_STATUS_FE_CD4'/>"
WRITE #1 "        <register address='0xbbf0018' value='0x" DATA.LONG(A:0xbf0018) "' name='RPMH_BCM_STATUS_FE_CD5'/>"
WRITE #1 "        <register address='0xbbf001c' value='0x" DATA.LONG(A:0xbf001c) "' name='RPMH_BCM_STATUS_FE_CD6'/>"
WRITE #1 "        <register address='0xbbf0020' value='0x" DATA.LONG(A:0xbf0020) "' name='RPMH_BCM_STATUS_FE_CD7'/>"
WRITE #1 "        <register address='0xbbf0024' value='0x" DATA.LONG(A:0xbf0024) "' name='RPMH_BCM_STATUS_FE_CD8'/>"
WRITE #1 "        <register address='0xbbf0028' value='0x" DATA.LONG(A:0xbf0028) "' name='RPMH_BCM_STATUS_FE_CD9'/>"
WRITE #1 "        <register address='0xbbf002c' value='0x" DATA.LONG(A:0xbf002c) "' name='RPMH_BCM_STATUS_FE_CD10'/>"
WRITE #1 "        <register address='0xbbf0030' value='0x" DATA.LONG(A:0xbf0030) "' name='RPMH_BCM_STATUS_FE_CD11'/>"
WRITE #1 "        <register address='0xbbf0084' value='0x" DATA.LONG(A:0xbf0084) "' name='RPMH_BCM_STATUS_DIRTY_ND_0'/>"
WRITE #1 "        <register address='0xbbf0088' value='0x" DATA.LONG(A:0xbf0088) "' name='RPMH_BCM_STATUS_DIRTY_ND_1'/>"
WRITE #1 "        <register address='0xbbf008c' value='0x" DATA.LONG(A:0xbf008c) "' name='RPMH_BCM_STATUS_SND0'/>"
WRITE #1 "        <register address='0xbbf0090' value='0x" DATA.LONG(A:0xbf0090) "' name='RPMH_BCM_STATUS_SND1'/>"
WRITE #1 "        <register address='0xbbf0094' value='0x" DATA.LONG(A:0xbf0094) "' name='RPMH_BCM_STATUS_SND2'/>"
WRITE #1 "        <register address='0xbbf0098' value='0x" DATA.LONG(A:0xbf0098) "' name='RPMH_BCM_STATUS_SND3'/>"
WRITE #1 "        <register address='0xbbf010c' value='0x" DATA.LONG(A:0xbf010c) "' name='RPMH_BCM_STATUS_AGG_BW_ND0'/>"
WRITE #1 "        <register address='0xbbf0110' value='0x" DATA.LONG(A:0xbf0110) "' name='RPMH_BCM_STATUS_AGG_BW_ND1'/>"
WRITE #1 "        <register address='0xbbf0114' value='0x" DATA.LONG(A:0xbf0114) "' name='RPMH_BCM_STATUS_AGG_BW_ND2'/>"
WRITE #1 "        <register address='0xbbf0118' value='0x" DATA.LONG(A:0xbf0118) "' name='RPMH_BCM_STATUS_AGG_BW_ND3'/>"
WRITE #1 "        <register address='0xbbf011c' value='0x" DATA.LONG(A:0xbf011c) "' name='RPMH_BCM_STATUS_AGG_BW_ND4'/>"
WRITE #1 "        <register address='0xbbf0120' value='0x" DATA.LONG(A:0xbf0120) "' name='RPMH_BCM_STATUS_AGG_BW_ND5'/>"
WRITE #1 "        <register address='0xbbf0124' value='0x" DATA.LONG(A:0xbf0124) "' name='RPMH_BCM_STATUS_AGG_BW_ND6'/>"
WRITE #1 "        <register address='0xbbf0128' value='0x" DATA.LONG(A:0xbf0128) "' name='RPMH_BCM_STATUS_AGG_BW_ND7'/>"
WRITE #1 "        <register address='0xbbf012c' value='0x" DATA.LONG(A:0xbf012c) "' name='RPMH_BCM_STATUS_AGG_BW_ND8'/>"
WRITE #1 "        <register address='0xbbf0130' value='0x" DATA.LONG(A:0xbf0130) "' name='RPMH_BCM_STATUS_AGG_BW_ND9'/>"
WRITE #1 "        <register address='0xbbf0134' value='0x" DATA.LONG(A:0xbf0134) "' name='RPMH_BCM_STATUS_AGG_BW_ND10'/>"
WRITE #1 "        <register address='0xbbf0138' value='0x" DATA.LONG(A:0xbf0138) "' name='RPMH_BCM_STATUS_AGG_BW_ND11'/>"
WRITE #1 "        <register address='0xbbf013c' value='0x" DATA.LONG(A:0xbf013c) "' name='RPMH_BCM_STATUS_AGG_BW_ND12'/>"
WRITE #1 "        <register address='0xbbf0140' value='0x" DATA.LONG(A:0xbf0140) "' name='RPMH_BCM_STATUS_AGG_BW_ND13'/>"
WRITE #1 "        <register address='0xbbf0144' value='0x" DATA.LONG(A:0xbf0144) "' name='RPMH_BCM_STATUS_AGG_BW_ND14'/>"
WRITE #1 "        <register address='0xbbf0148' value='0x" DATA.LONG(A:0xbf0148) "' name='RPMH_BCM_STATUS_AGG_BW_ND15'/>"
WRITE #1 "        <register address='0xbbf014c' value='0x" DATA.LONG(A:0xbf014c) "' name='RPMH_BCM_STATUS_AGG_BW_ND16'/>"
WRITE #1 "        <register address='0xbbf0150' value='0x" DATA.LONG(A:0xbf0150) "' name='RPMH_BCM_STATUS_AGG_BW_ND17'/>"
WRITE #1 "        <register address='0xbbf0154' value='0x" DATA.LONG(A:0xbf0154) "' name='RPMH_BCM_STATUS_AGG_BW_ND18'/>"
WRITE #1 "        <register address='0xbbf0158' value='0x" DATA.LONG(A:0xbf0158) "' name='RPMH_BCM_STATUS_AGG_BW_ND19'/>"
WRITE #1 "        <register address='0xbbf015c' value='0x" DATA.LONG(A:0xbf015c) "' name='RPMH_BCM_STATUS_AGG_BW_ND20'/>"
WRITE #1 "        <register address='0xbbf0160' value='0x" DATA.LONG(A:0xbf0160) "' name='RPMH_BCM_STATUS_AGG_BW_ND21'/>"
WRITE #1 "        <register address='0xbbf0164' value='0x" DATA.LONG(A:0xbf0164) "' name='RPMH_BCM_STATUS_AGG_BW_ND22'/>"
WRITE #1 "        <register address='0xbbf0168' value='0x" DATA.LONG(A:0xbf0168) "' name='RPMH_BCM_STATUS_AGG_BW_ND23'/>"
WRITE #1 "        <register address='0xbbf016c' value='0x" DATA.LONG(A:0xbf016c) "' name='RPMH_BCM_STATUS_AGG_BW_ND24'/>"
WRITE #1 "        <register address='0xbbf0170' value='0x" DATA.LONG(A:0xbf0170) "' name='RPMH_BCM_STATUS_AGG_BW_ND25'/>"
WRITE #1 "        <register address='0xbbf0174' value='0x" DATA.LONG(A:0xbf0174) "' name='RPMH_BCM_STATUS_AGG_BW_ND26'/>"
WRITE #1 "        <register address='0xbbf0178' value='0x" DATA.LONG(A:0xbf0178) "' name='RPMH_BCM_STATUS_AGG_BW_ND27'/>"
WRITE #1 "        <register address='0xbbf017c' value='0x" DATA.LONG(A:0xbf017c) "' name='RPMH_BCM_STATUS_AGG_BW_ND28'/>"
WRITE #1 "        <register address='0xbbf0180' value='0x" DATA.LONG(A:0xbf0180) "' name='RPMH_BCM_STATUS_AGG_BW_ND29'/>"
WRITE #1 "        <register address='0xbbf0184' value='0x" DATA.LONG(A:0xbf0184) "' name='RPMH_BCM_STATUS_AGG_BW_ND30'/>"
WRITE #1 "        <register address='0xbbf0188' value='0x" DATA.LONG(A:0xbf0188) "' name='RPMH_BCM_STATUS_AGG_BW_ND31'/>"
WRITE #1 "        <register address='0xbbf018c' value='0x" DATA.LONG(A:0xbf018c) "' name='RPMH_BCM_STATUS_AGG_BW_ND32'/>"
WRITE #1 "        <register address='0xbbf0190' value='0x" DATA.LONG(A:0xbf0190) "' name='RPMH_BCM_STATUS_AGG_BW_ND33'/>"
WRITE #1 "        <register address='0xbbf0194' value='0x" DATA.LONG(A:0xbf0194) "' name='RPMH_BCM_STATUS_AGG_BW_ND34'/>"
WRITE #1 "        <register address='0xbbf0198' value='0x" DATA.LONG(A:0xbf0198) "' name='RPMH_BCM_STATUS_AGG_BW_ND35'/>"
WRITE #1 "        <register address='0xbbf019c' value='0x" DATA.LONG(A:0xbf019c) "' name='RPMH_BCM_STATUS_AGG_BW_ND36'/>"
WRITE #1 "        <register address='0xbbf01a0' value='0x" DATA.LONG(A:0xbf01a0) "' name='RPMH_BCM_STATUS_AGG_BW_ND37'/>"
WRITE #1 "        <register address='0xbbf01a4' value='0x" DATA.LONG(A:0xbf01a4) "' name='RPMH_BCM_STATUS_AGG_BW_ND38'/>"
WRITE #1 "        <register address='0xbbf01a8' value='0x" DATA.LONG(A:0xbf01a8) "' name='RPMH_BCM_STATUS_AGG_BW_ND39'/>"
WRITE #1 "        <register address='0xbbf01ac' value='0x" DATA.LONG(A:0xbf01ac) "' name='RPMH_BCM_STATUS_AGG_BW_ND40'/>"
WRITE #1 "        <register address='0xbbf01b0' value='0x" DATA.LONG(A:0xbf01b0) "' name='RPMH_BCM_STATUS_AGG_BW_ND41'/>"
WRITE #1 "        <register address='0xbbf01b4' value='0x" DATA.LONG(A:0xbf01b4) "' name='RPMH_BCM_STATUS_AGG_BW_ND42'/>"
WRITE #1 "        <register address='0xbbf01b8' value='0x" DATA.LONG(A:0xbf01b8) "' name='RPMH_BCM_STATUS_AGG_BW_ND43'/>"
WRITE #1 "        <register address='0xbbf01bc' value='0x" DATA.LONG(A:0xbf01bc) "' name='RPMH_BCM_STATUS_AGG_BW_ND44'/>"
WRITE #1 "        <register address='0xbbf01c0' value='0x" DATA.LONG(A:0xbf01c0) "' name='RPMH_BCM_STATUS_AGG_BW_ND45'/>"
WRITE #1 "        <register address='0xbbf01c4' value='0x" DATA.LONG(A:0xbf01c4) "' name='RPMH_BCM_STATUS_AGG_BW_ND46'/>"
WRITE #1 "        <register address='0xbbf01c8' value='0x" DATA.LONG(A:0xbf01c8) "' name='RPMH_BCM_STATUS_AGG_BW_ND47'/>"
WRITE #1 "        <register address='0xbbf030c' value='0x" DATA.LONG(A:0xbf030c) "' name='RPMH_BCM_STATUS_AGG_BW_Z_ND0'/>"
WRITE #1 "        <register address='0xbbf0310' value='0x" DATA.LONG(A:0xbf0310) "' name='RPMH_BCM_STATUS_AGG_BW_Z_ND1'/>"
WRITE #1 "        <register address='0xbbf0314' value='0x" DATA.LONG(A:0xbf0314) "' name='RPMH_BCM_STATUS_AGG_BW_Z_ND2'/>"
WRITE #1 "        <register address='0xbbf0318' value='0x" DATA.LONG(A:0xbf0318) "' name='RPMH_BCM_STATUS_AGG_BW_Z_ND3'/>"
WRITE #1 "        <register address='0xbbf0800' value='0x" DATA.LONG(A:0xbf0800) "' name='RPMH_BCM_STATUS_BE_CD0'/>"
WRITE #1 "        <register address='0xbbf0804' value='0x" DATA.LONG(A:0xbf0804) "' name='RPMH_BCM_STATUS_BE_CD1'/>"
WRITE #1 "        <register address='0xbbf0808' value='0x" DATA.LONG(A:0xbf0808) "' name='RPMH_BCM_STATUS_BE_CD2'/>"
WRITE #1 "        <register address='0xbbf080c' value='0x" DATA.LONG(A:0xbf080c) "' name='RPMH_BCM_STATUS_BE_CD3'/>"
WRITE #1 "        <register address='0xbbf0810' value='0x" DATA.LONG(A:0xbf0810) "' name='RPMH_BCM_STATUS_BE_CD4'/>"
WRITE #1 "        <register address='0xbbf0814' value='0x" DATA.LONG(A:0xbf0814) "' name='RPMH_BCM_STATUS_BE_CD5'/>"
WRITE #1 "        <register address='0xbbf0818' value='0x" DATA.LONG(A:0xbf0818) "' name='RPMH_BCM_STATUS_BE_CD6'/>"
WRITE #1 "        <register address='0xbbf081c' value='0x" DATA.LONG(A:0xbf081c) "' name='RPMH_BCM_STATUS_BE_CD7'/>"
WRITE #1 "        <register address='0xbbf0820' value='0x" DATA.LONG(A:0xbf0820) "' name='RPMH_BCM_STATUS_BE_CD8'/>"
WRITE #1 "        <register address='0xbbf0824' value='0x" DATA.LONG(A:0xbf0824) "' name='RPMH_BCM_STATUS_BE_CD9'/>"
WRITE #1 "        <register address='0xbbf0828' value='0x" DATA.LONG(A:0xbf0828) "' name='RPMH_BCM_STATUS_BE_CD10'/>"
WRITE #1 "        <register address='0xbbf082c' value='0x" DATA.LONG(A:0xbf082c) "' name='RPMH_BCM_STATUS_BE_CD11'/>"
WRITE #1 "        <register address='0xbbf0880' value='0x" DATA.LONG(A:0xbf0880) "' name='RPMH_BCM_STATUS_BE_SEQ_CD0'/>"
WRITE #1 "        <register address='0xbbf0884' value='0x" DATA.LONG(A:0xbf0884) "' name='RPMH_BCM_STATUS_BE_SEQ_CD1'/>"
WRITE #1 "        <register address='0xbbf0888' value='0x" DATA.LONG(A:0xbf0888) "' name='RPMH_BCM_STATUS_BE_SEQ_CD2'/>"
WRITE #1 "        <register address='0xbbf088c' value='0x" DATA.LONG(A:0xbf088c) "' name='RPMH_BCM_STATUS_BE_SEQ_CD3'/>"
WRITE #1 "        <register address='0xbbf0890' value='0x" DATA.LONG(A:0xbf0890) "' name='RPMH_BCM_STATUS_BE_SEQ_CD4'/>"
WRITE #1 "        <register address='0xbbf0894' value='0x" DATA.LONG(A:0xbf0894) "' name='RPMH_BCM_STATUS_BE_SEQ_CD5'/>"
WRITE #1 "        <register address='0xbbf0898' value='0x" DATA.LONG(A:0xbf0898) "' name='RPMH_BCM_STATUS_BE_SEQ_CD6'/>"
WRITE #1 "        <register address='0xbbf089c' value='0x" DATA.LONG(A:0xbf089c) "' name='RPMH_BCM_STATUS_BE_SEQ_CD7'/>"
WRITE #1 "        <register address='0xbbf08a0' value='0x" DATA.LONG(A:0xbf08a0) "' name='RPMH_BCM_STATUS_BE_SEQ_CD8'/>"
WRITE #1 "        <register address='0xbbf08a4' value='0x" DATA.LONG(A:0xbf08a4) "' name='RPMH_BCM_STATUS_BE_SEQ_CD9'/>"
WRITE #1 "        <register address='0xbbf08a8' value='0x" DATA.LONG(A:0xbf08a8) "' name='RPMH_BCM_STATUS_BE_SEQ_CD10'/>"
WRITE #1 "        <register address='0xbbf08ac' value='0x" DATA.LONG(A:0xbf08ac) "' name='RPMH_BCM_STATUS_BE_SEQ_CD11'/>"
WRITE #1 "        <register address='0xbbf0900' value='0x" DATA.LONG(A:0xbf0900) "' name='RPMH_BCM_STATUS_BE_CMD_ISSUE_STATUS_CD0'/>"
WRITE #1 "        <register address='0xbbf0904' value='0x" DATA.LONG(A:0xbf0904) "' name='RPMH_BCM_STATUS_BE_CMD_ISSUE_STATUS_CD1'/>"
WRITE #1 "        <register address='0xbbf0908' value='0x" DATA.LONG(A:0xbf0908) "' name='RPMH_BCM_STATUS_BE_CMD_ISSUE_STATUS_CD2'/>"
WRITE #1 "        <register address='0xbbf090c' value='0x" DATA.LONG(A:0xbf090c) "' name='RPMH_BCM_STATUS_BE_CMD_ISSUE_STATUS_CD3'/>"
WRITE #1 "        <register address='0xbbf0910' value='0x" DATA.LONG(A:0xbf0910) "' name='RPMH_BCM_STATUS_BE_CMD_ISSUE_STATUS_CD4'/>"
WRITE #1 "        <register address='0xbbf0914' value='0x" DATA.LONG(A:0xbf0914) "' name='RPMH_BCM_STATUS_BE_CMD_ISSUE_STATUS_CD5'/>"
WRITE #1 "        <register address='0xbbf0918' value='0x" DATA.LONG(A:0xbf0918) "' name='RPMH_BCM_STATUS_BE_CMD_ISSUE_STATUS_CD6'/>"
WRITE #1 "        <register address='0xbbf091c' value='0x" DATA.LONG(A:0xbf091c) "' name='RPMH_BCM_STATUS_BE_CMD_ISSUE_STATUS_CD7'/>"
WRITE #1 "        <register address='0xbbf0920' value='0x" DATA.LONG(A:0xbf0920) "' name='RPMH_BCM_STATUS_BE_CMD_ISSUE_STATUS_CD8'/>"
WRITE #1 "        <register address='0xbbf0924' value='0x" DATA.LONG(A:0xbf0924) "' name='RPMH_BCM_STATUS_BE_CMD_ISSUE_STATUS_CD9'/>"
WRITE #1 "        <register address='0xbbf0928' value='0x" DATA.LONG(A:0xbf0928) "' name='RPMH_BCM_STATUS_BE_CMD_ISSUE_STATUS_CD10'/>"
WRITE #1 "        <register address='0xbbf092c' value='0x" DATA.LONG(A:0xbf092c) "' name='RPMH_BCM_STATUS_BE_CMD_ISSUE_STATUS_CD11'/>"
WRITE #1 "        <register address='0xbbf0980' value='0x" DATA.LONG(A:0xbf0980) "' name='RPMH_BCM_STATUS_BE_CMD_SENT_STATUS_CD0'/>"
WRITE #1 "        <register address='0xbbf0984' value='0x" DATA.LONG(A:0xbf0984) "' name='RPMH_BCM_STATUS_BE_CMD_SENT_STATUS_CD1'/>"
WRITE #1 "        <register address='0xbbf0988' value='0x" DATA.LONG(A:0xbf0988) "' name='RPMH_BCM_STATUS_BE_CMD_SENT_STATUS_CD2'/>"
WRITE #1 "        <register address='0xbbf098c' value='0x" DATA.LONG(A:0xbf098c) "' name='RPMH_BCM_STATUS_BE_CMD_SENT_STATUS_CD3'/>"
WRITE #1 "        <register address='0xbbf0990' value='0x" DATA.LONG(A:0xbf0990) "' name='RPMH_BCM_STATUS_BE_CMD_SENT_STATUS_CD4'/>"
WRITE #1 "        <register address='0xbbf0994' value='0x" DATA.LONG(A:0xbf0994) "' name='RPMH_BCM_STATUS_BE_CMD_SENT_STATUS_CD5'/>"
WRITE #1 "        <register address='0xbbf0998' value='0x" DATA.LONG(A:0xbf0998) "' name='RPMH_BCM_STATUS_BE_CMD_SENT_STATUS_CD6'/>"
WRITE #1 "        <register address='0xbbf099c' value='0x" DATA.LONG(A:0xbf099c) "' name='RPMH_BCM_STATUS_BE_CMD_SENT_STATUS_CD7'/>"
WRITE #1 "        <register address='0xbbf09a0' value='0x" DATA.LONG(A:0xbf09a0) "' name='RPMH_BCM_STATUS_BE_CMD_SENT_STATUS_CD8'/>"
WRITE #1 "        <register address='0xbbf09a4' value='0x" DATA.LONG(A:0xbf09a4) "' name='RPMH_BCM_STATUS_BE_CMD_SENT_STATUS_CD9'/>"
WRITE #1 "        <register address='0xbbf09a8' value='0x" DATA.LONG(A:0xbf09a8) "' name='RPMH_BCM_STATUS_BE_CMD_SENT_STATUS_CD10'/>"
WRITE #1 "        <register address='0xbbf09ac' value='0x" DATA.LONG(A:0xbf09ac) "' name='RPMH_BCM_STATUS_BE_CMD_SENT_STATUS_CD11'/>"
WRITE #1 "        <register address='0xbbf0a00' value='0x" DATA.LONG(A:0xbf0a00) "' name='RPMH_BCM_STATUS_BE_CMD_CMPL_STATUS_CD0'/>"
WRITE #1 "        <register address='0xbbf0a04' value='0x" DATA.LONG(A:0xbf0a04) "' name='RPMH_BCM_STATUS_BE_CMD_CMPL_STATUS_CD1'/>"
WRITE #1 "        <register address='0xbbf0a08' value='0x" DATA.LONG(A:0xbf0a08) "' name='RPMH_BCM_STATUS_BE_CMD_CMPL_STATUS_CD2'/>"
WRITE #1 "        <register address='0xbbf0a0c' value='0x" DATA.LONG(A:0xbf0a0c) "' name='RPMH_BCM_STATUS_BE_CMD_CMPL_STATUS_CD3'/>"
WRITE #1 "        <register address='0xbbf0a10' value='0x" DATA.LONG(A:0xbf0a10) "' name='RPMH_BCM_STATUS_BE_CMD_CMPL_STATUS_CD4'/>"
WRITE #1 "        <register address='0xbbf0a14' value='0x" DATA.LONG(A:0xbf0a14) "' name='RPMH_BCM_STATUS_BE_CMD_CMPL_STATUS_CD5'/>"
WRITE #1 "        <register address='0xbbf0a18' value='0x" DATA.LONG(A:0xbf0a18) "' name='RPMH_BCM_STATUS_BE_CMD_CMPL_STATUS_CD6'/>"
WRITE #1 "        <register address='0xbbf0a1c' value='0x" DATA.LONG(A:0xbf0a1c) "' name='RPMH_BCM_STATUS_BE_CMD_CMPL_STATUS_CD7'/>"
WRITE #1 "        <register address='0xbbf0a20' value='0x" DATA.LONG(A:0xbf0a20) "' name='RPMH_BCM_STATUS_BE_CMD_CMPL_STATUS_CD8'/>"
WRITE #1 "        <register address='0xbbf0a24' value='0x" DATA.LONG(A:0xbf0a24) "' name='RPMH_BCM_STATUS_BE_CMD_CMPL_STATUS_CD9'/>"
WRITE #1 "        <register address='0xbbf0a28' value='0x" DATA.LONG(A:0xbf0a28) "' name='RPMH_BCM_STATUS_BE_CMD_CMPL_STATUS_CD10'/>"
WRITE #1 "        <register address='0xbbf0a2c' value='0x" DATA.LONG(A:0xbf0a2c) "' name='RPMH_BCM_STATUS_BE_CMD_CMPL_STATUS_CD11'/>"
WRITE #1 "        <register address='0xbbf0a80' value='0x" DATA.LONG(A:0xbf0a80) "' name='RPMH_BCM_STATUS_BE_TCS_STATUS_CD0'/>"
WRITE #1 "        <register address='0xbbf0a84' value='0x" DATA.LONG(A:0xbf0a84) "' name='RPMH_BCM_STATUS_BE_TCS_STATUS_CD1'/>"
WRITE #1 "        <register address='0xbbf0a88' value='0x" DATA.LONG(A:0xbf0a88) "' name='RPMH_BCM_STATUS_BE_TCS_STATUS_CD2'/>"
WRITE #1 "        <register address='0xbbf0a8c' value='0x" DATA.LONG(A:0xbf0a8c) "' name='RPMH_BCM_STATUS_BE_TCS_STATUS_CD3'/>"
WRITE #1 "        <register address='0xbbf0a90' value='0x" DATA.LONG(A:0xbf0a90) "' name='RPMH_BCM_STATUS_BE_TCS_STATUS_CD4'/>"
WRITE #1 "        <register address='0xbbf0a94' value='0x" DATA.LONG(A:0xbf0a94) "' name='RPMH_BCM_STATUS_BE_TCS_STATUS_CD5'/>"
WRITE #1 "        <register address='0xbbf0a98' value='0x" DATA.LONG(A:0xbf0a98) "' name='RPMH_BCM_STATUS_BE_TCS_STATUS_CD6'/>"
WRITE #1 "        <register address='0xbbf0a9c' value='0x" DATA.LONG(A:0xbf0a9c) "' name='RPMH_BCM_STATUS_BE_TCS_STATUS_CD7'/>"
WRITE #1 "        <register address='0xbbf0aa0' value='0x" DATA.LONG(A:0xbf0aa0) "' name='RPMH_BCM_STATUS_BE_TCS_STATUS_CD8'/>"
WRITE #1 "        <register address='0xbbf0aa4' value='0x" DATA.LONG(A:0xbf0aa4) "' name='RPMH_BCM_STATUS_BE_TCS_STATUS_CD9'/>"
WRITE #1 "        <register address='0xbbf0aa8' value='0x" DATA.LONG(A:0xbf0aa8) "' name='RPMH_BCM_STATUS_BE_TCS_STATUS_CD10'/>"
WRITE #1 "        <register address='0xbbf0aac' value='0x" DATA.LONG(A:0xbf0aac) "' name='RPMH_BCM_STATUS_BE_TCS_STATUS_CD11'/>"
WRITE #1 "        <register address='0xbbf0f00' value='0x" DATA.LONG(A:0xbf0f00) "' name='RPMH_BCM_STATUS_CE_DRV0_CTT0'/>"
WRITE #1 "        <register address='0xbbf0f04' value='0x" DATA.LONG(A:0xbf0f04) "' name='RPMH_BCM_STATUS_CE_DRV0_CTT1'/>"
WRITE #1 "        <register address='0xbbf0f08' value='0x" DATA.LONG(A:0xbf0f08) "' name='RPMH_BCM_STATUS_CE_DRV0_CTT2'/>"
WRITE #1 "        <register address='0xbbf0f0c' value='0x" DATA.LONG(A:0xbf0f0c) "' name='RPMH_BCM_STATUS_CE_DRV0_CTT3'/>"
WRITE #1 "        <register address='0xbbf0f10' value='0x" DATA.LONG(A:0xbf0f10) "' name='RPMH_BCM_STATUS_CE_DRV0_CTT4'/>"
WRITE #1 "        <register address='0xbbf0f14' value='0x" DATA.LONG(A:0xbf0f14) "' name='RPMH_BCM_STATUS_CE_DRV0_CTT5'/>"
WRITE #1 "        <register address='0xbbf0f18' value='0x" DATA.LONG(A:0xbf0f18) "' name='RPMH_BCM_STATUS_CE_DRV0_CTT6'/>"
WRITE #1 "        <register address='0xbbf0f1c' value='0x" DATA.LONG(A:0xbf0f1c) "' name='RPMH_BCM_STATUS_CE_DRV0_CTT7'/>"
WRITE #1 "        <register address='0xbbf0f20' value='0x" DATA.LONG(A:0xbf0f20) "' name='RPMH_BCM_STATUS_CE_DRV0_CTT8'/>"
WRITE #1 "        <register address='0xbbf0f24' value='0x" DATA.LONG(A:0xbf0f24) "' name='RPMH_BCM_STATUS_CE_DRV0_CTT9'/>"
WRITE #1 "        <register address='0xbbf0f28' value='0x" DATA.LONG(A:0xbf0f28) "' name='RPMH_BCM_STATUS_CE_DRV0_CTT10'/>"
WRITE #1 "        <register address='0xbbf0f2c' value='0x" DATA.LONG(A:0xbf0f2c) "' name='RPMH_BCM_STATUS_CE_DRV0_CTT11'/>"
WRITE #1 "        <register address='0xbbf0f30' value='0x" DATA.LONG(A:0xbf0f30) "' name='RPMH_BCM_STATUS_CE_DRV0_CTT12'/>"
WRITE #1 "        <register address='0xbbf0f34' value='0x" DATA.LONG(A:0xbf0f34) "' name='RPMH_BCM_STATUS_CE_DRV0_CTT13'/>"
WRITE #1 "        <register address='0xbbf0f38' value='0x" DATA.LONG(A:0xbf0f38) "' name='RPMH_BCM_STATUS_CE_DRV0_CTT14'/>"
WRITE #1 "        <register address='0xbbf0f3c' value='0x" DATA.LONG(A:0xbf0f3c) "' name='RPMH_BCM_STATUS_CE_DRV0_CTT15'/>"
WRITE #1 "        <register address='0xbbf0f40' value='0x" DATA.LONG(A:0xbf0f40) "' name='RPMH_BCM_STATUS_CE_DRV0_CTT16'/>"
WRITE #1 "        <register address='0xbbf0f44' value='0x" DATA.LONG(A:0xbf0f44) "' name='RPMH_BCM_STATUS_CE_DRV0_CTT17'/>"
WRITE #1 "        <register address='0xbbf0f48' value='0x" DATA.LONG(A:0xbf0f48) "' name='RPMH_BCM_STATUS_CE_DRV0_CTT18'/>"
WRITE #1 "        <register address='0xbbf0f4c' value='0x" DATA.LONG(A:0xbf0f4c) "' name='RPMH_BCM_STATUS_CE_DRV0_CTT19'/>"
WRITE #1 "        <register address='0xbbf0f50' value='0x" DATA.LONG(A:0xbf0f50) "' name='RPMH_BCM_STATUS_CE_DRV0_CTT20'/>"
WRITE #1 "        <register address='0xbbf0f54' value='0x" DATA.LONG(A:0xbf0f54) "' name='RPMH_BCM_STATUS_CE_DRV0_CTT21'/>"
WRITE #1 "        <register address='0xbbf0f58' value='0x" DATA.LONG(A:0xbf0f58) "' name='RPMH_BCM_STATUS_CE_DRV0_CTT22'/>"
WRITE #1 "        <register address='0xbbf0f5c' value='0x" DATA.LONG(A:0xbf0f5c) "' name='RPMH_BCM_STATUS_CE_DRV0_CTT23'/>"
WRITE #1 "        <register address='0xbbf0f60' value='0x" DATA.LONG(A:0xbf0f60) "' name='RPMH_BCM_STATUS_CE_DRV1_CTT0'/>"
WRITE #1 "        <register address='0xbbf0f64' value='0x" DATA.LONG(A:0xbf0f64) "' name='RPMH_BCM_STATUS_CE_DRV1_CTT1'/>"
WRITE #1 "        <register address='0xbbf0f68' value='0x" DATA.LONG(A:0xbf0f68) "' name='RPMH_BCM_STATUS_CE_DRV1_CTT2'/>"
WRITE #1 "        <register address='0xbbf0f6c' value='0x" DATA.LONG(A:0xbf0f6c) "' name='RPMH_BCM_STATUS_CE_DRV1_CTT3'/>"
WRITE #1 "        <register address='0xbbf0f70' value='0x" DATA.LONG(A:0xbf0f70) "' name='RPMH_BCM_STATUS_CE_DRV1_CTT4'/>"
WRITE #1 "        <register address='0xbbf0f74' value='0x" DATA.LONG(A:0xbf0f74) "' name='RPMH_BCM_STATUS_CE_DRV1_CTT5'/>"
WRITE #1 "        <register address='0xbbf0f78' value='0x" DATA.LONG(A:0xbf0f78) "' name='RPMH_BCM_STATUS_CE_DRV1_CTT6'/>"
WRITE #1 "        <register address='0xbbf0f7c' value='0x" DATA.LONG(A:0xbf0f7c) "' name='RPMH_BCM_STATUS_CE_DRV1_CTT7'/>"
WRITE #1 "        <register address='0xbbf0f80' value='0x" DATA.LONG(A:0xbf0f80) "' name='RPMH_BCM_STATUS_CE_DRV1_CTT8'/>"
WRITE #1 "        <register address='0xbbf0f84' value='0x" DATA.LONG(A:0xbf0f84) "' name='RPMH_BCM_STATUS_CE_DRV1_CTT9'/>"
WRITE #1 "        <register address='0xbbf0f88' value='0x" DATA.LONG(A:0xbf0f88) "' name='RPMH_BCM_STATUS_CE_DRV1_CTT10'/>"
WRITE #1 "        <register address='0xbbf0f8c' value='0x" DATA.LONG(A:0xbf0f8c) "' name='RPMH_BCM_STATUS_CE_DRV1_CTT11'/>"
WRITE #1 "        <register address='0xbbf0f90' value='0x" DATA.LONG(A:0xbf0f90) "' name='RPMH_BCM_STATUS_CE_DRV1_CTT12'/>"
WRITE #1 "        <register address='0xbbf0f94' value='0x" DATA.LONG(A:0xbf0f94) "' name='RPMH_BCM_STATUS_CE_DRV1_CTT13'/>"
WRITE #1 "        <register address='0xbbf0f98' value='0x" DATA.LONG(A:0xbf0f98) "' name='RPMH_BCM_STATUS_CE_DRV1_CTT14'/>"
WRITE #1 "        <register address='0xbbf0f9c' value='0x" DATA.LONG(A:0xbf0f9c) "' name='RPMH_BCM_STATUS_CE_DRV1_CTT15'/>"
WRITE #1 "        <register address='0xbbf0fa0' value='0x" DATA.LONG(A:0xbf0fa0) "' name='RPMH_BCM_STATUS_CE_DRV1_CTT16'/>"
WRITE #1 "        <register address='0xbbf0fa4' value='0x" DATA.LONG(A:0xbf0fa4) "' name='RPMH_BCM_STATUS_CE_DRV1_CTT17'/>"
WRITE #1 "        <register address='0xbbf0fa8' value='0x" DATA.LONG(A:0xbf0fa8) "' name='RPMH_BCM_STATUS_CE_DRV1_CTT18'/>"
WRITE #1 "        <register address='0xbbf0fac' value='0x" DATA.LONG(A:0xbf0fac) "' name='RPMH_BCM_STATUS_CE_DRV1_CTT19'/>"
WRITE #1 "        <register address='0xbbf0fb0' value='0x" DATA.LONG(A:0xbf0fb0) "' name='RPMH_BCM_STATUS_CE_DRV1_CTT20'/>"
WRITE #1 "        <register address='0xbbf0fb4' value='0x" DATA.LONG(A:0xbf0fb4) "' name='RPMH_BCM_STATUS_CE_DRV1_CTT21'/>"
WRITE #1 "        <register address='0xbbf0fb8' value='0x" DATA.LONG(A:0xbf0fb8) "' name='RPMH_BCM_STATUS_CE_DRV1_CTT22'/>"
WRITE #1 "        <register address='0xbbf0fbc' value='0x" DATA.LONG(A:0xbf0fbc) "' name='RPMH_BCM_STATUS_CE_DRV1_CTT23'/>"
WRITE #1 "        <register address='0xbbf0fc0' value='0x" DATA.LONG(A:0xbf0fc0) "' name='RPMH_BCM_STATUS_CE_DRV2_CTT0'/>"
WRITE #1 "        <register address='0xbbf0fc4' value='0x" DATA.LONG(A:0xbf0fc4) "' name='RPMH_BCM_STATUS_CE_DRV2_CTT1'/>"
WRITE #1 "        <register address='0xbbf0fc8' value='0x" DATA.LONG(A:0xbf0fc8) "' name='RPMH_BCM_STATUS_CE_DRV2_CTT2'/>"
WRITE #1 "        <register address='0xbbf0fcc' value='0x" DATA.LONG(A:0xbf0fcc) "' name='RPMH_BCM_STATUS_CE_DRV2_CTT3'/>"
WRITE #1 "        <register address='0xbbf0fd0' value='0x" DATA.LONG(A:0xbf0fd0) "' name='RPMH_BCM_STATUS_CE_DRV2_CTT4'/>"
WRITE #1 "        <register address='0xbbf0fd4' value='0x" DATA.LONG(A:0xbf0fd4) "' name='RPMH_BCM_STATUS_CE_DRV2_CTT5'/>"
WRITE #1 "        <register address='0xbbf0fd8' value='0x" DATA.LONG(A:0xbf0fd8) "' name='RPMH_BCM_STATUS_CE_DRV2_CTT6'/>"
WRITE #1 "        <register address='0xbbf0fdc' value='0x" DATA.LONG(A:0xbf0fdc) "' name='RPMH_BCM_STATUS_CE_DRV2_CTT7'/>"
WRITE #1 "        <register address='0xbbf0fe0' value='0x" DATA.LONG(A:0xbf0fe0) "' name='RPMH_BCM_STATUS_CE_DRV2_CTT8'/>"
WRITE #1 "        <register address='0xbbf0fe4' value='0x" DATA.LONG(A:0xbf0fe4) "' name='RPMH_BCM_STATUS_CE_DRV2_CTT9'/>"
WRITE #1 "        <register address='0xbbf0fe8' value='0x" DATA.LONG(A:0xbf0fe8) "' name='RPMH_BCM_STATUS_CE_DRV2_CTT10'/>"
WRITE #1 "        <register address='0xbbf0fec' value='0x" DATA.LONG(A:0xbf0fec) "' name='RPMH_BCM_STATUS_CE_DRV2_CTT11'/>"
WRITE #1 "        <register address='0xbbf0ff0' value='0x" DATA.LONG(A:0xbf0ff0) "' name='RPMH_BCM_STATUS_CE_DRV2_CTT12'/>"
WRITE #1 "        <register address='0xbbf0ff4' value='0x" DATA.LONG(A:0xbf0ff4) "' name='RPMH_BCM_STATUS_CE_DRV2_CTT13'/>"
WRITE #1 "        <register address='0xbbf0ff8' value='0x" DATA.LONG(A:0xbf0ff8) "' name='RPMH_BCM_STATUS_CE_DRV2_CTT14'/>"
WRITE #1 "        <register address='0xbbf0ffc' value='0x" DATA.LONG(A:0xbf0ffc) "' name='RPMH_BCM_STATUS_CE_DRV2_CTT15'/>"
WRITE #1 "        <register address='0xbbf1000' value='0x" DATA.LONG(A:0xbf1000) "' name='RPMH_BCM_STATUS_CE_DRV2_CTT16'/>"
WRITE #1 "        <register address='0xbbf1004' value='0x" DATA.LONG(A:0xbf1004) "' name='RPMH_BCM_STATUS_CE_DRV2_CTT17'/>"
WRITE #1 "        <register address='0xbbf1008' value='0x" DATA.LONG(A:0xbf1008) "' name='RPMH_BCM_STATUS_CE_DRV2_CTT18'/>"
WRITE #1 "        <register address='0xbbf100c' value='0x" DATA.LONG(A:0xbf100c) "' name='RPMH_BCM_STATUS_CE_DRV2_CTT19'/>"
WRITE #1 "        <register address='0xbbf1010' value='0x" DATA.LONG(A:0xbf1010) "' name='RPMH_BCM_STATUS_CE_DRV2_CTT20'/>"
WRITE #1 "        <register address='0xbbf1014' value='0x" DATA.LONG(A:0xbf1014) "' name='RPMH_BCM_STATUS_CE_DRV2_CTT21'/>"
WRITE #1 "        <register address='0xbbf1018' value='0x" DATA.LONG(A:0xbf1018) "' name='RPMH_BCM_STATUS_CE_DRV2_CTT22'/>"
WRITE #1 "        <register address='0xbbf101c' value='0x" DATA.LONG(A:0xbf101c) "' name='RPMH_BCM_STATUS_CE_DRV2_CTT23'/>"
WRITE #1 "        <register address='0xbbf1020' value='0x" DATA.LONG(A:0xbf1020) "' name='RPMH_BCM_STATUS_CE_DRV3_CTT0'/>"
WRITE #1 "        <register address='0xbbf1024' value='0x" DATA.LONG(A:0xbf1024) "' name='RPMH_BCM_STATUS_CE_DRV3_CTT1'/>"
WRITE #1 "        <register address='0xbbf1028' value='0x" DATA.LONG(A:0xbf1028) "' name='RPMH_BCM_STATUS_CE_DRV3_CTT2'/>"
WRITE #1 "        <register address='0xbbf102c' value='0x" DATA.LONG(A:0xbf102c) "' name='RPMH_BCM_STATUS_CE_DRV3_CTT3'/>"
WRITE #1 "        <register address='0xbbf1030' value='0x" DATA.LONG(A:0xbf1030) "' name='RPMH_BCM_STATUS_CE_DRV3_CTT4'/>"
WRITE #1 "        <register address='0xbbf1034' value='0x" DATA.LONG(A:0xbf1034) "' name='RPMH_BCM_STATUS_CE_DRV3_CTT5'/>"
WRITE #1 "        <register address='0xbbf1038' value='0x" DATA.LONG(A:0xbf1038) "' name='RPMH_BCM_STATUS_CE_DRV3_CTT6'/>"
WRITE #1 "        <register address='0xbbf103c' value='0x" DATA.LONG(A:0xbf103c) "' name='RPMH_BCM_STATUS_CE_DRV3_CTT7'/>"
WRITE #1 "        <register address='0xbbf1040' value='0x" DATA.LONG(A:0xbf1040) "' name='RPMH_BCM_STATUS_CE_DRV3_CTT8'/>"
WRITE #1 "        <register address='0xbbf1044' value='0x" DATA.LONG(A:0xbf1044) "' name='RPMH_BCM_STATUS_CE_DRV3_CTT9'/>"
WRITE #1 "        <register address='0xbbf1048' value='0x" DATA.LONG(A:0xbf1048) "' name='RPMH_BCM_STATUS_CE_DRV3_CTT10'/>"
WRITE #1 "        <register address='0xbbf104c' value='0x" DATA.LONG(A:0xbf104c) "' name='RPMH_BCM_STATUS_CE_DRV3_CTT11'/>"
WRITE #1 "        <register address='0xbbf1050' value='0x" DATA.LONG(A:0xbf1050) "' name='RPMH_BCM_STATUS_CE_DRV3_CTT12'/>"
WRITE #1 "        <register address='0xbbf1054' value='0x" DATA.LONG(A:0xbf1054) "' name='RPMH_BCM_STATUS_CE_DRV3_CTT13'/>"
WRITE #1 "        <register address='0xbbf1058' value='0x" DATA.LONG(A:0xbf1058) "' name='RPMH_BCM_STATUS_CE_DRV3_CTT14'/>"
WRITE #1 "        <register address='0xbbf105c' value='0x" DATA.LONG(A:0xbf105c) "' name='RPMH_BCM_STATUS_CE_DRV3_CTT15'/>"
WRITE #1 "        <register address='0xbbf1060' value='0x" DATA.LONG(A:0xbf1060) "' name='RPMH_BCM_STATUS_CE_DRV3_CTT16'/>"
WRITE #1 "        <register address='0xbbf1064' value='0x" DATA.LONG(A:0xbf1064) "' name='RPMH_BCM_STATUS_CE_DRV3_CTT17'/>"
WRITE #1 "        <register address='0xbbf1068' value='0x" DATA.LONG(A:0xbf1068) "' name='RPMH_BCM_STATUS_CE_DRV3_CTT18'/>"
WRITE #1 "        <register address='0xbbf106c' value='0x" DATA.LONG(A:0xbf106c) "' name='RPMH_BCM_STATUS_CE_DRV3_CTT19'/>"
WRITE #1 "        <register address='0xbbf1070' value='0x" DATA.LONG(A:0xbf1070) "' name='RPMH_BCM_STATUS_CE_DRV3_CTT20'/>"
WRITE #1 "        <register address='0xbbf1074' value='0x" DATA.LONG(A:0xbf1074) "' name='RPMH_BCM_STATUS_CE_DRV3_CTT21'/>"
WRITE #1 "        <register address='0xbbf1078' value='0x" DATA.LONG(A:0xbf1078) "' name='RPMH_BCM_STATUS_CE_DRV3_CTT22'/>"
WRITE #1 "        <register address='0xbbf107c' value='0x" DATA.LONG(A:0xbf107c) "' name='RPMH_BCM_STATUS_CE_DRV3_CTT23'/>"
WRITE #1 "        <register address='0xbbf1080' value='0x" DATA.LONG(A:0xbf1080) "' name='RPMH_BCM_STATUS_CE_DRV4_CTT0'/>"
WRITE #1 "        <register address='0xbbf1084' value='0x" DATA.LONG(A:0xbf1084) "' name='RPMH_BCM_STATUS_CE_DRV4_CTT1'/>"
WRITE #1 "        <register address='0xbbf1088' value='0x" DATA.LONG(A:0xbf1088) "' name='RPMH_BCM_STATUS_CE_DRV4_CTT2'/>"
WRITE #1 "        <register address='0xbbf108c' value='0x" DATA.LONG(A:0xbf108c) "' name='RPMH_BCM_STATUS_CE_DRV4_CTT3'/>"
WRITE #1 "        <register address='0xbbf1090' value='0x" DATA.LONG(A:0xbf1090) "' name='RPMH_BCM_STATUS_CE_DRV4_CTT4'/>"
WRITE #1 "        <register address='0xbbf1094' value='0x" DATA.LONG(A:0xbf1094) "' name='RPMH_BCM_STATUS_CE_DRV4_CTT5'/>"
WRITE #1 "        <register address='0xbbf1098' value='0x" DATA.LONG(A:0xbf1098) "' name='RPMH_BCM_STATUS_CE_DRV4_CTT6'/>"
WRITE #1 "        <register address='0xbbf109c' value='0x" DATA.LONG(A:0xbf109c) "' name='RPMH_BCM_STATUS_CE_DRV4_CTT7'/>"
WRITE #1 "        <register address='0xbbf10a0' value='0x" DATA.LONG(A:0xbf10a0) "' name='RPMH_BCM_STATUS_CE_DRV4_CTT8'/>"
WRITE #1 "        <register address='0xbbf10a4' value='0x" DATA.LONG(A:0xbf10a4) "' name='RPMH_BCM_STATUS_CE_DRV4_CTT9'/>"
WRITE #1 "        <register address='0xbbf10a8' value='0x" DATA.LONG(A:0xbf10a8) "' name='RPMH_BCM_STATUS_CE_DRV4_CTT10'/>"
WRITE #1 "        <register address='0xbbf10ac' value='0x" DATA.LONG(A:0xbf10ac) "' name='RPMH_BCM_STATUS_CE_DRV4_CTT11'/>"
WRITE #1 "        <register address='0xbbf10b0' value='0x" DATA.LONG(A:0xbf10b0) "' name='RPMH_BCM_STATUS_CE_DRV4_CTT12'/>"
WRITE #1 "        <register address='0xbbf10b4' value='0x" DATA.LONG(A:0xbf10b4) "' name='RPMH_BCM_STATUS_CE_DRV4_CTT13'/>"
WRITE #1 "        <register address='0xbbf10b8' value='0x" DATA.LONG(A:0xbf10b8) "' name='RPMH_BCM_STATUS_CE_DRV4_CTT14'/>"
WRITE #1 "        <register address='0xbbf10bc' value='0x" DATA.LONG(A:0xbf10bc) "' name='RPMH_BCM_STATUS_CE_DRV4_CTT15'/>"
WRITE #1 "        <register address='0xbbf10c0' value='0x" DATA.LONG(A:0xbf10c0) "' name='RPMH_BCM_STATUS_CE_DRV4_CTT16'/>"
WRITE #1 "        <register address='0xbbf10c4' value='0x" DATA.LONG(A:0xbf10c4) "' name='RPMH_BCM_STATUS_CE_DRV4_CTT17'/>"
WRITE #1 "        <register address='0xbbf10c8' value='0x" DATA.LONG(A:0xbf10c8) "' name='RPMH_BCM_STATUS_CE_DRV4_CTT18'/>"
WRITE #1 "        <register address='0xbbf10cc' value='0x" DATA.LONG(A:0xbf10cc) "' name='RPMH_BCM_STATUS_CE_DRV4_CTT19'/>"
WRITE #1 "        <register address='0xbbf10d0' value='0x" DATA.LONG(A:0xbf10d0) "' name='RPMH_BCM_STATUS_CE_DRV4_CTT20'/>"
WRITE #1 "        <register address='0xbbf10d4' value='0x" DATA.LONG(A:0xbf10d4) "' name='RPMH_BCM_STATUS_CE_DRV4_CTT21'/>"
WRITE #1 "        <register address='0xbbf10d8' value='0x" DATA.LONG(A:0xbf10d8) "' name='RPMH_BCM_STATUS_CE_DRV4_CTT22'/>"
WRITE #1 "        <register address='0xbbf10dc' value='0x" DATA.LONG(A:0xbf10dc) "' name='RPMH_BCM_STATUS_CE_DRV4_CTT23'/>"
WRITE #1 "        <register address='0xbbf10e0' value='0x" DATA.LONG(A:0xbf10e0) "' name='RPMH_BCM_STATUS_CE_DRV5_CTT0'/>"
WRITE #1 "        <register address='0xbbf10e4' value='0x" DATA.LONG(A:0xbf10e4) "' name='RPMH_BCM_STATUS_CE_DRV5_CTT1'/>"
WRITE #1 "        <register address='0xbbf10e8' value='0x" DATA.LONG(A:0xbf10e8) "' name='RPMH_BCM_STATUS_CE_DRV5_CTT2'/>"
WRITE #1 "        <register address='0xbbf10ec' value='0x" DATA.LONG(A:0xbf10ec) "' name='RPMH_BCM_STATUS_CE_DRV5_CTT3'/>"
WRITE #1 "        <register address='0xbbf10f0' value='0x" DATA.LONG(A:0xbf10f0) "' name='RPMH_BCM_STATUS_CE_DRV5_CTT4'/>"
WRITE #1 "        <register address='0xbbf10f4' value='0x" DATA.LONG(A:0xbf10f4) "' name='RPMH_BCM_STATUS_CE_DRV5_CTT5'/>"
WRITE #1 "        <register address='0xbbf10f8' value='0x" DATA.LONG(A:0xbf10f8) "' name='RPMH_BCM_STATUS_CE_DRV5_CTT6'/>"
WRITE #1 "        <register address='0xbbf10fc' value='0x" DATA.LONG(A:0xbf10fc) "' name='RPMH_BCM_STATUS_CE_DRV5_CTT7'/>"
WRITE #1 "        <register address='0xbbf1100' value='0x" DATA.LONG(A:0xbf1100) "' name='RPMH_BCM_STATUS_CE_DRV5_CTT8'/>"
WRITE #1 "        <register address='0xbbf1104' value='0x" DATA.LONG(A:0xbf1104) "' name='RPMH_BCM_STATUS_CE_DRV5_CTT9'/>"
WRITE #1 "        <register address='0xbbf1108' value='0x" DATA.LONG(A:0xbf1108) "' name='RPMH_BCM_STATUS_CE_DRV5_CTT10'/>"
WRITE #1 "        <register address='0xbbf110c' value='0x" DATA.LONG(A:0xbf110c) "' name='RPMH_BCM_STATUS_CE_DRV5_CTT11'/>"
WRITE #1 "        <register address='0xbbf1110' value='0x" DATA.LONG(A:0xbf1110) "' name='RPMH_BCM_STATUS_CE_DRV5_CTT12'/>"
WRITE #1 "        <register address='0xbbf1114' value='0x" DATA.LONG(A:0xbf1114) "' name='RPMH_BCM_STATUS_CE_DRV5_CTT13'/>"
WRITE #1 "        <register address='0xbbf1118' value='0x" DATA.LONG(A:0xbf1118) "' name='RPMH_BCM_STATUS_CE_DRV5_CTT14'/>"
WRITE #1 "        <register address='0xbbf111c' value='0x" DATA.LONG(A:0xbf111c) "' name='RPMH_BCM_STATUS_CE_DRV5_CTT15'/>"
WRITE #1 "        <register address='0xbbf1120' value='0x" DATA.LONG(A:0xbf1120) "' name='RPMH_BCM_STATUS_CE_DRV5_CTT16'/>"
WRITE #1 "        <register address='0xbbf1124' value='0x" DATA.LONG(A:0xbf1124) "' name='RPMH_BCM_STATUS_CE_DRV5_CTT17'/>"
WRITE #1 "        <register address='0xbbf1128' value='0x" DATA.LONG(A:0xbf1128) "' name='RPMH_BCM_STATUS_CE_DRV5_CTT18'/>"
WRITE #1 "        <register address='0xbbf112c' value='0x" DATA.LONG(A:0xbf112c) "' name='RPMH_BCM_STATUS_CE_DRV5_CTT19'/>"
WRITE #1 "        <register address='0xbbf1130' value='0x" DATA.LONG(A:0xbf1130) "' name='RPMH_BCM_STATUS_CE_DRV5_CTT20'/>"
WRITE #1 "        <register address='0xbbf1134' value='0x" DATA.LONG(A:0xbf1134) "' name='RPMH_BCM_STATUS_CE_DRV5_CTT21'/>"
WRITE #1 "        <register address='0xbbf1138' value='0x" DATA.LONG(A:0xbf1138) "' name='RPMH_BCM_STATUS_CE_DRV5_CTT22'/>"
WRITE #1 "        <register address='0xbbf113c' value='0x" DATA.LONG(A:0xbf113c) "' name='RPMH_BCM_STATUS_CE_DRV5_CTT23'/>"
WRITE #1 "        <register address='0xbbf1140' value='0x" DATA.LONG(A:0xbf1140) "' name='RPMH_BCM_STATUS_CE_DRV6_CTT0'/>"
WRITE #1 "        <register address='0xbbf1144' value='0x" DATA.LONG(A:0xbf1144) "' name='RPMH_BCM_STATUS_CE_DRV6_CTT1'/>"
WRITE #1 "        <register address='0xbbf1148' value='0x" DATA.LONG(A:0xbf1148) "' name='RPMH_BCM_STATUS_CE_DRV6_CTT2'/>"
WRITE #1 "        <register address='0xbbf114c' value='0x" DATA.LONG(A:0xbf114c) "' name='RPMH_BCM_STATUS_CE_DRV6_CTT3'/>"
WRITE #1 "        <register address='0xbbf1150' value='0x" DATA.LONG(A:0xbf1150) "' name='RPMH_BCM_STATUS_CE_DRV6_CTT4'/>"
WRITE #1 "        <register address='0xbbf1154' value='0x" DATA.LONG(A:0xbf1154) "' name='RPMH_BCM_STATUS_CE_DRV6_CTT5'/>"
WRITE #1 "        <register address='0xbbf1158' value='0x" DATA.LONG(A:0xbf1158) "' name='RPMH_BCM_STATUS_CE_DRV6_CTT6'/>"
WRITE #1 "        <register address='0xbbf115c' value='0x" DATA.LONG(A:0xbf115c) "' name='RPMH_BCM_STATUS_CE_DRV6_CTT7'/>"
WRITE #1 "        <register address='0xbbf1160' value='0x" DATA.LONG(A:0xbf1160) "' name='RPMH_BCM_STATUS_CE_DRV6_CTT8'/>"
WRITE #1 "        <register address='0xbbf1164' value='0x" DATA.LONG(A:0xbf1164) "' name='RPMH_BCM_STATUS_CE_DRV6_CTT9'/>"
WRITE #1 "        <register address='0xbbf1168' value='0x" DATA.LONG(A:0xbf1168) "' name='RPMH_BCM_STATUS_CE_DRV6_CTT10'/>"
WRITE #1 "        <register address='0xbbf116c' value='0x" DATA.LONG(A:0xbf116c) "' name='RPMH_BCM_STATUS_CE_DRV6_CTT11'/>"
WRITE #1 "        <register address='0xbbf1170' value='0x" DATA.LONG(A:0xbf1170) "' name='RPMH_BCM_STATUS_CE_DRV6_CTT12'/>"
WRITE #1 "        <register address='0xbbf1174' value='0x" DATA.LONG(A:0xbf1174) "' name='RPMH_BCM_STATUS_CE_DRV6_CTT13'/>"
WRITE #1 "        <register address='0xbbf1178' value='0x" DATA.LONG(A:0xbf1178) "' name='RPMH_BCM_STATUS_CE_DRV6_CTT14'/>"
WRITE #1 "        <register address='0xbbf117c' value='0x" DATA.LONG(A:0xbf117c) "' name='RPMH_BCM_STATUS_CE_DRV6_CTT15'/>"
WRITE #1 "        <register address='0xbbf1180' value='0x" DATA.LONG(A:0xbf1180) "' name='RPMH_BCM_STATUS_CE_DRV6_CTT16'/>"
WRITE #1 "        <register address='0xbbf1184' value='0x" DATA.LONG(A:0xbf1184) "' name='RPMH_BCM_STATUS_CE_DRV6_CTT17'/>"
WRITE #1 "        <register address='0xbbf1188' value='0x" DATA.LONG(A:0xbf1188) "' name='RPMH_BCM_STATUS_CE_DRV6_CTT18'/>"
WRITE #1 "        <register address='0xbbf118c' value='0x" DATA.LONG(A:0xbf118c) "' name='RPMH_BCM_STATUS_CE_DRV6_CTT19'/>"
WRITE #1 "        <register address='0xbbf1190' value='0x" DATA.LONG(A:0xbf1190) "' name='RPMH_BCM_STATUS_CE_DRV6_CTT20'/>"
WRITE #1 "        <register address='0xbbf1194' value='0x" DATA.LONG(A:0xbf1194) "' name='RPMH_BCM_STATUS_CE_DRV6_CTT21'/>"
WRITE #1 "        <register address='0xbbf1198' value='0x" DATA.LONG(A:0xbf1198) "' name='RPMH_BCM_STATUS_CE_DRV6_CTT22'/>"
WRITE #1 "        <register address='0xbbf119c' value='0x" DATA.LONG(A:0xbf119c) "' name='RPMH_BCM_STATUS_CE_DRV6_CTT23'/>"
WRITE #1 "        <register address='0xbbf11a0' value='0x" DATA.LONG(A:0xbf11a0) "' name='RPMH_BCM_STATUS_CE_DRV7_CTT0'/>"
WRITE #1 "        <register address='0xbbf11a4' value='0x" DATA.LONG(A:0xbf11a4) "' name='RPMH_BCM_STATUS_CE_DRV7_CTT1'/>"
WRITE #1 "        <register address='0xbbf11a8' value='0x" DATA.LONG(A:0xbf11a8) "' name='RPMH_BCM_STATUS_CE_DRV7_CTT2'/>"
WRITE #1 "        <register address='0xbbf11ac' value='0x" DATA.LONG(A:0xbf11ac) "' name='RPMH_BCM_STATUS_CE_DRV7_CTT3'/>"
WRITE #1 "        <register address='0xbbf11b0' value='0x" DATA.LONG(A:0xbf11b0) "' name='RPMH_BCM_STATUS_CE_DRV7_CTT4'/>"
WRITE #1 "        <register address='0xbbf11b4' value='0x" DATA.LONG(A:0xbf11b4) "' name='RPMH_BCM_STATUS_CE_DRV7_CTT5'/>"
WRITE #1 "        <register address='0xbbf11b8' value='0x" DATA.LONG(A:0xbf11b8) "' name='RPMH_BCM_STATUS_CE_DRV7_CTT6'/>"
WRITE #1 "        <register address='0xbbf11bc' value='0x" DATA.LONG(A:0xbf11bc) "' name='RPMH_BCM_STATUS_CE_DRV7_CTT7'/>"
WRITE #1 "        <register address='0xbbf11c0' value='0x" DATA.LONG(A:0xbf11c0) "' name='RPMH_BCM_STATUS_CE_DRV7_CTT8'/>"
WRITE #1 "        <register address='0xbbf11c4' value='0x" DATA.LONG(A:0xbf11c4) "' name='RPMH_BCM_STATUS_CE_DRV7_CTT9'/>"
WRITE #1 "        <register address='0xbbf11c8' value='0x" DATA.LONG(A:0xbf11c8) "' name='RPMH_BCM_STATUS_CE_DRV7_CTT10'/>"
WRITE #1 "        <register address='0xbbf11cc' value='0x" DATA.LONG(A:0xbf11cc) "' name='RPMH_BCM_STATUS_CE_DRV7_CTT11'/>"
WRITE #1 "        <register address='0xbbf11d0' value='0x" DATA.LONG(A:0xbf11d0) "' name='RPMH_BCM_STATUS_CE_DRV7_CTT12'/>"
WRITE #1 "        <register address='0xbbf11d4' value='0x" DATA.LONG(A:0xbf11d4) "' name='RPMH_BCM_STATUS_CE_DRV7_CTT13'/>"
WRITE #1 "        <register address='0xbbf11d8' value='0x" DATA.LONG(A:0xbf11d8) "' name='RPMH_BCM_STATUS_CE_DRV7_CTT14'/>"
WRITE #1 "        <register address='0xbbf11dc' value='0x" DATA.LONG(A:0xbf11dc) "' name='RPMH_BCM_STATUS_CE_DRV7_CTT15'/>"
WRITE #1 "        <register address='0xbbf11e0' value='0x" DATA.LONG(A:0xbf11e0) "' name='RPMH_BCM_STATUS_CE_DRV7_CTT16'/>"
WRITE #1 "        <register address='0xbbf11e4' value='0x" DATA.LONG(A:0xbf11e4) "' name='RPMH_BCM_STATUS_CE_DRV7_CTT17'/>"
WRITE #1 "        <register address='0xbbf11e8' value='0x" DATA.LONG(A:0xbf11e8) "' name='RPMH_BCM_STATUS_CE_DRV7_CTT18'/>"
WRITE #1 "        <register address='0xbbf11ec' value='0x" DATA.LONG(A:0xbf11ec) "' name='RPMH_BCM_STATUS_CE_DRV7_CTT19'/>"
WRITE #1 "        <register address='0xbbf11f0' value='0x" DATA.LONG(A:0xbf11f0) "' name='RPMH_BCM_STATUS_CE_DRV7_CTT20'/>"
WRITE #1 "        <register address='0xbbf11f4' value='0x" DATA.LONG(A:0xbf11f4) "' name='RPMH_BCM_STATUS_CE_DRV7_CTT21'/>"
WRITE #1 "        <register address='0xbbf11f8' value='0x" DATA.LONG(A:0xbf11f8) "' name='RPMH_BCM_STATUS_CE_DRV7_CTT22'/>"
WRITE #1 "        <register address='0xbbf11fc' value='0x" DATA.LONG(A:0xbf11fc) "' name='RPMH_BCM_STATUS_CE_DRV7_CTT23'/>"
WRITE #1 "        <register address='0xbbf1200' value='0x" DATA.LONG(A:0xbf1200) "' name='RPMH_BCM_STATUS_CE_DRV8_CTT0'/>"
WRITE #1 "        <register address='0xbbf1204' value='0x" DATA.LONG(A:0xbf1204) "' name='RPMH_BCM_STATUS_CE_DRV8_CTT1'/>"
WRITE #1 "        <register address='0xbbf1208' value='0x" DATA.LONG(A:0xbf1208) "' name='RPMH_BCM_STATUS_CE_DRV8_CTT2'/>"
WRITE #1 "        <register address='0xbbf120c' value='0x" DATA.LONG(A:0xbf120c) "' name='RPMH_BCM_STATUS_CE_DRV8_CTT3'/>"
WRITE #1 "        <register address='0xbbf1210' value='0x" DATA.LONG(A:0xbf1210) "' name='RPMH_BCM_STATUS_CE_DRV8_CTT4'/>"
WRITE #1 "        <register address='0xbbf1214' value='0x" DATA.LONG(A:0xbf1214) "' name='RPMH_BCM_STATUS_CE_DRV8_CTT5'/>"
WRITE #1 "        <register address='0xbbf1218' value='0x" DATA.LONG(A:0xbf1218) "' name='RPMH_BCM_STATUS_CE_DRV8_CTT6'/>"
WRITE #1 "        <register address='0xbbf121c' value='0x" DATA.LONG(A:0xbf121c) "' name='RPMH_BCM_STATUS_CE_DRV8_CTT7'/>"
WRITE #1 "        <register address='0xbbf1220' value='0x" DATA.LONG(A:0xbf1220) "' name='RPMH_BCM_STATUS_CE_DRV8_CTT8'/>"
WRITE #1 "        <register address='0xbbf1224' value='0x" DATA.LONG(A:0xbf1224) "' name='RPMH_BCM_STATUS_CE_DRV8_CTT9'/>"
WRITE #1 "        <register address='0xbbf1228' value='0x" DATA.LONG(A:0xbf1228) "' name='RPMH_BCM_STATUS_CE_DRV8_CTT10'/>"
WRITE #1 "        <register address='0xbbf122c' value='0x" DATA.LONG(A:0xbf122c) "' name='RPMH_BCM_STATUS_CE_DRV8_CTT11'/>"
WRITE #1 "        <register address='0xbbf1230' value='0x" DATA.LONG(A:0xbf1230) "' name='RPMH_BCM_STATUS_CE_DRV8_CTT12'/>"
WRITE #1 "        <register address='0xbbf1234' value='0x" DATA.LONG(A:0xbf1234) "' name='RPMH_BCM_STATUS_CE_DRV8_CTT13'/>"
WRITE #1 "        <register address='0xbbf1238' value='0x" DATA.LONG(A:0xbf1238) "' name='RPMH_BCM_STATUS_CE_DRV8_CTT14'/>"
WRITE #1 "        <register address='0xbbf123c' value='0x" DATA.LONG(A:0xbf123c) "' name='RPMH_BCM_STATUS_CE_DRV8_CTT15'/>"
WRITE #1 "        <register address='0xbbf1240' value='0x" DATA.LONG(A:0xbf1240) "' name='RPMH_BCM_STATUS_CE_DRV8_CTT16'/>"
WRITE #1 "        <register address='0xbbf1244' value='0x" DATA.LONG(A:0xbf1244) "' name='RPMH_BCM_STATUS_CE_DRV8_CTT17'/>"
WRITE #1 "        <register address='0xbbf1248' value='0x" DATA.LONG(A:0xbf1248) "' name='RPMH_BCM_STATUS_CE_DRV8_CTT18'/>"
WRITE #1 "        <register address='0xbbf124c' value='0x" DATA.LONG(A:0xbf124c) "' name='RPMH_BCM_STATUS_CE_DRV8_CTT19'/>"
WRITE #1 "        <register address='0xbbf1250' value='0x" DATA.LONG(A:0xbf1250) "' name='RPMH_BCM_STATUS_CE_DRV8_CTT20'/>"
WRITE #1 "        <register address='0xbbf1254' value='0x" DATA.LONG(A:0xbf1254) "' name='RPMH_BCM_STATUS_CE_DRV8_CTT21'/>"
WRITE #1 "        <register address='0xbbf1258' value='0x" DATA.LONG(A:0xbf1258) "' name='RPMH_BCM_STATUS_CE_DRV8_CTT22'/>"
WRITE #1 "        <register address='0xbbf125c' value='0x" DATA.LONG(A:0xbf125c) "' name='RPMH_BCM_STATUS_CE_DRV8_CTT23'/>"
WRITE #1 "        <register address='0xbbf1260' value='0x" DATA.LONG(A:0xbf1260) "' name='RPMH_BCM_STATUS_CE_DRV9_CTT0'/>"
WRITE #1 "        <register address='0xbbf1264' value='0x" DATA.LONG(A:0xbf1264) "' name='RPMH_BCM_STATUS_CE_DRV9_CTT1'/>"
WRITE #1 "        <register address='0xbbf1268' value='0x" DATA.LONG(A:0xbf1268) "' name='RPMH_BCM_STATUS_CE_DRV9_CTT2'/>"
WRITE #1 "        <register address='0xbbf126c' value='0x" DATA.LONG(A:0xbf126c) "' name='RPMH_BCM_STATUS_CE_DRV9_CTT3'/>"
WRITE #1 "        <register address='0xbbf1270' value='0x" DATA.LONG(A:0xbf1270) "' name='RPMH_BCM_STATUS_CE_DRV9_CTT4'/>"
WRITE #1 "        <register address='0xbbf1274' value='0x" DATA.LONG(A:0xbf1274) "' name='RPMH_BCM_STATUS_CE_DRV9_CTT5'/>"
WRITE #1 "        <register address='0xbbf1278' value='0x" DATA.LONG(A:0xbf1278) "' name='RPMH_BCM_STATUS_CE_DRV9_CTT6'/>"
WRITE #1 "        <register address='0xbbf127c' value='0x" DATA.LONG(A:0xbf127c) "' name='RPMH_BCM_STATUS_CE_DRV9_CTT7'/>"
WRITE #1 "        <register address='0xbbf1280' value='0x" DATA.LONG(A:0xbf1280) "' name='RPMH_BCM_STATUS_CE_DRV9_CTT8'/>"
WRITE #1 "        <register address='0xbbf1284' value='0x" DATA.LONG(A:0xbf1284) "' name='RPMH_BCM_STATUS_CE_DRV9_CTT9'/>"
WRITE #1 "        <register address='0xbbf1288' value='0x" DATA.LONG(A:0xbf1288) "' name='RPMH_BCM_STATUS_CE_DRV9_CTT10'/>"
WRITE #1 "        <register address='0xbbf128c' value='0x" DATA.LONG(A:0xbf128c) "' name='RPMH_BCM_STATUS_CE_DRV9_CTT11'/>"
WRITE #1 "        <register address='0xbbf1290' value='0x" DATA.LONG(A:0xbf1290) "' name='RPMH_BCM_STATUS_CE_DRV9_CTT12'/>"
WRITE #1 "        <register address='0xbbf1294' value='0x" DATA.LONG(A:0xbf1294) "' name='RPMH_BCM_STATUS_CE_DRV9_CTT13'/>"
WRITE #1 "        <register address='0xbbf1298' value='0x" DATA.LONG(A:0xbf1298) "' name='RPMH_BCM_STATUS_CE_DRV9_CTT14'/>"
WRITE #1 "        <register address='0xbbf129c' value='0x" DATA.LONG(A:0xbf129c) "' name='RPMH_BCM_STATUS_CE_DRV9_CTT15'/>"
WRITE #1 "        <register address='0xbbf12a0' value='0x" DATA.LONG(A:0xbf12a0) "' name='RPMH_BCM_STATUS_CE_DRV9_CTT16'/>"
WRITE #1 "        <register address='0xbbf12a4' value='0x" DATA.LONG(A:0xbf12a4) "' name='RPMH_BCM_STATUS_CE_DRV9_CTT17'/>"
WRITE #1 "        <register address='0xbbf12a8' value='0x" DATA.LONG(A:0xbf12a8) "' name='RPMH_BCM_STATUS_CE_DRV9_CTT18'/>"
WRITE #1 "        <register address='0xbbf12ac' value='0x" DATA.LONG(A:0xbf12ac) "' name='RPMH_BCM_STATUS_CE_DRV9_CTT19'/>"
WRITE #1 "        <register address='0xbbf12b0' value='0x" DATA.LONG(A:0xbf12b0) "' name='RPMH_BCM_STATUS_CE_DRV9_CTT20'/>"
WRITE #1 "        <register address='0xbbf12b4' value='0x" DATA.LONG(A:0xbf12b4) "' name='RPMH_BCM_STATUS_CE_DRV9_CTT21'/>"
WRITE #1 "        <register address='0xbbf12b8' value='0x" DATA.LONG(A:0xbf12b8) "' name='RPMH_BCM_STATUS_CE_DRV9_CTT22'/>"
WRITE #1 "        <register address='0xbbf12bc' value='0x" DATA.LONG(A:0xbf12bc) "' name='RPMH_BCM_STATUS_CE_DRV9_CTT23'/>"
WRITE #1 "        <register address='0xbbf1700' value='0x" DATA.LONG(A:0xbf1700) "' name='RPMH_BCM_STATUS_CE'/>"
WRITE #1 "        <register address='0xbbf1704' value='0x" DATA.LONG(A:0xbf1704) "' name='RPMH_BCM_STATUS_BCM'/>"
WRITE #1 "        <register address='0xbbf1708' value='0x" DATA.LONG(A:0xbf1708) "' name='RPMH_BCM_HW_VERSION'/>"
WRITE #1 "        <register address='0xbbf1f00' value='0x" DATA.LONG(A:0xbf1f00) "' name='RPMH_BCM_INTERRUPT_AGG_DONE_INT_EN'/>"
WRITE #1 "        <register address='0xbbf1f04' value='0x" DATA.LONG(A:0xbf1f04) "' name='RPMH_BCM_INTERRUPT_CP_CHANGE_DONE_INT_EN'/>"
WRITE #1 "        <register address='0xbbf1f08' value='0x" DATA.LONG(A:0xbf1f08) "' name='RPMH_BCM_INTERRUPT_CTT_FULL_INT_EN'/>"
WRITE #1 "        <register address='0xbbf1f0c' value='0x" DATA.LONG(A:0xbf1f0c) "' name='RPMH_BCM_INTERRUPT_SEQ_GENERIC_INT_0_EN'/>"
WRITE #1 "        <register address='0xbbf1f10' value='0x" DATA.LONG(A:0xbf1f10) "' name='RPMH_BCM_INTERRUPT_SEQ_GENERIC_INT_1_EN'/>"
WRITE #1 "        <register address='0xbbf1f14' value='0x" DATA.LONG(A:0xbf1f14) "' name='RPMH_BCM_INTERRUPT_STOP_AGG_ACK_INT_EN'/>"
WRITE #1 "        <register address='0xbbf1f18' value='0x" DATA.LONG(A:0xbf1f18) "' name='RPMH_BCM_INTERRUPT_SW_CP_CHANGE_DONE_INT_EN'/>"
WRITE #1 "        <register address='0xbbf1f40' value='0x" DATA.LONG(A:0xbf1f40) "' name='RPMH_BCM_INTERRUPT_AGG_DONE_INT_STATUS'/>"
WRITE #1 "        <register address='0xbbf1f44' value='0x" DATA.LONG(A:0xbf1f44) "' name='RPMH_BCM_INTERRUPT_CP_CHANGE_DONE_INT_STATUS'/>"
WRITE #1 "        <register address='0xbbf1f48' value='0x" DATA.LONG(A:0xbf1f48) "' name='RPMH_BCM_INTERRUPT_CTT_FULL_INT_STATUS'/>"
WRITE #1 "        <register address='0xbbf1f4c' value='0x" DATA.LONG(A:0xbf1f4c) "' name='RPMH_BCM_INTERRUPT_SEQ_GENERIC_INT_0_STATUS'/>"
WRITE #1 "        <register address='0xbbf1f50' value='0x" DATA.LONG(A:0xbf1f50) "' name='RPMH_BCM_INTERRUPT_SEQ_GENERIC_INT_1_STATUS'/>"
WRITE #1 "        <register address='0xbbf1f54' value='0x" DATA.LONG(A:0xbf1f54) "' name='RPMH_BCM_INTERRUPT_STOP_AGG_ACK_INT_STATUS'/>"
WRITE #1 "        <register address='0xbbf1f58' value='0x" DATA.LONG(A:0xbf1f58) "' name='RPMH_BCM_INTERRUPT_SW_CP_CHANGE_DONE_INT_STATUS'/>"
WRITE #1 "        <register address='0xbbf2000' value='0x" DATA.LONG(A:0xbf2000) "' name='RPMH_BCM_AU_INST_MEM0'/>"
WRITE #1 "        <register address='0xbbf2004' value='0x" DATA.LONG(A:0xbf2004) "' name='RPMH_BCM_AU_INST_MEM1'/>"
WRITE #1 "        <register address='0xbbf2008' value='0x" DATA.LONG(A:0xbf2008) "' name='RPMH_BCM_AU_INST_MEM2'/>"
WRITE #1 "        <register address='0xbbf200c' value='0x" DATA.LONG(A:0xbf200c) "' name='RPMH_BCM_AU_INST_MEM3'/>"
WRITE #1 "        <register address='0xbbf2010' value='0x" DATA.LONG(A:0xbf2010) "' name='RPMH_BCM_AU_INST_MEM4'/>"
WRITE #1 "        <register address='0xbbf2014' value='0x" DATA.LONG(A:0xbf2014) "' name='RPMH_BCM_AU_INST_MEM5'/>"
WRITE #1 "        <register address='0xbbf2018' value='0x" DATA.LONG(A:0xbf2018) "' name='RPMH_BCM_AU_INST_MEM6'/>"
WRITE #1 "        <register address='0xbbf201c' value='0x" DATA.LONG(A:0xbf201c) "' name='RPMH_BCM_AU_INST_MEM7'/>"
WRITE #1 "        <register address='0xbbf2020' value='0x" DATA.LONG(A:0xbf2020) "' name='RPMH_BCM_AU_INST_MEM8'/>"
WRITE #1 "        <register address='0xbbf2024' value='0x" DATA.LONG(A:0xbf2024) "' name='RPMH_BCM_AU_INST_MEM9'/>"
WRITE #1 "        <register address='0xbbf2028' value='0x" DATA.LONG(A:0xbf2028) "' name='RPMH_BCM_AU_INST_MEM10'/>"
WRITE #1 "        <register address='0xbbf202c' value='0x" DATA.LONG(A:0xbf202c) "' name='RPMH_BCM_AU_INST_MEM11'/>"
WRITE #1 "        <register address='0xbbf2030' value='0x" DATA.LONG(A:0xbf2030) "' name='RPMH_BCM_AU_INST_MEM12'/>"
WRITE #1 "        <register address='0xbbf2034' value='0x" DATA.LONG(A:0xbf2034) "' name='RPMH_BCM_AU_INST_MEM13'/>"
WRITE #1 "        <register address='0xbbf2038' value='0x" DATA.LONG(A:0xbf2038) "' name='RPMH_BCM_AU_INST_MEM14'/>"
WRITE #1 "        <register address='0xbbf203c' value='0x" DATA.LONG(A:0xbf203c) "' name='RPMH_BCM_AU_INST_MEM15'/>"
WRITE #1 "        <register address='0xbbf2040' value='0x" DATA.LONG(A:0xbf2040) "' name='RPMH_BCM_AU_INST_MEM16'/>"
WRITE #1 "        <register address='0xbbf2044' value='0x" DATA.LONG(A:0xbf2044) "' name='RPMH_BCM_AU_INST_MEM17'/>"
WRITE #1 "        <register address='0xbbf2048' value='0x" DATA.LONG(A:0xbf2048) "' name='RPMH_BCM_AU_INST_MEM18'/>"
WRITE #1 "        <register address='0xbbf204c' value='0x" DATA.LONG(A:0xbf204c) "' name='RPMH_BCM_AU_INST_MEM19'/>"
WRITE #1 "        <register address='0xbbf2050' value='0x" DATA.LONG(A:0xbf2050) "' name='RPMH_BCM_AU_INST_MEM20'/>"
WRITE #1 "        <register address='0xbbf2054' value='0x" DATA.LONG(A:0xbf2054) "' name='RPMH_BCM_AU_INST_MEM21'/>"
WRITE #1 "        <register address='0xbbf2058' value='0x" DATA.LONG(A:0xbf2058) "' name='RPMH_BCM_AU_INST_MEM22'/>"
WRITE #1 "        <register address='0xbbf205c' value='0x" DATA.LONG(A:0xbf205c) "' name='RPMH_BCM_AU_INST_MEM23'/>"
WRITE #1 "        <register address='0xbbf2060' value='0x" DATA.LONG(A:0xbf2060) "' name='RPMH_BCM_AU_INST_MEM24'/>"
WRITE #1 "        <register address='0xbbf2064' value='0x" DATA.LONG(A:0xbf2064) "' name='RPMH_BCM_AU_INST_MEM25'/>"
WRITE #1 "        <register address='0xbbf2068' value='0x" DATA.LONG(A:0xbf2068) "' name='RPMH_BCM_AU_INST_MEM26'/>"
WRITE #1 "        <register address='0xbbf206c' value='0x" DATA.LONG(A:0xbf206c) "' name='RPMH_BCM_AU_INST_MEM27'/>"
WRITE #1 "        <register address='0xbbf2070' value='0x" DATA.LONG(A:0xbf2070) "' name='RPMH_BCM_AU_INST_MEM28'/>"
WRITE #1 "        <register address='0xbbf2074' value='0x" DATA.LONG(A:0xbf2074) "' name='RPMH_BCM_AU_INST_MEM29'/>"
WRITE #1 "        <register address='0xbbf2078' value='0x" DATA.LONG(A:0xbf2078) "' name='RPMH_BCM_AU_INST_MEM30'/>"
WRITE #1 "        <register address='0xbbf207c' value='0x" DATA.LONG(A:0xbf207c) "' name='RPMH_BCM_AU_INST_MEM31'/>"
WRITE #1 "        <register address='0xbbf2080' value='0x" DATA.LONG(A:0xbf2080) "' name='RPMH_BCM_AU_INST_MEM32'/>"
WRITE #1 "        <register address='0xbbf2084' value='0x" DATA.LONG(A:0xbf2084) "' name='RPMH_BCM_AU_INST_MEM33'/>"
WRITE #1 "        <register address='0xbbf2088' value='0x" DATA.LONG(A:0xbf2088) "' name='RPMH_BCM_AU_INST_MEM34'/>"
WRITE #1 "        <register address='0xbbf208c' value='0x" DATA.LONG(A:0xbf208c) "' name='RPMH_BCM_AU_INST_MEM35'/>"
WRITE #1 "        <register address='0xbbf2090' value='0x" DATA.LONG(A:0xbf2090) "' name='RPMH_BCM_AU_INST_MEM36'/>"
WRITE #1 "        <register address='0xbbf2094' value='0x" DATA.LONG(A:0xbf2094) "' name='RPMH_BCM_AU_INST_MEM37'/>"
WRITE #1 "        <register address='0xbbf2098' value='0x" DATA.LONG(A:0xbf2098) "' name='RPMH_BCM_AU_INST_MEM38'/>"
WRITE #1 "        <register address='0xbbf209c' value='0x" DATA.LONG(A:0xbf209c) "' name='RPMH_BCM_AU_INST_MEM39'/>"
WRITE #1 "        <register address='0xbbf20a0' value='0x" DATA.LONG(A:0xbf20a0) "' name='RPMH_BCM_AU_INST_MEM40'/>"
WRITE #1 "        <register address='0xbbf20a4' value='0x" DATA.LONG(A:0xbf20a4) "' name='RPMH_BCM_AU_INST_MEM41'/>"
WRITE #1 "        <register address='0xbbf20a8' value='0x" DATA.LONG(A:0xbf20a8) "' name='RPMH_BCM_AU_INST_MEM42'/>"
WRITE #1 "        <register address='0xbbf20ac' value='0x" DATA.LONG(A:0xbf20ac) "' name='RPMH_BCM_AU_INST_MEM43'/>"
WRITE #1 "        <register address='0xbbf20b0' value='0x" DATA.LONG(A:0xbf20b0) "' name='RPMH_BCM_AU_INST_MEM44'/>"
WRITE #1 "        <register address='0xbbf20b4' value='0x" DATA.LONG(A:0xbf20b4) "' name='RPMH_BCM_AU_INST_MEM45'/>"
WRITE #1 "        <register address='0xbbf20b8' value='0x" DATA.LONG(A:0xbf20b8) "' name='RPMH_BCM_AU_INST_MEM46'/>"
WRITE #1 "        <register address='0xbbf20bc' value='0x" DATA.LONG(A:0xbf20bc) "' name='RPMH_BCM_AU_INST_MEM47'/>"
WRITE #1 "        <register address='0xbbf20c0' value='0x" DATA.LONG(A:0xbf20c0) "' name='RPMH_BCM_AU_INST_MEM48'/>"
WRITE #1 "        <register address='0xbbf20c4' value='0x" DATA.LONG(A:0xbf20c4) "' name='RPMH_BCM_AU_INST_MEM49'/>"
WRITE #1 "        <register address='0xbbf20c8' value='0x" DATA.LONG(A:0xbf20c8) "' name='RPMH_BCM_AU_INST_MEM50'/>"
WRITE #1 "        <register address='0xbbf20cc' value='0x" DATA.LONG(A:0xbf20cc) "' name='RPMH_BCM_AU_INST_MEM51'/>"
WRITE #1 "        <register address='0xbbf20d0' value='0x" DATA.LONG(A:0xbf20d0) "' name='RPMH_BCM_AU_INST_MEM52'/>"
WRITE #1 "        <register address='0xbbf20d4' value='0x" DATA.LONG(A:0xbf20d4) "' name='RPMH_BCM_AU_INST_MEM53'/>"
WRITE #1 "        <register address='0xbbf20d8' value='0x" DATA.LONG(A:0xbf20d8) "' name='RPMH_BCM_AU_INST_MEM54'/>"
WRITE #1 "        <register address='0xbbf20dc' value='0x" DATA.LONG(A:0xbf20dc) "' name='RPMH_BCM_AU_INST_MEM55'/>"
WRITE #1 "        <register address='0xbbf20e0' value='0x" DATA.LONG(A:0xbf20e0) "' name='RPMH_BCM_AU_INST_MEM56'/>"
WRITE #1 "        <register address='0xbbf20e4' value='0x" DATA.LONG(A:0xbf20e4) "' name='RPMH_BCM_AU_INST_MEM57'/>"
WRITE #1 "        <register address='0xbbf20e8' value='0x" DATA.LONG(A:0xbf20e8) "' name='RPMH_BCM_AU_INST_MEM58'/>"
WRITE #1 "        <register address='0xbbf20ec' value='0x" DATA.LONG(A:0xbf20ec) "' name='RPMH_BCM_AU_INST_MEM59'/>"
WRITE #1 "        <register address='0xbbf20f0' value='0x" DATA.LONG(A:0xbf20f0) "' name='RPMH_BCM_AU_INST_MEM60'/>"
WRITE #1 "        <register address='0xbbf20f4' value='0x" DATA.LONG(A:0xbf20f4) "' name='RPMH_BCM_AU_INST_MEM61'/>"
WRITE #1 "        <register address='0xbbf20f8' value='0x" DATA.LONG(A:0xbf20f8) "' name='RPMH_BCM_AU_INST_MEM62'/>"
WRITE #1 "        <register address='0xbbf20fc' value='0x" DATA.LONG(A:0xbf20fc) "' name='RPMH_BCM_AU_INST_MEM63'/>"
WRITE #1 "        <register address='0xbbf2100' value='0x" DATA.LONG(A:0xbf2100) "' name='RPMH_BCM_AU_INST_MEM64'/>"
WRITE #1 "        <register address='0xbbf2104' value='0x" DATA.LONG(A:0xbf2104) "' name='RPMH_BCM_AU_INST_MEM65'/>"
WRITE #1 "        <register address='0xbbf2108' value='0x" DATA.LONG(A:0xbf2108) "' name='RPMH_BCM_AU_INST_MEM66'/>"
WRITE #1 "        <register address='0xbbf210c' value='0x" DATA.LONG(A:0xbf210c) "' name='RPMH_BCM_AU_INST_MEM67'/>"
WRITE #1 "        <register address='0xbbf2110' value='0x" DATA.LONG(A:0xbf2110) "' name='RPMH_BCM_AU_INST_MEM68'/>"
WRITE #1 "        <register address='0xbbf2114' value='0x" DATA.LONG(A:0xbf2114) "' name='RPMH_BCM_AU_INST_MEM69'/>"
WRITE #1 "        <register address='0xbbf2118' value='0x" DATA.LONG(A:0xbf2118) "' name='RPMH_BCM_AU_INST_MEM70'/>"
WRITE #1 "        <register address='0xbbf211c' value='0x" DATA.LONG(A:0xbf211c) "' name='RPMH_BCM_AU_INST_MEM71'/>"
WRITE #1 "        <register address='0xbbf2120' value='0x" DATA.LONG(A:0xbf2120) "' name='RPMH_BCM_AU_INST_MEM72'/>"
WRITE #1 "        <register address='0xbbf2124' value='0x" DATA.LONG(A:0xbf2124) "' name='RPMH_BCM_AU_INST_MEM73'/>"
WRITE #1 "        <register address='0xbbf2128' value='0x" DATA.LONG(A:0xbf2128) "' name='RPMH_BCM_AU_INST_MEM74'/>"
WRITE #1 "        <register address='0xbbf212c' value='0x" DATA.LONG(A:0xbf212c) "' name='RPMH_BCM_AU_INST_MEM75'/>"
WRITE #1 "        <register address='0xbbf2130' value='0x" DATA.LONG(A:0xbf2130) "' name='RPMH_BCM_AU_INST_MEM76'/>"
WRITE #1 "        <register address='0xbbf2134' value='0x" DATA.LONG(A:0xbf2134) "' name='RPMH_BCM_AU_INST_MEM77'/>"
WRITE #1 "        <register address='0xbbf2138' value='0x" DATA.LONG(A:0xbf2138) "' name='RPMH_BCM_AU_INST_MEM78'/>"
WRITE #1 "        <register address='0xbbf213c' value='0x" DATA.LONG(A:0xbf213c) "' name='RPMH_BCM_AU_INST_MEM79'/>"
WRITE #1 "        <register address='0xbbf2140' value='0x" DATA.LONG(A:0xbf2140) "' name='RPMH_BCM_AU_INST_MEM80'/>"
WRITE #1 "        <register address='0xbbf2144' value='0x" DATA.LONG(A:0xbf2144) "' name='RPMH_BCM_AU_INST_MEM81'/>"
WRITE #1 "        <register address='0xbbf2148' value='0x" DATA.LONG(A:0xbf2148) "' name='RPMH_BCM_AU_INST_MEM82'/>"
WRITE #1 "        <register address='0xbbf214c' value='0x" DATA.LONG(A:0xbf214c) "' name='RPMH_BCM_AU_INST_MEM83'/>"
WRITE #1 "        <register address='0xbbf2150' value='0x" DATA.LONG(A:0xbf2150) "' name='RPMH_BCM_AU_INST_MEM84'/>"
WRITE #1 "        <register address='0xbbf2154' value='0x" DATA.LONG(A:0xbf2154) "' name='RPMH_BCM_AU_INST_MEM85'/>"
WRITE #1 "        <register address='0xbbf2158' value='0x" DATA.LONG(A:0xbf2158) "' name='RPMH_BCM_AU_INST_MEM86'/>"
WRITE #1 "        <register address='0xbbf215c' value='0x" DATA.LONG(A:0xbf215c) "' name='RPMH_BCM_AU_INST_MEM87'/>"
WRITE #1 "        <register address='0xbbf2160' value='0x" DATA.LONG(A:0xbf2160) "' name='RPMH_BCM_AU_INST_MEM88'/>"
WRITE #1 "        <register address='0xbbf2164' value='0x" DATA.LONG(A:0xbf2164) "' name='RPMH_BCM_AU_INST_MEM89'/>"
WRITE #1 "        <register address='0xbbf2168' value='0x" DATA.LONG(A:0xbf2168) "' name='RPMH_BCM_AU_INST_MEM90'/>"
WRITE #1 "        <register address='0xbbf216c' value='0x" DATA.LONG(A:0xbf216c) "' name='RPMH_BCM_AU_INST_MEM91'/>"
WRITE #1 "        <register address='0xbbf2170' value='0x" DATA.LONG(A:0xbf2170) "' name='RPMH_BCM_AU_INST_MEM92'/>"
WRITE #1 "        <register address='0xbbf2174' value='0x" DATA.LONG(A:0xbf2174) "' name='RPMH_BCM_AU_INST_MEM93'/>"
WRITE #1 "        <register address='0xbbf2178' value='0x" DATA.LONG(A:0xbf2178) "' name='RPMH_BCM_AU_INST_MEM94'/>"
WRITE #1 "        <register address='0xbbf217c' value='0x" DATA.LONG(A:0xbf217c) "' name='RPMH_BCM_AU_INST_MEM95'/>"
WRITE #1 "        <register address='0xbbf2180' value='0x" DATA.LONG(A:0xbf2180) "' name='RPMH_BCM_AU_INST_MEM96'/>"
WRITE #1 "        <register address='0xbbf2184' value='0x" DATA.LONG(A:0xbf2184) "' name='RPMH_BCM_AU_INST_MEM97'/>"
WRITE #1 "        <register address='0xbbf2188' value='0x" DATA.LONG(A:0xbf2188) "' name='RPMH_BCM_AU_INST_MEM98'/>"
WRITE #1 "        <register address='0xbbf218c' value='0x" DATA.LONG(A:0xbf218c) "' name='RPMH_BCM_AU_INST_MEM99'/>"
WRITE #1 "        <register address='0xbbf2190' value='0x" DATA.LONG(A:0xbf2190) "' name='RPMH_BCM_AU_INST_MEM100'/>"
WRITE #1 "        <register address='0xbbf2194' value='0x" DATA.LONG(A:0xbf2194) "' name='RPMH_BCM_AU_INST_MEM101'/>"
WRITE #1 "        <register address='0xbbf2198' value='0x" DATA.LONG(A:0xbf2198) "' name='RPMH_BCM_AU_INST_MEM102'/>"
WRITE #1 "        <register address='0xbbf219c' value='0x" DATA.LONG(A:0xbf219c) "' name='RPMH_BCM_AU_INST_MEM103'/>"
WRITE #1 "        <register address='0xbbf21a0' value='0x" DATA.LONG(A:0xbf21a0) "' name='RPMH_BCM_AU_INST_MEM104'/>"
WRITE #1 "        <register address='0xbbf21a4' value='0x" DATA.LONG(A:0xbf21a4) "' name='RPMH_BCM_AU_INST_MEM105'/>"
WRITE #1 "        <register address='0xbbf21a8' value='0x" DATA.LONG(A:0xbf21a8) "' name='RPMH_BCM_AU_INST_MEM106'/>"
WRITE #1 "        <register address='0xbbf21ac' value='0x" DATA.LONG(A:0xbf21ac) "' name='RPMH_BCM_AU_INST_MEM107'/>"
WRITE #1 "        <register address='0xbbf21b0' value='0x" DATA.LONG(A:0xbf21b0) "' name='RPMH_BCM_AU_INST_MEM108'/>"
WRITE #1 "        <register address='0xbbf21b4' value='0x" DATA.LONG(A:0xbf21b4) "' name='RPMH_BCM_AU_INST_MEM109'/>"
WRITE #1 "        <register address='0xbbf21b8' value='0x" DATA.LONG(A:0xbf21b8) "' name='RPMH_BCM_AU_INST_MEM110'/>"
WRITE #1 "        <register address='0xbbf21bc' value='0x" DATA.LONG(A:0xbf21bc) "' name='RPMH_BCM_AU_INST_MEM111'/>"
WRITE #1 "        <register address='0xbbf21c0' value='0x" DATA.LONG(A:0xbf21c0) "' name='RPMH_BCM_AU_INST_MEM112'/>"
WRITE #1 "        <register address='0xbbf21c4' value='0x" DATA.LONG(A:0xbf21c4) "' name='RPMH_BCM_AU_INST_MEM113'/>"
WRITE #1 "        <register address='0xbbf21c8' value='0x" DATA.LONG(A:0xbf21c8) "' name='RPMH_BCM_AU_INST_MEM114'/>"
WRITE #1 "        <register address='0xbbf21cc' value='0x" DATA.LONG(A:0xbf21cc) "' name='RPMH_BCM_AU_INST_MEM115'/>"
WRITE #1 "        <register address='0xbbf21d0' value='0x" DATA.LONG(A:0xbf21d0) "' name='RPMH_BCM_AU_INST_MEM116'/>"
WRITE #1 "        <register address='0xbbf21d4' value='0x" DATA.LONG(A:0xbf21d4) "' name='RPMH_BCM_AU_INST_MEM117'/>"
WRITE #1 "        <register address='0xbbf21d8' value='0x" DATA.LONG(A:0xbf21d8) "' name='RPMH_BCM_AU_INST_MEM118'/>"
WRITE #1 "        <register address='0xbbf21dc' value='0x" DATA.LONG(A:0xbf21dc) "' name='RPMH_BCM_AU_INST_MEM119'/>"
WRITE #1 "        <register address='0xbbf21e0' value='0x" DATA.LONG(A:0xbf21e0) "' name='RPMH_BCM_AU_INST_MEM120'/>"
WRITE #1 "        <register address='0xbbf21e4' value='0x" DATA.LONG(A:0xbf21e4) "' name='RPMH_BCM_AU_INST_MEM121'/>"
WRITE #1 "        <register address='0xbbf21e8' value='0x" DATA.LONG(A:0xbf21e8) "' name='RPMH_BCM_AU_INST_MEM122'/>"
WRITE #1 "        <register address='0xbbf21ec' value='0x" DATA.LONG(A:0xbf21ec) "' name='RPMH_BCM_AU_INST_MEM123'/>"
WRITE #1 "        <register address='0xbbf21f0' value='0x" DATA.LONG(A:0xbf21f0) "' name='RPMH_BCM_AU_INST_MEM124'/>"
WRITE #1 "        <register address='0xbbf21f4' value='0x" DATA.LONG(A:0xbf21f4) "' name='RPMH_BCM_AU_INST_MEM125'/>"
WRITE #1 "        <register address='0xbbf21f8' value='0x" DATA.LONG(A:0xbf21f8) "' name='RPMH_BCM_AU_INST_MEM126'/>"
WRITE #1 "        <register address='0xbbf21fc' value='0x" DATA.LONG(A:0xbf21fc) "' name='RPMH_BCM_AU_INST_MEM127'/>"
WRITE #1 "        <register address='0xbbf2400' value='0x" DATA.LONG(A:0xbf2400) "' name='RPMH_BCM_SEQ_MEM0'/>"
WRITE #1 "        <register address='0xbbf2404' value='0x" DATA.LONG(A:0xbf2404) "' name='RPMH_BCM_SEQ_MEM1'/>"
WRITE #1 "        <register address='0xbbf2408' value='0x" DATA.LONG(A:0xbf2408) "' name='RPMH_BCM_SEQ_MEM2'/>"
WRITE #1 "        <register address='0xbbf240c' value='0x" DATA.LONG(A:0xbf240c) "' name='RPMH_BCM_SEQ_MEM3'/>"
WRITE #1 "        <register address='0xbbf2410' value='0x" DATA.LONG(A:0xbf2410) "' name='RPMH_BCM_SEQ_MEM4'/>"
WRITE #1 "        <register address='0xbbf2414' value='0x" DATA.LONG(A:0xbf2414) "' name='RPMH_BCM_SEQ_MEM5'/>"
WRITE #1 "        <register address='0xbbf2418' value='0x" DATA.LONG(A:0xbf2418) "' name='RPMH_BCM_SEQ_MEM6'/>"
WRITE #1 "        <register address='0xbbf241c' value='0x" DATA.LONG(A:0xbf241c) "' name='RPMH_BCM_SEQ_MEM7'/>"
WRITE #1 "        <register address='0xbbf2420' value='0x" DATA.LONG(A:0xbf2420) "' name='RPMH_BCM_SEQ_MEM8'/>"
WRITE #1 "        <register address='0xbbf2424' value='0x" DATA.LONG(A:0xbf2424) "' name='RPMH_BCM_SEQ_MEM9'/>"
WRITE #1 "        <register address='0xbbf2428' value='0x" DATA.LONG(A:0xbf2428) "' name='RPMH_BCM_SEQ_MEM10'/>"
WRITE #1 "        <register address='0xbbf242c' value='0x" DATA.LONG(A:0xbf242c) "' name='RPMH_BCM_SEQ_MEM11'/>"
WRITE #1 "        <register address='0xbbf2430' value='0x" DATA.LONG(A:0xbf2430) "' name='RPMH_BCM_SEQ_MEM12'/>"
WRITE #1 "        <register address='0xbbf2434' value='0x" DATA.LONG(A:0xbf2434) "' name='RPMH_BCM_SEQ_MEM13'/>"
WRITE #1 "        <register address='0xbbf2438' value='0x" DATA.LONG(A:0xbf2438) "' name='RPMH_BCM_SEQ_MEM14'/>"
WRITE #1 "        <register address='0xbbf243c' value='0x" DATA.LONG(A:0xbf243c) "' name='RPMH_BCM_SEQ_MEM15'/>"
WRITE #1 "        <register address='0xbbf2440' value='0x" DATA.LONG(A:0xbf2440) "' name='RPMH_BCM_SEQ_MEM16'/>"
WRITE #1 "        <register address='0xbbf2444' value='0x" DATA.LONG(A:0xbf2444) "' name='RPMH_BCM_SEQ_MEM17'/>"
WRITE #1 "        <register address='0xbbf2448' value='0x" DATA.LONG(A:0xbf2448) "' name='RPMH_BCM_SEQ_MEM18'/>"
WRITE #1 "        <register address='0xbbf244c' value='0x" DATA.LONG(A:0xbf244c) "' name='RPMH_BCM_SEQ_MEM19'/>"
WRITE #1 "        <register address='0xbbf2450' value='0x" DATA.LONG(A:0xbf2450) "' name='RPMH_BCM_SEQ_MEM20'/>"
WRITE #1 "        <register address='0xbbf2454' value='0x" DATA.LONG(A:0xbf2454) "' name='RPMH_BCM_SEQ_MEM21'/>"
WRITE #1 "        <register address='0xbbf2458' value='0x" DATA.LONG(A:0xbf2458) "' name='RPMH_BCM_SEQ_MEM22'/>"
WRITE #1 "        <register address='0xbbf245c' value='0x" DATA.LONG(A:0xbf245c) "' name='RPMH_BCM_SEQ_MEM23'/>"
WRITE #1 "        <register address='0xbbf2460' value='0x" DATA.LONG(A:0xbf2460) "' name='RPMH_BCM_SEQ_MEM24'/>"
WRITE #1 "        <register address='0xbbf2464' value='0x" DATA.LONG(A:0xbf2464) "' name='RPMH_BCM_SEQ_MEM25'/>"
WRITE #1 "        <register address='0xbbf2468' value='0x" DATA.LONG(A:0xbf2468) "' name='RPMH_BCM_SEQ_MEM26'/>"
WRITE #1 "        <register address='0xbbf246c' value='0x" DATA.LONG(A:0xbf246c) "' name='RPMH_BCM_SEQ_MEM27'/>"
WRITE #1 "        <register address='0xbbf2470' value='0x" DATA.LONG(A:0xbf2470) "' name='RPMH_BCM_SEQ_MEM28'/>"
WRITE #1 "        <register address='0xbbf2474' value='0x" DATA.LONG(A:0xbf2474) "' name='RPMH_BCM_SEQ_MEM29'/>"
WRITE #1 "        <register address='0xbbf2478' value='0x" DATA.LONG(A:0xbf2478) "' name='RPMH_BCM_SEQ_MEM30'/>"
WRITE #1 "        <register address='0xbbf247c' value='0x" DATA.LONG(A:0xbf247c) "' name='RPMH_BCM_SEQ_MEM31'/>"
WRITE #1 "        <register address='0xbbf2480' value='0x" DATA.LONG(A:0xbf2480) "' name='RPMH_BCM_SEQ_MEM32'/>"
WRITE #1 "        <register address='0xbbf2484' value='0x" DATA.LONG(A:0xbf2484) "' name='RPMH_BCM_SEQ_MEM33'/>"
WRITE #1 "        <register address='0xbbf2488' value='0x" DATA.LONG(A:0xbf2488) "' name='RPMH_BCM_SEQ_MEM34'/>"
WRITE #1 "        <register address='0xbbf248c' value='0x" DATA.LONG(A:0xbf248c) "' name='RPMH_BCM_SEQ_MEM35'/>"
WRITE #1 "        <register address='0xbbf2490' value='0x" DATA.LONG(A:0xbf2490) "' name='RPMH_BCM_SEQ_MEM36'/>"
WRITE #1 "        <register address='0xbbf2494' value='0x" DATA.LONG(A:0xbf2494) "' name='RPMH_BCM_SEQ_MEM37'/>"
WRITE #1 "        <register address='0xbbf2498' value='0x" DATA.LONG(A:0xbf2498) "' name='RPMH_BCM_SEQ_MEM38'/>"
WRITE #1 "        <register address='0xbbf249c' value='0x" DATA.LONG(A:0xbf249c) "' name='RPMH_BCM_SEQ_MEM39'/>"
WRITE #1 "        <register address='0xbbf24a0' value='0x" DATA.LONG(A:0xbf24a0) "' name='RPMH_BCM_SEQ_MEM40'/>"
WRITE #1 "        <register address='0xbbf24a4' value='0x" DATA.LONG(A:0xbf24a4) "' name='RPMH_BCM_SEQ_MEM41'/>"
WRITE #1 "        <register address='0xbbf24a8' value='0x" DATA.LONG(A:0xbf24a8) "' name='RPMH_BCM_SEQ_MEM42'/>"
WRITE #1 "        <register address='0xbbf24ac' value='0x" DATA.LONG(A:0xbf24ac) "' name='RPMH_BCM_SEQ_MEM43'/>"
WRITE #1 "        <register address='0xbbf24b0' value='0x" DATA.LONG(A:0xbf24b0) "' name='RPMH_BCM_SEQ_MEM44'/>"
WRITE #1 "        <register address='0xbbf24b4' value='0x" DATA.LONG(A:0xbf24b4) "' name='RPMH_BCM_SEQ_MEM45'/>"
WRITE #1 "        <register address='0xbbf24b8' value='0x" DATA.LONG(A:0xbf24b8) "' name='RPMH_BCM_SEQ_MEM46'/>"
WRITE #1 "        <register address='0xbbf24bc' value='0x" DATA.LONG(A:0xbf24bc) "' name='RPMH_BCM_SEQ_MEM47'/>"
WRITE #1 "        <register address='0xbbf24c0' value='0x" DATA.LONG(A:0xbf24c0) "' name='RPMH_BCM_SEQ_MEM48'/>"
WRITE #1 "        <register address='0xbbf24c4' value='0x" DATA.LONG(A:0xbf24c4) "' name='RPMH_BCM_SEQ_MEM49'/>"
WRITE #1 "        <register address='0xbbf24c8' value='0x" DATA.LONG(A:0xbf24c8) "' name='RPMH_BCM_SEQ_MEM50'/>"
WRITE #1 "        <register address='0xbbf24cc' value='0x" DATA.LONG(A:0xbf24cc) "' name='RPMH_BCM_SEQ_MEM51'/>"
WRITE #1 "        <register address='0xbbf24d0' value='0x" DATA.LONG(A:0xbf24d0) "' name='RPMH_BCM_SEQ_MEM52'/>"
WRITE #1 "        <register address='0xbbf24d4' value='0x" DATA.LONG(A:0xbf24d4) "' name='RPMH_BCM_SEQ_MEM53'/>"
WRITE #1 "        <register address='0xbbf24d8' value='0x" DATA.LONG(A:0xbf24d8) "' name='RPMH_BCM_SEQ_MEM54'/>"
WRITE #1 "        <register address='0xbbf24dc' value='0x" DATA.LONG(A:0xbf24dc) "' name='RPMH_BCM_SEQ_MEM55'/>"
WRITE #1 "        <register address='0xbbf24e0' value='0x" DATA.LONG(A:0xbf24e0) "' name='RPMH_BCM_SEQ_MEM56'/>"
WRITE #1 "        <register address='0xbbf24e4' value='0x" DATA.LONG(A:0xbf24e4) "' name='RPMH_BCM_SEQ_MEM57'/>"
WRITE #1 "        <register address='0xbbf24e8' value='0x" DATA.LONG(A:0xbf24e8) "' name='RPMH_BCM_SEQ_MEM58'/>"
WRITE #1 "        <register address='0xbbf24ec' value='0x" DATA.LONG(A:0xbf24ec) "' name='RPMH_BCM_SEQ_MEM59'/>"
WRITE #1 "        <register address='0xbbf24f0' value='0x" DATA.LONG(A:0xbf24f0) "' name='RPMH_BCM_SEQ_MEM60'/>"
WRITE #1 "        <register address='0xbbf24f4' value='0x" DATA.LONG(A:0xbf24f4) "' name='RPMH_BCM_SEQ_MEM61'/>"
WRITE #1 "        <register address='0xbbf24f8' value='0x" DATA.LONG(A:0xbf24f8) "' name='RPMH_BCM_SEQ_MEM62'/>"
WRITE #1 "        <register address='0xbbf24fc' value='0x" DATA.LONG(A:0xbf24fc) "' name='RPMH_BCM_SEQ_MEM63'/>"
WRITE #1 "        <register address='0xbbf2600' value='0x" DATA.LONG(A:0xbf2600) "' name='RPMH_BCM_SW_CP_CD0'/>"
WRITE #1 "        <register address='0xbbf2604' value='0x" DATA.LONG(A:0xbf2604) "' name='RPMH_BCM_SW_CP_CD1'/>"
WRITE #1 "        <register address='0xbbf2608' value='0x" DATA.LONG(A:0xbf2608) "' name='RPMH_BCM_SW_CP_CD2'/>"
WRITE #1 "        <register address='0xbbf260c' value='0x" DATA.LONG(A:0xbf260c) "' name='RPMH_BCM_SW_CP_CD3'/>"
WRITE #1 "        <register address='0xbbf2610' value='0x" DATA.LONG(A:0xbf2610) "' name='RPMH_BCM_SW_CP_CD4'/>"
WRITE #1 "        <register address='0xbbf2614' value='0x" DATA.LONG(A:0xbf2614) "' name='RPMH_BCM_SW_CP_CD5'/>"
WRITE #1 "        <register address='0xbbf2618' value='0x" DATA.LONG(A:0xbf2618) "' name='RPMH_BCM_SW_CP_CD6'/>"
WRITE #1 "        <register address='0xbbf261c' value='0x" DATA.LONG(A:0xbf261c) "' name='RPMH_BCM_SW_CP_CD7'/>"
WRITE #1 "        <register address='0xbbf2620' value='0x" DATA.LONG(A:0xbf2620) "' name='RPMH_BCM_SW_CP_CD8'/>"
WRITE #1 "        <register address='0xbbf2624' value='0x" DATA.LONG(A:0xbf2624) "' name='RPMH_BCM_SW_CP_CD9'/>"
WRITE #1 "        <register address='0xbbf2628' value='0x" DATA.LONG(A:0xbf2628) "' name='RPMH_BCM_SW_CP_CD10'/>"
WRITE #1 "        <register address='0xbbf262c' value='0x" DATA.LONG(A:0xbf262c) "' name='RPMH_BCM_SW_CP_CD11'/>"
WRITE #1 "        <register address='0xbbf2680' value='0x" DATA.LONG(A:0xbf2680) "' name='RPMH_BCM_SW_MASK_FE_BE_TRIG_CD0'/>"
WRITE #1 "        <register address='0xbbf2684' value='0x" DATA.LONG(A:0xbf2684) "' name='RPMH_BCM_SW_MASK_FE_BE_TRIG_CD1'/>"
WRITE #1 "        <register address='0xbbf2688' value='0x" DATA.LONG(A:0xbf2688) "' name='RPMH_BCM_SW_MASK_FE_BE_TRIG_CD2'/>"
WRITE #1 "        <register address='0xbbf268c' value='0x" DATA.LONG(A:0xbf268c) "' name='RPMH_BCM_SW_MASK_FE_BE_TRIG_CD3'/>"
WRITE #1 "        <register address='0xbbf2690' value='0x" DATA.LONG(A:0xbf2690) "' name='RPMH_BCM_SW_MASK_FE_BE_TRIG_CD4'/>"
WRITE #1 "        <register address='0xbbf2694' value='0x" DATA.LONG(A:0xbf2694) "' name='RPMH_BCM_SW_MASK_FE_BE_TRIG_CD5'/>"
WRITE #1 "        <register address='0xbbf2698' value='0x" DATA.LONG(A:0xbf2698) "' name='RPMH_BCM_SW_MASK_FE_BE_TRIG_CD6'/>"
WRITE #1 "        <register address='0xbbf269c' value='0x" DATA.LONG(A:0xbf269c) "' name='RPMH_BCM_SW_MASK_FE_BE_TRIG_CD7'/>"
WRITE #1 "        <register address='0xbbf26a0' value='0x" DATA.LONG(A:0xbf26a0) "' name='RPMH_BCM_SW_MASK_FE_BE_TRIG_CD8'/>"
WRITE #1 "        <register address='0xbbf26a4' value='0x" DATA.LONG(A:0xbf26a4) "' name='RPMH_BCM_SW_MASK_FE_BE_TRIG_CD9'/>"
WRITE #1 "        <register address='0xbbf26a8' value='0x" DATA.LONG(A:0xbf26a8) "' name='RPMH_BCM_SW_MASK_FE_BE_TRIG_CD10'/>"
WRITE #1 "        <register address='0xbbf26ac' value='0x" DATA.LONG(A:0xbf26ac) "' name='RPMH_BCM_SW_MASK_FE_BE_TRIG_CD11'/>"
WRITE #1 "        <register address='0xbbf2700' value='0x" DATA.LONG(A:0xbf2700) "' name='RPMH_BCM_SW_OVERRIDE_STOP_AGG_CD0'/>"
WRITE #1 "        <register address='0xbbf2704' value='0x" DATA.LONG(A:0xbf2704) "' name='RPMH_BCM_SW_OVERRIDE_STOP_AGG_CD1'/>"
WRITE #1 "        <register address='0xbbf2708' value='0x" DATA.LONG(A:0xbf2708) "' name='RPMH_BCM_SW_OVERRIDE_STOP_AGG_CD2'/>"
WRITE #1 "        <register address='0xbbf270c' value='0x" DATA.LONG(A:0xbf270c) "' name='RPMH_BCM_SW_OVERRIDE_STOP_AGG_CD3'/>"
WRITE #1 "        <register address='0xbbf2710' value='0x" DATA.LONG(A:0xbf2710) "' name='RPMH_BCM_SW_OVERRIDE_STOP_AGG_CD4'/>"
WRITE #1 "        <register address='0xbbf2714' value='0x" DATA.LONG(A:0xbf2714) "' name='RPMH_BCM_SW_OVERRIDE_STOP_AGG_CD5'/>"
WRITE #1 "        <register address='0xbbf2718' value='0x" DATA.LONG(A:0xbf2718) "' name='RPMH_BCM_SW_OVERRIDE_STOP_AGG_CD6'/>"
WRITE #1 "        <register address='0xbbf271c' value='0x" DATA.LONG(A:0xbf271c) "' name='RPMH_BCM_SW_OVERRIDE_STOP_AGG_CD7'/>"
WRITE #1 "        <register address='0xbbf2720' value='0x" DATA.LONG(A:0xbf2720) "' name='RPMH_BCM_SW_OVERRIDE_STOP_AGG_CD8'/>"
WRITE #1 "        <register address='0xbbf2724' value='0x" DATA.LONG(A:0xbf2724) "' name='RPMH_BCM_SW_OVERRIDE_STOP_AGG_CD9'/>"
WRITE #1 "        <register address='0xbbf2728' value='0x" DATA.LONG(A:0xbf2728) "' name='RPMH_BCM_SW_OVERRIDE_STOP_AGG_CD10'/>"
WRITE #1 "        <register address='0xbbf272c' value='0x" DATA.LONG(A:0xbf272c) "' name='RPMH_BCM_SW_OVERRIDE_STOP_AGG_CD11'/>"
WRITE #1 "        <register address='0xbbf2800' value='0x" DATA.LONG(A:0xbf2800) "' name='RPMH_BCM_SW_OVERWRITE_FINAL_CP_CD0'/>"
WRITE #1 "        <register address='0xbbf2804' value='0x" DATA.LONG(A:0xbf2804) "' name='RPMH_BCM_SW_OVERWRITE_FINAL_CP_CD1'/>"
WRITE #1 "        <register address='0xbbf2808' value='0x" DATA.LONG(A:0xbf2808) "' name='RPMH_BCM_SW_OVERWRITE_FINAL_CP_CD2'/>"
WRITE #1 "        <register address='0xbbf280c' value='0x" DATA.LONG(A:0xbf280c) "' name='RPMH_BCM_SW_OVERWRITE_FINAL_CP_CD3'/>"
WRITE #1 "        <register address='0xbbf2810' value='0x" DATA.LONG(A:0xbf2810) "' name='RPMH_BCM_SW_OVERWRITE_FINAL_CP_CD4'/>"
WRITE #1 "        <register address='0xbbf2814' value='0x" DATA.LONG(A:0xbf2814) "' name='RPMH_BCM_SW_OVERWRITE_FINAL_CP_CD5'/>"
WRITE #1 "        <register address='0xbbf2818' value='0x" DATA.LONG(A:0xbf2818) "' name='RPMH_BCM_SW_OVERWRITE_FINAL_CP_CD6'/>"
WRITE #1 "        <register address='0xbbf281c' value='0x" DATA.LONG(A:0xbf281c) "' name='RPMH_BCM_SW_OVERWRITE_FINAL_CP_CD7'/>"
WRITE #1 "        <register address='0xbbf2820' value='0x" DATA.LONG(A:0xbf2820) "' name='RPMH_BCM_SW_OVERWRITE_FINAL_CP_CD8'/>"
WRITE #1 "        <register address='0xbbf2824' value='0x" DATA.LONG(A:0xbf2824) "' name='RPMH_BCM_SW_OVERWRITE_FINAL_CP_CD9'/>"
WRITE #1 "        <register address='0xbbf2828' value='0x" DATA.LONG(A:0xbf2828) "' name='RPMH_BCM_SW_OVERWRITE_FINAL_CP_CD10'/>"
WRITE #1 "        <register address='0xbbf282c' value='0x" DATA.LONG(A:0xbf282c) "' name='RPMH_BCM_SW_OVERWRITE_FINAL_CP_CD11'/>"
WRITE #1 "        <register address='0xbbf2880' value='0x" DATA.LONG(A:0xbf2880) "' name='RPMH_BCM_SW_BLOCK_FINAL_CP_CD0'/>"
WRITE #1 "        <register address='0xbbf2884' value='0x" DATA.LONG(A:0xbf2884) "' name='RPMH_BCM_SW_BLOCK_FINAL_CP_CD1'/>"
WRITE #1 "        <register address='0xbbf2888' value='0x" DATA.LONG(A:0xbf2888) "' name='RPMH_BCM_SW_BLOCK_FINAL_CP_CD2'/>"
WRITE #1 "        <register address='0xbbf288c' value='0x" DATA.LONG(A:0xbf288c) "' name='RPMH_BCM_SW_BLOCK_FINAL_CP_CD3'/>"
WRITE #1 "        <register address='0xbbf2890' value='0x" DATA.LONG(A:0xbf2890) "' name='RPMH_BCM_SW_BLOCK_FINAL_CP_CD4'/>"
WRITE #1 "        <register address='0xbbf2894' value='0x" DATA.LONG(A:0xbf2894) "' name='RPMH_BCM_SW_BLOCK_FINAL_CP_CD5'/>"
WRITE #1 "        <register address='0xbbf2898' value='0x" DATA.LONG(A:0xbf2898) "' name='RPMH_BCM_SW_BLOCK_FINAL_CP_CD6'/>"
WRITE #1 "        <register address='0xbbf289c' value='0x" DATA.LONG(A:0xbf289c) "' name='RPMH_BCM_SW_BLOCK_FINAL_CP_CD7'/>"
WRITE #1 "        <register address='0xbbf28a0' value='0x" DATA.LONG(A:0xbf28a0) "' name='RPMH_BCM_SW_BLOCK_FINAL_CP_CD8'/>"
WRITE #1 "        <register address='0xbbf28a4' value='0x" DATA.LONG(A:0xbf28a4) "' name='RPMH_BCM_SW_BLOCK_FINAL_CP_CD9'/>"
WRITE #1 "        <register address='0xbbf28a8' value='0x" DATA.LONG(A:0xbf28a8) "' name='RPMH_BCM_SW_BLOCK_FINAL_CP_CD10'/>"
WRITE #1 "        <register address='0xbbf28ac' value='0x" DATA.LONG(A:0xbf28ac) "' name='RPMH_BCM_SW_BLOCK_FINAL_CP_CD11'/>"
WRITE #1 "        <register address='0xbbf2900' value='0x" DATA.LONG(A:0xbf2900) "' name='RPMH_BCM_SW_OVERWRITE_WRITTEN_CP_CD0'/>"
WRITE #1 "        <register address='0xbbf2904' value='0x" DATA.LONG(A:0xbf2904) "' name='RPMH_BCM_SW_OVERWRITE_WRITTEN_CP_CD1'/>"
WRITE #1 "        <register address='0xbbf2908' value='0x" DATA.LONG(A:0xbf2908) "' name='RPMH_BCM_SW_OVERWRITE_WRITTEN_CP_CD2'/>"
WRITE #1 "        <register address='0xbbf290c' value='0x" DATA.LONG(A:0xbf290c) "' name='RPMH_BCM_SW_OVERWRITE_WRITTEN_CP_CD3'/>"
WRITE #1 "        <register address='0xbbf2910' value='0x" DATA.LONG(A:0xbf2910) "' name='RPMH_BCM_SW_OVERWRITE_WRITTEN_CP_CD4'/>"
WRITE #1 "        <register address='0xbbf2914' value='0x" DATA.LONG(A:0xbf2914) "' name='RPMH_BCM_SW_OVERWRITE_WRITTEN_CP_CD5'/>"
WRITE #1 "        <register address='0xbbf2918' value='0x" DATA.LONG(A:0xbf2918) "' name='RPMH_BCM_SW_OVERWRITE_WRITTEN_CP_CD6'/>"
WRITE #1 "        <register address='0xbbf291c' value='0x" DATA.LONG(A:0xbf291c) "' name='RPMH_BCM_SW_OVERWRITE_WRITTEN_CP_CD7'/>"
WRITE #1 "        <register address='0xbbf2920' value='0x" DATA.LONG(A:0xbf2920) "' name='RPMH_BCM_SW_OVERWRITE_WRITTEN_CP_CD8'/>"
WRITE #1 "        <register address='0xbbf2924' value='0x" DATA.LONG(A:0xbf2924) "' name='RPMH_BCM_SW_OVERWRITE_WRITTEN_CP_CD9'/>"
WRITE #1 "        <register address='0xbbf2928' value='0x" DATA.LONG(A:0xbf2928) "' name='RPMH_BCM_SW_OVERWRITE_WRITTEN_CP_CD10'/>"
WRITE #1 "        <register address='0xbbf292c' value='0x" DATA.LONG(A:0xbf292c) "' name='RPMH_BCM_SW_OVERWRITE_WRITTEN_CP_CD11'/>"
WRITE #1 "        <register address='0xbbf2980' value='0x" DATA.LONG(A:0xbf2980) "' name='RPMH_BCM_SW_OVERWRITE_CURRENT_CP_CD0'/>"
WRITE #1 "        <register address='0xbbf2984' value='0x" DATA.LONG(A:0xbf2984) "' name='RPMH_BCM_SW_OVERWRITE_CURRENT_CP_CD1'/>"
WRITE #1 "        <register address='0xbbf2988' value='0x" DATA.LONG(A:0xbf2988) "' name='RPMH_BCM_SW_OVERWRITE_CURRENT_CP_CD2'/>"
WRITE #1 "        <register address='0xbbf298c' value='0x" DATA.LONG(A:0xbf298c) "' name='RPMH_BCM_SW_OVERWRITE_CURRENT_CP_CD3'/>"
WRITE #1 "        <register address='0xbbf2990' value='0x" DATA.LONG(A:0xbf2990) "' name='RPMH_BCM_SW_OVERWRITE_CURRENT_CP_CD4'/>"
WRITE #1 "        <register address='0xbbf2994' value='0x" DATA.LONG(A:0xbf2994) "' name='RPMH_BCM_SW_OVERWRITE_CURRENT_CP_CD5'/>"
WRITE #1 "        <register address='0xbbf2998' value='0x" DATA.LONG(A:0xbf2998) "' name='RPMH_BCM_SW_OVERWRITE_CURRENT_CP_CD6'/>"
WRITE #1 "        <register address='0xbbf299c' value='0x" DATA.LONG(A:0xbf299c) "' name='RPMH_BCM_SW_OVERWRITE_CURRENT_CP_CD7'/>"
WRITE #1 "        <register address='0xbbf29a0' value='0x" DATA.LONG(A:0xbf29a0) "' name='RPMH_BCM_SW_OVERWRITE_CURRENT_CP_CD8'/>"
WRITE #1 "        <register address='0xbbf29a4' value='0x" DATA.LONG(A:0xbf29a4) "' name='RPMH_BCM_SW_OVERWRITE_CURRENT_CP_CD9'/>"
WRITE #1 "        <register address='0xbbf29a8' value='0x" DATA.LONG(A:0xbf29a8) "' name='RPMH_BCM_SW_OVERWRITE_CURRENT_CP_CD10'/>"
WRITE #1 "        <register address='0xbbf29ac' value='0x" DATA.LONG(A:0xbf29ac) "' name='RPMH_BCM_SW_OVERWRITE_CURRENT_CP_CD11'/>"
WRITE #1 "        <register address='0xbbf2a00' value='0x" DATA.LONG(A:0xbf2a00) "' name='RPMH_BCM_SW_OVERRIDE_TCS_CP_SEL_CD0'/>"
WRITE #1 "        <register address='0xbbf2a04' value='0x" DATA.LONG(A:0xbf2a04) "' name='RPMH_BCM_SW_OVERRIDE_TCS_CP_SEL_CD1'/>"
WRITE #1 "        <register address='0xbbf2a08' value='0x" DATA.LONG(A:0xbf2a08) "' name='RPMH_BCM_SW_OVERRIDE_TCS_CP_SEL_CD2'/>"
WRITE #1 "        <register address='0xbbf2a0c' value='0x" DATA.LONG(A:0xbf2a0c) "' name='RPMH_BCM_SW_OVERRIDE_TCS_CP_SEL_CD3'/>"
WRITE #1 "        <register address='0xbbf2a10' value='0x" DATA.LONG(A:0xbf2a10) "' name='RPMH_BCM_SW_OVERRIDE_TCS_CP_SEL_CD4'/>"
WRITE #1 "        <register address='0xbbf2a14' value='0x" DATA.LONG(A:0xbf2a14) "' name='RPMH_BCM_SW_OVERRIDE_TCS_CP_SEL_CD5'/>"
WRITE #1 "        <register address='0xbbf2a18' value='0x" DATA.LONG(A:0xbf2a18) "' name='RPMH_BCM_SW_OVERRIDE_TCS_CP_SEL_CD6'/>"
WRITE #1 "        <register address='0xbbf2a1c' value='0x" DATA.LONG(A:0xbf2a1c) "' name='RPMH_BCM_SW_OVERRIDE_TCS_CP_SEL_CD7'/>"
WRITE #1 "        <register address='0xbbf2a20' value='0x" DATA.LONG(A:0xbf2a20) "' name='RPMH_BCM_SW_OVERRIDE_TCS_CP_SEL_CD8'/>"
WRITE #1 "        <register address='0xbbf2a24' value='0x" DATA.LONG(A:0xbf2a24) "' name='RPMH_BCM_SW_OVERRIDE_TCS_CP_SEL_CD9'/>"
WRITE #1 "        <register address='0xbbf2a28' value='0x" DATA.LONG(A:0xbf2a28) "' name='RPMH_BCM_SW_OVERRIDE_TCS_CP_SEL_CD10'/>"
WRITE #1 "        <register address='0xbbf2a2c' value='0x" DATA.LONG(A:0xbf2a2c) "' name='RPMH_BCM_SW_OVERRIDE_TCS_CP_SEL_CD11'/>"
WRITE #1 "        <register address='0xbbf2a80' value='0x" DATA.LONG(A:0xbf2a80) "' name='RPMH_BCM_SW_OVERRIDE_TCS_ENABLE_CD0'/>"
WRITE #1 "        <register address='0xbbf2a84' value='0x" DATA.LONG(A:0xbf2a84) "' name='RPMH_BCM_SW_OVERRIDE_TCS_ENABLE_CD1'/>"
WRITE #1 "        <register address='0xbbf2a88' value='0x" DATA.LONG(A:0xbf2a88) "' name='RPMH_BCM_SW_OVERRIDE_TCS_ENABLE_CD2'/>"
WRITE #1 "        <register address='0xbbf2a8c' value='0x" DATA.LONG(A:0xbf2a8c) "' name='RPMH_BCM_SW_OVERRIDE_TCS_ENABLE_CD3'/>"
WRITE #1 "        <register address='0xbbf2a90' value='0x" DATA.LONG(A:0xbf2a90) "' name='RPMH_BCM_SW_OVERRIDE_TCS_ENABLE_CD4'/>"
WRITE #1 "        <register address='0xbbf2a94' value='0x" DATA.LONG(A:0xbf2a94) "' name='RPMH_BCM_SW_OVERRIDE_TCS_ENABLE_CD5'/>"
WRITE #1 "        <register address='0xbbf2a98' value='0x" DATA.LONG(A:0xbf2a98) "' name='RPMH_BCM_SW_OVERRIDE_TCS_ENABLE_CD6'/>"
WRITE #1 "        <register address='0xbbf2a9c' value='0x" DATA.LONG(A:0xbf2a9c) "' name='RPMH_BCM_SW_OVERRIDE_TCS_ENABLE_CD7'/>"
WRITE #1 "        <register address='0xbbf2aa0' value='0x" DATA.LONG(A:0xbf2aa0) "' name='RPMH_BCM_SW_OVERRIDE_TCS_ENABLE_CD8'/>"
WRITE #1 "        <register address='0xbbf2aa4' value='0x" DATA.LONG(A:0xbf2aa4) "' name='RPMH_BCM_SW_OVERRIDE_TCS_ENABLE_CD9'/>"
WRITE #1 "        <register address='0xbbf2aa8' value='0x" DATA.LONG(A:0xbf2aa8) "' name='RPMH_BCM_SW_OVERRIDE_TCS_ENABLE_CD10'/>"
WRITE #1 "        <register address='0xbbf2aac' value='0x" DATA.LONG(A:0xbf2aac) "' name='RPMH_BCM_SW_OVERRIDE_TCS_ENABLE_CD11'/>"
WRITE #1 "        <register address='0xbbf2b00' value='0x" DATA.LONG(A:0xbf2b00) "' name='RPMH_BCM_SW_OVERRIDE_TCS_FLUSH_CD0'/>"
WRITE #1 "        <register address='0xbbf2b04' value='0x" DATA.LONG(A:0xbf2b04) "' name='RPMH_BCM_SW_OVERRIDE_TCS_FLUSH_CD1'/>"
WRITE #1 "        <register address='0xbbf2b08' value='0x" DATA.LONG(A:0xbf2b08) "' name='RPMH_BCM_SW_OVERRIDE_TCS_FLUSH_CD2'/>"
WRITE #1 "        <register address='0xbbf2b0c' value='0x" DATA.LONG(A:0xbf2b0c) "' name='RPMH_BCM_SW_OVERRIDE_TCS_FLUSH_CD3'/>"
WRITE #1 "        <register address='0xbbf2b10' value='0x" DATA.LONG(A:0xbf2b10) "' name='RPMH_BCM_SW_OVERRIDE_TCS_FLUSH_CD4'/>"
WRITE #1 "        <register address='0xbbf2b14' value='0x" DATA.LONG(A:0xbf2b14) "' name='RPMH_BCM_SW_OVERRIDE_TCS_FLUSH_CD5'/>"
WRITE #1 "        <register address='0xbbf2b18' value='0x" DATA.LONG(A:0xbf2b18) "' name='RPMH_BCM_SW_OVERRIDE_TCS_FLUSH_CD6'/>"
WRITE #1 "        <register address='0xbbf2b1c' value='0x" DATA.LONG(A:0xbf2b1c) "' name='RPMH_BCM_SW_OVERRIDE_TCS_FLUSH_CD7'/>"
WRITE #1 "        <register address='0xbbf2b20' value='0x" DATA.LONG(A:0xbf2b20) "' name='RPMH_BCM_SW_OVERRIDE_TCS_FLUSH_CD8'/>"
WRITE #1 "        <register address='0xbbf2b24' value='0x" DATA.LONG(A:0xbf2b24) "' name='RPMH_BCM_SW_OVERRIDE_TCS_FLUSH_CD9'/>"
WRITE #1 "        <register address='0xbbf2b28' value='0x" DATA.LONG(A:0xbf2b28) "' name='RPMH_BCM_SW_OVERRIDE_TCS_FLUSH_CD10'/>"
WRITE #1 "        <register address='0xbbf2b2c' value='0x" DATA.LONG(A:0xbf2b2c) "' name='RPMH_BCM_SW_OVERRIDE_TCS_FLUSH_CD11'/>"
WRITE #1 "        <register address='0xbbf2b80' value='0x" DATA.LONG(A:0xbf2b80) "' name='RPMH_BCM_SW_OVERRIDE_SEQ_UNBLOCK_STICKY_CD0'/>"
WRITE #1 "        <register address='0xbbf2b84' value='0x" DATA.LONG(A:0xbf2b84) "' name='RPMH_BCM_SW_OVERRIDE_SEQ_UNBLOCK_STICKY_CD1'/>"
WRITE #1 "        <register address='0xbbf2b88' value='0x" DATA.LONG(A:0xbf2b88) "' name='RPMH_BCM_SW_OVERRIDE_SEQ_UNBLOCK_STICKY_CD2'/>"
WRITE #1 "        <register address='0xbbf2b8c' value='0x" DATA.LONG(A:0xbf2b8c) "' name='RPMH_BCM_SW_OVERRIDE_SEQ_UNBLOCK_STICKY_CD3'/>"
WRITE #1 "        <register address='0xbbf2b90' value='0x" DATA.LONG(A:0xbf2b90) "' name='RPMH_BCM_SW_OVERRIDE_SEQ_UNBLOCK_STICKY_CD4'/>"
WRITE #1 "        <register address='0xbbf2b94' value='0x" DATA.LONG(A:0xbf2b94) "' name='RPMH_BCM_SW_OVERRIDE_SEQ_UNBLOCK_STICKY_CD5'/>"
WRITE #1 "        <register address='0xbbf2b98' value='0x" DATA.LONG(A:0xbf2b98) "' name='RPMH_BCM_SW_OVERRIDE_SEQ_UNBLOCK_STICKY_CD6'/>"
WRITE #1 "        <register address='0xbbf2b9c' value='0x" DATA.LONG(A:0xbf2b9c) "' name='RPMH_BCM_SW_OVERRIDE_SEQ_UNBLOCK_STICKY_CD7'/>"
WRITE #1 "        <register address='0xbbf2ba0' value='0x" DATA.LONG(A:0xbf2ba0) "' name='RPMH_BCM_SW_OVERRIDE_SEQ_UNBLOCK_STICKY_CD8'/>"
WRITE #1 "        <register address='0xbbf2ba4' value='0x" DATA.LONG(A:0xbf2ba4) "' name='RPMH_BCM_SW_OVERRIDE_SEQ_UNBLOCK_STICKY_CD9'/>"
WRITE #1 "        <register address='0xbbf2ba8' value='0x" DATA.LONG(A:0xbf2ba8) "' name='RPMH_BCM_SW_OVERRIDE_SEQ_UNBLOCK_STICKY_CD10'/>"
WRITE #1 "        <register address='0xbbf2bac' value='0x" DATA.LONG(A:0xbf2bac) "' name='RPMH_BCM_SW_OVERRIDE_SEQ_UNBLOCK_STICKY_CD11'/>"
WRITE #1 "        <register address='0xbbf2d00' value='0x" DATA.LONG(A:0xbf2d00) "' name='RPMH_BCM_SW_OVERRIDE_CE_INPUT_CD0'/>"
WRITE #1 "        <register address='0xbbf2d04' value='0x" DATA.LONG(A:0xbf2d04) "' name='RPMH_BCM_SW_OVERRIDE_CE_INPUT_CD1'/>"
WRITE #1 "        <register address='0xbbf2d08' value='0x" DATA.LONG(A:0xbf2d08) "' name='RPMH_BCM_SW_OVERRIDE_CE_INPUT_CD2'/>"
WRITE #1 "        <register address='0xbbf2d0c' value='0x" DATA.LONG(A:0xbf2d0c) "' name='RPMH_BCM_SW_OVERRIDE_CE_INPUT_CD3'/>"
WRITE #1 "        <register address='0xbbf2d10' value='0x" DATA.LONG(A:0xbf2d10) "' name='RPMH_BCM_SW_OVERRIDE_CE_INPUT_CD4'/>"
WRITE #1 "        <register address='0xbbf2d14' value='0x" DATA.LONG(A:0xbf2d14) "' name='RPMH_BCM_SW_OVERRIDE_CE_INPUT_CD5'/>"
WRITE #1 "        <register address='0xbbf2d18' value='0x" DATA.LONG(A:0xbf2d18) "' name='RPMH_BCM_SW_OVERRIDE_CE_INPUT_CD6'/>"
WRITE #1 "        <register address='0xbbf2d1c' value='0x" DATA.LONG(A:0xbf2d1c) "' name='RPMH_BCM_SW_OVERRIDE_CE_INPUT_CD7'/>"
WRITE #1 "        <register address='0xbbf2d20' value='0x" DATA.LONG(A:0xbf2d20) "' name='RPMH_BCM_SW_OVERRIDE_CE_INPUT_CD8'/>"
WRITE #1 "        <register address='0xbbf2d24' value='0x" DATA.LONG(A:0xbf2d24) "' name='RPMH_BCM_SW_OVERRIDE_CE_INPUT_CD9'/>"
WRITE #1 "        <register address='0xbbf2d28' value='0x" DATA.LONG(A:0xbf2d28) "' name='RPMH_BCM_SW_OVERRIDE_CE_INPUT_CD10'/>"
WRITE #1 "        <register address='0xbbf2d2c' value='0x" DATA.LONG(A:0xbf2d2c) "' name='RPMH_BCM_SW_OVERRIDE_CE_INPUT_CD11'/>"
WRITE #1 "        <register address='0xbbf2d80' value='0x" DATA.LONG(A:0xbf2d80) "' name='RPMH_BCM_SW_OVERRIDE_BE_SEQ_TCS_CLK_ON_CD0'/>"
WRITE #1 "        <register address='0xbbf2d84' value='0x" DATA.LONG(A:0xbf2d84) "' name='RPMH_BCM_SW_OVERRIDE_BE_SEQ_TCS_CLK_ON_CD1'/>"
WRITE #1 "        <register address='0xbbf2d88' value='0x" DATA.LONG(A:0xbf2d88) "' name='RPMH_BCM_SW_OVERRIDE_BE_SEQ_TCS_CLK_ON_CD2'/>"
WRITE #1 "        <register address='0xbbf2d8c' value='0x" DATA.LONG(A:0xbf2d8c) "' name='RPMH_BCM_SW_OVERRIDE_BE_SEQ_TCS_CLK_ON_CD3'/>"
WRITE #1 "        <register address='0xbbf2d90' value='0x" DATA.LONG(A:0xbf2d90) "' name='RPMH_BCM_SW_OVERRIDE_BE_SEQ_TCS_CLK_ON_CD4'/>"
WRITE #1 "        <register address='0xbbf2d94' value='0x" DATA.LONG(A:0xbf2d94) "' name='RPMH_BCM_SW_OVERRIDE_BE_SEQ_TCS_CLK_ON_CD5'/>"
WRITE #1 "        <register address='0xbbf2d98' value='0x" DATA.LONG(A:0xbf2d98) "' name='RPMH_BCM_SW_OVERRIDE_BE_SEQ_TCS_CLK_ON_CD6'/>"
WRITE #1 "        <register address='0xbbf2d9c' value='0x" DATA.LONG(A:0xbf2d9c) "' name='RPMH_BCM_SW_OVERRIDE_BE_SEQ_TCS_CLK_ON_CD7'/>"
WRITE #1 "        <register address='0xbbf2da0' value='0x" DATA.LONG(A:0xbf2da0) "' name='RPMH_BCM_SW_OVERRIDE_BE_SEQ_TCS_CLK_ON_CD8'/>"
WRITE #1 "        <register address='0xbbf2da4' value='0x" DATA.LONG(A:0xbf2da4) "' name='RPMH_BCM_SW_OVERRIDE_BE_SEQ_TCS_CLK_ON_CD9'/>"
WRITE #1 "        <register address='0xbbf2da8' value='0x" DATA.LONG(A:0xbf2da8) "' name='RPMH_BCM_SW_OVERRIDE_BE_SEQ_TCS_CLK_ON_CD10'/>"
WRITE #1 "        <register address='0xbbf2dac' value='0x" DATA.LONG(A:0xbf2dac) "' name='RPMH_BCM_SW_OVERRIDE_BE_SEQ_TCS_CLK_ON_CD11'/>"
WRITE #1 "        <register address='0xbc00000' value='0x" DATA.LONG(A:0xc00000) "' name='RPMH_DDRAUX_RSI_TCS0_CFG'/>"
WRITE #1 "        <register address='0xbc00004' value='0x" DATA.LONG(A:0xc00004) "' name='RPMH_DDRAUX_RSI_TCS1_CFG'/>"
WRITE #1 "        <register address='0xbc00008' value='0x" DATA.LONG(A:0xc00008) "' name='RPMH_DDRAUX_RSI_TCS2_CFG'/>"
WRITE #1 "        <register address='0xbc0000c' value='0x" DATA.LONG(A:0xc0000c) "' name='RPMH_DDRAUX_RSI_TCS3_CFG'/>"
WRITE #1 "        <register address='0xbc00010' value='0x" DATA.LONG(A:0xc00010) "' name='RPMH_DDRAUX_RSI_TCS4_CFG'/>"
WRITE #1 "        <register address='0xbc00014' value='0x" DATA.LONG(A:0xc00014) "' name='RPMH_DDRAUX_RSI_TCS5_CFG'/>"
WRITE #1 "        <register address='0xbc00018' value='0x" DATA.LONG(A:0xc00018) "' name='RPMH_DDRAUX_RSI_TCS6_CFG'/>"
WRITE #1 "        <register address='0xbc0001c' value='0x" DATA.LONG(A:0xc0001c) "' name='RPMH_DDRAUX_RSI_TCS7_CFG'/>"
WRITE #1 "        <register address='0xbc00020' value='0x" DATA.LONG(A:0xc00020) "' name='RPMH_DDRAUX_RSI_TCS8_CFG'/>"
WRITE #1 "        <register address='0xbc00024' value='0x" DATA.LONG(A:0xc00024) "' name='RPMH_DDRAUX_RSI_TCS9_CFG'/>"
WRITE #1 "        <register address='0xbc00028' value='0x" DATA.LONG(A:0xc00028) "' name='RPMH_DDRAUX_RSI_TCS10_CFG'/>"
WRITE #1 "        <register address='0xbc0002c' value='0x" DATA.LONG(A:0xc0002c) "' name='RPMH_DDRAUX_RSI_TCS11_CFG'/>"
WRITE #1 "        <register address='0xbc00030' value='0x" DATA.LONG(A:0xc00030) "' name='RPMH_DDRAUX_RSI_TCS12_CFG'/>"
WRITE #1 "        <register address='0xbc00034' value='0x" DATA.LONG(A:0xc00034) "' name='RPMH_DDRAUX_RSI_TCS13_CFG'/>"
WRITE #1 "        <register address='0xbc00040' value='0x" DATA.LONG(A:0xc00040) "' name='RPMH_DDRAUX_RSI_TCS0_STAT'/>"
WRITE #1 "        <register address='0xbc00044' value='0x" DATA.LONG(A:0xc00044) "' name='RPMH_DDRAUX_RSI_TCS1_STAT'/>"
WRITE #1 "        <register address='0xbc00048' value='0x" DATA.LONG(A:0xc00048) "' name='RPMH_DDRAUX_RSI_TCS2_STAT'/>"
WRITE #1 "        <register address='0xbc0004c' value='0x" DATA.LONG(A:0xc0004c) "' name='RPMH_DDRAUX_RSI_TCS3_STAT'/>"
WRITE #1 "        <register address='0xbc00050' value='0x" DATA.LONG(A:0xc00050) "' name='RPMH_DDRAUX_RSI_TCS4_STAT'/>"
WRITE #1 "        <register address='0xbc00054' value='0x" DATA.LONG(A:0xc00054) "' name='RPMH_DDRAUX_RSI_TCS5_STAT'/>"
WRITE #1 "        <register address='0xbc00058' value='0x" DATA.LONG(A:0xc00058) "' name='RPMH_DDRAUX_RSI_TCS6_STAT'/>"
WRITE #1 "        <register address='0xbc0005c' value='0x" DATA.LONG(A:0xc0005c) "' name='RPMH_DDRAUX_RSI_TCS7_STAT'/>"
WRITE #1 "        <register address='0xbc00060' value='0x" DATA.LONG(A:0xc00060) "' name='RPMH_DDRAUX_RSI_TCS8_STAT'/>"
WRITE #1 "        <register address='0xbc00064' value='0x" DATA.LONG(A:0xc00064) "' name='RPMH_DDRAUX_RSI_TCS9_STAT'/>"
WRITE #1 "        <register address='0xbc00068' value='0x" DATA.LONG(A:0xc00068) "' name='RPMH_DDRAUX_RSI_TCS10_STAT'/>"
WRITE #1 "        <register address='0xbc0006c' value='0x" DATA.LONG(A:0xc0006c) "' name='RPMH_DDRAUX_RSI_TCS11_STAT'/>"
WRITE #1 "        <register address='0xbc00070' value='0x" DATA.LONG(A:0xc00070) "' name='RPMH_DDRAUX_RSI_TCS12_STAT'/>"
WRITE #1 "        <register address='0xbc00074' value='0x" DATA.LONG(A:0xc00074) "' name='RPMH_DDRAUX_RSI_TCS13_STAT'/>"
WRITE #1 "        <register address='0xbc00080' value='0x" DATA.LONG(A:0xc00080) "' name='RPMH_DDRAUX_RSI_TCS0_CMD0'/>"
WRITE #1 "        <register address='0xbc00084' value='0x" DATA.LONG(A:0xc00084) "' name='RPMH_DDRAUX_RSI_TCS0_CMD1'/>"
WRITE #1 "        <register address='0xbc00088' value='0x" DATA.LONG(A:0xc00088) "' name='RPMH_DDRAUX_RSI_TCS0_CMD2'/>"
WRITE #1 "        <register address='0xbc0008c' value='0x" DATA.LONG(A:0xc0008c) "' name='RPMH_DDRAUX_RSI_TCS0_CMD3'/>"
WRITE #1 "        <register address='0xbc00090' value='0x" DATA.LONG(A:0xc00090) "' name='RPMH_DDRAUX_RSI_TCS1_CMD0'/>"
WRITE #1 "        <register address='0xbc00094' value='0x" DATA.LONG(A:0xc00094) "' name='RPMH_DDRAUX_RSI_TCS1_CMD1'/>"
WRITE #1 "        <register address='0xbc00098' value='0x" DATA.LONG(A:0xc00098) "' name='RPMH_DDRAUX_RSI_TCS1_CMD2'/>"
WRITE #1 "        <register address='0xbc0009c' value='0x" DATA.LONG(A:0xc0009c) "' name='RPMH_DDRAUX_RSI_TCS1_CMD3'/>"
WRITE #1 "        <register address='0xbc000a0' value='0x" DATA.LONG(A:0xc000a0) "' name='RPMH_DDRAUX_RSI_TCS2_CMD0'/>"
WRITE #1 "        <register address='0xbc000a4' value='0x" DATA.LONG(A:0xc000a4) "' name='RPMH_DDRAUX_RSI_TCS2_CMD1'/>"
WRITE #1 "        <register address='0xbc000a8' value='0x" DATA.LONG(A:0xc000a8) "' name='RPMH_DDRAUX_RSI_TCS2_CMD2'/>"
WRITE #1 "        <register address='0xbc000ac' value='0x" DATA.LONG(A:0xc000ac) "' name='RPMH_DDRAUX_RSI_TCS2_CMD3'/>"
WRITE #1 "        <register address='0xbc000b0' value='0x" DATA.LONG(A:0xc000b0) "' name='RPMH_DDRAUX_RSI_TCS3_CMD0'/>"
WRITE #1 "        <register address='0xbc000b4' value='0x" DATA.LONG(A:0xc000b4) "' name='RPMH_DDRAUX_RSI_TCS3_CMD1'/>"
WRITE #1 "        <register address='0xbc000b8' value='0x" DATA.LONG(A:0xc000b8) "' name='RPMH_DDRAUX_RSI_TCS3_CMD2'/>"
WRITE #1 "        <register address='0xbc000bc' value='0x" DATA.LONG(A:0xc000bc) "' name='RPMH_DDRAUX_RSI_TCS3_CMD3'/>"
WRITE #1 "        <register address='0xbc000c0' value='0x" DATA.LONG(A:0xc000c0) "' name='RPMH_DDRAUX_RSI_TCS4_CMD0'/>"
WRITE #1 "        <register address='0xbc000c4' value='0x" DATA.LONG(A:0xc000c4) "' name='RPMH_DDRAUX_RSI_TCS4_CMD1'/>"
WRITE #1 "        <register address='0xbc000c8' value='0x" DATA.LONG(A:0xc000c8) "' name='RPMH_DDRAUX_RSI_TCS4_CMD2'/>"
WRITE #1 "        <register address='0xbc000cc' value='0x" DATA.LONG(A:0xc000cc) "' name='RPMH_DDRAUX_RSI_TCS4_CMD3'/>"
WRITE #1 "        <register address='0xbc000d0' value='0x" DATA.LONG(A:0xc000d0) "' name='RPMH_DDRAUX_RSI_TCS5_CMD0'/>"
WRITE #1 "        <register address='0xbc000d4' value='0x" DATA.LONG(A:0xc000d4) "' name='RPMH_DDRAUX_RSI_TCS5_CMD1'/>"
WRITE #1 "        <register address='0xbc000d8' value='0x" DATA.LONG(A:0xc000d8) "' name='RPMH_DDRAUX_RSI_TCS5_CMD2'/>"
WRITE #1 "        <register address='0xbc000dc' value='0x" DATA.LONG(A:0xc000dc) "' name='RPMH_DDRAUX_RSI_TCS5_CMD3'/>"
WRITE #1 "        <register address='0xbc000e0' value='0x" DATA.LONG(A:0xc000e0) "' name='RPMH_DDRAUX_RSI_TCS6_CMD0'/>"
WRITE #1 "        <register address='0xbc000e4' value='0x" DATA.LONG(A:0xc000e4) "' name='RPMH_DDRAUX_RSI_TCS6_CMD1'/>"
WRITE #1 "        <register address='0xbc000e8' value='0x" DATA.LONG(A:0xc000e8) "' name='RPMH_DDRAUX_RSI_TCS6_CMD2'/>"
WRITE #1 "        <register address='0xbc000ec' value='0x" DATA.LONG(A:0xc000ec) "' name='RPMH_DDRAUX_RSI_TCS6_CMD3'/>"
WRITE #1 "        <register address='0xbc000f0' value='0x" DATA.LONG(A:0xc000f0) "' name='RPMH_DDRAUX_RSI_TCS7_CMD0'/>"
WRITE #1 "        <register address='0xbc000f4' value='0x" DATA.LONG(A:0xc000f4) "' name='RPMH_DDRAUX_RSI_TCS7_CMD1'/>"
WRITE #1 "        <register address='0xbc000f8' value='0x" DATA.LONG(A:0xc000f8) "' name='RPMH_DDRAUX_RSI_TCS7_CMD2'/>"
WRITE #1 "        <register address='0xbc000fc' value='0x" DATA.LONG(A:0xc000fc) "' name='RPMH_DDRAUX_RSI_TCS7_CMD3'/>"
WRITE #1 "        <register address='0xbc00100' value='0x" DATA.LONG(A:0xc00100) "' name='RPMH_DDRAUX_RSI_TCS8_CMD0'/>"
WRITE #1 "        <register address='0xbc00104' value='0x" DATA.LONG(A:0xc00104) "' name='RPMH_DDRAUX_RSI_TCS8_CMD1'/>"
WRITE #1 "        <register address='0xbc00108' value='0x" DATA.LONG(A:0xc00108) "' name='RPMH_DDRAUX_RSI_TCS8_CMD2'/>"
WRITE #1 "        <register address='0xbc0010c' value='0x" DATA.LONG(A:0xc0010c) "' name='RPMH_DDRAUX_RSI_TCS8_CMD3'/>"
WRITE #1 "        <register address='0xbc00110' value='0x" DATA.LONG(A:0xc00110) "' name='RPMH_DDRAUX_RSI_TCS9_CMD0'/>"
WRITE #1 "        <register address='0xbc00114' value='0x" DATA.LONG(A:0xc00114) "' name='RPMH_DDRAUX_RSI_TCS9_CMD1'/>"
WRITE #1 "        <register address='0xbc00118' value='0x" DATA.LONG(A:0xc00118) "' name='RPMH_DDRAUX_RSI_TCS9_CMD2'/>"
WRITE #1 "        <register address='0xbc0011c' value='0x" DATA.LONG(A:0xc0011c) "' name='RPMH_DDRAUX_RSI_TCS9_CMD3'/>"
WRITE #1 "        <register address='0xbc00120' value='0x" DATA.LONG(A:0xc00120) "' name='RPMH_DDRAUX_RSI_TCS10_CMD0'/>"
WRITE #1 "        <register address='0xbc00124' value='0x" DATA.LONG(A:0xc00124) "' name='RPMH_DDRAUX_RSI_TCS10_CMD1'/>"
WRITE #1 "        <register address='0xbc00128' value='0x" DATA.LONG(A:0xc00128) "' name='RPMH_DDRAUX_RSI_TCS10_CMD2'/>"
WRITE #1 "        <register address='0xbc0012c' value='0x" DATA.LONG(A:0xc0012c) "' name='RPMH_DDRAUX_RSI_TCS10_CMD3'/>"
WRITE #1 "        <register address='0xbc00130' value='0x" DATA.LONG(A:0xc00130) "' name='RPMH_DDRAUX_RSI_TCS11_CMD0'/>"
WRITE #1 "        <register address='0xbc00134' value='0x" DATA.LONG(A:0xc00134) "' name='RPMH_DDRAUX_RSI_TCS11_CMD1'/>"
WRITE #1 "        <register address='0xbc00138' value='0x" DATA.LONG(A:0xc00138) "' name='RPMH_DDRAUX_RSI_TCS11_CMD2'/>"
WRITE #1 "        <register address='0xbc0013c' value='0x" DATA.LONG(A:0xc0013c) "' name='RPMH_DDRAUX_RSI_TCS11_CMD3'/>"
WRITE #1 "        <register address='0xbc00140' value='0x" DATA.LONG(A:0xc00140) "' name='RPMH_DDRAUX_RSI_TCS12_CMD0'/>"
WRITE #1 "        <register address='0xbc00144' value='0x" DATA.LONG(A:0xc00144) "' name='RPMH_DDRAUX_RSI_TCS12_CMD1'/>"
WRITE #1 "        <register address='0xbc00148' value='0x" DATA.LONG(A:0xc00148) "' name='RPMH_DDRAUX_RSI_TCS12_CMD2'/>"
WRITE #1 "        <register address='0xbc0014c' value='0x" DATA.LONG(A:0xc0014c) "' name='RPMH_DDRAUX_RSI_TCS12_CMD3'/>"
WRITE #1 "        <register address='0xbc00150' value='0x" DATA.LONG(A:0xc00150) "' name='RPMH_DDRAUX_RSI_TCS13_CMD0'/>"
WRITE #1 "        <register address='0xbc00154' value='0x" DATA.LONG(A:0xc00154) "' name='RPMH_DDRAUX_RSI_TCS13_CMD1'/>"
WRITE #1 "        <register address='0xbc00158' value='0x" DATA.LONG(A:0xc00158) "' name='RPMH_DDRAUX_RSI_TCS13_CMD2'/>"
WRITE #1 "        <register address='0xbc0015c' value='0x" DATA.LONG(A:0xc0015c) "' name='RPMH_DDRAUX_RSI_TCS13_CMD3'/>"
WRITE #1 "        <register address='0xbc00180' value='0x" DATA.LONG(A:0xc00180) "' name='RPMH_DDRAUX_RSI_TCS0_AMC_MODE'/>"
WRITE #1 "        <register address='0xbc00184' value='0x" DATA.LONG(A:0xc00184) "' name='RPMH_DDRAUX_RSI_TCS1_AMC_MODE'/>"
WRITE #1 "        <register address='0xbc00188' value='0x" DATA.LONG(A:0xc00188) "' name='RPMH_DDRAUX_RSI_TCS2_AMC_MODE'/>"
WRITE #1 "        <register address='0xbc0018c' value='0x" DATA.LONG(A:0xc0018c) "' name='RPMH_DDRAUX_RSI_TCS3_AMC_MODE'/>"
WRITE #1 "        <register address='0xbc00190' value='0x" DATA.LONG(A:0xc00190) "' name='RPMH_DDRAUX_RSI_TCS4_AMC_MODE'/>"
WRITE #1 "        <register address='0xbc00194' value='0x" DATA.LONG(A:0xc00194) "' name='RPMH_DDRAUX_RSI_TCS5_AMC_MODE'/>"
WRITE #1 "        <register address='0xbc00198' value='0x" DATA.LONG(A:0xc00198) "' name='RPMH_DDRAUX_RSI_TCS6_AMC_MODE'/>"
WRITE #1 "        <register address='0xbc0019c' value='0x" DATA.LONG(A:0xc0019c) "' name='RPMH_DDRAUX_RSI_TCS7_AMC_MODE'/>"
WRITE #1 "        <register address='0xbc001a0' value='0x" DATA.LONG(A:0xc001a0) "' name='RPMH_DDRAUX_RSI_TCS8_AMC_MODE'/>"
WRITE #1 "        <register address='0xbc001a4' value='0x" DATA.LONG(A:0xc001a4) "' name='RPMH_DDRAUX_RSI_TCS9_AMC_MODE'/>"
WRITE #1 "        <register address='0xbc001a8' value='0x" DATA.LONG(A:0xc001a8) "' name='RPMH_DDRAUX_RSI_TCS10_AMC_MODE'/>"
WRITE #1 "        <register address='0xbc001ac' value='0x" DATA.LONG(A:0xc001ac) "' name='RPMH_DDRAUX_RSI_TCS11_AMC_MODE'/>"
WRITE #1 "        <register address='0xbc001b0' value='0x" DATA.LONG(A:0xc001b0) "' name='RPMH_DDRAUX_RSI_TCS12_AMC_MODE'/>"
WRITE #1 "        <register address='0xbc001b4' value='0x" DATA.LONG(A:0xc001b4) "' name='RPMH_DDRAUX_RSI_TCS13_AMC_MODE'/>"
WRITE #1 "        <register address='0xbc001c0' value='0x" DATA.LONG(A:0xc001c0) "' name='RPMH_DDRAUX_RSI_TCS0_RESP_DATA0'/>"
WRITE #1 "        <register address='0xbc001c4' value='0x" DATA.LONG(A:0xc001c4) "' name='RPMH_DDRAUX_RSI_TCS0_RESP_DATA1'/>"
WRITE #1 "        <register address='0xbc001c8' value='0x" DATA.LONG(A:0xc001c8) "' name='RPMH_DDRAUX_RSI_TCS0_RESP_DATA2'/>"
WRITE #1 "        <register address='0xbc001cc' value='0x" DATA.LONG(A:0xc001cc) "' name='RPMH_DDRAUX_RSI_TCS0_RESP_DATA3'/>"
WRITE #1 "        <register address='0xbc001d0' value='0x" DATA.LONG(A:0xc001d0) "' name='RPMH_DDRAUX_RSI_TCS_BUSY_SUMMARY'/>"
WRITE #1 "        <register address='0xbc00200' value='0x" DATA.LONG(A:0xc00200) "' name='RPMH_DDRAUX_SEQ_BRANCH_EVENT'/>"
WRITE #1 "        <register address='0xbc00208' value='0x" DATA.LONG(A:0xc00208) "' name='RPMH_DDRAUX_SEQ_GCC_CLKPLAN'/>"
WRITE #1 "        <register address='0xbc0021c' value='0x" DATA.LONG(A:0xc0021c) "' name='RPMH_DDRAUX_SEQ0_DBG_STAT'/>"
WRITE #1 "        <register address='0xbc00220' value='0x" DATA.LONG(A:0xc00220) "' name='RPMH_DDRAUX_SEQ1_DBG_STAT'/>"
WRITE #1 "        <register address='0xbc00224' value='0x" DATA.LONG(A:0xc00224) "' name='RPMH_DDRAUX_SEQ0_DBG_BREAKPOINT_ADDR'/>"
WRITE #1 "        <register address='0xbc00228' value='0x" DATA.LONG(A:0xc00228) "' name='RPMH_DDRAUX_SEQ1_DBG_BREAKPOINT_ADDR'/>"
WRITE #1 "        <register address='0xbc0022c' value='0x" DATA.LONG(A:0xc0022c) "' name='RPMH_DDRAUX_SEQ0_CFG'/>"
WRITE #1 "        <register address='0xbc00230' value='0x" DATA.LONG(A:0xc00230) "' name='RPMH_DDRAUX_SEQ1_CFG'/>"
WRITE #1 "        <register address='0xbc00234' value='0x" DATA.LONG(A:0xc00234) "' name='RPMH_DDRAUX_SEQ0_STAT'/>"
WRITE #1 "        <register address='0xbc00238' value='0x" DATA.LONG(A:0xc00238) "' name='RPMH_DDRAUX_SEQ1_STAT'/>"
WRITE #1 "        <register address='0xbc0023c' value='0x" DATA.LONG(A:0xc0023c) "' name='RPMH_DDRAUX_SEQ_VCD_SEL'/>"
WRITE #1 "        <register address='0xbc00244' value='0x" DATA.LONG(A:0xc00244) "' name='RPMH_DDRAUX_SEQ0_PWR_CTRL_OVRD_BIT_31_TO_0_MASK'/>"
WRITE #1 "        <register address='0xbc00248' value='0x" DATA.LONG(A:0xc00248) "' name='RPMH_DDRAUX_SEQ1_PWR_CTRL_OVRD_BIT_31_TO_0_MASK'/>"
WRITE #1 "        <register address='0xbc0024c' value='0x" DATA.LONG(A:0xc0024c) "' name='RPMH_DDRAUX_SEQ0_PWR_CTRL_OVRD_BIT_63_TO_32_MASK'/>"
WRITE #1 "        <register address='0xbc00250' value='0x" DATA.LONG(A:0xc00250) "' name='RPMH_DDRAUX_SEQ1_PWR_CTRL_OVRD_BIT_63_TO_32_MASK'/>"
WRITE #1 "        <register address='0xbc00254' value='0x" DATA.LONG(A:0xc00254) "' name='RPMH_DDRAUX_SEQ0_PWR_CTRL_OVRD_BIT_31_TO_0_VAL'/>"
WRITE #1 "        <register address='0xbc00258' value='0x" DATA.LONG(A:0xc00258) "' name='RPMH_DDRAUX_SEQ1_PWR_CTRL_OVRD_BIT_31_TO_0_VAL'/>"
WRITE #1 "        <register address='0xbc0025c' value='0x" DATA.LONG(A:0xc0025c) "' name='RPMH_DDRAUX_SEQ0_PWR_CTRL_OVRD_BIT_63_TO_32_VAL'/>"
WRITE #1 "        <register address='0xbc00260' value='0x" DATA.LONG(A:0xc00260) "' name='RPMH_DDRAUX_SEQ1_PWR_CTRL_OVRD_BIT_63_TO_32_VAL'/>"
WRITE #1 "        <register address='0xbc00264' value='0x" DATA.LONG(A:0xc00264) "' name='RPMH_DDRAUX_SEQ0_WAIT_EVENT_BIT_31_TO_0_OVRD_MASK'/>"
WRITE #1 "        <register address='0xbc00268' value='0x" DATA.LONG(A:0xc00268) "' name='RPMH_DDRAUX_SEQ1_WAIT_EVENT_BIT_31_TO_0_OVRD_MASK'/>"
WRITE #1 "        <register address='0xbc0026c' value='0x" DATA.LONG(A:0xc0026c) "' name='RPMH_DDRAUX_SEQ0_WAIT_EVENT_BIT_63_TO_32_OVRD_MASK'/>"
WRITE #1 "        <register address='0xbc00270' value='0x" DATA.LONG(A:0xc00270) "' name='RPMH_DDRAUX_SEQ1_WAIT_EVENT_BIT_63_TO_32_OVRD_MASK'/>"
WRITE #1 "        <register address='0xbc00274' value='0x" DATA.LONG(A:0xc00274) "' name='RPMH_DDRAUX_SEQ0_WAIT_EVENT_BIT_31_TO_0_OVRD_VAL'/>"
WRITE #1 "        <register address='0xbc00278' value='0x" DATA.LONG(A:0xc00278) "' name='RPMH_DDRAUX_SEQ1_WAIT_EVENT_BIT_31_TO_0_OVRD_VAL'/>"
WRITE #1 "        <register address='0xbc0027c' value='0x" DATA.LONG(A:0xc0027c) "' name='RPMH_DDRAUX_SEQ0_WAIT_EVENT_BIT_63_TO_32_OVRD_VAL'/>"
WRITE #1 "        <register address='0xbc00280' value='0x" DATA.LONG(A:0xc00280) "' name='RPMH_DDRAUX_SEQ1_WAIT_EVENT_BIT_63_TO_32_OVRD_VAL'/>"
WRITE #1 "        <register address='0xbc00284' value='0x" DATA.LONG(A:0xc00284) "' name='RPMH_DDRAUX_SEQ0_BRANCH_EVENT_OVRD_MASK'/>"
WRITE #1 "        <register address='0xbc00288' value='0x" DATA.LONG(A:0xc00288) "' name='RPMH_DDRAUX_SEQ1_BRANCH_EVENT_OVRD_MASK'/>"
WRITE #1 "        <register address='0xbc0028c' value='0x" DATA.LONG(A:0xc0028c) "' name='RPMH_DDRAUX_SEQ0_BRANCH_EVENT_OVRD_VAL'/>"
WRITE #1 "        <register address='0xbc00290' value='0x" DATA.LONG(A:0xc00290) "' name='RPMH_DDRAUX_SEQ1_BRANCH_EVENT_OVRD_VAL'/>"
WRITE #1 "        <register address='0xbc00298' value='0x" DATA.LONG(A:0xc00298) "' name='RPMH_DDRAUX_SEQ_CFG_DELAY_VAL_0'/>"
WRITE #1 "        <register address='0xbc0029c' value='0x" DATA.LONG(A:0xc0029c) "' name='RPMH_DDRAUX_SEQ_CFG_DELAY_VAL_1'/>"
WRITE #1 "        <register address='0xbc002a0' value='0x" DATA.LONG(A:0xc002a0) "' name='RPMH_DDRAUX_SEQ_CFG_DELAY_VAL_2'/>"
WRITE #1 "        <register address='0xbc002a4' value='0x" DATA.LONG(A:0xc002a4) "' name='RPMH_DDRAUX_SEQ_CFG_DELAY_VAL_3'/>"
WRITE #1 "        <register address='0xbc00308' value='0x" DATA.LONG(A:0xc00308) "' name='RPMH_DDRAUX_BRANCH_ADDR0'/>"
WRITE #1 "        <register address='0xbc0030c' value='0x" DATA.LONG(A:0xc0030c) "' name='RPMH_DDRAUX_BRANCH_ADDR1'/>"
WRITE #1 "        <register address='0xbc00310' value='0x" DATA.LONG(A:0xc00310) "' name='RPMH_DDRAUX_BRANCH_ADDR2'/>"
WRITE #1 "        <register address='0xbc00314' value='0x" DATA.LONG(A:0xc00314) "' name='RPMH_DDRAUX_BRANCH_ADDR3'/>"
WRITE #1 "        <register address='0xbc00318' value='0x" DATA.LONG(A:0xc00318) "' name='RPMH_DDRAUX_BRANCH_ADDR4'/>"
WRITE #1 "        <register address='0xbc0031c' value='0x" DATA.LONG(A:0xc0031c) "' name='RPMH_DDRAUX_BRANCH_ADDR5'/>"
WRITE #1 "        <register address='0xbc00320' value='0x" DATA.LONG(A:0xc00320) "' name='RPMH_DDRAUX_BRANCH_ADDR6'/>"
WRITE #1 "        <register address='0xbc00324' value='0x" DATA.LONG(A:0xc00324) "' name='RPMH_DDRAUX_BRANCH_ADDR7'/>"
WRITE #1 "        <register address='0xbc00328' value='0x" DATA.LONG(A:0xc00328) "' name='RPMH_DDRAUX_BRANCH_ADDR8'/>"
WRITE #1 "        <register address='0xbc0032c' value='0x" DATA.LONG(A:0xc0032c) "' name='RPMH_DDRAUX_BRANCH_ADDR9'/>"
WRITE #1 "        <register address='0xbc00330' value='0x" DATA.LONG(A:0xc00330) "' name='RPMH_DDRAUX_BRANCH_ADDR10'/>"
WRITE #1 "        <register address='0xbc00334' value='0x" DATA.LONG(A:0xc00334) "' name='RPMH_DDRAUX_BRANCH_ADDR11'/>"
WRITE #1 "        <register address='0xbc00338' value='0x" DATA.LONG(A:0xc00338) "' name='RPMH_DDRAUX_BRANCH_ADDR12'/>"
WRITE #1 "        <register address='0xbc0033c' value='0x" DATA.LONG(A:0xc0033c) "' name='RPMH_DDRAUX_BRANCH_ADDR13'/>"
WRITE #1 "        <register address='0xbc00340' value='0x" DATA.LONG(A:0xc00340) "' name='RPMH_DDRAUX_BRANCH_ADDR14'/>"
WRITE #1 "        <register address='0xbc00344' value='0x" DATA.LONG(A:0xc00344) "' name='RPMH_DDRAUX_BRANCH_ADDR15'/>"
WRITE #1 "        <register address='0xbc00348' value='0x" DATA.LONG(A:0xc00348) "' name='RPMH_DDRAUX_BRANCH_ADDR16'/>"
WRITE #1 "        <register address='0xbc0034c' value='0x" DATA.LONG(A:0xc0034c) "' name='RPMH_DDRAUX_BRANCH_ADDR17'/>"
WRITE #1 "        <register address='0xbc00350' value='0x" DATA.LONG(A:0xc00350) "' name='RPMH_DDRAUX_BRANCH_ADDR18'/>"
WRITE #1 "        <register address='0xbc00354' value='0x" DATA.LONG(A:0xc00354) "' name='RPMH_DDRAUX_BRANCH_ADDR19'/>"
WRITE #1 "        <register address='0xbc00358' value='0x" DATA.LONG(A:0xc00358) "' name='RPMH_DDRAUX_BRANCH_ADDR20'/>"
WRITE #1 "        <register address='0xbc0035c' value='0x" DATA.LONG(A:0xc0035c) "' name='RPMH_DDRAUX_BRANCH_ADDR21'/>"
WRITE #1 "        <register address='0xbc00360' value='0x" DATA.LONG(A:0xc00360) "' name='RPMH_DDRAUX_BRANCH_ADDR22'/>"
WRITE #1 "        <register address='0xbc00364' value='0x" DATA.LONG(A:0xc00364) "' name='RPMH_DDRAUX_BRANCH_ADDR23'/>"
WRITE #1 "        <register address='0xbc00368' value='0x" DATA.LONG(A:0xc00368) "' name='RPMH_DDRAUX_BRANCH_ADDR24'/>"
WRITE #1 "        <register address='0xbc0036c' value='0x" DATA.LONG(A:0xc0036c) "' name='RPMH_DDRAUX_BRANCH_ADDR25'/>"
WRITE #1 "        <register address='0xbc00370' value='0x" DATA.LONG(A:0xc00370) "' name='RPMH_DDRAUX_BRANCH_ADDR26'/>"
WRITE #1 "        <register address='0xbc00374' value='0x" DATA.LONG(A:0xc00374) "' name='RPMH_DDRAUX_BRANCH_ADDR27'/>"
WRITE #1 "        <register address='0xbc00378' value='0x" DATA.LONG(A:0xc00378) "' name='RPMH_DDRAUX_BRANCH_ADDR28'/>"
WRITE #1 "        <register address='0xbc0037c' value='0x" DATA.LONG(A:0xc0037c) "' name='RPMH_DDRAUX_BRANCH_ADDR29'/>"
WRITE #1 "        <register address='0xbc00380' value='0x" DATA.LONG(A:0xc00380) "' name='RPMH_DDRAUX_BRANCH_ADDR30'/>"
WRITE #1 "        <register address='0xbc00384' value='0x" DATA.LONG(A:0xc00384) "' name='RPMH_DDRAUX_BRANCH_ADDR31'/>"
WRITE #1 "        <register address='0xbc00388' value='0x" DATA.LONG(A:0xc00388) "' name='RPMH_DDRAUX_BRANCH_ADDR32'/>"
WRITE #1 "        <register address='0xbc0038c' value='0x" DATA.LONG(A:0xc0038c) "' name='RPMH_DDRAUX_BRANCH_ADDR33'/>"
WRITE #1 "        <register address='0xbc00390' value='0x" DATA.LONG(A:0xc00390) "' name='RPMH_DDRAUX_BRANCH_ADDR34'/>"
WRITE #1 "        <register address='0xbc00394' value='0x" DATA.LONG(A:0xc00394) "' name='RPMH_DDRAUX_BRANCH_ADDR35'/>"
WRITE #1 "        <register address='0xbc00398' value='0x" DATA.LONG(A:0xc00398) "' name='RPMH_DDRAUX_BRANCH_ADDR36'/>"
WRITE #1 "        <register address='0xbc0039c' value='0x" DATA.LONG(A:0xc0039c) "' name='RPMH_DDRAUX_BRANCH_ADDR37'/>"
WRITE #1 "        <register address='0xbc003a0' value='0x" DATA.LONG(A:0xc003a0) "' name='RPMH_DDRAUX_BRANCH_ADDR38'/>"
WRITE #1 "        <register address='0xbc003a4' value='0x" DATA.LONG(A:0xc003a4) "' name='RPMH_DDRAUX_BRANCH_ADDR39'/>"
WRITE #1 "        <register address='0xbc003a8' value='0x" DATA.LONG(A:0xc003a8) "' name='RPMH_DDRAUX_BRANCH_ADDR40'/>"
WRITE #1 "        <register address='0xbc003ac' value='0x" DATA.LONG(A:0xc003ac) "' name='RPMH_DDRAUX_BRANCH_ADDR41'/>"
WRITE #1 "        <register address='0xbc003b0' value='0x" DATA.LONG(A:0xc003b0) "' name='RPMH_DDRAUX_BRANCH_ADDR42'/>"
WRITE #1 "        <register address='0xbc003b4' value='0x" DATA.LONG(A:0xc003b4) "' name='RPMH_DDRAUX_BRANCH_ADDR43'/>"
WRITE #1 "        <register address='0xbc003b8' value='0x" DATA.LONG(A:0xc003b8) "' name='RPMH_DDRAUX_BRANCH_ADDR44'/>"
WRITE #1 "        <register address='0xbc003bc' value='0x" DATA.LONG(A:0xc003bc) "' name='RPMH_DDRAUX_BRANCH_ADDR45'/>"
WRITE #1 "        <register address='0xbc003c0' value='0x" DATA.LONG(A:0xc003c0) "' name='RPMH_DDRAUX_BRANCH_ADDR46'/>"
WRITE #1 "        <register address='0xbc003c4' value='0x" DATA.LONG(A:0xc003c4) "' name='RPMH_DDRAUX_BRANCH_ADDR47'/>"
WRITE #1 "        <register address='0xbc003c8' value='0x" DATA.LONG(A:0xc003c8) "' name='RPMH_DDRAUX_BRANCH_ADDR48'/>"
WRITE #1 "        <register address='0xbc003cc' value='0x" DATA.LONG(A:0xc003cc) "' name='RPMH_DDRAUX_BRANCH_ADDR49'/>"
WRITE #1 "        <register address='0xbc003d0' value='0x" DATA.LONG(A:0xc003d0) "' name='RPMH_DDRAUX_BRANCH_ADDR50'/>"
WRITE #1 "        <register address='0xbc003d4' value='0x" DATA.LONG(A:0xc003d4) "' name='RPMH_DDRAUX_BRANCH_ADDR51'/>"
WRITE #1 "        <register address='0xbc003d8' value='0x" DATA.LONG(A:0xc003d8) "' name='RPMH_DDRAUX_BRANCH_ADDR52'/>"
WRITE #1 "        <register address='0xbc003dc' value='0x" DATA.LONG(A:0xc003dc) "' name='RPMH_DDRAUX_BRANCH_ADDR53'/>"
WRITE #1 "        <register address='0xbc003e0' value='0x" DATA.LONG(A:0xc003e0) "' name='RPMH_DDRAUX_BRANCH_ADDR54'/>"
WRITE #1 "        <register address='0xbc003e4' value='0x" DATA.LONG(A:0xc003e4) "' name='RPMH_DDRAUX_BRANCH_ADDR55'/>"
WRITE #1 "        <register address='0xbc003e8' value='0x" DATA.LONG(A:0xc003e8) "' name='RPMH_DDRAUX_BRANCH_ADDR56'/>"
WRITE #1 "        <register address='0xbc003ec' value='0x" DATA.LONG(A:0xc003ec) "' name='RPMH_DDRAUX_BRANCH_ADDR57'/>"
WRITE #1 "        <register address='0xbc003f0' value='0x" DATA.LONG(A:0xc003f0) "' name='RPMH_DDRAUX_BRANCH_ADDR58'/>"
WRITE #1 "        <register address='0xbc003f4' value='0x" DATA.LONG(A:0xc003f4) "' name='RPMH_DDRAUX_BRANCH_ADDR59'/>"
WRITE #1 "        <register address='0xbc003f8' value='0x" DATA.LONG(A:0xc003f8) "' name='RPMH_DDRAUX_BRANCH_ADDR60'/>"
WRITE #1 "        <register address='0xbc003fc' value='0x" DATA.LONG(A:0xc003fc) "' name='RPMH_DDRAUX_BRANCH_ADDR61'/>"
WRITE #1 "        <register address='0xbc00400' value='0x" DATA.LONG(A:0xc00400) "' name='RPMH_DDRAUX_BRANCH_ADDR62'/>"
WRITE #1 "        <register address='0xbc00404' value='0x" DATA.LONG(A:0xc00404) "' name='RPMH_DDRAUX_BRANCH_ADDR63'/>"
WRITE #1 "        <register address='0xbc00408' value='0x" DATA.LONG(A:0xc00408) "' name='RPMH_DDRAUX_SEQ0_PWR_CTRL_STAT_BIT_31_TO_0'/>"
WRITE #1 "        <register address='0xbc0040c' value='0x" DATA.LONG(A:0xc0040c) "' name='RPMH_DDRAUX_SEQ1_PWR_CTRL_STAT_BIT_31_TO_0'/>"
WRITE #1 "        <register address='0xbc00410' value='0x" DATA.LONG(A:0xc00410) "' name='RPMH_DDRAUX_SEQ0_PWR_CTRL_STAT_BIT_63_TO_32'/>"
WRITE #1 "        <register address='0xbc00414' value='0x" DATA.LONG(A:0xc00414) "' name='RPMH_DDRAUX_SEQ1_PWR_CTRL_STAT_BIT_63_TO_32'/>"
WRITE #1 "        <register address='0xbc00418' value='0x" DATA.LONG(A:0xc00418) "' name='RPMH_DDRAUX_SEQ_MEM0'/>"
WRITE #1 "        <register address='0xbc0041c' value='0x" DATA.LONG(A:0xc0041c) "' name='RPMH_DDRAUX_SEQ_MEM1'/>"
WRITE #1 "        <register address='0xbc00420' value='0x" DATA.LONG(A:0xc00420) "' name='RPMH_DDRAUX_SEQ_MEM2'/>"
WRITE #1 "        <register address='0xbc00424' value='0x" DATA.LONG(A:0xc00424) "' name='RPMH_DDRAUX_SEQ_MEM3'/>"
WRITE #1 "        <register address='0xbc00428' value='0x" DATA.LONG(A:0xc00428) "' name='RPMH_DDRAUX_SEQ_MEM4'/>"
WRITE #1 "        <register address='0xbc0042c' value='0x" DATA.LONG(A:0xc0042c) "' name='RPMH_DDRAUX_SEQ_MEM5'/>"
WRITE #1 "        <register address='0xbc00430' value='0x" DATA.LONG(A:0xc00430) "' name='RPMH_DDRAUX_SEQ_MEM6'/>"
WRITE #1 "        <register address='0xbc00434' value='0x" DATA.LONG(A:0xc00434) "' name='RPMH_DDRAUX_SEQ_MEM7'/>"
WRITE #1 "        <register address='0xbc00438' value='0x" DATA.LONG(A:0xc00438) "' name='RPMH_DDRAUX_SEQ_MEM8'/>"
WRITE #1 "        <register address='0xbc0043c' value='0x" DATA.LONG(A:0xc0043c) "' name='RPMH_DDRAUX_SEQ_MEM9'/>"
WRITE #1 "        <register address='0xbc00440' value='0x" DATA.LONG(A:0xc00440) "' name='RPMH_DDRAUX_SEQ_MEM10'/>"
WRITE #1 "        <register address='0xbc00444' value='0x" DATA.LONG(A:0xc00444) "' name='RPMH_DDRAUX_SEQ_MEM11'/>"
WRITE #1 "        <register address='0xbc00448' value='0x" DATA.LONG(A:0xc00448) "' name='RPMH_DDRAUX_SEQ_MEM12'/>"
WRITE #1 "        <register address='0xbc0044c' value='0x" DATA.LONG(A:0xc0044c) "' name='RPMH_DDRAUX_SEQ_MEM13'/>"
WRITE #1 "        <register address='0xbc00450' value='0x" DATA.LONG(A:0xc00450) "' name='RPMH_DDRAUX_SEQ_MEM14'/>"
WRITE #1 "        <register address='0xbc00454' value='0x" DATA.LONG(A:0xc00454) "' name='RPMH_DDRAUX_SEQ_MEM15'/>"
WRITE #1 "        <register address='0xbc00458' value='0x" DATA.LONG(A:0xc00458) "' name='RPMH_DDRAUX_SEQ_MEM16'/>"
WRITE #1 "        <register address='0xbc0045c' value='0x" DATA.LONG(A:0xc0045c) "' name='RPMH_DDRAUX_SEQ_MEM17'/>"
WRITE #1 "        <register address='0xbc00460' value='0x" DATA.LONG(A:0xc00460) "' name='RPMH_DDRAUX_SEQ_MEM18'/>"
WRITE #1 "        <register address='0xbc00464' value='0x" DATA.LONG(A:0xc00464) "' name='RPMH_DDRAUX_SEQ_MEM19'/>"
WRITE #1 "        <register address='0xbc00468' value='0x" DATA.LONG(A:0xc00468) "' name='RPMH_DDRAUX_SEQ_MEM20'/>"
WRITE #1 "        <register address='0xbc0046c' value='0x" DATA.LONG(A:0xc0046c) "' name='RPMH_DDRAUX_SEQ_MEM21'/>"
WRITE #1 "        <register address='0xbc00470' value='0x" DATA.LONG(A:0xc00470) "' name='RPMH_DDRAUX_SEQ_MEM22'/>"
WRITE #1 "        <register address='0xbc00474' value='0x" DATA.LONG(A:0xc00474) "' name='RPMH_DDRAUX_SEQ_MEM23'/>"
WRITE #1 "        <register address='0xbc00478' value='0x" DATA.LONG(A:0xc00478) "' name='RPMH_DDRAUX_SEQ_MEM24'/>"
WRITE #1 "        <register address='0xbc0047c' value='0x" DATA.LONG(A:0xc0047c) "' name='RPMH_DDRAUX_SEQ_MEM25'/>"
WRITE #1 "        <register address='0xbc00480' value='0x" DATA.LONG(A:0xc00480) "' name='RPMH_DDRAUX_SEQ_MEM26'/>"
WRITE #1 "        <register address='0xbc00484' value='0x" DATA.LONG(A:0xc00484) "' name='RPMH_DDRAUX_SEQ_MEM27'/>"
WRITE #1 "        <register address='0xbc00488' value='0x" DATA.LONG(A:0xc00488) "' name='RPMH_DDRAUX_SEQ_MEM28'/>"
WRITE #1 "        <register address='0xbc0048c' value='0x" DATA.LONG(A:0xc0048c) "' name='RPMH_DDRAUX_SEQ_MEM29'/>"
WRITE #1 "        <register address='0xbc00490' value='0x" DATA.LONG(A:0xc00490) "' name='RPMH_DDRAUX_SEQ_MEM30'/>"
WRITE #1 "        <register address='0xbc00494' value='0x" DATA.LONG(A:0xc00494) "' name='RPMH_DDRAUX_SEQ_MEM31'/>"
WRITE #1 "        <register address='0xbc00498' value='0x" DATA.LONG(A:0xc00498) "' name='RPMH_DDRAUX_SEQ_MEM32'/>"
WRITE #1 "        <register address='0xbc0049c' value='0x" DATA.LONG(A:0xc0049c) "' name='RPMH_DDRAUX_SEQ_MEM33'/>"
WRITE #1 "        <register address='0xbc004a0' value='0x" DATA.LONG(A:0xc004a0) "' name='RPMH_DDRAUX_SEQ_MEM34'/>"
WRITE #1 "        <register address='0xbc004a4' value='0x" DATA.LONG(A:0xc004a4) "' name='RPMH_DDRAUX_SEQ_MEM35'/>"
WRITE #1 "        <register address='0xbc004a8' value='0x" DATA.LONG(A:0xc004a8) "' name='RPMH_DDRAUX_SEQ_MEM36'/>"
WRITE #1 "        <register address='0xbc004ac' value='0x" DATA.LONG(A:0xc004ac) "' name='RPMH_DDRAUX_SEQ_MEM37'/>"
WRITE #1 "        <register address='0xbc004b0' value='0x" DATA.LONG(A:0xc004b0) "' name='RPMH_DDRAUX_SEQ_MEM38'/>"
WRITE #1 "        <register address='0xbc004b4' value='0x" DATA.LONG(A:0xc004b4) "' name='RPMH_DDRAUX_SEQ_MEM39'/>"
WRITE #1 "        <register address='0xbc004b8' value='0x" DATA.LONG(A:0xc004b8) "' name='RPMH_DDRAUX_SEQ_MEM40'/>"
WRITE #1 "        <register address='0xbc004bc' value='0x" DATA.LONG(A:0xc004bc) "' name='RPMH_DDRAUX_SEQ_MEM41'/>"
WRITE #1 "        <register address='0xbc004c0' value='0x" DATA.LONG(A:0xc004c0) "' name='RPMH_DDRAUX_SEQ_MEM42'/>"
WRITE #1 "        <register address='0xbc004c4' value='0x" DATA.LONG(A:0xc004c4) "' name='RPMH_DDRAUX_SEQ_MEM43'/>"
WRITE #1 "        <register address='0xbc004c8' value='0x" DATA.LONG(A:0xc004c8) "' name='RPMH_DDRAUX_SEQ_MEM44'/>"
WRITE #1 "        <register address='0xbc004cc' value='0x" DATA.LONG(A:0xc004cc) "' name='RPMH_DDRAUX_SEQ_MEM45'/>"
WRITE #1 "        <register address='0xbc004d0' value='0x" DATA.LONG(A:0xc004d0) "' name='RPMH_DDRAUX_SEQ_MEM46'/>"
WRITE #1 "        <register address='0xbc004d4' value='0x" DATA.LONG(A:0xc004d4) "' name='RPMH_DDRAUX_SEQ_MEM47'/>"
WRITE #1 "        <register address='0xbc004d8' value='0x" DATA.LONG(A:0xc004d8) "' name='RPMH_DDRAUX_SEQ_MEM48'/>"
WRITE #1 "        <register address='0xbc004dc' value='0x" DATA.LONG(A:0xc004dc) "' name='RPMH_DDRAUX_SEQ_MEM49'/>"
WRITE #1 "        <register address='0xbc004e0' value='0x" DATA.LONG(A:0xc004e0) "' name='RPMH_DDRAUX_SEQ_MEM50'/>"
WRITE #1 "        <register address='0xbc004e4' value='0x" DATA.LONG(A:0xc004e4) "' name='RPMH_DDRAUX_SEQ_MEM51'/>"
WRITE #1 "        <register address='0xbc004e8' value='0x" DATA.LONG(A:0xc004e8) "' name='RPMH_DDRAUX_SEQ_MEM52'/>"
WRITE #1 "        <register address='0xbc004ec' value='0x" DATA.LONG(A:0xc004ec) "' name='RPMH_DDRAUX_SEQ_MEM53'/>"
WRITE #1 "        <register address='0xbc004f0' value='0x" DATA.LONG(A:0xc004f0) "' name='RPMH_DDRAUX_SEQ_MEM54'/>"
WRITE #1 "        <register address='0xbc004f4' value='0x" DATA.LONG(A:0xc004f4) "' name='RPMH_DDRAUX_SEQ_MEM55'/>"
WRITE #1 "        <register address='0xbc004f8' value='0x" DATA.LONG(A:0xc004f8) "' name='RPMH_DDRAUX_SEQ_MEM56'/>"
WRITE #1 "        <register address='0xbc004fc' value='0x" DATA.LONG(A:0xc004fc) "' name='RPMH_DDRAUX_SEQ_MEM57'/>"
WRITE #1 "        <register address='0xbc00500' value='0x" DATA.LONG(A:0xc00500) "' name='RPMH_DDRAUX_SEQ_MEM58'/>"
WRITE #1 "        <register address='0xbc00504' value='0x" DATA.LONG(A:0xc00504) "' name='RPMH_DDRAUX_SEQ_MEM59'/>"
WRITE #1 "        <register address='0xbc00508' value='0x" DATA.LONG(A:0xc00508) "' name='RPMH_DDRAUX_SEQ_MEM60'/>"
WRITE #1 "        <register address='0xbc0050c' value='0x" DATA.LONG(A:0xc0050c) "' name='RPMH_DDRAUX_SEQ_MEM61'/>"
WRITE #1 "        <register address='0xbc00510' value='0x" DATA.LONG(A:0xc00510) "' name='RPMH_DDRAUX_SEQ_MEM62'/>"
WRITE #1 "        <register address='0xbc00514' value='0x" DATA.LONG(A:0xc00514) "' name='RPMH_DDRAUX_SEQ_MEM63'/>"
WRITE #1 "        <register address='0xbc00518' value='0x" DATA.LONG(A:0xc00518) "' name='RPMH_DDRAUX_SEQ_MEM64'/>"
WRITE #1 "        <register address='0xbc0051c' value='0x" DATA.LONG(A:0xc0051c) "' name='RPMH_DDRAUX_SEQ_MEM65'/>"
WRITE #1 "        <register address='0xbc00520' value='0x" DATA.LONG(A:0xc00520) "' name='RPMH_DDRAUX_SEQ_MEM66'/>"
WRITE #1 "        <register address='0xbc00524' value='0x" DATA.LONG(A:0xc00524) "' name='RPMH_DDRAUX_SEQ_MEM67'/>"
WRITE #1 "        <register address='0xbc00528' value='0x" DATA.LONG(A:0xc00528) "' name='RPMH_DDRAUX_SEQ_MEM68'/>"
WRITE #1 "        <register address='0xbc0052c' value='0x" DATA.LONG(A:0xc0052c) "' name='RPMH_DDRAUX_SEQ_MEM69'/>"
WRITE #1 "        <register address='0xbc00530' value='0x" DATA.LONG(A:0xc00530) "' name='RPMH_DDRAUX_SEQ_MEM70'/>"
WRITE #1 "        <register address='0xbc00534' value='0x" DATA.LONG(A:0xc00534) "' name='RPMH_DDRAUX_SEQ_MEM71'/>"
WRITE #1 "        <register address='0xbc00538' value='0x" DATA.LONG(A:0xc00538) "' name='RPMH_DDRAUX_SEQ_MEM72'/>"
WRITE #1 "        <register address='0xbc0053c' value='0x" DATA.LONG(A:0xc0053c) "' name='RPMH_DDRAUX_SEQ_MEM73'/>"
WRITE #1 "        <register address='0xbc00540' value='0x" DATA.LONG(A:0xc00540) "' name='RPMH_DDRAUX_SEQ_MEM74'/>"
WRITE #1 "        <register address='0xbc00544' value='0x" DATA.LONG(A:0xc00544) "' name='RPMH_DDRAUX_SEQ_MEM75'/>"
WRITE #1 "        <register address='0xbc00548' value='0x" DATA.LONG(A:0xc00548) "' name='RPMH_DDRAUX_SEQ_MEM76'/>"
WRITE #1 "        <register address='0xbc0054c' value='0x" DATA.LONG(A:0xc0054c) "' name='RPMH_DDRAUX_SEQ_MEM77'/>"
WRITE #1 "        <register address='0xbc00550' value='0x" DATA.LONG(A:0xc00550) "' name='RPMH_DDRAUX_SEQ_MEM78'/>"
WRITE #1 "        <register address='0xbc00554' value='0x" DATA.LONG(A:0xc00554) "' name='RPMH_DDRAUX_SEQ_MEM79'/>"
WRITE #1 "        <register address='0xbc00558' value='0x" DATA.LONG(A:0xc00558) "' name='RPMH_DDRAUX_SEQ_MEM80'/>"
WRITE #1 "        <register address='0xbc0055c' value='0x" DATA.LONG(A:0xc0055c) "' name='RPMH_DDRAUX_SEQ_MEM81'/>"
WRITE #1 "        <register address='0xbc00560' value='0x" DATA.LONG(A:0xc00560) "' name='RPMH_DDRAUX_SEQ_MEM82'/>"
WRITE #1 "        <register address='0xbc00564' value='0x" DATA.LONG(A:0xc00564) "' name='RPMH_DDRAUX_SEQ_MEM83'/>"
WRITE #1 "        <register address='0xbc00568' value='0x" DATA.LONG(A:0xc00568) "' name='RPMH_DDRAUX_SEQ_MEM84'/>"
WRITE #1 "        <register address='0xbc0056c' value='0x" DATA.LONG(A:0xc0056c) "' name='RPMH_DDRAUX_SEQ_MEM85'/>"
WRITE #1 "        <register address='0xbc00570' value='0x" DATA.LONG(A:0xc00570) "' name='RPMH_DDRAUX_SEQ_MEM86'/>"
WRITE #1 "        <register address='0xbc00574' value='0x" DATA.LONG(A:0xc00574) "' name='RPMH_DDRAUX_SEQ_MEM87'/>"
WRITE #1 "        <register address='0xbc00578' value='0x" DATA.LONG(A:0xc00578) "' name='RPMH_DDRAUX_SEQ_MEM88'/>"
WRITE #1 "        <register address='0xbc0057c' value='0x" DATA.LONG(A:0xc0057c) "' name='RPMH_DDRAUX_SEQ_MEM89'/>"
WRITE #1 "        <register address='0xbc00580' value='0x" DATA.LONG(A:0xc00580) "' name='RPMH_DDRAUX_SEQ_MEM90'/>"
WRITE #1 "        <register address='0xbc00584' value='0x" DATA.LONG(A:0xc00584) "' name='RPMH_DDRAUX_SEQ_MEM91'/>"
WRITE #1 "        <register address='0xbc00588' value='0x" DATA.LONG(A:0xc00588) "' name='RPMH_DDRAUX_SEQ_MEM92'/>"
WRITE #1 "        <register address='0xbc0058c' value='0x" DATA.LONG(A:0xc0058c) "' name='RPMH_DDRAUX_SEQ_MEM93'/>"
WRITE #1 "        <register address='0xbc00590' value='0x" DATA.LONG(A:0xc00590) "' name='RPMH_DDRAUX_SEQ_MEM94'/>"
WRITE #1 "        <register address='0xbc00594' value='0x" DATA.LONG(A:0xc00594) "' name='RPMH_DDRAUX_SEQ_MEM95'/>"
WRITE #1 "        <register address='0xbc00598' value='0x" DATA.LONG(A:0xc00598) "' name='RPMH_DDRAUX_SEQ_MEM96'/>"
WRITE #1 "        <register address='0xbc0059c' value='0x" DATA.LONG(A:0xc0059c) "' name='RPMH_DDRAUX_SEQ_MEM97'/>"
WRITE #1 "        <register address='0xbc005a0' value='0x" DATA.LONG(A:0xc005a0) "' name='RPMH_DDRAUX_SEQ_MEM98'/>"
WRITE #1 "        <register address='0xbc005a4' value='0x" DATA.LONG(A:0xc005a4) "' name='RPMH_DDRAUX_SEQ_MEM99'/>"
WRITE #1 "        <register address='0xbc005a8' value='0x" DATA.LONG(A:0xc005a8) "' name='RPMH_DDRAUX_SEQ_MEM100'/>"
WRITE #1 "        <register address='0xbc005ac' value='0x" DATA.LONG(A:0xc005ac) "' name='RPMH_DDRAUX_SEQ_MEM101'/>"
WRITE #1 "        <register address='0xbc005b0' value='0x" DATA.LONG(A:0xc005b0) "' name='RPMH_DDRAUX_SEQ_MEM102'/>"
WRITE #1 "        <register address='0xbc005b4' value='0x" DATA.LONG(A:0xc005b4) "' name='RPMH_DDRAUX_SEQ_MEM103'/>"
WRITE #1 "        <register address='0xbc005b8' value='0x" DATA.LONG(A:0xc005b8) "' name='RPMH_DDRAUX_SEQ_MEM104'/>"
WRITE #1 "        <register address='0xbc005bc' value='0x" DATA.LONG(A:0xc005bc) "' name='RPMH_DDRAUX_SEQ_MEM105'/>"
WRITE #1 "        <register address='0xbc005c0' value='0x" DATA.LONG(A:0xc005c0) "' name='RPMH_DDRAUX_SEQ_MEM106'/>"
WRITE #1 "        <register address='0xbc005c4' value='0x" DATA.LONG(A:0xc005c4) "' name='RPMH_DDRAUX_SEQ_MEM107'/>"
WRITE #1 "        <register address='0xbc005c8' value='0x" DATA.LONG(A:0xc005c8) "' name='RPMH_DDRAUX_SEQ_MEM108'/>"
WRITE #1 "        <register address='0xbc005cc' value='0x" DATA.LONG(A:0xc005cc) "' name='RPMH_DDRAUX_SEQ_MEM109'/>"
WRITE #1 "        <register address='0xbc005d0' value='0x" DATA.LONG(A:0xc005d0) "' name='RPMH_DDRAUX_SEQ_MEM110'/>"
WRITE #1 "        <register address='0xbc005d4' value='0x" DATA.LONG(A:0xc005d4) "' name='RPMH_DDRAUX_SEQ_MEM111'/>"
WRITE #1 "        <register address='0xbc005d8' value='0x" DATA.LONG(A:0xc005d8) "' name='RPMH_DDRAUX_SEQ_MEM112'/>"
WRITE #1 "        <register address='0xbc005dc' value='0x" DATA.LONG(A:0xc005dc) "' name='RPMH_DDRAUX_SEQ_MEM113'/>"
WRITE #1 "        <register address='0xbc005e0' value='0x" DATA.LONG(A:0xc005e0) "' name='RPMH_DDRAUX_SEQ_MEM114'/>"
WRITE #1 "        <register address='0xbc005e4' value='0x" DATA.LONG(A:0xc005e4) "' name='RPMH_DDRAUX_SEQ_MEM115'/>"
WRITE #1 "        <register address='0xbc005e8' value='0x" DATA.LONG(A:0xc005e8) "' name='RPMH_DDRAUX_SEQ_MEM116'/>"
WRITE #1 "        <register address='0xbc005ec' value='0x" DATA.LONG(A:0xc005ec) "' name='RPMH_DDRAUX_SEQ_MEM117'/>"
WRITE #1 "        <register address='0xbc005f0' value='0x" DATA.LONG(A:0xc005f0) "' name='RPMH_DDRAUX_SEQ_MEM118'/>"
WRITE #1 "        <register address='0xbc005f4' value='0x" DATA.LONG(A:0xc005f4) "' name='RPMH_DDRAUX_SEQ_MEM119'/>"
WRITE #1 "        <register address='0xbc005f8' value='0x" DATA.LONG(A:0xc005f8) "' name='RPMH_DDRAUX_SEQ_MEM120'/>"
WRITE #1 "        <register address='0xbc005fc' value='0x" DATA.LONG(A:0xc005fc) "' name='RPMH_DDRAUX_SEQ_MEM121'/>"
WRITE #1 "        <register address='0xbc00600' value='0x" DATA.LONG(A:0xc00600) "' name='RPMH_DDRAUX_SEQ_MEM122'/>"
WRITE #1 "        <register address='0xbc00604' value='0x" DATA.LONG(A:0xc00604) "' name='RPMH_DDRAUX_SEQ_MEM123'/>"
WRITE #1 "        <register address='0xbc00608' value='0x" DATA.LONG(A:0xc00608) "' name='RPMH_DDRAUX_SEQ_MEM124'/>"
WRITE #1 "        <register address='0xbc0060c' value='0x" DATA.LONG(A:0xc0060c) "' name='RPMH_DDRAUX_SEQ_MEM125'/>"
WRITE #1 "        <register address='0xbc00610' value='0x" DATA.LONG(A:0xc00610) "' name='RPMH_DDRAUX_SEQ_MEM126'/>"
WRITE #1 "        <register address='0xbc00614' value='0x" DATA.LONG(A:0xc00614) "' name='RPMH_DDRAUX_SEQ_MEM127'/>"
WRITE #1 "        <register address='0xbc00700' value='0x" DATA.LONG(A:0xc00700) "' name='RPMH_DDRAUX_VERSION'/>"
WRITE #1 "        <register address='0xbc00704' value='0x" DATA.LONG(A:0xc00704) "' name='RPMH_DDRAUX_DDR_AUX_HW_ENABLE'/>"
WRITE #1 "        <register address='0xbc00708' value='0x" DATA.LONG(A:0xc00708) "' name='RPMH_DDRAUX_AOP_INTR_STAT'/>"
WRITE #1 "        <register address='0xbc0070c' value='0x" DATA.LONG(A:0xc0070c) "' name='RPMH_DDRAUX_AOP_INTR_DETAIL'/>"
WRITE #1 "        <register address='0xbc00710' value='0x" DATA.LONG(A:0xc00710) "' name='RPMH_DDRAUX_AOP_INTR_MASK'/>"
WRITE #1 "        <register address='0xbc00718' value='0x" DATA.LONG(A:0xc00718) "' name='RPMH_DDRAUX_ARC_INTF_PERF_LVL'/>"
WRITE #1 "        <register address='0xbc0071c' value='0x" DATA.LONG(A:0xc0071c) "' name='RPMH_DDRAUX_SHRM_RSI_GPW_DATA'/>"
WRITE #1 "        <register address='0xbc00720' value='0x" DATA.LONG(A:0xc00720) "' name='RPMH_DDRAUX_GCC_INTF_STAT'/>"
WRITE #1 "        <register address='0xbc00724' value='0x" DATA.LONG(A:0xc00724) "' name='RPMH_DDRAUX_ARC_INTF_STAT'/>"
WRITE #1 "        <register address='0xbc00728' value='0x" DATA.LONG(A:0xc00728) "' name='RPMH_DDRAUX_BCM_INTF_STAT'/>"
WRITE #1 "        <register address='0xbc0072c' value='0x" DATA.LONG(A:0xc0072c) "' name='RPMH_DDRAUX_BCM_INTF_CLKPLAN'/>"
WRITE #1 "        <register address='0xbc00730' value='0x" DATA.LONG(A:0xc00730) "' name='RPMH_DDRAUX_RSI_TIMEOUT'/>"
WRITE #1 "        <register address='0xbc00734' value='0x" DATA.LONG(A:0xc00734) "' name='RPMH_DDRAUX_DEBUG_GPIO_SRC_SEL'/>"
WRITE #1 "        <register address='0xbc00738' value='0x" DATA.LONG(A:0xc00738) "' name='RPMH_DDRAUX_DEBUG_CLKON'/>"
WRITE #1 "        <register address='0xbc0073c' value='0x" DATA.LONG(A:0xc0073c) "' name='RPMH_DDRAUX_DDR_AUX_STAT'/>"
WRITE #1 "        <register address='0xbc00740' value='0x" DATA.LONG(A:0xc00740) "' name='RPMH_DDRAUX_SEQ_TCS_CLK_ON'/>"
WRITE #1 "        <register address='0xc200000' value='0x" DATA.LONG(A:0x1200000) "' name='RPMH_CPRF_HW_VERSION'/>"
WRITE #1 "        <register address='0xc200004' value='0x" DATA.LONG(A:0x1200004) "' name='RPMH_CPRF_AOSS_SETTINGS'/>"
WRITE #1 "        <register address='0xc200008' value='0x" DATA.LONG(A:0x1200008) "' name='RPMH_CPRF_INTERRUPT_STATUS'/>"
WRITE #1 "        <register address='0xc20000c' value='0x" DATA.LONG(A:0x120000c) "' name='RPMH_CPRF_VRM_COMPLETION_WA'/>"
WRITE #1 "        <register address='0xc200010' value='0x" DATA.LONG(A:0x1200010) "' name='RPMH_CPRF_VRM_BRCST_WA'/>"
WRITE #1 "        <register address='0xc200014' value='0x" DATA.LONG(A:0x1200014) "' name='RPMH_CPRF_DEBUG_BUS_CTRL_0'/>"
WRITE #1 "        <register address='0xc200018' value='0x" DATA.LONG(A:0x1200018) "' name='RPMH_CPRF_DEBUG_BUS_CTRL_1'/>"
WRITE #1 "        <register address='0xc20001c' value='0x" DATA.LONG(A:0x120001c) "' name='RPMH_CPRF_DEBUG_BUS_OUTPUT_0'/>"
WRITE #1 "        <register address='0xc200020' value='0x" DATA.LONG(A:0x1200020) "' name='RPMH_CPRF_DEBUG_BUS_OUTPUT_1'/>"
WRITE #1 "        <register address='0xc200024' value='0x" DATA.LONG(A:0x1200024) "' name='RPMH_CPRF_CXO_ON_SETTINGS'/>"
WRITE #1 "        <register address='0xc200028' value='0x" DATA.LONG(A:0x1200028) "' name='RPMH_CPRF_CLOCK_MGMT_RESET'/>"
WRITE #1 "        <register address='0xc20002c' value='0x" DATA.LONG(A:0x120002c) "' name='RPMH_CPRF_CLOCK_MGMT_ENABLE'/>"
WRITE #1 "        <register address='0xc200030' value='0x" DATA.LONG(A:0x1200030) "' name='RPMH_CPRF_VRM_BRCST_ENDIANNESS'/>"
WRITE #1 "        <register address='0xc200034' value='0x" DATA.LONG(A:0x1200034) "' name='RPMH_CPRF_ARC_CXO_BIT_ORDER'/>"
WRITE #1 "        <register address='0xc200038' value='0x" DATA.LONG(A:0x1200038) "' name='RPMH_CPRF_MISC_RESET'/>"
WRITE #1 "        <register address='0xc20003c' value='0x" DATA.LONG(A:0x120003c) "' name='RPMH_CPRF_MISC_CTRL'/>"
WRITE #1 "        <register address='0xc201000' value='0x" DATA.LONG(A:0x1201000) "' name='RPMH_CPRF_CPRF0_RESET'/>"
WRITE #1 "        <register address='0xc202000' value='0x" DATA.LONG(A:0x1202000) "' name='RPMH_CPRF_CPRF1_RESET'/>"
WRITE #1 "        <register address='0xc203000' value='0x" DATA.LONG(A:0x1203000) "' name='RPMH_CPRF_CPRF2_RESET'/>"
WRITE #1 "        <register address='0xc204000' value='0x" DATA.LONG(A:0x1204000) "' name='RPMH_CPRF_CPRF3_RESET'/>"
WRITE #1 "        <register address='0xc205000' value='0x" DATA.LONG(A:0x1205000) "' name='RPMH_CPRF_CPRF4_RESET'/>"
WRITE #1 "        <register address='0xc206000' value='0x" DATA.LONG(A:0x1206000) "' name='RPMH_CPRF_CPRF5_RESET'/>"
WRITE #1 "        <register address='0xc201004' value='0x" DATA.LONG(A:0x1201004) "' name='RPMH_CPRF_CPRF0_CTRL'/>"
WRITE #1 "        <register address='0xc202004' value='0x" DATA.LONG(A:0x1202004) "' name='RPMH_CPRF_CPRF1_CTRL'/>"
WRITE #1 "        <register address='0xc203004' value='0x" DATA.LONG(A:0x1203004) "' name='RPMH_CPRF_CPRF2_CTRL'/>"
WRITE #1 "        <register address='0xc204004' value='0x" DATA.LONG(A:0x1204004) "' name='RPMH_CPRF_CPRF3_CTRL'/>"
WRITE #1 "        <register address='0xc205004' value='0x" DATA.LONG(A:0x1205004) "' name='RPMH_CPRF_CPRF4_CTRL'/>"
WRITE #1 "        <register address='0xc206004' value='0x" DATA.LONG(A:0x1206004) "' name='RPMH_CPRF_CPRF5_CTRL'/>"
WRITE #1 "        <register address='0xc201008' value='0x" DATA.LONG(A:0x1201008) "' name='RPMH_CPRF_CPRF0_VRM_SETTINGS'/>"
WRITE #1 "        <register address='0xc202008' value='0x" DATA.LONG(A:0x1202008) "' name='RPMH_CPRF_CPRF1_VRM_SETTINGS'/>"
WRITE #1 "        <register address='0xc203008' value='0x" DATA.LONG(A:0x1203008) "' name='RPMH_CPRF_CPRF2_VRM_SETTINGS'/>"
WRITE #1 "        <register address='0xc204008' value='0x" DATA.LONG(A:0x1204008) "' name='RPMH_CPRF_CPRF3_VRM_SETTINGS'/>"
WRITE #1 "        <register address='0xc205008' value='0x" DATA.LONG(A:0x1205008) "' name='RPMH_CPRF_CPRF4_VRM_SETTINGS'/>"
WRITE #1 "        <register address='0xc206008' value='0x" DATA.LONG(A:0x1206008) "' name='RPMH_CPRF_CPRF5_VRM_SETTINGS'/>"
WRITE #1 "        <register address='0xc20100c' value='0x" DATA.LONG(A:0x120100c) "' name='RPMH_CPRF_CPRF0_VOLTAGE_LIMITS_0'/>"
WRITE #1 "        <register address='0xc201010' value='0x" DATA.LONG(A:0x1201010) "' name='RPMH_CPRF_CPRF0_VOLTAGE_LIMITS_1'/>"
WRITE #1 "        <register address='0xc201014' value='0x" DATA.LONG(A:0x1201014) "' name='RPMH_CPRF_CPRF0_VOLTAGE_LIMITS_2'/>"
WRITE #1 "        <register address='0xc201018' value='0x" DATA.LONG(A:0x1201018) "' name='RPMH_CPRF_CPRF0_VOLTAGE_LIMITS_3'/>"
WRITE #1 "        <register address='0xc20101c' value='0x" DATA.LONG(A:0x120101c) "' name='RPMH_CPRF_CPRF0_VOLTAGE_LIMITS_4'/>"
WRITE #1 "        <register address='0xc201020' value='0x" DATA.LONG(A:0x1201020) "' name='RPMH_CPRF_CPRF0_VOLTAGE_LIMITS_5'/>"
WRITE #1 "        <register address='0xc201024' value='0x" DATA.LONG(A:0x1201024) "' name='RPMH_CPRF_CPRF0_VOLTAGE_LIMITS_6'/>"
WRITE #1 "        <register address='0xc201028' value='0x" DATA.LONG(A:0x1201028) "' name='RPMH_CPRF_CPRF0_VOLTAGE_LIMITS_7'/>"
WRITE #1 "        <register address='0xc20102c' value='0x" DATA.LONG(A:0x120102c) "' name='RPMH_CPRF_CPRF0_VOLTAGE_LIMITS_8'/>"
WRITE #1 "        <register address='0xc201030' value='0x" DATA.LONG(A:0x1201030) "' name='RPMH_CPRF_CPRF0_VOLTAGE_LIMITS_9'/>"
WRITE #1 "        <register address='0xc201034' value='0x" DATA.LONG(A:0x1201034) "' name='RPMH_CPRF_CPRF0_VOLTAGE_LIMITS_10'/>"
WRITE #1 "        <register address='0xc201038' value='0x" DATA.LONG(A:0x1201038) "' name='RPMH_CPRF_CPRF0_VOLTAGE_LIMITS_11'/>"
WRITE #1 "        <register address='0xc20103c' value='0x" DATA.LONG(A:0x120103c) "' name='RPMH_CPRF_CPRF0_VOLTAGE_LIMITS_12'/>"
WRITE #1 "        <register address='0xc201040' value='0x" DATA.LONG(A:0x1201040) "' name='RPMH_CPRF_CPRF0_VOLTAGE_LIMITS_13'/>"
WRITE #1 "        <register address='0xc201044' value='0x" DATA.LONG(A:0x1201044) "' name='RPMH_CPRF_CPRF0_VOLTAGE_LIMITS_14'/>"
WRITE #1 "        <register address='0xc201048' value='0x" DATA.LONG(A:0x1201048) "' name='RPMH_CPRF_CPRF0_VOLTAGE_LIMITS_15'/>"
WRITE #1 "        <register address='0xc20200c' value='0x" DATA.LONG(A:0x120200c) "' name='RPMH_CPRF_CPRF1_VOLTAGE_LIMITS_0'/>"
WRITE #1 "        <register address='0xc202010' value='0x" DATA.LONG(A:0x1202010) "' name='RPMH_CPRF_CPRF1_VOLTAGE_LIMITS_1'/>"
WRITE #1 "        <register address='0xc202014' value='0x" DATA.LONG(A:0x1202014) "' name='RPMH_CPRF_CPRF1_VOLTAGE_LIMITS_2'/>"
WRITE #1 "        <register address='0xc202018' value='0x" DATA.LONG(A:0x1202018) "' name='RPMH_CPRF_CPRF1_VOLTAGE_LIMITS_3'/>"
WRITE #1 "        <register address='0xc20201c' value='0x" DATA.LONG(A:0x120201c) "' name='RPMH_CPRF_CPRF1_VOLTAGE_LIMITS_4'/>"
WRITE #1 "        <register address='0xc202020' value='0x" DATA.LONG(A:0x1202020) "' name='RPMH_CPRF_CPRF1_VOLTAGE_LIMITS_5'/>"
WRITE #1 "        <register address='0xc202024' value='0x" DATA.LONG(A:0x1202024) "' name='RPMH_CPRF_CPRF1_VOLTAGE_LIMITS_6'/>"
WRITE #1 "        <register address='0xc202028' value='0x" DATA.LONG(A:0x1202028) "' name='RPMH_CPRF_CPRF1_VOLTAGE_LIMITS_7'/>"
WRITE #1 "        <register address='0xc20202c' value='0x" DATA.LONG(A:0x120202c) "' name='RPMH_CPRF_CPRF1_VOLTAGE_LIMITS_8'/>"
WRITE #1 "        <register address='0xc202030' value='0x" DATA.LONG(A:0x1202030) "' name='RPMH_CPRF_CPRF1_VOLTAGE_LIMITS_9'/>"
WRITE #1 "        <register address='0xc202034' value='0x" DATA.LONG(A:0x1202034) "' name='RPMH_CPRF_CPRF1_VOLTAGE_LIMITS_10'/>"
WRITE #1 "        <register address='0xc202038' value='0x" DATA.LONG(A:0x1202038) "' name='RPMH_CPRF_CPRF1_VOLTAGE_LIMITS_11'/>"
WRITE #1 "        <register address='0xc20203c' value='0x" DATA.LONG(A:0x120203c) "' name='RPMH_CPRF_CPRF1_VOLTAGE_LIMITS_12'/>"
WRITE #1 "        <register address='0xc202040' value='0x" DATA.LONG(A:0x1202040) "' name='RPMH_CPRF_CPRF1_VOLTAGE_LIMITS_13'/>"
WRITE #1 "        <register address='0xc202044' value='0x" DATA.LONG(A:0x1202044) "' name='RPMH_CPRF_CPRF1_VOLTAGE_LIMITS_14'/>"
WRITE #1 "        <register address='0xc202048' value='0x" DATA.LONG(A:0x1202048) "' name='RPMH_CPRF_CPRF1_VOLTAGE_LIMITS_15'/>"
WRITE #1 "        <register address='0xc20300c' value='0x" DATA.LONG(A:0x120300c) "' name='RPMH_CPRF_CPRF2_VOLTAGE_LIMITS_0'/>"
WRITE #1 "        <register address='0xc203010' value='0x" DATA.LONG(A:0x1203010) "' name='RPMH_CPRF_CPRF2_VOLTAGE_LIMITS_1'/>"
WRITE #1 "        <register address='0xc203014' value='0x" DATA.LONG(A:0x1203014) "' name='RPMH_CPRF_CPRF2_VOLTAGE_LIMITS_2'/>"
WRITE #1 "        <register address='0xc203018' value='0x" DATA.LONG(A:0x1203018) "' name='RPMH_CPRF_CPRF2_VOLTAGE_LIMITS_3'/>"
WRITE #1 "        <register address='0xc20301c' value='0x" DATA.LONG(A:0x120301c) "' name='RPMH_CPRF_CPRF2_VOLTAGE_LIMITS_4'/>"
WRITE #1 "        <register address='0xc203020' value='0x" DATA.LONG(A:0x1203020) "' name='RPMH_CPRF_CPRF2_VOLTAGE_LIMITS_5'/>"
WRITE #1 "        <register address='0xc203024' value='0x" DATA.LONG(A:0x1203024) "' name='RPMH_CPRF_CPRF2_VOLTAGE_LIMITS_6'/>"
WRITE #1 "        <register address='0xc203028' value='0x" DATA.LONG(A:0x1203028) "' name='RPMH_CPRF_CPRF2_VOLTAGE_LIMITS_7'/>"
WRITE #1 "        <register address='0xc20302c' value='0x" DATA.LONG(A:0x120302c) "' name='RPMH_CPRF_CPRF2_VOLTAGE_LIMITS_8'/>"
WRITE #1 "        <register address='0xc203030' value='0x" DATA.LONG(A:0x1203030) "' name='RPMH_CPRF_CPRF2_VOLTAGE_LIMITS_9'/>"
WRITE #1 "        <register address='0xc203034' value='0x" DATA.LONG(A:0x1203034) "' name='RPMH_CPRF_CPRF2_VOLTAGE_LIMITS_10'/>"
WRITE #1 "        <register address='0xc203038' value='0x" DATA.LONG(A:0x1203038) "' name='RPMH_CPRF_CPRF2_VOLTAGE_LIMITS_11'/>"
WRITE #1 "        <register address='0xc20303c' value='0x" DATA.LONG(A:0x120303c) "' name='RPMH_CPRF_CPRF2_VOLTAGE_LIMITS_12'/>"
WRITE #1 "        <register address='0xc203040' value='0x" DATA.LONG(A:0x1203040) "' name='RPMH_CPRF_CPRF2_VOLTAGE_LIMITS_13'/>"
WRITE #1 "        <register address='0xc203044' value='0x" DATA.LONG(A:0x1203044) "' name='RPMH_CPRF_CPRF2_VOLTAGE_LIMITS_14'/>"
WRITE #1 "        <register address='0xc203048' value='0x" DATA.LONG(A:0x1203048) "' name='RPMH_CPRF_CPRF2_VOLTAGE_LIMITS_15'/>"
WRITE #1 "        <register address='0xc20400c' value='0x" DATA.LONG(A:0x120400c) "' name='RPMH_CPRF_CPRF3_VOLTAGE_LIMITS_0'/>"
WRITE #1 "        <register address='0xc204010' value='0x" DATA.LONG(A:0x1204010) "' name='RPMH_CPRF_CPRF3_VOLTAGE_LIMITS_1'/>"
WRITE #1 "        <register address='0xc204014' value='0x" DATA.LONG(A:0x1204014) "' name='RPMH_CPRF_CPRF3_VOLTAGE_LIMITS_2'/>"
WRITE #1 "        <register address='0xc204018' value='0x" DATA.LONG(A:0x1204018) "' name='RPMH_CPRF_CPRF3_VOLTAGE_LIMITS_3'/>"
WRITE #1 "        <register address='0xc20401c' value='0x" DATA.LONG(A:0x120401c) "' name='RPMH_CPRF_CPRF3_VOLTAGE_LIMITS_4'/>"
WRITE #1 "        <register address='0xc204020' value='0x" DATA.LONG(A:0x1204020) "' name='RPMH_CPRF_CPRF3_VOLTAGE_LIMITS_5'/>"
WRITE #1 "        <register address='0xc204024' value='0x" DATA.LONG(A:0x1204024) "' name='RPMH_CPRF_CPRF3_VOLTAGE_LIMITS_6'/>"
WRITE #1 "        <register address='0xc204028' value='0x" DATA.LONG(A:0x1204028) "' name='RPMH_CPRF_CPRF3_VOLTAGE_LIMITS_7'/>"
WRITE #1 "        <register address='0xc20402c' value='0x" DATA.LONG(A:0x120402c) "' name='RPMH_CPRF_CPRF3_VOLTAGE_LIMITS_8'/>"
WRITE #1 "        <register address='0xc204030' value='0x" DATA.LONG(A:0x1204030) "' name='RPMH_CPRF_CPRF3_VOLTAGE_LIMITS_9'/>"
WRITE #1 "        <register address='0xc204034' value='0x" DATA.LONG(A:0x1204034) "' name='RPMH_CPRF_CPRF3_VOLTAGE_LIMITS_10'/>"
WRITE #1 "        <register address='0xc204038' value='0x" DATA.LONG(A:0x1204038) "' name='RPMH_CPRF_CPRF3_VOLTAGE_LIMITS_11'/>"
WRITE #1 "        <register address='0xc20403c' value='0x" DATA.LONG(A:0x120403c) "' name='RPMH_CPRF_CPRF3_VOLTAGE_LIMITS_12'/>"
WRITE #1 "        <register address='0xc204040' value='0x" DATA.LONG(A:0x1204040) "' name='RPMH_CPRF_CPRF3_VOLTAGE_LIMITS_13'/>"
WRITE #1 "        <register address='0xc204044' value='0x" DATA.LONG(A:0x1204044) "' name='RPMH_CPRF_CPRF3_VOLTAGE_LIMITS_14'/>"
WRITE #1 "        <register address='0xc204048' value='0x" DATA.LONG(A:0x1204048) "' name='RPMH_CPRF_CPRF3_VOLTAGE_LIMITS_15'/>"
WRITE #1 "        <register address='0xc20500c' value='0x" DATA.LONG(A:0x120500c) "' name='RPMH_CPRF_CPRF4_VOLTAGE_LIMITS_0'/>"
WRITE #1 "        <register address='0xc205010' value='0x" DATA.LONG(A:0x1205010) "' name='RPMH_CPRF_CPRF4_VOLTAGE_LIMITS_1'/>"
WRITE #1 "        <register address='0xc205014' value='0x" DATA.LONG(A:0x1205014) "' name='RPMH_CPRF_CPRF4_VOLTAGE_LIMITS_2'/>"
WRITE #1 "        <register address='0xc205018' value='0x" DATA.LONG(A:0x1205018) "' name='RPMH_CPRF_CPRF4_VOLTAGE_LIMITS_3'/>"
WRITE #1 "        <register address='0xc20501c' value='0x" DATA.LONG(A:0x120501c) "' name='RPMH_CPRF_CPRF4_VOLTAGE_LIMITS_4'/>"
WRITE #1 "        <register address='0xc205020' value='0x" DATA.LONG(A:0x1205020) "' name='RPMH_CPRF_CPRF4_VOLTAGE_LIMITS_5'/>"
WRITE #1 "        <register address='0xc205024' value='0x" DATA.LONG(A:0x1205024) "' name='RPMH_CPRF_CPRF4_VOLTAGE_LIMITS_6'/>"
WRITE #1 "        <register address='0xc205028' value='0x" DATA.LONG(A:0x1205028) "' name='RPMH_CPRF_CPRF4_VOLTAGE_LIMITS_7'/>"
WRITE #1 "        <register address='0xc20502c' value='0x" DATA.LONG(A:0x120502c) "' name='RPMH_CPRF_CPRF4_VOLTAGE_LIMITS_8'/>"
WRITE #1 "        <register address='0xc205030' value='0x" DATA.LONG(A:0x1205030) "' name='RPMH_CPRF_CPRF4_VOLTAGE_LIMITS_9'/>"
WRITE #1 "        <register address='0xc205034' value='0x" DATA.LONG(A:0x1205034) "' name='RPMH_CPRF_CPRF4_VOLTAGE_LIMITS_10'/>"
WRITE #1 "        <register address='0xc205038' value='0x" DATA.LONG(A:0x1205038) "' name='RPMH_CPRF_CPRF4_VOLTAGE_LIMITS_11'/>"
WRITE #1 "        <register address='0xc20503c' value='0x" DATA.LONG(A:0x120503c) "' name='RPMH_CPRF_CPRF4_VOLTAGE_LIMITS_12'/>"
WRITE #1 "        <register address='0xc205040' value='0x" DATA.LONG(A:0x1205040) "' name='RPMH_CPRF_CPRF4_VOLTAGE_LIMITS_13'/>"
WRITE #1 "        <register address='0xc205044' value='0x" DATA.LONG(A:0x1205044) "' name='RPMH_CPRF_CPRF4_VOLTAGE_LIMITS_14'/>"
WRITE #1 "        <register address='0xc205048' value='0x" DATA.LONG(A:0x1205048) "' name='RPMH_CPRF_CPRF4_VOLTAGE_LIMITS_15'/>"
WRITE #1 "        <register address='0xc20600c' value='0x" DATA.LONG(A:0x120600c) "' name='RPMH_CPRF_CPRF5_VOLTAGE_LIMITS_0'/>"
WRITE #1 "        <register address='0xc206010' value='0x" DATA.LONG(A:0x1206010) "' name='RPMH_CPRF_CPRF5_VOLTAGE_LIMITS_1'/>"
WRITE #1 "        <register address='0xc206014' value='0x" DATA.LONG(A:0x1206014) "' name='RPMH_CPRF_CPRF5_VOLTAGE_LIMITS_2'/>"
WRITE #1 "        <register address='0xc206018' value='0x" DATA.LONG(A:0x1206018) "' name='RPMH_CPRF_CPRF5_VOLTAGE_LIMITS_3'/>"
WRITE #1 "        <register address='0xc20601c' value='0x" DATA.LONG(A:0x120601c) "' name='RPMH_CPRF_CPRF5_VOLTAGE_LIMITS_4'/>"
WRITE #1 "        <register address='0xc206020' value='0x" DATA.LONG(A:0x1206020) "' name='RPMH_CPRF_CPRF5_VOLTAGE_LIMITS_5'/>"
WRITE #1 "        <register address='0xc206024' value='0x" DATA.LONG(A:0x1206024) "' name='RPMH_CPRF_CPRF5_VOLTAGE_LIMITS_6'/>"
WRITE #1 "        <register address='0xc206028' value='0x" DATA.LONG(A:0x1206028) "' name='RPMH_CPRF_CPRF5_VOLTAGE_LIMITS_7'/>"
WRITE #1 "        <register address='0xc20602c' value='0x" DATA.LONG(A:0x120602c) "' name='RPMH_CPRF_CPRF5_VOLTAGE_LIMITS_8'/>"
WRITE #1 "        <register address='0xc206030' value='0x" DATA.LONG(A:0x1206030) "' name='RPMH_CPRF_CPRF5_VOLTAGE_LIMITS_9'/>"
WRITE #1 "        <register address='0xc206034' value='0x" DATA.LONG(A:0x1206034) "' name='RPMH_CPRF_CPRF5_VOLTAGE_LIMITS_10'/>"
WRITE #1 "        <register address='0xc206038' value='0x" DATA.LONG(A:0x1206038) "' name='RPMH_CPRF_CPRF5_VOLTAGE_LIMITS_11'/>"
WRITE #1 "        <register address='0xc20603c' value='0x" DATA.LONG(A:0x120603c) "' name='RPMH_CPRF_CPRF5_VOLTAGE_LIMITS_12'/>"
WRITE #1 "        <register address='0xc206040' value='0x" DATA.LONG(A:0x1206040) "' name='RPMH_CPRF_CPRF5_VOLTAGE_LIMITS_13'/>"
WRITE #1 "        <register address='0xc206044' value='0x" DATA.LONG(A:0x1206044) "' name='RPMH_CPRF_CPRF5_VOLTAGE_LIMITS_14'/>"
WRITE #1 "        <register address='0xc206048' value='0x" DATA.LONG(A:0x1206048) "' name='RPMH_CPRF_CPRF5_VOLTAGE_LIMITS_15'/>"
WRITE #1 "        <register address='0xc20108c' value='0x" DATA.LONG(A:0x120108c) "' name='RPMH_CPRF_CPRF0_SAFE_VOLTAGE_0'/>"
WRITE #1 "        <register address='0xc201090' value='0x" DATA.LONG(A:0x1201090) "' name='RPMH_CPRF_CPRF0_SAFE_VOLTAGE_1'/>"
WRITE #1 "        <register address='0xc201094' value='0x" DATA.LONG(A:0x1201094) "' name='RPMH_CPRF_CPRF0_SAFE_VOLTAGE_2'/>"
WRITE #1 "        <register address='0xc201098' value='0x" DATA.LONG(A:0x1201098) "' name='RPMH_CPRF_CPRF0_SAFE_VOLTAGE_3'/>"
WRITE #1 "        <register address='0xc20109c' value='0x" DATA.LONG(A:0x120109c) "' name='RPMH_CPRF_CPRF0_SAFE_VOLTAGE_4'/>"
WRITE #1 "        <register address='0xc2010a0' value='0x" DATA.LONG(A:0x12010a0) "' name='RPMH_CPRF_CPRF0_SAFE_VOLTAGE_5'/>"
WRITE #1 "        <register address='0xc2010a4' value='0x" DATA.LONG(A:0x12010a4) "' name='RPMH_CPRF_CPRF0_SAFE_VOLTAGE_6'/>"
WRITE #1 "        <register address='0xc2010a8' value='0x" DATA.LONG(A:0x12010a8) "' name='RPMH_CPRF_CPRF0_SAFE_VOLTAGE_7'/>"
WRITE #1 "        <register address='0xc2010ac' value='0x" DATA.LONG(A:0x12010ac) "' name='RPMH_CPRF_CPRF0_SAFE_VOLTAGE_8'/>"
WRITE #1 "        <register address='0xc2010b0' value='0x" DATA.LONG(A:0x12010b0) "' name='RPMH_CPRF_CPRF0_SAFE_VOLTAGE_9'/>"
WRITE #1 "        <register address='0xc2010b4' value='0x" DATA.LONG(A:0x12010b4) "' name='RPMH_CPRF_CPRF0_SAFE_VOLTAGE_10'/>"
WRITE #1 "        <register address='0xc2010b8' value='0x" DATA.LONG(A:0x12010b8) "' name='RPMH_CPRF_CPRF0_SAFE_VOLTAGE_11'/>"
WRITE #1 "        <register address='0xc2010bc' value='0x" DATA.LONG(A:0x12010bc) "' name='RPMH_CPRF_CPRF0_SAFE_VOLTAGE_12'/>"
WRITE #1 "        <register address='0xc2010c0' value='0x" DATA.LONG(A:0x12010c0) "' name='RPMH_CPRF_CPRF0_SAFE_VOLTAGE_13'/>"
WRITE #1 "        <register address='0xc2010c4' value='0x" DATA.LONG(A:0x12010c4) "' name='RPMH_CPRF_CPRF0_SAFE_VOLTAGE_14'/>"
WRITE #1 "        <register address='0xc2010c8' value='0x" DATA.LONG(A:0x12010c8) "' name='RPMH_CPRF_CPRF0_SAFE_VOLTAGE_15'/>"
WRITE #1 "        <register address='0xc20208c' value='0x" DATA.LONG(A:0x120208c) "' name='RPMH_CPRF_CPRF1_SAFE_VOLTAGE_0'/>"
WRITE #1 "        <register address='0xc202090' value='0x" DATA.LONG(A:0x1202090) "' name='RPMH_CPRF_CPRF1_SAFE_VOLTAGE_1'/>"
WRITE #1 "        <register address='0xc202094' value='0x" DATA.LONG(A:0x1202094) "' name='RPMH_CPRF_CPRF1_SAFE_VOLTAGE_2'/>"
WRITE #1 "        <register address='0xc202098' value='0x" DATA.LONG(A:0x1202098) "' name='RPMH_CPRF_CPRF1_SAFE_VOLTAGE_3'/>"
WRITE #1 "        <register address='0xc20209c' value='0x" DATA.LONG(A:0x120209c) "' name='RPMH_CPRF_CPRF1_SAFE_VOLTAGE_4'/>"
WRITE #1 "        <register address='0xc2020a0' value='0x" DATA.LONG(A:0x12020a0) "' name='RPMH_CPRF_CPRF1_SAFE_VOLTAGE_5'/>"
WRITE #1 "        <register address='0xc2020a4' value='0x" DATA.LONG(A:0x12020a4) "' name='RPMH_CPRF_CPRF1_SAFE_VOLTAGE_6'/>"
WRITE #1 "        <register address='0xc2020a8' value='0x" DATA.LONG(A:0x12020a8) "' name='RPMH_CPRF_CPRF1_SAFE_VOLTAGE_7'/>"
WRITE #1 "        <register address='0xc2020ac' value='0x" DATA.LONG(A:0x12020ac) "' name='RPMH_CPRF_CPRF1_SAFE_VOLTAGE_8'/>"
WRITE #1 "        <register address='0xc2020b0' value='0x" DATA.LONG(A:0x12020b0) "' name='RPMH_CPRF_CPRF1_SAFE_VOLTAGE_9'/>"
WRITE #1 "        <register address='0xc2020b4' value='0x" DATA.LONG(A:0x12020b4) "' name='RPMH_CPRF_CPRF1_SAFE_VOLTAGE_10'/>"
WRITE #1 "        <register address='0xc2020b8' value='0x" DATA.LONG(A:0x12020b8) "' name='RPMH_CPRF_CPRF1_SAFE_VOLTAGE_11'/>"
WRITE #1 "        <register address='0xc2020bc' value='0x" DATA.LONG(A:0x12020bc) "' name='RPMH_CPRF_CPRF1_SAFE_VOLTAGE_12'/>"
WRITE #1 "        <register address='0xc2020c0' value='0x" DATA.LONG(A:0x12020c0) "' name='RPMH_CPRF_CPRF1_SAFE_VOLTAGE_13'/>"
WRITE #1 "        <register address='0xc2020c4' value='0x" DATA.LONG(A:0x12020c4) "' name='RPMH_CPRF_CPRF1_SAFE_VOLTAGE_14'/>"
WRITE #1 "        <register address='0xc2020c8' value='0x" DATA.LONG(A:0x12020c8) "' name='RPMH_CPRF_CPRF1_SAFE_VOLTAGE_15'/>"
WRITE #1 "        <register address='0xc20308c' value='0x" DATA.LONG(A:0x120308c) "' name='RPMH_CPRF_CPRF2_SAFE_VOLTAGE_0'/>"
WRITE #1 "        <register address='0xc203090' value='0x" DATA.LONG(A:0x1203090) "' name='RPMH_CPRF_CPRF2_SAFE_VOLTAGE_1'/>"
WRITE #1 "        <register address='0xc203094' value='0x" DATA.LONG(A:0x1203094) "' name='RPMH_CPRF_CPRF2_SAFE_VOLTAGE_2'/>"
WRITE #1 "        <register address='0xc203098' value='0x" DATA.LONG(A:0x1203098) "' name='RPMH_CPRF_CPRF2_SAFE_VOLTAGE_3'/>"
WRITE #1 "        <register address='0xc20309c' value='0x" DATA.LONG(A:0x120309c) "' name='RPMH_CPRF_CPRF2_SAFE_VOLTAGE_4'/>"
WRITE #1 "        <register address='0xc2030a0' value='0x" DATA.LONG(A:0x12030a0) "' name='RPMH_CPRF_CPRF2_SAFE_VOLTAGE_5'/>"
WRITE #1 "        <register address='0xc2030a4' value='0x" DATA.LONG(A:0x12030a4) "' name='RPMH_CPRF_CPRF2_SAFE_VOLTAGE_6'/>"
WRITE #1 "        <register address='0xc2030a8' value='0x" DATA.LONG(A:0x12030a8) "' name='RPMH_CPRF_CPRF2_SAFE_VOLTAGE_7'/>"
WRITE #1 "        <register address='0xc2030ac' value='0x" DATA.LONG(A:0x12030ac) "' name='RPMH_CPRF_CPRF2_SAFE_VOLTAGE_8'/>"
WRITE #1 "        <register address='0xc2030b0' value='0x" DATA.LONG(A:0x12030b0) "' name='RPMH_CPRF_CPRF2_SAFE_VOLTAGE_9'/>"
WRITE #1 "        <register address='0xc2030b4' value='0x" DATA.LONG(A:0x12030b4) "' name='RPMH_CPRF_CPRF2_SAFE_VOLTAGE_10'/>"
WRITE #1 "        <register address='0xc2030b8' value='0x" DATA.LONG(A:0x12030b8) "' name='RPMH_CPRF_CPRF2_SAFE_VOLTAGE_11'/>"
WRITE #1 "        <register address='0xc2030bc' value='0x" DATA.LONG(A:0x12030bc) "' name='RPMH_CPRF_CPRF2_SAFE_VOLTAGE_12'/>"
WRITE #1 "        <register address='0xc2030c0' value='0x" DATA.LONG(A:0x12030c0) "' name='RPMH_CPRF_CPRF2_SAFE_VOLTAGE_13'/>"
WRITE #1 "        <register address='0xc2030c4' value='0x" DATA.LONG(A:0x12030c4) "' name='RPMH_CPRF_CPRF2_SAFE_VOLTAGE_14'/>"
WRITE #1 "        <register address='0xc2030c8' value='0x" DATA.LONG(A:0x12030c8) "' name='RPMH_CPRF_CPRF2_SAFE_VOLTAGE_15'/>"
WRITE #1 "        <register address='0xc20408c' value='0x" DATA.LONG(A:0x120408c) "' name='RPMH_CPRF_CPRF3_SAFE_VOLTAGE_0'/>"
WRITE #1 "        <register address='0xc204090' value='0x" DATA.LONG(A:0x1204090) "' name='RPMH_CPRF_CPRF3_SAFE_VOLTAGE_1'/>"
WRITE #1 "        <register address='0xc204094' value='0x" DATA.LONG(A:0x1204094) "' name='RPMH_CPRF_CPRF3_SAFE_VOLTAGE_2'/>"
WRITE #1 "        <register address='0xc204098' value='0x" DATA.LONG(A:0x1204098) "' name='RPMH_CPRF_CPRF3_SAFE_VOLTAGE_3'/>"
WRITE #1 "        <register address='0xc20409c' value='0x" DATA.LONG(A:0x120409c) "' name='RPMH_CPRF_CPRF3_SAFE_VOLTAGE_4'/>"
WRITE #1 "        <register address='0xc2040a0' value='0x" DATA.LONG(A:0x12040a0) "' name='RPMH_CPRF_CPRF3_SAFE_VOLTAGE_5'/>"
WRITE #1 "        <register address='0xc2040a4' value='0x" DATA.LONG(A:0x12040a4) "' name='RPMH_CPRF_CPRF3_SAFE_VOLTAGE_6'/>"
WRITE #1 "        <register address='0xc2040a8' value='0x" DATA.LONG(A:0x12040a8) "' name='RPMH_CPRF_CPRF3_SAFE_VOLTAGE_7'/>"
WRITE #1 "        <register address='0xc2040ac' value='0x" DATA.LONG(A:0x12040ac) "' name='RPMH_CPRF_CPRF3_SAFE_VOLTAGE_8'/>"
WRITE #1 "        <register address='0xc2040b0' value='0x" DATA.LONG(A:0x12040b0) "' name='RPMH_CPRF_CPRF3_SAFE_VOLTAGE_9'/>"
WRITE #1 "        <register address='0xc2040b4' value='0x" DATA.LONG(A:0x12040b4) "' name='RPMH_CPRF_CPRF3_SAFE_VOLTAGE_10'/>"
WRITE #1 "        <register address='0xc2040b8' value='0x" DATA.LONG(A:0x12040b8) "' name='RPMH_CPRF_CPRF3_SAFE_VOLTAGE_11'/>"
WRITE #1 "        <register address='0xc2040bc' value='0x" DATA.LONG(A:0x12040bc) "' name='RPMH_CPRF_CPRF3_SAFE_VOLTAGE_12'/>"
WRITE #1 "        <register address='0xc2040c0' value='0x" DATA.LONG(A:0x12040c0) "' name='RPMH_CPRF_CPRF3_SAFE_VOLTAGE_13'/>"
WRITE #1 "        <register address='0xc2040c4' value='0x" DATA.LONG(A:0x12040c4) "' name='RPMH_CPRF_CPRF3_SAFE_VOLTAGE_14'/>"
WRITE #1 "        <register address='0xc2040c8' value='0x" DATA.LONG(A:0x12040c8) "' name='RPMH_CPRF_CPRF3_SAFE_VOLTAGE_15'/>"
WRITE #1 "        <register address='0xc20508c' value='0x" DATA.LONG(A:0x120508c) "' name='RPMH_CPRF_CPRF4_SAFE_VOLTAGE_0'/>"
WRITE #1 "        <register address='0xc205090' value='0x" DATA.LONG(A:0x1205090) "' name='RPMH_CPRF_CPRF4_SAFE_VOLTAGE_1'/>"
WRITE #1 "        <register address='0xc205094' value='0x" DATA.LONG(A:0x1205094) "' name='RPMH_CPRF_CPRF4_SAFE_VOLTAGE_2'/>"
WRITE #1 "        <register address='0xc205098' value='0x" DATA.LONG(A:0x1205098) "' name='RPMH_CPRF_CPRF4_SAFE_VOLTAGE_3'/>"
WRITE #1 "        <register address='0xc20509c' value='0x" DATA.LONG(A:0x120509c) "' name='RPMH_CPRF_CPRF4_SAFE_VOLTAGE_4'/>"
WRITE #1 "        <register address='0xc2050a0' value='0x" DATA.LONG(A:0x12050a0) "' name='RPMH_CPRF_CPRF4_SAFE_VOLTAGE_5'/>"
WRITE #1 "        <register address='0xc2050a4' value='0x" DATA.LONG(A:0x12050a4) "' name='RPMH_CPRF_CPRF4_SAFE_VOLTAGE_6'/>"
WRITE #1 "        <register address='0xc2050a8' value='0x" DATA.LONG(A:0x12050a8) "' name='RPMH_CPRF_CPRF4_SAFE_VOLTAGE_7'/>"
WRITE #1 "        <register address='0xc2050ac' value='0x" DATA.LONG(A:0x12050ac) "' name='RPMH_CPRF_CPRF4_SAFE_VOLTAGE_8'/>"
WRITE #1 "        <register address='0xc2050b0' value='0x" DATA.LONG(A:0x12050b0) "' name='RPMH_CPRF_CPRF4_SAFE_VOLTAGE_9'/>"
WRITE #1 "        <register address='0xc2050b4' value='0x" DATA.LONG(A:0x12050b4) "' name='RPMH_CPRF_CPRF4_SAFE_VOLTAGE_10'/>"
WRITE #1 "        <register address='0xc2050b8' value='0x" DATA.LONG(A:0x12050b8) "' name='RPMH_CPRF_CPRF4_SAFE_VOLTAGE_11'/>"
WRITE #1 "        <register address='0xc2050bc' value='0x" DATA.LONG(A:0x12050bc) "' name='RPMH_CPRF_CPRF4_SAFE_VOLTAGE_12'/>"
WRITE #1 "        <register address='0xc2050c0' value='0x" DATA.LONG(A:0x12050c0) "' name='RPMH_CPRF_CPRF4_SAFE_VOLTAGE_13'/>"
WRITE #1 "        <register address='0xc2050c4' value='0x" DATA.LONG(A:0x12050c4) "' name='RPMH_CPRF_CPRF4_SAFE_VOLTAGE_14'/>"
WRITE #1 "        <register address='0xc2050c8' value='0x" DATA.LONG(A:0x12050c8) "' name='RPMH_CPRF_CPRF4_SAFE_VOLTAGE_15'/>"
WRITE #1 "        <register address='0xc20608c' value='0x" DATA.LONG(A:0x120608c) "' name='RPMH_CPRF_CPRF5_SAFE_VOLTAGE_0'/>"
WRITE #1 "        <register address='0xc206090' value='0x" DATA.LONG(A:0x1206090) "' name='RPMH_CPRF_CPRF5_SAFE_VOLTAGE_1'/>"
WRITE #1 "        <register address='0xc206094' value='0x" DATA.LONG(A:0x1206094) "' name='RPMH_CPRF_CPRF5_SAFE_VOLTAGE_2'/>"
WRITE #1 "        <register address='0xc206098' value='0x" DATA.LONG(A:0x1206098) "' name='RPMH_CPRF_CPRF5_SAFE_VOLTAGE_3'/>"
WRITE #1 "        <register address='0xc20609c' value='0x" DATA.LONG(A:0x120609c) "' name='RPMH_CPRF_CPRF5_SAFE_VOLTAGE_4'/>"
WRITE #1 "        <register address='0xc2060a0' value='0x" DATA.LONG(A:0x12060a0) "' name='RPMH_CPRF_CPRF5_SAFE_VOLTAGE_5'/>"
WRITE #1 "        <register address='0xc2060a4' value='0x" DATA.LONG(A:0x12060a4) "' name='RPMH_CPRF_CPRF5_SAFE_VOLTAGE_6'/>"
WRITE #1 "        <register address='0xc2060a8' value='0x" DATA.LONG(A:0x12060a8) "' name='RPMH_CPRF_CPRF5_SAFE_VOLTAGE_7'/>"
WRITE #1 "        <register address='0xc2060ac' value='0x" DATA.LONG(A:0x12060ac) "' name='RPMH_CPRF_CPRF5_SAFE_VOLTAGE_8'/>"
WRITE #1 "        <register address='0xc2060b0' value='0x" DATA.LONG(A:0x12060b0) "' name='RPMH_CPRF_CPRF5_SAFE_VOLTAGE_9'/>"
WRITE #1 "        <register address='0xc2060b4' value='0x" DATA.LONG(A:0x12060b4) "' name='RPMH_CPRF_CPRF5_SAFE_VOLTAGE_10'/>"
WRITE #1 "        <register address='0xc2060b8' value='0x" DATA.LONG(A:0x12060b8) "' name='RPMH_CPRF_CPRF5_SAFE_VOLTAGE_11'/>"
WRITE #1 "        <register address='0xc2060bc' value='0x" DATA.LONG(A:0x12060bc) "' name='RPMH_CPRF_CPRF5_SAFE_VOLTAGE_12'/>"
WRITE #1 "        <register address='0xc2060c0' value='0x" DATA.LONG(A:0x12060c0) "' name='RPMH_CPRF_CPRF5_SAFE_VOLTAGE_13'/>"
WRITE #1 "        <register address='0xc2060c4' value='0x" DATA.LONG(A:0x12060c4) "' name='RPMH_CPRF_CPRF5_SAFE_VOLTAGE_14'/>"
WRITE #1 "        <register address='0xc2060c8' value='0x" DATA.LONG(A:0x12060c8) "' name='RPMH_CPRF_CPRF5_SAFE_VOLTAGE_15'/>"
WRITE #1 "        <register address='0xc201110' value='0x" DATA.LONG(A:0x1201110) "' name='RPMH_CPRF_CPRF0_DELAY_CPRC'/>"
WRITE #1 "        <register address='0xc202110' value='0x" DATA.LONG(A:0x1202110) "' name='RPMH_CPRF_CPRF1_DELAY_CPRC'/>"
WRITE #1 "        <register address='0xc203110' value='0x" DATA.LONG(A:0x1203110) "' name='RPMH_CPRF_CPRF2_DELAY_CPRC'/>"
WRITE #1 "        <register address='0xc204110' value='0x" DATA.LONG(A:0x1204110) "' name='RPMH_CPRF_CPRF3_DELAY_CPRC'/>"
WRITE #1 "        <register address='0xc205110' value='0x" DATA.LONG(A:0x1205110) "' name='RPMH_CPRF_CPRF4_DELAY_CPRC'/>"
WRITE #1 "        <register address='0xc206110' value='0x" DATA.LONG(A:0x1206110) "' name='RPMH_CPRF_CPRF5_DELAY_CPRC'/>"
WRITE #1 "        <register address='0xc201114' value='0x" DATA.LONG(A:0x1201114) "' name='RPMH_CPRF_CPRF0_INITIAL_SETTINGS'/>"
WRITE #1 "        <register address='0xc202114' value='0x" DATA.LONG(A:0x1202114) "' name='RPMH_CPRF_CPRF1_INITIAL_SETTINGS'/>"
WRITE #1 "        <register address='0xc203114' value='0x" DATA.LONG(A:0x1203114) "' name='RPMH_CPRF_CPRF2_INITIAL_SETTINGS'/>"
WRITE #1 "        <register address='0xc204114' value='0x" DATA.LONG(A:0x1204114) "' name='RPMH_CPRF_CPRF3_INITIAL_SETTINGS'/>"
WRITE #1 "        <register address='0xc205114' value='0x" DATA.LONG(A:0x1205114) "' name='RPMH_CPRF_CPRF4_INITIAL_SETTINGS'/>"
WRITE #1 "        <register address='0xc206114' value='0x" DATA.LONG(A:0x1206114) "' name='RPMH_CPRF_CPRF5_INITIAL_SETTINGS'/>"
WRITE #1 "        <register address='0xc201118' value='0x" DATA.LONG(A:0x1201118) "' name='RPMH_CPRF_CPRF0_ENABLE'/>"
WRITE #1 "        <register address='0xc202118' value='0x" DATA.LONG(A:0x1202118) "' name='RPMH_CPRF_CPRF1_ENABLE'/>"
WRITE #1 "        <register address='0xc203118' value='0x" DATA.LONG(A:0x1203118) "' name='RPMH_CPRF_CPRF2_ENABLE'/>"
WRITE #1 "        <register address='0xc204118' value='0x" DATA.LONG(A:0x1204118) "' name='RPMH_CPRF_CPRF3_ENABLE'/>"
WRITE #1 "        <register address='0xc205118' value='0x" DATA.LONG(A:0x1205118) "' name='RPMH_CPRF_CPRF4_ENABLE'/>"
WRITE #1 "        <register address='0xc206118' value='0x" DATA.LONG(A:0x1206118) "' name='RPMH_CPRF_CPRF5_ENABLE'/>"
WRITE #1 "        <register address='0xc20111c' value='0x" DATA.LONG(A:0x120111c) "' name='RPMH_CPRF_CPRF0_FORCE_SETTINGS'/>"
WRITE #1 "        <register address='0xc20211c' value='0x" DATA.LONG(A:0x120211c) "' name='RPMH_CPRF_CPRF1_FORCE_SETTINGS'/>"
WRITE #1 "        <register address='0xc20311c' value='0x" DATA.LONG(A:0x120311c) "' name='RPMH_CPRF_CPRF2_FORCE_SETTINGS'/>"
WRITE #1 "        <register address='0xc20411c' value='0x" DATA.LONG(A:0x120411c) "' name='RPMH_CPRF_CPRF3_FORCE_SETTINGS'/>"
WRITE #1 "        <register address='0xc20511c' value='0x" DATA.LONG(A:0x120511c) "' name='RPMH_CPRF_CPRF4_FORCE_SETTINGS'/>"
WRITE #1 "        <register address='0xc20611c' value='0x" DATA.LONG(A:0x120611c) "' name='RPMH_CPRF_CPRF5_FORCE_SETTINGS'/>"
WRITE #1 "        <register address='0xc201120' value='0x" DATA.LONG(A:0x1201120) "' name='RPMH_CPRF_CPRF0_RECORDING_SETTINGS_0'/>"
WRITE #1 "        <register address='0xc201124' value='0x" DATA.LONG(A:0x1201124) "' name='RPMH_CPRF_CPRF0_RECORDING_SETTINGS_1'/>"
WRITE #1 "        <register address='0xc201128' value='0x" DATA.LONG(A:0x1201128) "' name='RPMH_CPRF_CPRF0_RECORDING_SETTINGS_2'/>"
WRITE #1 "        <register address='0xc20112c' value='0x" DATA.LONG(A:0x120112c) "' name='RPMH_CPRF_CPRF0_RECORDING_SETTINGS_3'/>"
WRITE #1 "        <register address='0xc201130' value='0x" DATA.LONG(A:0x1201130) "' name='RPMH_CPRF_CPRF0_RECORDING_SETTINGS_4'/>"
WRITE #1 "        <register address='0xc201134' value='0x" DATA.LONG(A:0x1201134) "' name='RPMH_CPRF_CPRF0_RECORDING_SETTINGS_5'/>"
WRITE #1 "        <register address='0xc201138' value='0x" DATA.LONG(A:0x1201138) "' name='RPMH_CPRF_CPRF0_RECORDING_SETTINGS_6'/>"
WRITE #1 "        <register address='0xc20113c' value='0x" DATA.LONG(A:0x120113c) "' name='RPMH_CPRF_CPRF0_RECORDING_SETTINGS_7'/>"
WRITE #1 "        <register address='0xc201140' value='0x" DATA.LONG(A:0x1201140) "' name='RPMH_CPRF_CPRF0_RECORDING_SETTINGS_8'/>"
WRITE #1 "        <register address='0xc201144' value='0x" DATA.LONG(A:0x1201144) "' name='RPMH_CPRF_CPRF0_RECORDING_SETTINGS_9'/>"
WRITE #1 "        <register address='0xc201148' value='0x" DATA.LONG(A:0x1201148) "' name='RPMH_CPRF_CPRF0_RECORDING_SETTINGS_10'/>"
WRITE #1 "        <register address='0xc20114c' value='0x" DATA.LONG(A:0x120114c) "' name='RPMH_CPRF_CPRF0_RECORDING_SETTINGS_11'/>"
WRITE #1 "        <register address='0xc201150' value='0x" DATA.LONG(A:0x1201150) "' name='RPMH_CPRF_CPRF0_RECORDING_SETTINGS_12'/>"
WRITE #1 "        <register address='0xc201154' value='0x" DATA.LONG(A:0x1201154) "' name='RPMH_CPRF_CPRF0_RECORDING_SETTINGS_13'/>"
WRITE #1 "        <register address='0xc201158' value='0x" DATA.LONG(A:0x1201158) "' name='RPMH_CPRF_CPRF0_RECORDING_SETTINGS_14'/>"
WRITE #1 "        <register address='0xc20115c' value='0x" DATA.LONG(A:0x120115c) "' name='RPMH_CPRF_CPRF0_RECORDING_SETTINGS_15'/>"
WRITE #1 "        <register address='0xc202120' value='0x" DATA.LONG(A:0x1202120) "' name='RPMH_CPRF_CPRF1_RECORDING_SETTINGS_0'/>"
WRITE #1 "        <register address='0xc202124' value='0x" DATA.LONG(A:0x1202124) "' name='RPMH_CPRF_CPRF1_RECORDING_SETTINGS_1'/>"
WRITE #1 "        <register address='0xc202128' value='0x" DATA.LONG(A:0x1202128) "' name='RPMH_CPRF_CPRF1_RECORDING_SETTINGS_2'/>"
WRITE #1 "        <register address='0xc20212c' value='0x" DATA.LONG(A:0x120212c) "' name='RPMH_CPRF_CPRF1_RECORDING_SETTINGS_3'/>"
WRITE #1 "        <register address='0xc202130' value='0x" DATA.LONG(A:0x1202130) "' name='RPMH_CPRF_CPRF1_RECORDING_SETTINGS_4'/>"
WRITE #1 "        <register address='0xc202134' value='0x" DATA.LONG(A:0x1202134) "' name='RPMH_CPRF_CPRF1_RECORDING_SETTINGS_5'/>"
WRITE #1 "        <register address='0xc202138' value='0x" DATA.LONG(A:0x1202138) "' name='RPMH_CPRF_CPRF1_RECORDING_SETTINGS_6'/>"
WRITE #1 "        <register address='0xc20213c' value='0x" DATA.LONG(A:0x120213c) "' name='RPMH_CPRF_CPRF1_RECORDING_SETTINGS_7'/>"
WRITE #1 "        <register address='0xc202140' value='0x" DATA.LONG(A:0x1202140) "' name='RPMH_CPRF_CPRF1_RECORDING_SETTINGS_8'/>"
WRITE #1 "        <register address='0xc202144' value='0x" DATA.LONG(A:0x1202144) "' name='RPMH_CPRF_CPRF1_RECORDING_SETTINGS_9'/>"
WRITE #1 "        <register address='0xc202148' value='0x" DATA.LONG(A:0x1202148) "' name='RPMH_CPRF_CPRF1_RECORDING_SETTINGS_10'/>"
WRITE #1 "        <register address='0xc20214c' value='0x" DATA.LONG(A:0x120214c) "' name='RPMH_CPRF_CPRF1_RECORDING_SETTINGS_11'/>"
WRITE #1 "        <register address='0xc202150' value='0x" DATA.LONG(A:0x1202150) "' name='RPMH_CPRF_CPRF1_RECORDING_SETTINGS_12'/>"
WRITE #1 "        <register address='0xc202154' value='0x" DATA.LONG(A:0x1202154) "' name='RPMH_CPRF_CPRF1_RECORDING_SETTINGS_13'/>"
WRITE #1 "        <register address='0xc202158' value='0x" DATA.LONG(A:0x1202158) "' name='RPMH_CPRF_CPRF1_RECORDING_SETTINGS_14'/>"
WRITE #1 "        <register address='0xc20215c' value='0x" DATA.LONG(A:0x120215c) "' name='RPMH_CPRF_CPRF1_RECORDING_SETTINGS_15'/>"
WRITE #1 "        <register address='0xc203120' value='0x" DATA.LONG(A:0x1203120) "' name='RPMH_CPRF_CPRF2_RECORDING_SETTINGS_0'/>"
WRITE #1 "        <register address='0xc203124' value='0x" DATA.LONG(A:0x1203124) "' name='RPMH_CPRF_CPRF2_RECORDING_SETTINGS_1'/>"
WRITE #1 "        <register address='0xc203128' value='0x" DATA.LONG(A:0x1203128) "' name='RPMH_CPRF_CPRF2_RECORDING_SETTINGS_2'/>"
WRITE #1 "        <register address='0xc20312c' value='0x" DATA.LONG(A:0x120312c) "' name='RPMH_CPRF_CPRF2_RECORDING_SETTINGS_3'/>"
WRITE #1 "        <register address='0xc203130' value='0x" DATA.LONG(A:0x1203130) "' name='RPMH_CPRF_CPRF2_RECORDING_SETTINGS_4'/>"
WRITE #1 "        <register address='0xc203134' value='0x" DATA.LONG(A:0x1203134) "' name='RPMH_CPRF_CPRF2_RECORDING_SETTINGS_5'/>"
WRITE #1 "        <register address='0xc203138' value='0x" DATA.LONG(A:0x1203138) "' name='RPMH_CPRF_CPRF2_RECORDING_SETTINGS_6'/>"
WRITE #1 "        <register address='0xc20313c' value='0x" DATA.LONG(A:0x120313c) "' name='RPMH_CPRF_CPRF2_RECORDING_SETTINGS_7'/>"
WRITE #1 "        <register address='0xc203140' value='0x" DATA.LONG(A:0x1203140) "' name='RPMH_CPRF_CPRF2_RECORDING_SETTINGS_8'/>"
WRITE #1 "        <register address='0xc203144' value='0x" DATA.LONG(A:0x1203144) "' name='RPMH_CPRF_CPRF2_RECORDING_SETTINGS_9'/>"
WRITE #1 "        <register address='0xc203148' value='0x" DATA.LONG(A:0x1203148) "' name='RPMH_CPRF_CPRF2_RECORDING_SETTINGS_10'/>"
WRITE #1 "        <register address='0xc20314c' value='0x" DATA.LONG(A:0x120314c) "' name='RPMH_CPRF_CPRF2_RECORDING_SETTINGS_11'/>"
WRITE #1 "        <register address='0xc203150' value='0x" DATA.LONG(A:0x1203150) "' name='RPMH_CPRF_CPRF2_RECORDING_SETTINGS_12'/>"
WRITE #1 "        <register address='0xc203154' value='0x" DATA.LONG(A:0x1203154) "' name='RPMH_CPRF_CPRF2_RECORDING_SETTINGS_13'/>"
WRITE #1 "        <register address='0xc203158' value='0x" DATA.LONG(A:0x1203158) "' name='RPMH_CPRF_CPRF2_RECORDING_SETTINGS_14'/>"
WRITE #1 "        <register address='0xc20315c' value='0x" DATA.LONG(A:0x120315c) "' name='RPMH_CPRF_CPRF2_RECORDING_SETTINGS_15'/>"
WRITE #1 "        <register address='0xc204120' value='0x" DATA.LONG(A:0x1204120) "' name='RPMH_CPRF_CPRF3_RECORDING_SETTINGS_0'/>"
WRITE #1 "        <register address='0xc204124' value='0x" DATA.LONG(A:0x1204124) "' name='RPMH_CPRF_CPRF3_RECORDING_SETTINGS_1'/>"
WRITE #1 "        <register address='0xc204128' value='0x" DATA.LONG(A:0x1204128) "' name='RPMH_CPRF_CPRF3_RECORDING_SETTINGS_2'/>"
WRITE #1 "        <register address='0xc20412c' value='0x" DATA.LONG(A:0x120412c) "' name='RPMH_CPRF_CPRF3_RECORDING_SETTINGS_3'/>"
WRITE #1 "        <register address='0xc204130' value='0x" DATA.LONG(A:0x1204130) "' name='RPMH_CPRF_CPRF3_RECORDING_SETTINGS_4'/>"
WRITE #1 "        <register address='0xc204134' value='0x" DATA.LONG(A:0x1204134) "' name='RPMH_CPRF_CPRF3_RECORDING_SETTINGS_5'/>"
WRITE #1 "        <register address='0xc204138' value='0x" DATA.LONG(A:0x1204138) "' name='RPMH_CPRF_CPRF3_RECORDING_SETTINGS_6'/>"
WRITE #1 "        <register address='0xc20413c' value='0x" DATA.LONG(A:0x120413c) "' name='RPMH_CPRF_CPRF3_RECORDING_SETTINGS_7'/>"
WRITE #1 "        <register address='0xc204140' value='0x" DATA.LONG(A:0x1204140) "' name='RPMH_CPRF_CPRF3_RECORDING_SETTINGS_8'/>"
WRITE #1 "        <register address='0xc204144' value='0x" DATA.LONG(A:0x1204144) "' name='RPMH_CPRF_CPRF3_RECORDING_SETTINGS_9'/>"
WRITE #1 "        <register address='0xc204148' value='0x" DATA.LONG(A:0x1204148) "' name='RPMH_CPRF_CPRF3_RECORDING_SETTINGS_10'/>"
WRITE #1 "        <register address='0xc20414c' value='0x" DATA.LONG(A:0x120414c) "' name='RPMH_CPRF_CPRF3_RECORDING_SETTINGS_11'/>"
WRITE #1 "        <register address='0xc204150' value='0x" DATA.LONG(A:0x1204150) "' name='RPMH_CPRF_CPRF3_RECORDING_SETTINGS_12'/>"
WRITE #1 "        <register address='0xc204154' value='0x" DATA.LONG(A:0x1204154) "' name='RPMH_CPRF_CPRF3_RECORDING_SETTINGS_13'/>"
WRITE #1 "        <register address='0xc204158' value='0x" DATA.LONG(A:0x1204158) "' name='RPMH_CPRF_CPRF3_RECORDING_SETTINGS_14'/>"
WRITE #1 "        <register address='0xc20415c' value='0x" DATA.LONG(A:0x120415c) "' name='RPMH_CPRF_CPRF3_RECORDING_SETTINGS_15'/>"
WRITE #1 "        <register address='0xc205120' value='0x" DATA.LONG(A:0x1205120) "' name='RPMH_CPRF_CPRF4_RECORDING_SETTINGS_0'/>"
WRITE #1 "        <register address='0xc205124' value='0x" DATA.LONG(A:0x1205124) "' name='RPMH_CPRF_CPRF4_RECORDING_SETTINGS_1'/>"
WRITE #1 "        <register address='0xc205128' value='0x" DATA.LONG(A:0x1205128) "' name='RPMH_CPRF_CPRF4_RECORDING_SETTINGS_2'/>"
WRITE #1 "        <register address='0xc20512c' value='0x" DATA.LONG(A:0x120512c) "' name='RPMH_CPRF_CPRF4_RECORDING_SETTINGS_3'/>"
WRITE #1 "        <register address='0xc205130' value='0x" DATA.LONG(A:0x1205130) "' name='RPMH_CPRF_CPRF4_RECORDING_SETTINGS_4'/>"
WRITE #1 "        <register address='0xc205134' value='0x" DATA.LONG(A:0x1205134) "' name='RPMH_CPRF_CPRF4_RECORDING_SETTINGS_5'/>"
WRITE #1 "        <register address='0xc205138' value='0x" DATA.LONG(A:0x1205138) "' name='RPMH_CPRF_CPRF4_RECORDING_SETTINGS_6'/>"
WRITE #1 "        <register address='0xc20513c' value='0x" DATA.LONG(A:0x120513c) "' name='RPMH_CPRF_CPRF4_RECORDING_SETTINGS_7'/>"
WRITE #1 "        <register address='0xc205140' value='0x" DATA.LONG(A:0x1205140) "' name='RPMH_CPRF_CPRF4_RECORDING_SETTINGS_8'/>"
WRITE #1 "        <register address='0xc205144' value='0x" DATA.LONG(A:0x1205144) "' name='RPMH_CPRF_CPRF4_RECORDING_SETTINGS_9'/>"
WRITE #1 "        <register address='0xc205148' value='0x" DATA.LONG(A:0x1205148) "' name='RPMH_CPRF_CPRF4_RECORDING_SETTINGS_10'/>"
WRITE #1 "        <register address='0xc20514c' value='0x" DATA.LONG(A:0x120514c) "' name='RPMH_CPRF_CPRF4_RECORDING_SETTINGS_11'/>"
WRITE #1 "        <register address='0xc205150' value='0x" DATA.LONG(A:0x1205150) "' name='RPMH_CPRF_CPRF4_RECORDING_SETTINGS_12'/>"
WRITE #1 "        <register address='0xc205154' value='0x" DATA.LONG(A:0x1205154) "' name='RPMH_CPRF_CPRF4_RECORDING_SETTINGS_13'/>"
WRITE #1 "        <register address='0xc205158' value='0x" DATA.LONG(A:0x1205158) "' name='RPMH_CPRF_CPRF4_RECORDING_SETTINGS_14'/>"
WRITE #1 "        <register address='0xc20515c' value='0x" DATA.LONG(A:0x120515c) "' name='RPMH_CPRF_CPRF4_RECORDING_SETTINGS_15'/>"
WRITE #1 "        <register address='0xc206120' value='0x" DATA.LONG(A:0x1206120) "' name='RPMH_CPRF_CPRF5_RECORDING_SETTINGS_0'/>"
WRITE #1 "        <register address='0xc206124' value='0x" DATA.LONG(A:0x1206124) "' name='RPMH_CPRF_CPRF5_RECORDING_SETTINGS_1'/>"
WRITE #1 "        <register address='0xc206128' value='0x" DATA.LONG(A:0x1206128) "' name='RPMH_CPRF_CPRF5_RECORDING_SETTINGS_2'/>"
WRITE #1 "        <register address='0xc20612c' value='0x" DATA.LONG(A:0x120612c) "' name='RPMH_CPRF_CPRF5_RECORDING_SETTINGS_3'/>"
WRITE #1 "        <register address='0xc206130' value='0x" DATA.LONG(A:0x1206130) "' name='RPMH_CPRF_CPRF5_RECORDING_SETTINGS_4'/>"
WRITE #1 "        <register address='0xc206134' value='0x" DATA.LONG(A:0x1206134) "' name='RPMH_CPRF_CPRF5_RECORDING_SETTINGS_5'/>"
WRITE #1 "        <register address='0xc206138' value='0x" DATA.LONG(A:0x1206138) "' name='RPMH_CPRF_CPRF5_RECORDING_SETTINGS_6'/>"
WRITE #1 "        <register address='0xc20613c' value='0x" DATA.LONG(A:0x120613c) "' name='RPMH_CPRF_CPRF5_RECORDING_SETTINGS_7'/>"
WRITE #1 "        <register address='0xc206140' value='0x" DATA.LONG(A:0x1206140) "' name='RPMH_CPRF_CPRF5_RECORDING_SETTINGS_8'/>"
WRITE #1 "        <register address='0xc206144' value='0x" DATA.LONG(A:0x1206144) "' name='RPMH_CPRF_CPRF5_RECORDING_SETTINGS_9'/>"
WRITE #1 "        <register address='0xc206148' value='0x" DATA.LONG(A:0x1206148) "' name='RPMH_CPRF_CPRF5_RECORDING_SETTINGS_10'/>"
WRITE #1 "        <register address='0xc20614c' value='0x" DATA.LONG(A:0x120614c) "' name='RPMH_CPRF_CPRF5_RECORDING_SETTINGS_11'/>"
WRITE #1 "        <register address='0xc206150' value='0x" DATA.LONG(A:0x1206150) "' name='RPMH_CPRF_CPRF5_RECORDING_SETTINGS_12'/>"
WRITE #1 "        <register address='0xc206154' value='0x" DATA.LONG(A:0x1206154) "' name='RPMH_CPRF_CPRF5_RECORDING_SETTINGS_13'/>"
WRITE #1 "        <register address='0xc206158' value='0x" DATA.LONG(A:0x1206158) "' name='RPMH_CPRF_CPRF5_RECORDING_SETTINGS_14'/>"
WRITE #1 "        <register address='0xc20615c' value='0x" DATA.LONG(A:0x120615c) "' name='RPMH_CPRF_CPRF5_RECORDING_SETTINGS_15'/>"
WRITE #1 "        <register address='0xc2011a0' value='0x" DATA.LONG(A:0x12011a0) "' name='RPMH_CPRF_CPRF0_CAP_STEP_SETTINGS_0'/>"
WRITE #1 "        <register address='0xc2011a4' value='0x" DATA.LONG(A:0x12011a4) "' name='RPMH_CPRF_CPRF0_CAP_STEP_SETTINGS_1'/>"
WRITE #1 "        <register address='0xc2011a8' value='0x" DATA.LONG(A:0x12011a8) "' name='RPMH_CPRF_CPRF0_CAP_STEP_SETTINGS_2'/>"
WRITE #1 "        <register address='0xc2011ac' value='0x" DATA.LONG(A:0x12011ac) "' name='RPMH_CPRF_CPRF0_CAP_STEP_SETTINGS_3'/>"
WRITE #1 "        <register address='0xc2011b0' value='0x" DATA.LONG(A:0x12011b0) "' name='RPMH_CPRF_CPRF0_CAP_STEP_SETTINGS_4'/>"
WRITE #1 "        <register address='0xc2011b4' value='0x" DATA.LONG(A:0x12011b4) "' name='RPMH_CPRF_CPRF0_CAP_STEP_SETTINGS_5'/>"
WRITE #1 "        <register address='0xc2011b8' value='0x" DATA.LONG(A:0x12011b8) "' name='RPMH_CPRF_CPRF0_CAP_STEP_SETTINGS_6'/>"
WRITE #1 "        <register address='0xc2011bc' value='0x" DATA.LONG(A:0x12011bc) "' name='RPMH_CPRF_CPRF0_CAP_STEP_SETTINGS_7'/>"
WRITE #1 "        <register address='0xc2011c0' value='0x" DATA.LONG(A:0x12011c0) "' name='RPMH_CPRF_CPRF0_CAP_STEP_SETTINGS_8'/>"
WRITE #1 "        <register address='0xc2011c4' value='0x" DATA.LONG(A:0x12011c4) "' name='RPMH_CPRF_CPRF0_CAP_STEP_SETTINGS_9'/>"
WRITE #1 "        <register address='0xc2011c8' value='0x" DATA.LONG(A:0x12011c8) "' name='RPMH_CPRF_CPRF0_CAP_STEP_SETTINGS_10'/>"
WRITE #1 "        <register address='0xc2011cc' value='0x" DATA.LONG(A:0x12011cc) "' name='RPMH_CPRF_CPRF0_CAP_STEP_SETTINGS_11'/>"
WRITE #1 "        <register address='0xc2011d0' value='0x" DATA.LONG(A:0x12011d0) "' name='RPMH_CPRF_CPRF0_CAP_STEP_SETTINGS_12'/>"
WRITE #1 "        <register address='0xc2011d4' value='0x" DATA.LONG(A:0x12011d4) "' name='RPMH_CPRF_CPRF0_CAP_STEP_SETTINGS_13'/>"
WRITE #1 "        <register address='0xc2011d8' value='0x" DATA.LONG(A:0x12011d8) "' name='RPMH_CPRF_CPRF0_CAP_STEP_SETTINGS_14'/>"
WRITE #1 "        <register address='0xc2011dc' value='0x" DATA.LONG(A:0x12011dc) "' name='RPMH_CPRF_CPRF0_CAP_STEP_SETTINGS_15'/>"
WRITE #1 "        <register address='0xc2021a0' value='0x" DATA.LONG(A:0x12021a0) "' name='RPMH_CPRF_CPRF1_CAP_STEP_SETTINGS_0'/>"
WRITE #1 "        <register address='0xc2021a4' value='0x" DATA.LONG(A:0x12021a4) "' name='RPMH_CPRF_CPRF1_CAP_STEP_SETTINGS_1'/>"
WRITE #1 "        <register address='0xc2021a8' value='0x" DATA.LONG(A:0x12021a8) "' name='RPMH_CPRF_CPRF1_CAP_STEP_SETTINGS_2'/>"
WRITE #1 "        <register address='0xc2021ac' value='0x" DATA.LONG(A:0x12021ac) "' name='RPMH_CPRF_CPRF1_CAP_STEP_SETTINGS_3'/>"
WRITE #1 "        <register address='0xc2021b0' value='0x" DATA.LONG(A:0x12021b0) "' name='RPMH_CPRF_CPRF1_CAP_STEP_SETTINGS_4'/>"
WRITE #1 "        <register address='0xc2021b4' value='0x" DATA.LONG(A:0x12021b4) "' name='RPMH_CPRF_CPRF1_CAP_STEP_SETTINGS_5'/>"
WRITE #1 "        <register address='0xc2021b8' value='0x" DATA.LONG(A:0x12021b8) "' name='RPMH_CPRF_CPRF1_CAP_STEP_SETTINGS_6'/>"
WRITE #1 "        <register address='0xc2021bc' value='0x" DATA.LONG(A:0x12021bc) "' name='RPMH_CPRF_CPRF1_CAP_STEP_SETTINGS_7'/>"
WRITE #1 "        <register address='0xc2021c0' value='0x" DATA.LONG(A:0x12021c0) "' name='RPMH_CPRF_CPRF1_CAP_STEP_SETTINGS_8'/>"
WRITE #1 "        <register address='0xc2021c4' value='0x" DATA.LONG(A:0x12021c4) "' name='RPMH_CPRF_CPRF1_CAP_STEP_SETTINGS_9'/>"
WRITE #1 "        <register address='0xc2021c8' value='0x" DATA.LONG(A:0x12021c8) "' name='RPMH_CPRF_CPRF1_CAP_STEP_SETTINGS_10'/>"
WRITE #1 "        <register address='0xc2021cc' value='0x" DATA.LONG(A:0x12021cc) "' name='RPMH_CPRF_CPRF1_CAP_STEP_SETTINGS_11'/>"
WRITE #1 "        <register address='0xc2021d0' value='0x" DATA.LONG(A:0x12021d0) "' name='RPMH_CPRF_CPRF1_CAP_STEP_SETTINGS_12'/>"
WRITE #1 "        <register address='0xc2021d4' value='0x" DATA.LONG(A:0x12021d4) "' name='RPMH_CPRF_CPRF1_CAP_STEP_SETTINGS_13'/>"
WRITE #1 "        <register address='0xc2021d8' value='0x" DATA.LONG(A:0x12021d8) "' name='RPMH_CPRF_CPRF1_CAP_STEP_SETTINGS_14'/>"
WRITE #1 "        <register address='0xc2021dc' value='0x" DATA.LONG(A:0x12021dc) "' name='RPMH_CPRF_CPRF1_CAP_STEP_SETTINGS_15'/>"
WRITE #1 "        <register address='0xc2031a0' value='0x" DATA.LONG(A:0x12031a0) "' name='RPMH_CPRF_CPRF2_CAP_STEP_SETTINGS_0'/>"
WRITE #1 "        <register address='0xc2031a4' value='0x" DATA.LONG(A:0x12031a4) "' name='RPMH_CPRF_CPRF2_CAP_STEP_SETTINGS_1'/>"
WRITE #1 "        <register address='0xc2031a8' value='0x" DATA.LONG(A:0x12031a8) "' name='RPMH_CPRF_CPRF2_CAP_STEP_SETTINGS_2'/>"
WRITE #1 "        <register address='0xc2031ac' value='0x" DATA.LONG(A:0x12031ac) "' name='RPMH_CPRF_CPRF2_CAP_STEP_SETTINGS_3'/>"
WRITE #1 "        <register address='0xc2031b0' value='0x" DATA.LONG(A:0x12031b0) "' name='RPMH_CPRF_CPRF2_CAP_STEP_SETTINGS_4'/>"
WRITE #1 "        <register address='0xc2031b4' value='0x" DATA.LONG(A:0x12031b4) "' name='RPMH_CPRF_CPRF2_CAP_STEP_SETTINGS_5'/>"
WRITE #1 "        <register address='0xc2031b8' value='0x" DATA.LONG(A:0x12031b8) "' name='RPMH_CPRF_CPRF2_CAP_STEP_SETTINGS_6'/>"
WRITE #1 "        <register address='0xc2031bc' value='0x" DATA.LONG(A:0x12031bc) "' name='RPMH_CPRF_CPRF2_CAP_STEP_SETTINGS_7'/>"
WRITE #1 "        <register address='0xc2031c0' value='0x" DATA.LONG(A:0x12031c0) "' name='RPMH_CPRF_CPRF2_CAP_STEP_SETTINGS_8'/>"
WRITE #1 "        <register address='0xc2031c4' value='0x" DATA.LONG(A:0x12031c4) "' name='RPMH_CPRF_CPRF2_CAP_STEP_SETTINGS_9'/>"
WRITE #1 "        <register address='0xc2031c8' value='0x" DATA.LONG(A:0x12031c8) "' name='RPMH_CPRF_CPRF2_CAP_STEP_SETTINGS_10'/>"
WRITE #1 "        <register address='0xc2031cc' value='0x" DATA.LONG(A:0x12031cc) "' name='RPMH_CPRF_CPRF2_CAP_STEP_SETTINGS_11'/>"
WRITE #1 "        <register address='0xc2031d0' value='0x" DATA.LONG(A:0x12031d0) "' name='RPMH_CPRF_CPRF2_CAP_STEP_SETTINGS_12'/>"
WRITE #1 "        <register address='0xc2031d4' value='0x" DATA.LONG(A:0x12031d4) "' name='RPMH_CPRF_CPRF2_CAP_STEP_SETTINGS_13'/>"
WRITE #1 "        <register address='0xc2031d8' value='0x" DATA.LONG(A:0x12031d8) "' name='RPMH_CPRF_CPRF2_CAP_STEP_SETTINGS_14'/>"
WRITE #1 "        <register address='0xc2031dc' value='0x" DATA.LONG(A:0x12031dc) "' name='RPMH_CPRF_CPRF2_CAP_STEP_SETTINGS_15'/>"
WRITE #1 "        <register address='0xc2041a0' value='0x" DATA.LONG(A:0x12041a0) "' name='RPMH_CPRF_CPRF3_CAP_STEP_SETTINGS_0'/>"
WRITE #1 "        <register address='0xc2041a4' value='0x" DATA.LONG(A:0x12041a4) "' name='RPMH_CPRF_CPRF3_CAP_STEP_SETTINGS_1'/>"
WRITE #1 "        <register address='0xc2041a8' value='0x" DATA.LONG(A:0x12041a8) "' name='RPMH_CPRF_CPRF3_CAP_STEP_SETTINGS_2'/>"
WRITE #1 "        <register address='0xc2041ac' value='0x" DATA.LONG(A:0x12041ac) "' name='RPMH_CPRF_CPRF3_CAP_STEP_SETTINGS_3'/>"
WRITE #1 "        <register address='0xc2041b0' value='0x" DATA.LONG(A:0x12041b0) "' name='RPMH_CPRF_CPRF3_CAP_STEP_SETTINGS_4'/>"
WRITE #1 "        <register address='0xc2041b4' value='0x" DATA.LONG(A:0x12041b4) "' name='RPMH_CPRF_CPRF3_CAP_STEP_SETTINGS_5'/>"
WRITE #1 "        <register address='0xc2041b8' value='0x" DATA.LONG(A:0x12041b8) "' name='RPMH_CPRF_CPRF3_CAP_STEP_SETTINGS_6'/>"
WRITE #1 "        <register address='0xc2041bc' value='0x" DATA.LONG(A:0x12041bc) "' name='RPMH_CPRF_CPRF3_CAP_STEP_SETTINGS_7'/>"
WRITE #1 "        <register address='0xc2041c0' value='0x" DATA.LONG(A:0x12041c0) "' name='RPMH_CPRF_CPRF3_CAP_STEP_SETTINGS_8'/>"
WRITE #1 "        <register address='0xc2041c4' value='0x" DATA.LONG(A:0x12041c4) "' name='RPMH_CPRF_CPRF3_CAP_STEP_SETTINGS_9'/>"
WRITE #1 "        <register address='0xc2041c8' value='0x" DATA.LONG(A:0x12041c8) "' name='RPMH_CPRF_CPRF3_CAP_STEP_SETTINGS_10'/>"
WRITE #1 "        <register address='0xc2041cc' value='0x" DATA.LONG(A:0x12041cc) "' name='RPMH_CPRF_CPRF3_CAP_STEP_SETTINGS_11'/>"
WRITE #1 "        <register address='0xc2041d0' value='0x" DATA.LONG(A:0x12041d0) "' name='RPMH_CPRF_CPRF3_CAP_STEP_SETTINGS_12'/>"
WRITE #1 "        <register address='0xc2041d4' value='0x" DATA.LONG(A:0x12041d4) "' name='RPMH_CPRF_CPRF3_CAP_STEP_SETTINGS_13'/>"
WRITE #1 "        <register address='0xc2041d8' value='0x" DATA.LONG(A:0x12041d8) "' name='RPMH_CPRF_CPRF3_CAP_STEP_SETTINGS_14'/>"
WRITE #1 "        <register address='0xc2041dc' value='0x" DATA.LONG(A:0x12041dc) "' name='RPMH_CPRF_CPRF3_CAP_STEP_SETTINGS_15'/>"
WRITE #1 "        <register address='0xc2051a0' value='0x" DATA.LONG(A:0x12051a0) "' name='RPMH_CPRF_CPRF4_CAP_STEP_SETTINGS_0'/>"
WRITE #1 "        <register address='0xc2051a4' value='0x" DATA.LONG(A:0x12051a4) "' name='RPMH_CPRF_CPRF4_CAP_STEP_SETTINGS_1'/>"
WRITE #1 "        <register address='0xc2051a8' value='0x" DATA.LONG(A:0x12051a8) "' name='RPMH_CPRF_CPRF4_CAP_STEP_SETTINGS_2'/>"
WRITE #1 "        <register address='0xc2051ac' value='0x" DATA.LONG(A:0x12051ac) "' name='RPMH_CPRF_CPRF4_CAP_STEP_SETTINGS_3'/>"
WRITE #1 "        <register address='0xc2051b0' value='0x" DATA.LONG(A:0x12051b0) "' name='RPMH_CPRF_CPRF4_CAP_STEP_SETTINGS_4'/>"
WRITE #1 "        <register address='0xc2051b4' value='0x" DATA.LONG(A:0x12051b4) "' name='RPMH_CPRF_CPRF4_CAP_STEP_SETTINGS_5'/>"
WRITE #1 "        <register address='0xc2051b8' value='0x" DATA.LONG(A:0x12051b8) "' name='RPMH_CPRF_CPRF4_CAP_STEP_SETTINGS_6'/>"
WRITE #1 "        <register address='0xc2051bc' value='0x" DATA.LONG(A:0x12051bc) "' name='RPMH_CPRF_CPRF4_CAP_STEP_SETTINGS_7'/>"
WRITE #1 "        <register address='0xc2051c0' value='0x" DATA.LONG(A:0x12051c0) "' name='RPMH_CPRF_CPRF4_CAP_STEP_SETTINGS_8'/>"
WRITE #1 "        <register address='0xc2051c4' value='0x" DATA.LONG(A:0x12051c4) "' name='RPMH_CPRF_CPRF4_CAP_STEP_SETTINGS_9'/>"
WRITE #1 "        <register address='0xc2051c8' value='0x" DATA.LONG(A:0x12051c8) "' name='RPMH_CPRF_CPRF4_CAP_STEP_SETTINGS_10'/>"
WRITE #1 "        <register address='0xc2051cc' value='0x" DATA.LONG(A:0x12051cc) "' name='RPMH_CPRF_CPRF4_CAP_STEP_SETTINGS_11'/>"
WRITE #1 "        <register address='0xc2051d0' value='0x" DATA.LONG(A:0x12051d0) "' name='RPMH_CPRF_CPRF4_CAP_STEP_SETTINGS_12'/>"
WRITE #1 "        <register address='0xc2051d4' value='0x" DATA.LONG(A:0x12051d4) "' name='RPMH_CPRF_CPRF4_CAP_STEP_SETTINGS_13'/>"
WRITE #1 "        <register address='0xc2051d8' value='0x" DATA.LONG(A:0x12051d8) "' name='RPMH_CPRF_CPRF4_CAP_STEP_SETTINGS_14'/>"
WRITE #1 "        <register address='0xc2051dc' value='0x" DATA.LONG(A:0x12051dc) "' name='RPMH_CPRF_CPRF4_CAP_STEP_SETTINGS_15'/>"
WRITE #1 "        <register address='0xc2061a0' value='0x" DATA.LONG(A:0x12061a0) "' name='RPMH_CPRF_CPRF5_CAP_STEP_SETTINGS_0'/>"
WRITE #1 "        <register address='0xc2061a4' value='0x" DATA.LONG(A:0x12061a4) "' name='RPMH_CPRF_CPRF5_CAP_STEP_SETTINGS_1'/>"
WRITE #1 "        <register address='0xc2061a8' value='0x" DATA.LONG(A:0x12061a8) "' name='RPMH_CPRF_CPRF5_CAP_STEP_SETTINGS_2'/>"
WRITE #1 "        <register address='0xc2061ac' value='0x" DATA.LONG(A:0x12061ac) "' name='RPMH_CPRF_CPRF5_CAP_STEP_SETTINGS_3'/>"
WRITE #1 "        <register address='0xc2061b0' value='0x" DATA.LONG(A:0x12061b0) "' name='RPMH_CPRF_CPRF5_CAP_STEP_SETTINGS_4'/>"
WRITE #1 "        <register address='0xc2061b4' value='0x" DATA.LONG(A:0x12061b4) "' name='RPMH_CPRF_CPRF5_CAP_STEP_SETTINGS_5'/>"
WRITE #1 "        <register address='0xc2061b8' value='0x" DATA.LONG(A:0x12061b8) "' name='RPMH_CPRF_CPRF5_CAP_STEP_SETTINGS_6'/>"
WRITE #1 "        <register address='0xc2061bc' value='0x" DATA.LONG(A:0x12061bc) "' name='RPMH_CPRF_CPRF5_CAP_STEP_SETTINGS_7'/>"
WRITE #1 "        <register address='0xc2061c0' value='0x" DATA.LONG(A:0x12061c0) "' name='RPMH_CPRF_CPRF5_CAP_STEP_SETTINGS_8'/>"
WRITE #1 "        <register address='0xc2061c4' value='0x" DATA.LONG(A:0x12061c4) "' name='RPMH_CPRF_CPRF5_CAP_STEP_SETTINGS_9'/>"
WRITE #1 "        <register address='0xc2061c8' value='0x" DATA.LONG(A:0x12061c8) "' name='RPMH_CPRF_CPRF5_CAP_STEP_SETTINGS_10'/>"
WRITE #1 "        <register address='0xc2061cc' value='0x" DATA.LONG(A:0x12061cc) "' name='RPMH_CPRF_CPRF5_CAP_STEP_SETTINGS_11'/>"
WRITE #1 "        <register address='0xc2061d0' value='0x" DATA.LONG(A:0x12061d0) "' name='RPMH_CPRF_CPRF5_CAP_STEP_SETTINGS_12'/>"
WRITE #1 "        <register address='0xc2061d4' value='0x" DATA.LONG(A:0x12061d4) "' name='RPMH_CPRF_CPRF5_CAP_STEP_SETTINGS_13'/>"
WRITE #1 "        <register address='0xc2061d8' value='0x" DATA.LONG(A:0x12061d8) "' name='RPMH_CPRF_CPRF5_CAP_STEP_SETTINGS_14'/>"
WRITE #1 "        <register address='0xc2061dc' value='0x" DATA.LONG(A:0x12061dc) "' name='RPMH_CPRF_CPRF5_CAP_STEP_SETTINGS_15'/>"
WRITE #1 "        <register address='0xc201220' value='0x" DATA.LONG(A:0x1201220) "' name='RPMH_CPRF_CPRF0_INTERRUPT_STATUS'/>"
WRITE #1 "        <register address='0xc202220' value='0x" DATA.LONG(A:0x1202220) "' name='RPMH_CPRF_CPRF1_INTERRUPT_STATUS'/>"
WRITE #1 "        <register address='0xc203220' value='0x" DATA.LONG(A:0x1203220) "' name='RPMH_CPRF_CPRF2_INTERRUPT_STATUS'/>"
WRITE #1 "        <register address='0xc204220' value='0x" DATA.LONG(A:0x1204220) "' name='RPMH_CPRF_CPRF3_INTERRUPT_STATUS'/>"
WRITE #1 "        <register address='0xc205220' value='0x" DATA.LONG(A:0x1205220) "' name='RPMH_CPRF_CPRF4_INTERRUPT_STATUS'/>"
WRITE #1 "        <register address='0xc206220' value='0x" DATA.LONG(A:0x1206220) "' name='RPMH_CPRF_CPRF5_INTERRUPT_STATUS'/>"
WRITE #1 "        <register address='0xc201224' value='0x" DATA.LONG(A:0x1201224) "' name='RPMH_CPRF_CPRF0_INTERRUPT_MASK'/>"
WRITE #1 "        <register address='0xc202224' value='0x" DATA.LONG(A:0x1202224) "' name='RPMH_CPRF_CPRF1_INTERRUPT_MASK'/>"
WRITE #1 "        <register address='0xc203224' value='0x" DATA.LONG(A:0x1203224) "' name='RPMH_CPRF_CPRF2_INTERRUPT_MASK'/>"
WRITE #1 "        <register address='0xc204224' value='0x" DATA.LONG(A:0x1204224) "' name='RPMH_CPRF_CPRF3_INTERRUPT_MASK'/>"
WRITE #1 "        <register address='0xc205224' value='0x" DATA.LONG(A:0x1205224) "' name='RPMH_CPRF_CPRF4_INTERRUPT_MASK'/>"
WRITE #1 "        <register address='0xc206224' value='0x" DATA.LONG(A:0x1206224) "' name='RPMH_CPRF_CPRF5_INTERRUPT_MASK'/>"
WRITE #1 "        <register address='0xc201228' value='0x" DATA.LONG(A:0x1201228) "' name='RPMH_CPRF_CPRF0_ARC_PR_WA'/>"
WRITE #1 "        <register address='0xc202228' value='0x" DATA.LONG(A:0x1202228) "' name='RPMH_CPRF_CPRF1_ARC_PR_WA'/>"
WRITE #1 "        <register address='0xc203228' value='0x" DATA.LONG(A:0x1203228) "' name='RPMH_CPRF_CPRF2_ARC_PR_WA'/>"
WRITE #1 "        <register address='0xc204228' value='0x" DATA.LONG(A:0x1204228) "' name='RPMH_CPRF_CPRF3_ARC_PR_WA'/>"
WRITE #1 "        <register address='0xc205228' value='0x" DATA.LONG(A:0x1205228) "' name='RPMH_CPRF_CPRF4_ARC_PR_WA'/>"
WRITE #1 "        <register address='0xc206228' value='0x" DATA.LONG(A:0x1206228) "' name='RPMH_CPRF_CPRF5_ARC_PR_WA'/>"
WRITE #1 "        <register address='0xc20122c' value='0x" DATA.LONG(A:0x120122c) "' name='RPMH_CPRF_CPRF0_ARC_CXO_WA'/>"
WRITE #1 "        <register address='0xc20222c' value='0x" DATA.LONG(A:0x120222c) "' name='RPMH_CPRF_CPRF1_ARC_CXO_WA'/>"
WRITE #1 "        <register address='0xc20322c' value='0x" DATA.LONG(A:0x120322c) "' name='RPMH_CPRF_CPRF2_ARC_CXO_WA'/>"
WRITE #1 "        <register address='0xc20422c' value='0x" DATA.LONG(A:0x120422c) "' name='RPMH_CPRF_CPRF3_ARC_CXO_WA'/>"
WRITE #1 "        <register address='0xc20522c' value='0x" DATA.LONG(A:0x120522c) "' name='RPMH_CPRF_CPRF4_ARC_CXO_WA'/>"
WRITE #1 "        <register address='0xc20622c' value='0x" DATA.LONG(A:0x120622c) "' name='RPMH_CPRF_CPRF5_ARC_CXO_WA'/>"
WRITE #1 "        <register address='0xc201230' value='0x" DATA.LONG(A:0x1201230) "' name='RPMH_CPRF_CPRF0_VALUES'/>"
WRITE #1 "        <register address='0xc202230' value='0x" DATA.LONG(A:0x1202230) "' name='RPMH_CPRF_CPRF1_VALUES'/>"
WRITE #1 "        <register address='0xc203230' value='0x" DATA.LONG(A:0x1203230) "' name='RPMH_CPRF_CPRF2_VALUES'/>"
WRITE #1 "        <register address='0xc204230' value='0x" DATA.LONG(A:0x1204230) "' name='RPMH_CPRF_CPRF3_VALUES'/>"
WRITE #1 "        <register address='0xc205230' value='0x" DATA.LONG(A:0x1205230) "' name='RPMH_CPRF_CPRF4_VALUES'/>"
WRITE #1 "        <register address='0xc206230' value='0x" DATA.LONG(A:0x1206230) "' name='RPMH_CPRF_CPRF5_VALUES'/>"
WRITE #1 "        <register address='0xc201234' value='0x" DATA.LONG(A:0x1201234) "' name='RPMH_CPRF_CPRF0_STEP_SETTINGS'/>"
WRITE #1 "        <register address='0xc202234' value='0x" DATA.LONG(A:0x1202234) "' name='RPMH_CPRF_CPRF1_STEP_SETTINGS'/>"
WRITE #1 "        <register address='0xc203234' value='0x" DATA.LONG(A:0x1203234) "' name='RPMH_CPRF_CPRF2_STEP_SETTINGS'/>"
WRITE #1 "        <register address='0xc204234' value='0x" DATA.LONG(A:0x1204234) "' name='RPMH_CPRF_CPRF3_STEP_SETTINGS'/>"
WRITE #1 "        <register address='0xc205234' value='0x" DATA.LONG(A:0x1205234) "' name='RPMH_CPRF_CPRF4_STEP_SETTINGS'/>"
WRITE #1 "        <register address='0xc206234' value='0x" DATA.LONG(A:0x1206234) "' name='RPMH_CPRF_CPRF5_STEP_SETTINGS'/>"
WRITE #1 "        <register address='0xc201238' value='0x" DATA.LONG(A:0x1201238) "' name='RPMH_CPRF_CPRF0_FLOOR_SETTINGS'/>"
WRITE #1 "        <register address='0xc202238' value='0x" DATA.LONG(A:0x1202238) "' name='RPMH_CPRF_CPRF1_FLOOR_SETTINGS'/>"
WRITE #1 "        <register address='0xc203238' value='0x" DATA.LONG(A:0x1203238) "' name='RPMH_CPRF_CPRF2_FLOOR_SETTINGS'/>"
WRITE #1 "        <register address='0xc204238' value='0x" DATA.LONG(A:0x1204238) "' name='RPMH_CPRF_CPRF3_FLOOR_SETTINGS'/>"
WRITE #1 "        <register address='0xc205238' value='0x" DATA.LONG(A:0x1205238) "' name='RPMH_CPRF_CPRF4_FLOOR_SETTINGS'/>"
WRITE #1 "        <register address='0xc206238' value='0x" DATA.LONG(A:0x1206238) "' name='RPMH_CPRF_CPRF5_FLOOR_SETTINGS'/>"
WRITE #1 "        <register address='0xc20123c' value='0x" DATA.LONG(A:0x120123c) "' name='RPMH_CPRF_CPRF0_TIMEOUT'/>"
WRITE #1 "        <register address='0xc20223c' value='0x" DATA.LONG(A:0x120223c) "' name='RPMH_CPRF_CPRF1_TIMEOUT'/>"
WRITE #1 "        <register address='0xc20323c' value='0x" DATA.LONG(A:0x120323c) "' name='RPMH_CPRF_CPRF2_TIMEOUT'/>"
WRITE #1 "        <register address='0xc20423c' value='0x" DATA.LONG(A:0x120423c) "' name='RPMH_CPRF_CPRF3_TIMEOUT'/>"
WRITE #1 "        <register address='0xc20523c' value='0x" DATA.LONG(A:0x120523c) "' name='RPMH_CPRF_CPRF4_TIMEOUT'/>"
WRITE #1 "        <register address='0xc20623c' value='0x" DATA.LONG(A:0x120623c) "' name='RPMH_CPRF_CPRF5_TIMEOUT'/>"
WRITE #1 "        <register address='0xc201240' value='0x" DATA.LONG(A:0x1201240) "' name='RPMH_CPRF_CPRF0_ON_SETTINGS'/>"
WRITE #1 "        <register address='0xc202240' value='0x" DATA.LONG(A:0x1202240) "' name='RPMH_CPRF_CPRF1_ON_SETTINGS'/>"
WRITE #1 "        <register address='0xc203240' value='0x" DATA.LONG(A:0x1203240) "' name='RPMH_CPRF_CPRF2_ON_SETTINGS'/>"
WRITE #1 "        <register address='0xc204240' value='0x" DATA.LONG(A:0x1204240) "' name='RPMH_CPRF_CPRF3_ON_SETTINGS'/>"
WRITE #1 "        <register address='0xc205240' value='0x" DATA.LONG(A:0x1205240) "' name='RPMH_CPRF_CPRF4_ON_SETTINGS'/>"
WRITE #1 "        <register address='0xc206240' value='0x" DATA.LONG(A:0x1206240) "' name='RPMH_CPRF_CPRF5_ON_SETTINGS'/>"
WRITE #1 "        <register address='0xc201244' value='0x" DATA.LONG(A:0x1201244) "' name='RPMH_CPRF_CPRF0_VALUES_1'/>"
WRITE #1 "        <register address='0xc202244' value='0x" DATA.LONG(A:0x1202244) "' name='RPMH_CPRF_CPRF1_VALUES_1'/>"
WRITE #1 "        <register address='0xc203244' value='0x" DATA.LONG(A:0x1203244) "' name='RPMH_CPRF_CPRF2_VALUES_1'/>"
WRITE #1 "        <register address='0xc204244' value='0x" DATA.LONG(A:0x1204244) "' name='RPMH_CPRF_CPRF3_VALUES_1'/>"
WRITE #1 "        <register address='0xc205244' value='0x" DATA.LONG(A:0x1205244) "' name='RPMH_CPRF_CPRF4_VALUES_1'/>"
WRITE #1 "        <register address='0xc206244' value='0x" DATA.LONG(A:0x1206244) "' name='RPMH_CPRF_CPRF5_VALUES_1'/>"
WRITE #1 "        <register address='0xc201248' value='0x" DATA.LONG(A:0x1201248) "' name='RPMH_CPRF_CPRF0_ARC_PR_BIT_ORDER'/>"
WRITE #1 "        <register address='0xc202248' value='0x" DATA.LONG(A:0x1202248) "' name='RPMH_CPRF_CPRF1_ARC_PR_BIT_ORDER'/>"
WRITE #1 "        <register address='0xc203248' value='0x" DATA.LONG(A:0x1203248) "' name='RPMH_CPRF_CPRF2_ARC_PR_BIT_ORDER'/>"
WRITE #1 "        <register address='0xc204248' value='0x" DATA.LONG(A:0x1204248) "' name='RPMH_CPRF_CPRF3_ARC_PR_BIT_ORDER'/>"
WRITE #1 "        <register address='0xc205248' value='0x" DATA.LONG(A:0x1205248) "' name='RPMH_CPRF_CPRF4_ARC_PR_BIT_ORDER'/>"
WRITE #1 "        <register address='0xc206248' value='0x" DATA.LONG(A:0x1206248) "' name='RPMH_CPRF_CPRF5_ARC_PR_BIT_ORDER'/>"
WRITE #1 "        <register address='0xc20124c' value='0x" DATA.LONG(A:0x120124c) "' name='RPMH_CPRF_CPRF0_DELTA_0'/>"
WRITE #1 "        <register address='0xc201250' value='0x" DATA.LONG(A:0x1201250) "' name='RPMH_CPRF_CPRF0_DELTA_1'/>"
WRITE #1 "        <register address='0xc201254' value='0x" DATA.LONG(A:0x1201254) "' name='RPMH_CPRF_CPRF0_DELTA_2'/>"
WRITE #1 "        <register address='0xc201258' value='0x" DATA.LONG(A:0x1201258) "' name='RPMH_CPRF_CPRF0_DELTA_3'/>"
WRITE #1 "        <register address='0xc20125c' value='0x" DATA.LONG(A:0x120125c) "' name='RPMH_CPRF_CPRF0_DELTA_4'/>"
WRITE #1 "        <register address='0xc201260' value='0x" DATA.LONG(A:0x1201260) "' name='RPMH_CPRF_CPRF0_DELTA_5'/>"
WRITE #1 "        <register address='0xc201264' value='0x" DATA.LONG(A:0x1201264) "' name='RPMH_CPRF_CPRF0_DELTA_6'/>"
WRITE #1 "        <register address='0xc201268' value='0x" DATA.LONG(A:0x1201268) "' name='RPMH_CPRF_CPRF0_DELTA_7'/>"
WRITE #1 "        <register address='0xc20126c' value='0x" DATA.LONG(A:0x120126c) "' name='RPMH_CPRF_CPRF0_DELTA_8'/>"
WRITE #1 "        <register address='0xc201270' value='0x" DATA.LONG(A:0x1201270) "' name='RPMH_CPRF_CPRF0_DELTA_9'/>"
WRITE #1 "        <register address='0xc201274' value='0x" DATA.LONG(A:0x1201274) "' name='RPMH_CPRF_CPRF0_DELTA_10'/>"
WRITE #1 "        <register address='0xc201278' value='0x" DATA.LONG(A:0x1201278) "' name='RPMH_CPRF_CPRF0_DELTA_11'/>"
WRITE #1 "        <register address='0xc20127c' value='0x" DATA.LONG(A:0x120127c) "' name='RPMH_CPRF_CPRF0_DELTA_12'/>"
WRITE #1 "        <register address='0xc201280' value='0x" DATA.LONG(A:0x1201280) "' name='RPMH_CPRF_CPRF0_DELTA_13'/>"
WRITE #1 "        <register address='0xc201284' value='0x" DATA.LONG(A:0x1201284) "' name='RPMH_CPRF_CPRF0_DELTA_14'/>"
WRITE #1 "        <register address='0xc201288' value='0x" DATA.LONG(A:0x1201288) "' name='RPMH_CPRF_CPRF0_DELTA_15'/>"
WRITE #1 "        <register address='0xc20224c' value='0x" DATA.LONG(A:0x120224c) "' name='RPMH_CPRF_CPRF1_DELTA_0'/>"
WRITE #1 "        <register address='0xc202250' value='0x" DATA.LONG(A:0x1202250) "' name='RPMH_CPRF_CPRF1_DELTA_1'/>"
WRITE #1 "        <register address='0xc202254' value='0x" DATA.LONG(A:0x1202254) "' name='RPMH_CPRF_CPRF1_DELTA_2'/>"
WRITE #1 "        <register address='0xc202258' value='0x" DATA.LONG(A:0x1202258) "' name='RPMH_CPRF_CPRF1_DELTA_3'/>"
WRITE #1 "        <register address='0xc20225c' value='0x" DATA.LONG(A:0x120225c) "' name='RPMH_CPRF_CPRF1_DELTA_4'/>"
WRITE #1 "        <register address='0xc202260' value='0x" DATA.LONG(A:0x1202260) "' name='RPMH_CPRF_CPRF1_DELTA_5'/>"
WRITE #1 "        <register address='0xc202264' value='0x" DATA.LONG(A:0x1202264) "' name='RPMH_CPRF_CPRF1_DELTA_6'/>"
WRITE #1 "        <register address='0xc202268' value='0x" DATA.LONG(A:0x1202268) "' name='RPMH_CPRF_CPRF1_DELTA_7'/>"
WRITE #1 "        <register address='0xc20226c' value='0x" DATA.LONG(A:0x120226c) "' name='RPMH_CPRF_CPRF1_DELTA_8'/>"
WRITE #1 "        <register address='0xc202270' value='0x" DATA.LONG(A:0x1202270) "' name='RPMH_CPRF_CPRF1_DELTA_9'/>"
WRITE #1 "        <register address='0xc202274' value='0x" DATA.LONG(A:0x1202274) "' name='RPMH_CPRF_CPRF1_DELTA_10'/>"
WRITE #1 "        <register address='0xc202278' value='0x" DATA.LONG(A:0x1202278) "' name='RPMH_CPRF_CPRF1_DELTA_11'/>"
WRITE #1 "        <register address='0xc20227c' value='0x" DATA.LONG(A:0x120227c) "' name='RPMH_CPRF_CPRF1_DELTA_12'/>"
WRITE #1 "        <register address='0xc202280' value='0x" DATA.LONG(A:0x1202280) "' name='RPMH_CPRF_CPRF1_DELTA_13'/>"
WRITE #1 "        <register address='0xc202284' value='0x" DATA.LONG(A:0x1202284) "' name='RPMH_CPRF_CPRF1_DELTA_14'/>"
WRITE #1 "        <register address='0xc202288' value='0x" DATA.LONG(A:0x1202288) "' name='RPMH_CPRF_CPRF1_DELTA_15'/>"
WRITE #1 "        <register address='0xc20324c' value='0x" DATA.LONG(A:0x120324c) "' name='RPMH_CPRF_CPRF2_DELTA_0'/>"
WRITE #1 "        <register address='0xc203250' value='0x" DATA.LONG(A:0x1203250) "' name='RPMH_CPRF_CPRF2_DELTA_1'/>"
WRITE #1 "        <register address='0xc203254' value='0x" DATA.LONG(A:0x1203254) "' name='RPMH_CPRF_CPRF2_DELTA_2'/>"
WRITE #1 "        <register address='0xc203258' value='0x" DATA.LONG(A:0x1203258) "' name='RPMH_CPRF_CPRF2_DELTA_3'/>"
WRITE #1 "        <register address='0xc20325c' value='0x" DATA.LONG(A:0x120325c) "' name='RPMH_CPRF_CPRF2_DELTA_4'/>"
WRITE #1 "        <register address='0xc203260' value='0x" DATA.LONG(A:0x1203260) "' name='RPMH_CPRF_CPRF2_DELTA_5'/>"
WRITE #1 "        <register address='0xc203264' value='0x" DATA.LONG(A:0x1203264) "' name='RPMH_CPRF_CPRF2_DELTA_6'/>"
WRITE #1 "        <register address='0xc203268' value='0x" DATA.LONG(A:0x1203268) "' name='RPMH_CPRF_CPRF2_DELTA_7'/>"
WRITE #1 "        <register address='0xc20326c' value='0x" DATA.LONG(A:0x120326c) "' name='RPMH_CPRF_CPRF2_DELTA_8'/>"
WRITE #1 "        <register address='0xc203270' value='0x" DATA.LONG(A:0x1203270) "' name='RPMH_CPRF_CPRF2_DELTA_9'/>"
WRITE #1 "        <register address='0xc203274' value='0x" DATA.LONG(A:0x1203274) "' name='RPMH_CPRF_CPRF2_DELTA_10'/>"
WRITE #1 "        <register address='0xc203278' value='0x" DATA.LONG(A:0x1203278) "' name='RPMH_CPRF_CPRF2_DELTA_11'/>"
WRITE #1 "        <register address='0xc20327c' value='0x" DATA.LONG(A:0x120327c) "' name='RPMH_CPRF_CPRF2_DELTA_12'/>"
WRITE #1 "        <register address='0xc203280' value='0x" DATA.LONG(A:0x1203280) "' name='RPMH_CPRF_CPRF2_DELTA_13'/>"
WRITE #1 "        <register address='0xc203284' value='0x" DATA.LONG(A:0x1203284) "' name='RPMH_CPRF_CPRF2_DELTA_14'/>"
WRITE #1 "        <register address='0xc203288' value='0x" DATA.LONG(A:0x1203288) "' name='RPMH_CPRF_CPRF2_DELTA_15'/>"
WRITE #1 "        <register address='0xc20424c' value='0x" DATA.LONG(A:0x120424c) "' name='RPMH_CPRF_CPRF3_DELTA_0'/>"
WRITE #1 "        <register address='0xc204250' value='0x" DATA.LONG(A:0x1204250) "' name='RPMH_CPRF_CPRF3_DELTA_1'/>"
WRITE #1 "        <register address='0xc204254' value='0x" DATA.LONG(A:0x1204254) "' name='RPMH_CPRF_CPRF3_DELTA_2'/>"
WRITE #1 "        <register address='0xc204258' value='0x" DATA.LONG(A:0x1204258) "' name='RPMH_CPRF_CPRF3_DELTA_3'/>"
WRITE #1 "        <register address='0xc20425c' value='0x" DATA.LONG(A:0x120425c) "' name='RPMH_CPRF_CPRF3_DELTA_4'/>"
WRITE #1 "        <register address='0xc204260' value='0x" DATA.LONG(A:0x1204260) "' name='RPMH_CPRF_CPRF3_DELTA_5'/>"
WRITE #1 "        <register address='0xc204264' value='0x" DATA.LONG(A:0x1204264) "' name='RPMH_CPRF_CPRF3_DELTA_6'/>"
WRITE #1 "        <register address='0xc204268' value='0x" DATA.LONG(A:0x1204268) "' name='RPMH_CPRF_CPRF3_DELTA_7'/>"
WRITE #1 "        <register address='0xc20426c' value='0x" DATA.LONG(A:0x120426c) "' name='RPMH_CPRF_CPRF3_DELTA_8'/>"
WRITE #1 "        <register address='0xc204270' value='0x" DATA.LONG(A:0x1204270) "' name='RPMH_CPRF_CPRF3_DELTA_9'/>"
WRITE #1 "        <register address='0xc204274' value='0x" DATA.LONG(A:0x1204274) "' name='RPMH_CPRF_CPRF3_DELTA_10'/>"
WRITE #1 "        <register address='0xc204278' value='0x" DATA.LONG(A:0x1204278) "' name='RPMH_CPRF_CPRF3_DELTA_11'/>"
WRITE #1 "        <register address='0xc20427c' value='0x" DATA.LONG(A:0x120427c) "' name='RPMH_CPRF_CPRF3_DELTA_12'/>"
WRITE #1 "        <register address='0xc204280' value='0x" DATA.LONG(A:0x1204280) "' name='RPMH_CPRF_CPRF3_DELTA_13'/>"
WRITE #1 "        <register address='0xc204284' value='0x" DATA.LONG(A:0x1204284) "' name='RPMH_CPRF_CPRF3_DELTA_14'/>"
WRITE #1 "        <register address='0xc204288' value='0x" DATA.LONG(A:0x1204288) "' name='RPMH_CPRF_CPRF3_DELTA_15'/>"
WRITE #1 "        <register address='0xc20524c' value='0x" DATA.LONG(A:0x120524c) "' name='RPMH_CPRF_CPRF4_DELTA_0'/>"
WRITE #1 "        <register address='0xc205250' value='0x" DATA.LONG(A:0x1205250) "' name='RPMH_CPRF_CPRF4_DELTA_1'/>"
WRITE #1 "        <register address='0xc205254' value='0x" DATA.LONG(A:0x1205254) "' name='RPMH_CPRF_CPRF4_DELTA_2'/>"
WRITE #1 "        <register address='0xc205258' value='0x" DATA.LONG(A:0x1205258) "' name='RPMH_CPRF_CPRF4_DELTA_3'/>"
WRITE #1 "        <register address='0xc20525c' value='0x" DATA.LONG(A:0x120525c) "' name='RPMH_CPRF_CPRF4_DELTA_4'/>"
WRITE #1 "        <register address='0xc205260' value='0x" DATA.LONG(A:0x1205260) "' name='RPMH_CPRF_CPRF4_DELTA_5'/>"
WRITE #1 "        <register address='0xc205264' value='0x" DATA.LONG(A:0x1205264) "' name='RPMH_CPRF_CPRF4_DELTA_6'/>"
WRITE #1 "        <register address='0xc205268' value='0x" DATA.LONG(A:0x1205268) "' name='RPMH_CPRF_CPRF4_DELTA_7'/>"
WRITE #1 "        <register address='0xc20526c' value='0x" DATA.LONG(A:0x120526c) "' name='RPMH_CPRF_CPRF4_DELTA_8'/>"
WRITE #1 "        <register address='0xc205270' value='0x" DATA.LONG(A:0x1205270) "' name='RPMH_CPRF_CPRF4_DELTA_9'/>"
WRITE #1 "        <register address='0xc205274' value='0x" DATA.LONG(A:0x1205274) "' name='RPMH_CPRF_CPRF4_DELTA_10'/>"
WRITE #1 "        <register address='0xc205278' value='0x" DATA.LONG(A:0x1205278) "' name='RPMH_CPRF_CPRF4_DELTA_11'/>"
WRITE #1 "        <register address='0xc20527c' value='0x" DATA.LONG(A:0x120527c) "' name='RPMH_CPRF_CPRF4_DELTA_12'/>"
WRITE #1 "        <register address='0xc205280' value='0x" DATA.LONG(A:0x1205280) "' name='RPMH_CPRF_CPRF4_DELTA_13'/>"
WRITE #1 "        <register address='0xc205284' value='0x" DATA.LONG(A:0x1205284) "' name='RPMH_CPRF_CPRF4_DELTA_14'/>"
WRITE #1 "        <register address='0xc205288' value='0x" DATA.LONG(A:0x1205288) "' name='RPMH_CPRF_CPRF4_DELTA_15'/>"
WRITE #1 "        <register address='0xc20624c' value='0x" DATA.LONG(A:0x120624c) "' name='RPMH_CPRF_CPRF5_DELTA_0'/>"
WRITE #1 "        <register address='0xc206250' value='0x" DATA.LONG(A:0x1206250) "' name='RPMH_CPRF_CPRF5_DELTA_1'/>"
WRITE #1 "        <register address='0xc206254' value='0x" DATA.LONG(A:0x1206254) "' name='RPMH_CPRF_CPRF5_DELTA_2'/>"
WRITE #1 "        <register address='0xc206258' value='0x" DATA.LONG(A:0x1206258) "' name='RPMH_CPRF_CPRF5_DELTA_3'/>"
WRITE #1 "        <register address='0xc20625c' value='0x" DATA.LONG(A:0x120625c) "' name='RPMH_CPRF_CPRF5_DELTA_4'/>"
WRITE #1 "        <register address='0xc206260' value='0x" DATA.LONG(A:0x1206260) "' name='RPMH_CPRF_CPRF5_DELTA_5'/>"
WRITE #1 "        <register address='0xc206264' value='0x" DATA.LONG(A:0x1206264) "' name='RPMH_CPRF_CPRF5_DELTA_6'/>"
WRITE #1 "        <register address='0xc206268' value='0x" DATA.LONG(A:0x1206268) "' name='RPMH_CPRF_CPRF5_DELTA_7'/>"
WRITE #1 "        <register address='0xc20626c' value='0x" DATA.LONG(A:0x120626c) "' name='RPMH_CPRF_CPRF5_DELTA_8'/>"
WRITE #1 "        <register address='0xc206270' value='0x" DATA.LONG(A:0x1206270) "' name='RPMH_CPRF_CPRF5_DELTA_9'/>"
WRITE #1 "        <register address='0xc206274' value='0x" DATA.LONG(A:0x1206274) "' name='RPMH_CPRF_CPRF5_DELTA_10'/>"
WRITE #1 "        <register address='0xc206278' value='0x" DATA.LONG(A:0x1206278) "' name='RPMH_CPRF_CPRF5_DELTA_11'/>"
WRITE #1 "        <register address='0xc20627c' value='0x" DATA.LONG(A:0x120627c) "' name='RPMH_CPRF_CPRF5_DELTA_12'/>"
WRITE #1 "        <register address='0xc206280' value='0x" DATA.LONG(A:0x1206280) "' name='RPMH_CPRF_CPRF5_DELTA_13'/>"
WRITE #1 "        <register address='0xc206284' value='0x" DATA.LONG(A:0x1206284) "' name='RPMH_CPRF_CPRF5_DELTA_14'/>"
WRITE #1 "        <register address='0xc206288' value='0x" DATA.LONG(A:0x1206288) "' name='RPMH_CPRF_CPRF5_DELTA_15'/>"
WRITE #1 "        <register address='0xc2012cc' value='0x" DATA.LONG(A:0x12012cc) "' name='RPMH_CPRF_CPRF0_VALUES_CONTROL'/>"
WRITE #1 "        <register address='0xc2022cc' value='0x" DATA.LONG(A:0x12022cc) "' name='RPMH_CPRF_CPRF1_VALUES_CONTROL'/>"
WRITE #1 "        <register address='0xc2032cc' value='0x" DATA.LONG(A:0x12032cc) "' name='RPMH_CPRF_CPRF2_VALUES_CONTROL'/>"
WRITE #1 "        <register address='0xc2042cc' value='0x" DATA.LONG(A:0x12042cc) "' name='RPMH_CPRF_CPRF3_VALUES_CONTROL'/>"
WRITE #1 "        <register address='0xc2052cc' value='0x" DATA.LONG(A:0x12052cc) "' name='RPMH_CPRF_CPRF4_VALUES_CONTROL'/>"
WRITE #1 "        <register address='0xc2062cc' value='0x" DATA.LONG(A:0x12062cc) "' name='RPMH_CPRF_CPRF5_VALUES_CONTROL'/>"
WRITE #1 "        <register address='0xc2012d0' value='0x" DATA.LONG(A:0x12012d0) "' name='RPMH_CPRF_CPRF0_VALUES_2_0'/>"
WRITE #1 "        <register address='0xc2012d4' value='0x" DATA.LONG(A:0x12012d4) "' name='RPMH_CPRF_CPRF0_VALUES_2_1'/>"
WRITE #1 "        <register address='0xc2012d8' value='0x" DATA.LONG(A:0x12012d8) "' name='RPMH_CPRF_CPRF0_VALUES_2_2'/>"
WRITE #1 "        <register address='0xc2012dc' value='0x" DATA.LONG(A:0x12012dc) "' name='RPMH_CPRF_CPRF0_VALUES_2_3'/>"
WRITE #1 "        <register address='0xc2012e0' value='0x" DATA.LONG(A:0x12012e0) "' name='RPMH_CPRF_CPRF0_VALUES_2_4'/>"
WRITE #1 "        <register address='0xc2012e4' value='0x" DATA.LONG(A:0x12012e4) "' name='RPMH_CPRF_CPRF0_VALUES_2_5'/>"
WRITE #1 "        <register address='0xc2012e8' value='0x" DATA.LONG(A:0x12012e8) "' name='RPMH_CPRF_CPRF0_VALUES_2_6'/>"
WRITE #1 "        <register address='0xc2012ec' value='0x" DATA.LONG(A:0x12012ec) "' name='RPMH_CPRF_CPRF0_VALUES_2_7'/>"
WRITE #1 "        <register address='0xc2012f0' value='0x" DATA.LONG(A:0x12012f0) "' name='RPMH_CPRF_CPRF0_VALUES_2_8'/>"
WRITE #1 "        <register address='0xc2012f4' value='0x" DATA.LONG(A:0x12012f4) "' name='RPMH_CPRF_CPRF0_VALUES_2_9'/>"
WRITE #1 "        <register address='0xc2012f8' value='0x" DATA.LONG(A:0x12012f8) "' name='RPMH_CPRF_CPRF0_VALUES_2_10'/>"
WRITE #1 "        <register address='0xc2012fc' value='0x" DATA.LONG(A:0x12012fc) "' name='RPMH_CPRF_CPRF0_VALUES_2_11'/>"
WRITE #1 "        <register address='0xc201300' value='0x" DATA.LONG(A:0x1201300) "' name='RPMH_CPRF_CPRF0_VALUES_2_12'/>"
WRITE #1 "        <register address='0xc201304' value='0x" DATA.LONG(A:0x1201304) "' name='RPMH_CPRF_CPRF0_VALUES_2_13'/>"
WRITE #1 "        <register address='0xc201308' value='0x" DATA.LONG(A:0x1201308) "' name='RPMH_CPRF_CPRF0_VALUES_2_14'/>"
WRITE #1 "        <register address='0xc20130c' value='0x" DATA.LONG(A:0x120130c) "' name='RPMH_CPRF_CPRF0_VALUES_2_15'/>"
WRITE #1 "        <register address='0xc2022d0' value='0x" DATA.LONG(A:0x12022d0) "' name='RPMH_CPRF_CPRF1_VALUES_2_0'/>"
WRITE #1 "        <register address='0xc2022d4' value='0x" DATA.LONG(A:0x12022d4) "' name='RPMH_CPRF_CPRF1_VALUES_2_1'/>"
WRITE #1 "        <register address='0xc2022d8' value='0x" DATA.LONG(A:0x12022d8) "' name='RPMH_CPRF_CPRF1_VALUES_2_2'/>"
WRITE #1 "        <register address='0xc2022dc' value='0x" DATA.LONG(A:0x12022dc) "' name='RPMH_CPRF_CPRF1_VALUES_2_3'/>"
WRITE #1 "        <register address='0xc2022e0' value='0x" DATA.LONG(A:0x12022e0) "' name='RPMH_CPRF_CPRF1_VALUES_2_4'/>"
WRITE #1 "        <register address='0xc2022e4' value='0x" DATA.LONG(A:0x12022e4) "' name='RPMH_CPRF_CPRF1_VALUES_2_5'/>"
WRITE #1 "        <register address='0xc2022e8' value='0x" DATA.LONG(A:0x12022e8) "' name='RPMH_CPRF_CPRF1_VALUES_2_6'/>"
WRITE #1 "        <register address='0xc2022ec' value='0x" DATA.LONG(A:0x12022ec) "' name='RPMH_CPRF_CPRF1_VALUES_2_7'/>"
WRITE #1 "        <register address='0xc2022f0' value='0x" DATA.LONG(A:0x12022f0) "' name='RPMH_CPRF_CPRF1_VALUES_2_8'/>"
WRITE #1 "        <register address='0xc2022f4' value='0x" DATA.LONG(A:0x12022f4) "' name='RPMH_CPRF_CPRF1_VALUES_2_9'/>"
WRITE #1 "        <register address='0xc2022f8' value='0x" DATA.LONG(A:0x12022f8) "' name='RPMH_CPRF_CPRF1_VALUES_2_10'/>"
WRITE #1 "        <register address='0xc2022fc' value='0x" DATA.LONG(A:0x12022fc) "' name='RPMH_CPRF_CPRF1_VALUES_2_11'/>"
WRITE #1 "        <register address='0xc202300' value='0x" DATA.LONG(A:0x1202300) "' name='RPMH_CPRF_CPRF1_VALUES_2_12'/>"
WRITE #1 "        <register address='0xc202304' value='0x" DATA.LONG(A:0x1202304) "' name='RPMH_CPRF_CPRF1_VALUES_2_13'/>"
WRITE #1 "        <register address='0xc202308' value='0x" DATA.LONG(A:0x1202308) "' name='RPMH_CPRF_CPRF1_VALUES_2_14'/>"
WRITE #1 "        <register address='0xc20230c' value='0x" DATA.LONG(A:0x120230c) "' name='RPMH_CPRF_CPRF1_VALUES_2_15'/>"
WRITE #1 "        <register address='0xc2032d0' value='0x" DATA.LONG(A:0x12032d0) "' name='RPMH_CPRF_CPRF2_VALUES_2_0'/>"
WRITE #1 "        <register address='0xc2032d4' value='0x" DATA.LONG(A:0x12032d4) "' name='RPMH_CPRF_CPRF2_VALUES_2_1'/>"
WRITE #1 "        <register address='0xc2032d8' value='0x" DATA.LONG(A:0x12032d8) "' name='RPMH_CPRF_CPRF2_VALUES_2_2'/>"
WRITE #1 "        <register address='0xc2032dc' value='0x" DATA.LONG(A:0x12032dc) "' name='RPMH_CPRF_CPRF2_VALUES_2_3'/>"
WRITE #1 "        <register address='0xc2032e0' value='0x" DATA.LONG(A:0x12032e0) "' name='RPMH_CPRF_CPRF2_VALUES_2_4'/>"
WRITE #1 "        <register address='0xc2032e4' value='0x" DATA.LONG(A:0x12032e4) "' name='RPMH_CPRF_CPRF2_VALUES_2_5'/>"
WRITE #1 "        <register address='0xc2032e8' value='0x" DATA.LONG(A:0x12032e8) "' name='RPMH_CPRF_CPRF2_VALUES_2_6'/>"
WRITE #1 "        <register address='0xc2032ec' value='0x" DATA.LONG(A:0x12032ec) "' name='RPMH_CPRF_CPRF2_VALUES_2_7'/>"
WRITE #1 "        <register address='0xc2032f0' value='0x" DATA.LONG(A:0x12032f0) "' name='RPMH_CPRF_CPRF2_VALUES_2_8'/>"
WRITE #1 "        <register address='0xc2032f4' value='0x" DATA.LONG(A:0x12032f4) "' name='RPMH_CPRF_CPRF2_VALUES_2_9'/>"
WRITE #1 "        <register address='0xc2032f8' value='0x" DATA.LONG(A:0x12032f8) "' name='RPMH_CPRF_CPRF2_VALUES_2_10'/>"
WRITE #1 "        <register address='0xc2032fc' value='0x" DATA.LONG(A:0x12032fc) "' name='RPMH_CPRF_CPRF2_VALUES_2_11'/>"
WRITE #1 "        <register address='0xc203300' value='0x" DATA.LONG(A:0x1203300) "' name='RPMH_CPRF_CPRF2_VALUES_2_12'/>"
WRITE #1 "        <register address='0xc203304' value='0x" DATA.LONG(A:0x1203304) "' name='RPMH_CPRF_CPRF2_VALUES_2_13'/>"
WRITE #1 "        <register address='0xc203308' value='0x" DATA.LONG(A:0x1203308) "' name='RPMH_CPRF_CPRF2_VALUES_2_14'/>"
WRITE #1 "        <register address='0xc20330c' value='0x" DATA.LONG(A:0x120330c) "' name='RPMH_CPRF_CPRF2_VALUES_2_15'/>"
WRITE #1 "        <register address='0xc2042d0' value='0x" DATA.LONG(A:0x12042d0) "' name='RPMH_CPRF_CPRF3_VALUES_2_0'/>"
WRITE #1 "        <register address='0xc2042d4' value='0x" DATA.LONG(A:0x12042d4) "' name='RPMH_CPRF_CPRF3_VALUES_2_1'/>"
WRITE #1 "        <register address='0xc2042d8' value='0x" DATA.LONG(A:0x12042d8) "' name='RPMH_CPRF_CPRF3_VALUES_2_2'/>"
WRITE #1 "        <register address='0xc2042dc' value='0x" DATA.LONG(A:0x12042dc) "' name='RPMH_CPRF_CPRF3_VALUES_2_3'/>"
WRITE #1 "        <register address='0xc2042e0' value='0x" DATA.LONG(A:0x12042e0) "' name='RPMH_CPRF_CPRF3_VALUES_2_4'/>"
WRITE #1 "        <register address='0xc2042e4' value='0x" DATA.LONG(A:0x12042e4) "' name='RPMH_CPRF_CPRF3_VALUES_2_5'/>"
WRITE #1 "        <register address='0xc2042e8' value='0x" DATA.LONG(A:0x12042e8) "' name='RPMH_CPRF_CPRF3_VALUES_2_6'/>"
WRITE #1 "        <register address='0xc2042ec' value='0x" DATA.LONG(A:0x12042ec) "' name='RPMH_CPRF_CPRF3_VALUES_2_7'/>"
WRITE #1 "        <register address='0xc2042f0' value='0x" DATA.LONG(A:0x12042f0) "' name='RPMH_CPRF_CPRF3_VALUES_2_8'/>"
WRITE #1 "        <register address='0xc2042f4' value='0x" DATA.LONG(A:0x12042f4) "' name='RPMH_CPRF_CPRF3_VALUES_2_9'/>"
WRITE #1 "        <register address='0xc2042f8' value='0x" DATA.LONG(A:0x12042f8) "' name='RPMH_CPRF_CPRF3_VALUES_2_10'/>"
WRITE #1 "        <register address='0xc2042fc' value='0x" DATA.LONG(A:0x12042fc) "' name='RPMH_CPRF_CPRF3_VALUES_2_11'/>"
WRITE #1 "        <register address='0xc204300' value='0x" DATA.LONG(A:0x1204300) "' name='RPMH_CPRF_CPRF3_VALUES_2_12'/>"
WRITE #1 "        <register address='0xc204304' value='0x" DATA.LONG(A:0x1204304) "' name='RPMH_CPRF_CPRF3_VALUES_2_13'/>"
WRITE #1 "        <register address='0xc204308' value='0x" DATA.LONG(A:0x1204308) "' name='RPMH_CPRF_CPRF3_VALUES_2_14'/>"
WRITE #1 "        <register address='0xc20430c' value='0x" DATA.LONG(A:0x120430c) "' name='RPMH_CPRF_CPRF3_VALUES_2_15'/>"
WRITE #1 "        <register address='0xc2052d0' value='0x" DATA.LONG(A:0x12052d0) "' name='RPMH_CPRF_CPRF4_VALUES_2_0'/>"
WRITE #1 "        <register address='0xc2052d4' value='0x" DATA.LONG(A:0x12052d4) "' name='RPMH_CPRF_CPRF4_VALUES_2_1'/>"
WRITE #1 "        <register address='0xc2052d8' value='0x" DATA.LONG(A:0x12052d8) "' name='RPMH_CPRF_CPRF4_VALUES_2_2'/>"
WRITE #1 "        <register address='0xc2052dc' value='0x" DATA.LONG(A:0x12052dc) "' name='RPMH_CPRF_CPRF4_VALUES_2_3'/>"
WRITE #1 "        <register address='0xc2052e0' value='0x" DATA.LONG(A:0x12052e0) "' name='RPMH_CPRF_CPRF4_VALUES_2_4'/>"
WRITE #1 "        <register address='0xc2052e4' value='0x" DATA.LONG(A:0x12052e4) "' name='RPMH_CPRF_CPRF4_VALUES_2_5'/>"
WRITE #1 "        <register address='0xc2052e8' value='0x" DATA.LONG(A:0x12052e8) "' name='RPMH_CPRF_CPRF4_VALUES_2_6'/>"
WRITE #1 "        <register address='0xc2052ec' value='0x" DATA.LONG(A:0x12052ec) "' name='RPMH_CPRF_CPRF4_VALUES_2_7'/>"
WRITE #1 "        <register address='0xc2052f0' value='0x" DATA.LONG(A:0x12052f0) "' name='RPMH_CPRF_CPRF4_VALUES_2_8'/>"
WRITE #1 "        <register address='0xc2052f4' value='0x" DATA.LONG(A:0x12052f4) "' name='RPMH_CPRF_CPRF4_VALUES_2_9'/>"
WRITE #1 "        <register address='0xc2052f8' value='0x" DATA.LONG(A:0x12052f8) "' name='RPMH_CPRF_CPRF4_VALUES_2_10'/>"
WRITE #1 "        <register address='0xc2052fc' value='0x" DATA.LONG(A:0x12052fc) "' name='RPMH_CPRF_CPRF4_VALUES_2_11'/>"
WRITE #1 "        <register address='0xc205300' value='0x" DATA.LONG(A:0x1205300) "' name='RPMH_CPRF_CPRF4_VALUES_2_12'/>"
WRITE #1 "        <register address='0xc205304' value='0x" DATA.LONG(A:0x1205304) "' name='RPMH_CPRF_CPRF4_VALUES_2_13'/>"
WRITE #1 "        <register address='0xc205308' value='0x" DATA.LONG(A:0x1205308) "' name='RPMH_CPRF_CPRF4_VALUES_2_14'/>"
WRITE #1 "        <register address='0xc20530c' value='0x" DATA.LONG(A:0x120530c) "' name='RPMH_CPRF_CPRF4_VALUES_2_15'/>"
WRITE #1 "        <register address='0xc2062d0' value='0x" DATA.LONG(A:0x12062d0) "' name='RPMH_CPRF_CPRF5_VALUES_2_0'/>"
WRITE #1 "        <register address='0xc2062d4' value='0x" DATA.LONG(A:0x12062d4) "' name='RPMH_CPRF_CPRF5_VALUES_2_1'/>"
WRITE #1 "        <register address='0xc2062d8' value='0x" DATA.LONG(A:0x12062d8) "' name='RPMH_CPRF_CPRF5_VALUES_2_2'/>"
WRITE #1 "        <register address='0xc2062dc' value='0x" DATA.LONG(A:0x12062dc) "' name='RPMH_CPRF_CPRF5_VALUES_2_3'/>"
WRITE #1 "        <register address='0xc2062e0' value='0x" DATA.LONG(A:0x12062e0) "' name='RPMH_CPRF_CPRF5_VALUES_2_4'/>"
WRITE #1 "        <register address='0xc2062e4' value='0x" DATA.LONG(A:0x12062e4) "' name='RPMH_CPRF_CPRF5_VALUES_2_5'/>"
WRITE #1 "        <register address='0xc2062e8' value='0x" DATA.LONG(A:0x12062e8) "' name='RPMH_CPRF_CPRF5_VALUES_2_6'/>"
WRITE #1 "        <register address='0xc2062ec' value='0x" DATA.LONG(A:0x12062ec) "' name='RPMH_CPRF_CPRF5_VALUES_2_7'/>"
WRITE #1 "        <register address='0xc2062f0' value='0x" DATA.LONG(A:0x12062f0) "' name='RPMH_CPRF_CPRF5_VALUES_2_8'/>"
WRITE #1 "        <register address='0xc2062f4' value='0x" DATA.LONG(A:0x12062f4) "' name='RPMH_CPRF_CPRF5_VALUES_2_9'/>"
WRITE #1 "        <register address='0xc2062f8' value='0x" DATA.LONG(A:0x12062f8) "' name='RPMH_CPRF_CPRF5_VALUES_2_10'/>"
WRITE #1 "        <register address='0xc2062fc' value='0x" DATA.LONG(A:0x12062fc) "' name='RPMH_CPRF_CPRF5_VALUES_2_11'/>"
WRITE #1 "        <register address='0xc206300' value='0x" DATA.LONG(A:0x1206300) "' name='RPMH_CPRF_CPRF5_VALUES_2_12'/>"
WRITE #1 "        <register address='0xc206304' value='0x" DATA.LONG(A:0x1206304) "' name='RPMH_CPRF_CPRF5_VALUES_2_13'/>"
WRITE #1 "        <register address='0xc206308' value='0x" DATA.LONG(A:0x1206308) "' name='RPMH_CPRF_CPRF5_VALUES_2_14'/>"
WRITE #1 "        <register address='0xc20630c' value='0x" DATA.LONG(A:0x120630c) "' name='RPMH_CPRF_CPRF5_VALUES_2_15'/>"
WRITE #1 "        <register address='0xc201350' value='0x" DATA.LONG(A:0x1201350) "' name='RPMH_CPRF_CPRF0_VALUES_3_0'/>"
WRITE #1 "        <register address='0xc201354' value='0x" DATA.LONG(A:0x1201354) "' name='RPMH_CPRF_CPRF0_VALUES_3_1'/>"
WRITE #1 "        <register address='0xc201358' value='0x" DATA.LONG(A:0x1201358) "' name='RPMH_CPRF_CPRF0_VALUES_3_2'/>"
WRITE #1 "        <register address='0xc20135c' value='0x" DATA.LONG(A:0x120135c) "' name='RPMH_CPRF_CPRF0_VALUES_3_3'/>"
WRITE #1 "        <register address='0xc201360' value='0x" DATA.LONG(A:0x1201360) "' name='RPMH_CPRF_CPRF0_VALUES_3_4'/>"
WRITE #1 "        <register address='0xc201364' value='0x" DATA.LONG(A:0x1201364) "' name='RPMH_CPRF_CPRF0_VALUES_3_5'/>"
WRITE #1 "        <register address='0xc201368' value='0x" DATA.LONG(A:0x1201368) "' name='RPMH_CPRF_CPRF0_VALUES_3_6'/>"
WRITE #1 "        <register address='0xc20136c' value='0x" DATA.LONG(A:0x120136c) "' name='RPMH_CPRF_CPRF0_VALUES_3_7'/>"
WRITE #1 "        <register address='0xc201370' value='0x" DATA.LONG(A:0x1201370) "' name='RPMH_CPRF_CPRF0_VALUES_3_8'/>"
WRITE #1 "        <register address='0xc201374' value='0x" DATA.LONG(A:0x1201374) "' name='RPMH_CPRF_CPRF0_VALUES_3_9'/>"
WRITE #1 "        <register address='0xc201378' value='0x" DATA.LONG(A:0x1201378) "' name='RPMH_CPRF_CPRF0_VALUES_3_10'/>"
WRITE #1 "        <register address='0xc20137c' value='0x" DATA.LONG(A:0x120137c) "' name='RPMH_CPRF_CPRF0_VALUES_3_11'/>"
WRITE #1 "        <register address='0xc201380' value='0x" DATA.LONG(A:0x1201380) "' name='RPMH_CPRF_CPRF0_VALUES_3_12'/>"
WRITE #1 "        <register address='0xc201384' value='0x" DATA.LONG(A:0x1201384) "' name='RPMH_CPRF_CPRF0_VALUES_3_13'/>"
WRITE #1 "        <register address='0xc201388' value='0x" DATA.LONG(A:0x1201388) "' name='RPMH_CPRF_CPRF0_VALUES_3_14'/>"
WRITE #1 "        <register address='0xc20138c' value='0x" DATA.LONG(A:0x120138c) "' name='RPMH_CPRF_CPRF0_VALUES_3_15'/>"
WRITE #1 "        <register address='0xc202350' value='0x" DATA.LONG(A:0x1202350) "' name='RPMH_CPRF_CPRF1_VALUES_3_0'/>"
WRITE #1 "        <register address='0xc202354' value='0x" DATA.LONG(A:0x1202354) "' name='RPMH_CPRF_CPRF1_VALUES_3_1'/>"
WRITE #1 "        <register address='0xc202358' value='0x" DATA.LONG(A:0x1202358) "' name='RPMH_CPRF_CPRF1_VALUES_3_2'/>"
WRITE #1 "        <register address='0xc20235c' value='0x" DATA.LONG(A:0x120235c) "' name='RPMH_CPRF_CPRF1_VALUES_3_3'/>"
WRITE #1 "        <register address='0xc202360' value='0x" DATA.LONG(A:0x1202360) "' name='RPMH_CPRF_CPRF1_VALUES_3_4'/>"
WRITE #1 "        <register address='0xc202364' value='0x" DATA.LONG(A:0x1202364) "' name='RPMH_CPRF_CPRF1_VALUES_3_5'/>"
WRITE #1 "        <register address='0xc202368' value='0x" DATA.LONG(A:0x1202368) "' name='RPMH_CPRF_CPRF1_VALUES_3_6'/>"
WRITE #1 "        <register address='0xc20236c' value='0x" DATA.LONG(A:0x120236c) "' name='RPMH_CPRF_CPRF1_VALUES_3_7'/>"
WRITE #1 "        <register address='0xc202370' value='0x" DATA.LONG(A:0x1202370) "' name='RPMH_CPRF_CPRF1_VALUES_3_8'/>"
WRITE #1 "        <register address='0xc202374' value='0x" DATA.LONG(A:0x1202374) "' name='RPMH_CPRF_CPRF1_VALUES_3_9'/>"
WRITE #1 "        <register address='0xc202378' value='0x" DATA.LONG(A:0x1202378) "' name='RPMH_CPRF_CPRF1_VALUES_3_10'/>"
WRITE #1 "        <register address='0xc20237c' value='0x" DATA.LONG(A:0x120237c) "' name='RPMH_CPRF_CPRF1_VALUES_3_11'/>"
WRITE #1 "        <register address='0xc202380' value='0x" DATA.LONG(A:0x1202380) "' name='RPMH_CPRF_CPRF1_VALUES_3_12'/>"
WRITE #1 "        <register address='0xc202384' value='0x" DATA.LONG(A:0x1202384) "' name='RPMH_CPRF_CPRF1_VALUES_3_13'/>"
WRITE #1 "        <register address='0xc202388' value='0x" DATA.LONG(A:0x1202388) "' name='RPMH_CPRF_CPRF1_VALUES_3_14'/>"
WRITE #1 "        <register address='0xc20238c' value='0x" DATA.LONG(A:0x120238c) "' name='RPMH_CPRF_CPRF1_VALUES_3_15'/>"
WRITE #1 "        <register address='0xc203350' value='0x" DATA.LONG(A:0x1203350) "' name='RPMH_CPRF_CPRF2_VALUES_3_0'/>"
WRITE #1 "        <register address='0xc203354' value='0x" DATA.LONG(A:0x1203354) "' name='RPMH_CPRF_CPRF2_VALUES_3_1'/>"
WRITE #1 "        <register address='0xc203358' value='0x" DATA.LONG(A:0x1203358) "' name='RPMH_CPRF_CPRF2_VALUES_3_2'/>"
WRITE #1 "        <register address='0xc20335c' value='0x" DATA.LONG(A:0x120335c) "' name='RPMH_CPRF_CPRF2_VALUES_3_3'/>"
WRITE #1 "        <register address='0xc203360' value='0x" DATA.LONG(A:0x1203360) "' name='RPMH_CPRF_CPRF2_VALUES_3_4'/>"
WRITE #1 "        <register address='0xc203364' value='0x" DATA.LONG(A:0x1203364) "' name='RPMH_CPRF_CPRF2_VALUES_3_5'/>"
WRITE #1 "        <register address='0xc203368' value='0x" DATA.LONG(A:0x1203368) "' name='RPMH_CPRF_CPRF2_VALUES_3_6'/>"
WRITE #1 "        <register address='0xc20336c' value='0x" DATA.LONG(A:0x120336c) "' name='RPMH_CPRF_CPRF2_VALUES_3_7'/>"
WRITE #1 "        <register address='0xc203370' value='0x" DATA.LONG(A:0x1203370) "' name='RPMH_CPRF_CPRF2_VALUES_3_8'/>"
WRITE #1 "        <register address='0xc203374' value='0x" DATA.LONG(A:0x1203374) "' name='RPMH_CPRF_CPRF2_VALUES_3_9'/>"
WRITE #1 "        <register address='0xc203378' value='0x" DATA.LONG(A:0x1203378) "' name='RPMH_CPRF_CPRF2_VALUES_3_10'/>"
WRITE #1 "        <register address='0xc20337c' value='0x" DATA.LONG(A:0x120337c) "' name='RPMH_CPRF_CPRF2_VALUES_3_11'/>"
WRITE #1 "        <register address='0xc203380' value='0x" DATA.LONG(A:0x1203380) "' name='RPMH_CPRF_CPRF2_VALUES_3_12'/>"
WRITE #1 "        <register address='0xc203384' value='0x" DATA.LONG(A:0x1203384) "' name='RPMH_CPRF_CPRF2_VALUES_3_13'/>"
WRITE #1 "        <register address='0xc203388' value='0x" DATA.LONG(A:0x1203388) "' name='RPMH_CPRF_CPRF2_VALUES_3_14'/>"
WRITE #1 "        <register address='0xc20338c' value='0x" DATA.LONG(A:0x120338c) "' name='RPMH_CPRF_CPRF2_VALUES_3_15'/>"
WRITE #1 "        <register address='0xc204350' value='0x" DATA.LONG(A:0x1204350) "' name='RPMH_CPRF_CPRF3_VALUES_3_0'/>"
WRITE #1 "        <register address='0xc204354' value='0x" DATA.LONG(A:0x1204354) "' name='RPMH_CPRF_CPRF3_VALUES_3_1'/>"
WRITE #1 "        <register address='0xc204358' value='0x" DATA.LONG(A:0x1204358) "' name='RPMH_CPRF_CPRF3_VALUES_3_2'/>"
WRITE #1 "        <register address='0xc20435c' value='0x" DATA.LONG(A:0x120435c) "' name='RPMH_CPRF_CPRF3_VALUES_3_3'/>"
WRITE #1 "        <register address='0xc204360' value='0x" DATA.LONG(A:0x1204360) "' name='RPMH_CPRF_CPRF3_VALUES_3_4'/>"
WRITE #1 "        <register address='0xc204364' value='0x" DATA.LONG(A:0x1204364) "' name='RPMH_CPRF_CPRF3_VALUES_3_5'/>"
WRITE #1 "        <register address='0xc204368' value='0x" DATA.LONG(A:0x1204368) "' name='RPMH_CPRF_CPRF3_VALUES_3_6'/>"
WRITE #1 "        <register address='0xc20436c' value='0x" DATA.LONG(A:0x120436c) "' name='RPMH_CPRF_CPRF3_VALUES_3_7'/>"
WRITE #1 "        <register address='0xc204370' value='0x" DATA.LONG(A:0x1204370) "' name='RPMH_CPRF_CPRF3_VALUES_3_8'/>"
WRITE #1 "        <register address='0xc204374' value='0x" DATA.LONG(A:0x1204374) "' name='RPMH_CPRF_CPRF3_VALUES_3_9'/>"
WRITE #1 "        <register address='0xc204378' value='0x" DATA.LONG(A:0x1204378) "' name='RPMH_CPRF_CPRF3_VALUES_3_10'/>"
WRITE #1 "        <register address='0xc20437c' value='0x" DATA.LONG(A:0x120437c) "' name='RPMH_CPRF_CPRF3_VALUES_3_11'/>"
WRITE #1 "        <register address='0xc204380' value='0x" DATA.LONG(A:0x1204380) "' name='RPMH_CPRF_CPRF3_VALUES_3_12'/>"
WRITE #1 "        <register address='0xc204384' value='0x" DATA.LONG(A:0x1204384) "' name='RPMH_CPRF_CPRF3_VALUES_3_13'/>"
WRITE #1 "        <register address='0xc204388' value='0x" DATA.LONG(A:0x1204388) "' name='RPMH_CPRF_CPRF3_VALUES_3_14'/>"
WRITE #1 "        <register address='0xc20438c' value='0x" DATA.LONG(A:0x120438c) "' name='RPMH_CPRF_CPRF3_VALUES_3_15'/>"
WRITE #1 "        <register address='0xc205350' value='0x" DATA.LONG(A:0x1205350) "' name='RPMH_CPRF_CPRF4_VALUES_3_0'/>"
WRITE #1 "        <register address='0xc205354' value='0x" DATA.LONG(A:0x1205354) "' name='RPMH_CPRF_CPRF4_VALUES_3_1'/>"
WRITE #1 "        <register address='0xc205358' value='0x" DATA.LONG(A:0x1205358) "' name='RPMH_CPRF_CPRF4_VALUES_3_2'/>"
WRITE #1 "        <register address='0xc20535c' value='0x" DATA.LONG(A:0x120535c) "' name='RPMH_CPRF_CPRF4_VALUES_3_3'/>"
WRITE #1 "        <register address='0xc205360' value='0x" DATA.LONG(A:0x1205360) "' name='RPMH_CPRF_CPRF4_VALUES_3_4'/>"
WRITE #1 "        <register address='0xc205364' value='0x" DATA.LONG(A:0x1205364) "' name='RPMH_CPRF_CPRF4_VALUES_3_5'/>"
WRITE #1 "        <register address='0xc205368' value='0x" DATA.LONG(A:0x1205368) "' name='RPMH_CPRF_CPRF4_VALUES_3_6'/>"
WRITE #1 "        <register address='0xc20536c' value='0x" DATA.LONG(A:0x120536c) "' name='RPMH_CPRF_CPRF4_VALUES_3_7'/>"
WRITE #1 "        <register address='0xc205370' value='0x" DATA.LONG(A:0x1205370) "' name='RPMH_CPRF_CPRF4_VALUES_3_8'/>"
WRITE #1 "        <register address='0xc205374' value='0x" DATA.LONG(A:0x1205374) "' name='RPMH_CPRF_CPRF4_VALUES_3_9'/>"
WRITE #1 "        <register address='0xc205378' value='0x" DATA.LONG(A:0x1205378) "' name='RPMH_CPRF_CPRF4_VALUES_3_10'/>"
WRITE #1 "        <register address='0xc20537c' value='0x" DATA.LONG(A:0x120537c) "' name='RPMH_CPRF_CPRF4_VALUES_3_11'/>"
WRITE #1 "        <register address='0xc205380' value='0x" DATA.LONG(A:0x1205380) "' name='RPMH_CPRF_CPRF4_VALUES_3_12'/>"
WRITE #1 "        <register address='0xc205384' value='0x" DATA.LONG(A:0x1205384) "' name='RPMH_CPRF_CPRF4_VALUES_3_13'/>"
WRITE #1 "        <register address='0xc205388' value='0x" DATA.LONG(A:0x1205388) "' name='RPMH_CPRF_CPRF4_VALUES_3_14'/>"
WRITE #1 "        <register address='0xc20538c' value='0x" DATA.LONG(A:0x120538c) "' name='RPMH_CPRF_CPRF4_VALUES_3_15'/>"
WRITE #1 "        <register address='0xc206350' value='0x" DATA.LONG(A:0x1206350) "' name='RPMH_CPRF_CPRF5_VALUES_3_0'/>"
WRITE #1 "        <register address='0xc206354' value='0x" DATA.LONG(A:0x1206354) "' name='RPMH_CPRF_CPRF5_VALUES_3_1'/>"
WRITE #1 "        <register address='0xc206358' value='0x" DATA.LONG(A:0x1206358) "' name='RPMH_CPRF_CPRF5_VALUES_3_2'/>"
WRITE #1 "        <register address='0xc20635c' value='0x" DATA.LONG(A:0x120635c) "' name='RPMH_CPRF_CPRF5_VALUES_3_3'/>"
WRITE #1 "        <register address='0xc206360' value='0x" DATA.LONG(A:0x1206360) "' name='RPMH_CPRF_CPRF5_VALUES_3_4'/>"
WRITE #1 "        <register address='0xc206364' value='0x" DATA.LONG(A:0x1206364) "' name='RPMH_CPRF_CPRF5_VALUES_3_5'/>"
WRITE #1 "        <register address='0xc206368' value='0x" DATA.LONG(A:0x1206368) "' name='RPMH_CPRF_CPRF5_VALUES_3_6'/>"
WRITE #1 "        <register address='0xc20636c' value='0x" DATA.LONG(A:0x120636c) "' name='RPMH_CPRF_CPRF5_VALUES_3_7'/>"
WRITE #1 "        <register address='0xc206370' value='0x" DATA.LONG(A:0x1206370) "' name='RPMH_CPRF_CPRF5_VALUES_3_8'/>"
WRITE #1 "        <register address='0xc206374' value='0x" DATA.LONG(A:0x1206374) "' name='RPMH_CPRF_CPRF5_VALUES_3_9'/>"
WRITE #1 "        <register address='0xc206378' value='0x" DATA.LONG(A:0x1206378) "' name='RPMH_CPRF_CPRF5_VALUES_3_10'/>"
WRITE #1 "        <register address='0xc20637c' value='0x" DATA.LONG(A:0x120637c) "' name='RPMH_CPRF_CPRF5_VALUES_3_11'/>"
WRITE #1 "        <register address='0xc206380' value='0x" DATA.LONG(A:0x1206380) "' name='RPMH_CPRF_CPRF5_VALUES_3_12'/>"
WRITE #1 "        <register address='0xc206384' value='0x" DATA.LONG(A:0x1206384) "' name='RPMH_CPRF_CPRF5_VALUES_3_13'/>"
WRITE #1 "        <register address='0xc206388' value='0x" DATA.LONG(A:0x1206388) "' name='RPMH_CPRF_CPRF5_VALUES_3_14'/>"
WRITE #1 "        <register address='0xc20638c' value='0x" DATA.LONG(A:0x120638c) "' name='RPMH_CPRF_CPRF5_VALUES_3_15'/>"
WRITE #1 "        <register address='0xc2013d0' value='0x" DATA.LONG(A:0x12013d0) "' name='RPMH_CPRF_CPRF0_VALUES_4_0'/>"
WRITE #1 "        <register address='0xc2013d4' value='0x" DATA.LONG(A:0x12013d4) "' name='RPMH_CPRF_CPRF0_VALUES_4_1'/>"
WRITE #1 "        <register address='0xc2013d8' value='0x" DATA.LONG(A:0x12013d8) "' name='RPMH_CPRF_CPRF0_VALUES_4_2'/>"
WRITE #1 "        <register address='0xc2013dc' value='0x" DATA.LONG(A:0x12013dc) "' name='RPMH_CPRF_CPRF0_VALUES_4_3'/>"
WRITE #1 "        <register address='0xc2013e0' value='0x" DATA.LONG(A:0x12013e0) "' name='RPMH_CPRF_CPRF0_VALUES_4_4'/>"
WRITE #1 "        <register address='0xc2013e4' value='0x" DATA.LONG(A:0x12013e4) "' name='RPMH_CPRF_CPRF0_VALUES_4_5'/>"
WRITE #1 "        <register address='0xc2013e8' value='0x" DATA.LONG(A:0x12013e8) "' name='RPMH_CPRF_CPRF0_VALUES_4_6'/>"
WRITE #1 "        <register address='0xc2013ec' value='0x" DATA.LONG(A:0x12013ec) "' name='RPMH_CPRF_CPRF0_VALUES_4_7'/>"
WRITE #1 "        <register address='0xc2013f0' value='0x" DATA.LONG(A:0x12013f0) "' name='RPMH_CPRF_CPRF0_VALUES_4_8'/>"
WRITE #1 "        <register address='0xc2013f4' value='0x" DATA.LONG(A:0x12013f4) "' name='RPMH_CPRF_CPRF0_VALUES_4_9'/>"
WRITE #1 "        <register address='0xc2013f8' value='0x" DATA.LONG(A:0x12013f8) "' name='RPMH_CPRF_CPRF0_VALUES_4_10'/>"
WRITE #1 "        <register address='0xc2013fc' value='0x" DATA.LONG(A:0x12013fc) "' name='RPMH_CPRF_CPRF0_VALUES_4_11'/>"
WRITE #1 "        <register address='0xc201400' value='0x" DATA.LONG(A:0x1201400) "' name='RPMH_CPRF_CPRF0_VALUES_4_12'/>"
WRITE #1 "        <register address='0xc201404' value='0x" DATA.LONG(A:0x1201404) "' name='RPMH_CPRF_CPRF0_VALUES_4_13'/>"
WRITE #1 "        <register address='0xc201408' value='0x" DATA.LONG(A:0x1201408) "' name='RPMH_CPRF_CPRF0_VALUES_4_14'/>"
WRITE #1 "        <register address='0xc20140c' value='0x" DATA.LONG(A:0x120140c) "' name='RPMH_CPRF_CPRF0_VALUES_4_15'/>"
WRITE #1 "        <register address='0xc2023d0' value='0x" DATA.LONG(A:0x12023d0) "' name='RPMH_CPRF_CPRF1_VALUES_4_0'/>"
WRITE #1 "        <register address='0xc2023d4' value='0x" DATA.LONG(A:0x12023d4) "' name='RPMH_CPRF_CPRF1_VALUES_4_1'/>"
WRITE #1 "        <register address='0xc2023d8' value='0x" DATA.LONG(A:0x12023d8) "' name='RPMH_CPRF_CPRF1_VALUES_4_2'/>"
WRITE #1 "        <register address='0xc2023dc' value='0x" DATA.LONG(A:0x12023dc) "' name='RPMH_CPRF_CPRF1_VALUES_4_3'/>"
WRITE #1 "        <register address='0xc2023e0' value='0x" DATA.LONG(A:0x12023e0) "' name='RPMH_CPRF_CPRF1_VALUES_4_4'/>"
WRITE #1 "        <register address='0xc2023e4' value='0x" DATA.LONG(A:0x12023e4) "' name='RPMH_CPRF_CPRF1_VALUES_4_5'/>"
WRITE #1 "        <register address='0xc2023e8' value='0x" DATA.LONG(A:0x12023e8) "' name='RPMH_CPRF_CPRF1_VALUES_4_6'/>"
WRITE #1 "        <register address='0xc2023ec' value='0x" DATA.LONG(A:0x12023ec) "' name='RPMH_CPRF_CPRF1_VALUES_4_7'/>"
WRITE #1 "        <register address='0xc2023f0' value='0x" DATA.LONG(A:0x12023f0) "' name='RPMH_CPRF_CPRF1_VALUES_4_8'/>"
WRITE #1 "        <register address='0xc2023f4' value='0x" DATA.LONG(A:0x12023f4) "' name='RPMH_CPRF_CPRF1_VALUES_4_9'/>"
WRITE #1 "        <register address='0xc2023f8' value='0x" DATA.LONG(A:0x12023f8) "' name='RPMH_CPRF_CPRF1_VALUES_4_10'/>"
WRITE #1 "        <register address='0xc2023fc' value='0x" DATA.LONG(A:0x12023fc) "' name='RPMH_CPRF_CPRF1_VALUES_4_11'/>"
WRITE #1 "        <register address='0xc202400' value='0x" DATA.LONG(A:0x1202400) "' name='RPMH_CPRF_CPRF1_VALUES_4_12'/>"
WRITE #1 "        <register address='0xc202404' value='0x" DATA.LONG(A:0x1202404) "' name='RPMH_CPRF_CPRF1_VALUES_4_13'/>"
WRITE #1 "        <register address='0xc202408' value='0x" DATA.LONG(A:0x1202408) "' name='RPMH_CPRF_CPRF1_VALUES_4_14'/>"
WRITE #1 "        <register address='0xc20240c' value='0x" DATA.LONG(A:0x120240c) "' name='RPMH_CPRF_CPRF1_VALUES_4_15'/>"
WRITE #1 "        <register address='0xc2033d0' value='0x" DATA.LONG(A:0x12033d0) "' name='RPMH_CPRF_CPRF2_VALUES_4_0'/>"
WRITE #1 "        <register address='0xc2033d4' value='0x" DATA.LONG(A:0x12033d4) "' name='RPMH_CPRF_CPRF2_VALUES_4_1'/>"
WRITE #1 "        <register address='0xc2033d8' value='0x" DATA.LONG(A:0x12033d8) "' name='RPMH_CPRF_CPRF2_VALUES_4_2'/>"
WRITE #1 "        <register address='0xc2033dc' value='0x" DATA.LONG(A:0x12033dc) "' name='RPMH_CPRF_CPRF2_VALUES_4_3'/>"
WRITE #1 "        <register address='0xc2033e0' value='0x" DATA.LONG(A:0x12033e0) "' name='RPMH_CPRF_CPRF2_VALUES_4_4'/>"
WRITE #1 "        <register address='0xc2033e4' value='0x" DATA.LONG(A:0x12033e4) "' name='RPMH_CPRF_CPRF2_VALUES_4_5'/>"
WRITE #1 "        <register address='0xc2033e8' value='0x" DATA.LONG(A:0x12033e8) "' name='RPMH_CPRF_CPRF2_VALUES_4_6'/>"
WRITE #1 "        <register address='0xc2033ec' value='0x" DATA.LONG(A:0x12033ec) "' name='RPMH_CPRF_CPRF2_VALUES_4_7'/>"
WRITE #1 "        <register address='0xc2033f0' value='0x" DATA.LONG(A:0x12033f0) "' name='RPMH_CPRF_CPRF2_VALUES_4_8'/>"
WRITE #1 "        <register address='0xc2033f4' value='0x" DATA.LONG(A:0x12033f4) "' name='RPMH_CPRF_CPRF2_VALUES_4_9'/>"
WRITE #1 "        <register address='0xc2033f8' value='0x" DATA.LONG(A:0x12033f8) "' name='RPMH_CPRF_CPRF2_VALUES_4_10'/>"
WRITE #1 "        <register address='0xc2033fc' value='0x" DATA.LONG(A:0x12033fc) "' name='RPMH_CPRF_CPRF2_VALUES_4_11'/>"
WRITE #1 "        <register address='0xc203400' value='0x" DATA.LONG(A:0x1203400) "' name='RPMH_CPRF_CPRF2_VALUES_4_12'/>"
WRITE #1 "        <register address='0xc203404' value='0x" DATA.LONG(A:0x1203404) "' name='RPMH_CPRF_CPRF2_VALUES_4_13'/>"
WRITE #1 "        <register address='0xc203408' value='0x" DATA.LONG(A:0x1203408) "' name='RPMH_CPRF_CPRF2_VALUES_4_14'/>"
WRITE #1 "        <register address='0xc20340c' value='0x" DATA.LONG(A:0x120340c) "' name='RPMH_CPRF_CPRF2_VALUES_4_15'/>"
WRITE #1 "        <register address='0xc2043d0' value='0x" DATA.LONG(A:0x12043d0) "' name='RPMH_CPRF_CPRF3_VALUES_4_0'/>"
WRITE #1 "        <register address='0xc2043d4' value='0x" DATA.LONG(A:0x12043d4) "' name='RPMH_CPRF_CPRF3_VALUES_4_1'/>"
WRITE #1 "        <register address='0xc2043d8' value='0x" DATA.LONG(A:0x12043d8) "' name='RPMH_CPRF_CPRF3_VALUES_4_2'/>"
WRITE #1 "        <register address='0xc2043dc' value='0x" DATA.LONG(A:0x12043dc) "' name='RPMH_CPRF_CPRF3_VALUES_4_3'/>"
WRITE #1 "        <register address='0xc2043e0' value='0x" DATA.LONG(A:0x12043e0) "' name='RPMH_CPRF_CPRF3_VALUES_4_4'/>"
WRITE #1 "        <register address='0xc2043e4' value='0x" DATA.LONG(A:0x12043e4) "' name='RPMH_CPRF_CPRF3_VALUES_4_5'/>"
WRITE #1 "        <register address='0xc2043e8' value='0x" DATA.LONG(A:0x12043e8) "' name='RPMH_CPRF_CPRF3_VALUES_4_6'/>"
WRITE #1 "        <register address='0xc2043ec' value='0x" DATA.LONG(A:0x12043ec) "' name='RPMH_CPRF_CPRF3_VALUES_4_7'/>"
WRITE #1 "        <register address='0xc2043f0' value='0x" DATA.LONG(A:0x12043f0) "' name='RPMH_CPRF_CPRF3_VALUES_4_8'/>"
WRITE #1 "        <register address='0xc2043f4' value='0x" DATA.LONG(A:0x12043f4) "' name='RPMH_CPRF_CPRF3_VALUES_4_9'/>"
WRITE #1 "        <register address='0xc2043f8' value='0x" DATA.LONG(A:0x12043f8) "' name='RPMH_CPRF_CPRF3_VALUES_4_10'/>"
WRITE #1 "        <register address='0xc2043fc' value='0x" DATA.LONG(A:0x12043fc) "' name='RPMH_CPRF_CPRF3_VALUES_4_11'/>"
WRITE #1 "        <register address='0xc204400' value='0x" DATA.LONG(A:0x1204400) "' name='RPMH_CPRF_CPRF3_VALUES_4_12'/>"
WRITE #1 "        <register address='0xc204404' value='0x" DATA.LONG(A:0x1204404) "' name='RPMH_CPRF_CPRF3_VALUES_4_13'/>"
WRITE #1 "        <register address='0xc204408' value='0x" DATA.LONG(A:0x1204408) "' name='RPMH_CPRF_CPRF3_VALUES_4_14'/>"
WRITE #1 "        <register address='0xc20440c' value='0x" DATA.LONG(A:0x120440c) "' name='RPMH_CPRF_CPRF3_VALUES_4_15'/>"
WRITE #1 "        <register address='0xc2053d0' value='0x" DATA.LONG(A:0x12053d0) "' name='RPMH_CPRF_CPRF4_VALUES_4_0'/>"
WRITE #1 "        <register address='0xc2053d4' value='0x" DATA.LONG(A:0x12053d4) "' name='RPMH_CPRF_CPRF4_VALUES_4_1'/>"
WRITE #1 "        <register address='0xc2053d8' value='0x" DATA.LONG(A:0x12053d8) "' name='RPMH_CPRF_CPRF4_VALUES_4_2'/>"
WRITE #1 "        <register address='0xc2053dc' value='0x" DATA.LONG(A:0x12053dc) "' name='RPMH_CPRF_CPRF4_VALUES_4_3'/>"
WRITE #1 "        <register address='0xc2053e0' value='0x" DATA.LONG(A:0x12053e0) "' name='RPMH_CPRF_CPRF4_VALUES_4_4'/>"
WRITE #1 "        <register address='0xc2053e4' value='0x" DATA.LONG(A:0x12053e4) "' name='RPMH_CPRF_CPRF4_VALUES_4_5'/>"
WRITE #1 "        <register address='0xc2053e8' value='0x" DATA.LONG(A:0x12053e8) "' name='RPMH_CPRF_CPRF4_VALUES_4_6'/>"
WRITE #1 "        <register address='0xc2053ec' value='0x" DATA.LONG(A:0x12053ec) "' name='RPMH_CPRF_CPRF4_VALUES_4_7'/>"
WRITE #1 "        <register address='0xc2053f0' value='0x" DATA.LONG(A:0x12053f0) "' name='RPMH_CPRF_CPRF4_VALUES_4_8'/>"
WRITE #1 "        <register address='0xc2053f4' value='0x" DATA.LONG(A:0x12053f4) "' name='RPMH_CPRF_CPRF4_VALUES_4_9'/>"
WRITE #1 "        <register address='0xc2053f8' value='0x" DATA.LONG(A:0x12053f8) "' name='RPMH_CPRF_CPRF4_VALUES_4_10'/>"
WRITE #1 "        <register address='0xc2053fc' value='0x" DATA.LONG(A:0x12053fc) "' name='RPMH_CPRF_CPRF4_VALUES_4_11'/>"
WRITE #1 "        <register address='0xc205400' value='0x" DATA.LONG(A:0x1205400) "' name='RPMH_CPRF_CPRF4_VALUES_4_12'/>"
WRITE #1 "        <register address='0xc205404' value='0x" DATA.LONG(A:0x1205404) "' name='RPMH_CPRF_CPRF4_VALUES_4_13'/>"
WRITE #1 "        <register address='0xc205408' value='0x" DATA.LONG(A:0x1205408) "' name='RPMH_CPRF_CPRF4_VALUES_4_14'/>"
WRITE #1 "        <register address='0xc20540c' value='0x" DATA.LONG(A:0x120540c) "' name='RPMH_CPRF_CPRF4_VALUES_4_15'/>"
WRITE #1 "        <register address='0xc2063d0' value='0x" DATA.LONG(A:0x12063d0) "' name='RPMH_CPRF_CPRF5_VALUES_4_0'/>"
WRITE #1 "        <register address='0xc2063d4' value='0x" DATA.LONG(A:0x12063d4) "' name='RPMH_CPRF_CPRF5_VALUES_4_1'/>"
WRITE #1 "        <register address='0xc2063d8' value='0x" DATA.LONG(A:0x12063d8) "' name='RPMH_CPRF_CPRF5_VALUES_4_2'/>"
WRITE #1 "        <register address='0xc2063dc' value='0x" DATA.LONG(A:0x12063dc) "' name='RPMH_CPRF_CPRF5_VALUES_4_3'/>"
WRITE #1 "        <register address='0xc2063e0' value='0x" DATA.LONG(A:0x12063e0) "' name='RPMH_CPRF_CPRF5_VALUES_4_4'/>"
WRITE #1 "        <register address='0xc2063e4' value='0x" DATA.LONG(A:0x12063e4) "' name='RPMH_CPRF_CPRF5_VALUES_4_5'/>"
WRITE #1 "        <register address='0xc2063e8' value='0x" DATA.LONG(A:0x12063e8) "' name='RPMH_CPRF_CPRF5_VALUES_4_6'/>"
WRITE #1 "        <register address='0xc2063ec' value='0x" DATA.LONG(A:0x12063ec) "' name='RPMH_CPRF_CPRF5_VALUES_4_7'/>"
WRITE #1 "        <register address='0xc2063f0' value='0x" DATA.LONG(A:0x12063f0) "' name='RPMH_CPRF_CPRF5_VALUES_4_8'/>"
WRITE #1 "        <register address='0xc2063f4' value='0x" DATA.LONG(A:0x12063f4) "' name='RPMH_CPRF_CPRF5_VALUES_4_9'/>"
WRITE #1 "        <register address='0xc2063f8' value='0x" DATA.LONG(A:0x12063f8) "' name='RPMH_CPRF_CPRF5_VALUES_4_10'/>"
WRITE #1 "        <register address='0xc2063fc' value='0x" DATA.LONG(A:0x12063fc) "' name='RPMH_CPRF_CPRF5_VALUES_4_11'/>"
WRITE #1 "        <register address='0xc206400' value='0x" DATA.LONG(A:0x1206400) "' name='RPMH_CPRF_CPRF5_VALUES_4_12'/>"
WRITE #1 "        <register address='0xc206404' value='0x" DATA.LONG(A:0x1206404) "' name='RPMH_CPRF_CPRF5_VALUES_4_13'/>"
WRITE #1 "        <register address='0xc206408' value='0x" DATA.LONG(A:0x1206408) "' name='RPMH_CPRF_CPRF5_VALUES_4_14'/>"
WRITE #1 "        <register address='0xc20640c' value='0x" DATA.LONG(A:0x120640c) "' name='RPMH_CPRF_CPRF5_VALUES_4_15'/>"
WRITE #1 "        <register address='0xc201450' value='0x" DATA.LONG(A:0x1201450) "' name='RPMH_CPRF_CPRF0_VALUES_5_0'/>"
WRITE #1 "        <register address='0xc201454' value='0x" DATA.LONG(A:0x1201454) "' name='RPMH_CPRF_CPRF0_VALUES_5_1'/>"
WRITE #1 "        <register address='0xc201458' value='0x" DATA.LONG(A:0x1201458) "' name='RPMH_CPRF_CPRF0_VALUES_5_2'/>"
WRITE #1 "        <register address='0xc20145c' value='0x" DATA.LONG(A:0x120145c) "' name='RPMH_CPRF_CPRF0_VALUES_5_3'/>"
WRITE #1 "        <register address='0xc201460' value='0x" DATA.LONG(A:0x1201460) "' name='RPMH_CPRF_CPRF0_VALUES_5_4'/>"
WRITE #1 "        <register address='0xc201464' value='0x" DATA.LONG(A:0x1201464) "' name='RPMH_CPRF_CPRF0_VALUES_5_5'/>"
WRITE #1 "        <register address='0xc201468' value='0x" DATA.LONG(A:0x1201468) "' name='RPMH_CPRF_CPRF0_VALUES_5_6'/>"
WRITE #1 "        <register address='0xc20146c' value='0x" DATA.LONG(A:0x120146c) "' name='RPMH_CPRF_CPRF0_VALUES_5_7'/>"
WRITE #1 "        <register address='0xc201470' value='0x" DATA.LONG(A:0x1201470) "' name='RPMH_CPRF_CPRF0_VALUES_5_8'/>"
WRITE #1 "        <register address='0xc201474' value='0x" DATA.LONG(A:0x1201474) "' name='RPMH_CPRF_CPRF0_VALUES_5_9'/>"
WRITE #1 "        <register address='0xc201478' value='0x" DATA.LONG(A:0x1201478) "' name='RPMH_CPRF_CPRF0_VALUES_5_10'/>"
WRITE #1 "        <register address='0xc20147c' value='0x" DATA.LONG(A:0x120147c) "' name='RPMH_CPRF_CPRF0_VALUES_5_11'/>"
WRITE #1 "        <register address='0xc201480' value='0x" DATA.LONG(A:0x1201480) "' name='RPMH_CPRF_CPRF0_VALUES_5_12'/>"
WRITE #1 "        <register address='0xc201484' value='0x" DATA.LONG(A:0x1201484) "' name='RPMH_CPRF_CPRF0_VALUES_5_13'/>"
WRITE #1 "        <register address='0xc201488' value='0x" DATA.LONG(A:0x1201488) "' name='RPMH_CPRF_CPRF0_VALUES_5_14'/>"
WRITE #1 "        <register address='0xc20148c' value='0x" DATA.LONG(A:0x120148c) "' name='RPMH_CPRF_CPRF0_VALUES_5_15'/>"
WRITE #1 "        <register address='0xc202450' value='0x" DATA.LONG(A:0x1202450) "' name='RPMH_CPRF_CPRF1_VALUES_5_0'/>"
WRITE #1 "        <register address='0xc202454' value='0x" DATA.LONG(A:0x1202454) "' name='RPMH_CPRF_CPRF1_VALUES_5_1'/>"
WRITE #1 "        <register address='0xc202458' value='0x" DATA.LONG(A:0x1202458) "' name='RPMH_CPRF_CPRF1_VALUES_5_2'/>"
WRITE #1 "        <register address='0xc20245c' value='0x" DATA.LONG(A:0x120245c) "' name='RPMH_CPRF_CPRF1_VALUES_5_3'/>"
WRITE #1 "        <register address='0xc202460' value='0x" DATA.LONG(A:0x1202460) "' name='RPMH_CPRF_CPRF1_VALUES_5_4'/>"
WRITE #1 "        <register address='0xc202464' value='0x" DATA.LONG(A:0x1202464) "' name='RPMH_CPRF_CPRF1_VALUES_5_5'/>"
WRITE #1 "        <register address='0xc202468' value='0x" DATA.LONG(A:0x1202468) "' name='RPMH_CPRF_CPRF1_VALUES_5_6'/>"
WRITE #1 "        <register address='0xc20246c' value='0x" DATA.LONG(A:0x120246c) "' name='RPMH_CPRF_CPRF1_VALUES_5_7'/>"
WRITE #1 "        <register address='0xc202470' value='0x" DATA.LONG(A:0x1202470) "' name='RPMH_CPRF_CPRF1_VALUES_5_8'/>"
WRITE #1 "        <register address='0xc202474' value='0x" DATA.LONG(A:0x1202474) "' name='RPMH_CPRF_CPRF1_VALUES_5_9'/>"
WRITE #1 "        <register address='0xc202478' value='0x" DATA.LONG(A:0x1202478) "' name='RPMH_CPRF_CPRF1_VALUES_5_10'/>"
WRITE #1 "        <register address='0xc20247c' value='0x" DATA.LONG(A:0x120247c) "' name='RPMH_CPRF_CPRF1_VALUES_5_11'/>"
WRITE #1 "        <register address='0xc202480' value='0x" DATA.LONG(A:0x1202480) "' name='RPMH_CPRF_CPRF1_VALUES_5_12'/>"
WRITE #1 "        <register address='0xc202484' value='0x" DATA.LONG(A:0x1202484) "' name='RPMH_CPRF_CPRF1_VALUES_5_13'/>"
WRITE #1 "        <register address='0xc202488' value='0x" DATA.LONG(A:0x1202488) "' name='RPMH_CPRF_CPRF1_VALUES_5_14'/>"
WRITE #1 "        <register address='0xc20248c' value='0x" DATA.LONG(A:0x120248c) "' name='RPMH_CPRF_CPRF1_VALUES_5_15'/>"
WRITE #1 "        <register address='0xc203450' value='0x" DATA.LONG(A:0x1203450) "' name='RPMH_CPRF_CPRF2_VALUES_5_0'/>"
WRITE #1 "        <register address='0xc203454' value='0x" DATA.LONG(A:0x1203454) "' name='RPMH_CPRF_CPRF2_VALUES_5_1'/>"
WRITE #1 "        <register address='0xc203458' value='0x" DATA.LONG(A:0x1203458) "' name='RPMH_CPRF_CPRF2_VALUES_5_2'/>"
WRITE #1 "        <register address='0xc20345c' value='0x" DATA.LONG(A:0x120345c) "' name='RPMH_CPRF_CPRF2_VALUES_5_3'/>"
WRITE #1 "        <register address='0xc203460' value='0x" DATA.LONG(A:0x1203460) "' name='RPMH_CPRF_CPRF2_VALUES_5_4'/>"
WRITE #1 "        <register address='0xc203464' value='0x" DATA.LONG(A:0x1203464) "' name='RPMH_CPRF_CPRF2_VALUES_5_5'/>"
WRITE #1 "        <register address='0xc203468' value='0x" DATA.LONG(A:0x1203468) "' name='RPMH_CPRF_CPRF2_VALUES_5_6'/>"
WRITE #1 "        <register address='0xc20346c' value='0x" DATA.LONG(A:0x120346c) "' name='RPMH_CPRF_CPRF2_VALUES_5_7'/>"
WRITE #1 "        <register address='0xc203470' value='0x" DATA.LONG(A:0x1203470) "' name='RPMH_CPRF_CPRF2_VALUES_5_8'/>"
WRITE #1 "        <register address='0xc203474' value='0x" DATA.LONG(A:0x1203474) "' name='RPMH_CPRF_CPRF2_VALUES_5_9'/>"
WRITE #1 "        <register address='0xc203478' value='0x" DATA.LONG(A:0x1203478) "' name='RPMH_CPRF_CPRF2_VALUES_5_10'/>"
WRITE #1 "        <register address='0xc20347c' value='0x" DATA.LONG(A:0x120347c) "' name='RPMH_CPRF_CPRF2_VALUES_5_11'/>"
WRITE #1 "        <register address='0xc203480' value='0x" DATA.LONG(A:0x1203480) "' name='RPMH_CPRF_CPRF2_VALUES_5_12'/>"
WRITE #1 "        <register address='0xc203484' value='0x" DATA.LONG(A:0x1203484) "' name='RPMH_CPRF_CPRF2_VALUES_5_13'/>"
WRITE #1 "        <register address='0xc203488' value='0x" DATA.LONG(A:0x1203488) "' name='RPMH_CPRF_CPRF2_VALUES_5_14'/>"
WRITE #1 "        <register address='0xc20348c' value='0x" DATA.LONG(A:0x120348c) "' name='RPMH_CPRF_CPRF2_VALUES_5_15'/>"
WRITE #1 "        <register address='0xc204450' value='0x" DATA.LONG(A:0x1204450) "' name='RPMH_CPRF_CPRF3_VALUES_5_0'/>"
WRITE #1 "        <register address='0xc204454' value='0x" DATA.LONG(A:0x1204454) "' name='RPMH_CPRF_CPRF3_VALUES_5_1'/>"
WRITE #1 "        <register address='0xc204458' value='0x" DATA.LONG(A:0x1204458) "' name='RPMH_CPRF_CPRF3_VALUES_5_2'/>"
WRITE #1 "        <register address='0xc20445c' value='0x" DATA.LONG(A:0x120445c) "' name='RPMH_CPRF_CPRF3_VALUES_5_3'/>"
WRITE #1 "        <register address='0xc204460' value='0x" DATA.LONG(A:0x1204460) "' name='RPMH_CPRF_CPRF3_VALUES_5_4'/>"
WRITE #1 "        <register address='0xc204464' value='0x" DATA.LONG(A:0x1204464) "' name='RPMH_CPRF_CPRF3_VALUES_5_5'/>"
WRITE #1 "        <register address='0xc204468' value='0x" DATA.LONG(A:0x1204468) "' name='RPMH_CPRF_CPRF3_VALUES_5_6'/>"
WRITE #1 "        <register address='0xc20446c' value='0x" DATA.LONG(A:0x120446c) "' name='RPMH_CPRF_CPRF3_VALUES_5_7'/>"
WRITE #1 "        <register address='0xc204470' value='0x" DATA.LONG(A:0x1204470) "' name='RPMH_CPRF_CPRF3_VALUES_5_8'/>"
WRITE #1 "        <register address='0xc204474' value='0x" DATA.LONG(A:0x1204474) "' name='RPMH_CPRF_CPRF3_VALUES_5_9'/>"
WRITE #1 "        <register address='0xc204478' value='0x" DATA.LONG(A:0x1204478) "' name='RPMH_CPRF_CPRF3_VALUES_5_10'/>"
WRITE #1 "        <register address='0xc20447c' value='0x" DATA.LONG(A:0x120447c) "' name='RPMH_CPRF_CPRF3_VALUES_5_11'/>"
WRITE #1 "        <register address='0xc204480' value='0x" DATA.LONG(A:0x1204480) "' name='RPMH_CPRF_CPRF3_VALUES_5_12'/>"
WRITE #1 "        <register address='0xc204484' value='0x" DATA.LONG(A:0x1204484) "' name='RPMH_CPRF_CPRF3_VALUES_5_13'/>"
WRITE #1 "        <register address='0xc204488' value='0x" DATA.LONG(A:0x1204488) "' name='RPMH_CPRF_CPRF3_VALUES_5_14'/>"
WRITE #1 "        <register address='0xc20448c' value='0x" DATA.LONG(A:0x120448c) "' name='RPMH_CPRF_CPRF3_VALUES_5_15'/>"
WRITE #1 "        <register address='0xc205450' value='0x" DATA.LONG(A:0x1205450) "' name='RPMH_CPRF_CPRF4_VALUES_5_0'/>"
WRITE #1 "        <register address='0xc205454' value='0x" DATA.LONG(A:0x1205454) "' name='RPMH_CPRF_CPRF4_VALUES_5_1'/>"
WRITE #1 "        <register address='0xc205458' value='0x" DATA.LONG(A:0x1205458) "' name='RPMH_CPRF_CPRF4_VALUES_5_2'/>"
WRITE #1 "        <register address='0xc20545c' value='0x" DATA.LONG(A:0x120545c) "' name='RPMH_CPRF_CPRF4_VALUES_5_3'/>"
WRITE #1 "        <register address='0xc205460' value='0x" DATA.LONG(A:0x1205460) "' name='RPMH_CPRF_CPRF4_VALUES_5_4'/>"
WRITE #1 "        <register address='0xc205464' value='0x" DATA.LONG(A:0x1205464) "' name='RPMH_CPRF_CPRF4_VALUES_5_5'/>"
WRITE #1 "        <register address='0xc205468' value='0x" DATA.LONG(A:0x1205468) "' name='RPMH_CPRF_CPRF4_VALUES_5_6'/>"
WRITE #1 "        <register address='0xc20546c' value='0x" DATA.LONG(A:0x120546c) "' name='RPMH_CPRF_CPRF4_VALUES_5_7'/>"
WRITE #1 "        <register address='0xc205470' value='0x" DATA.LONG(A:0x1205470) "' name='RPMH_CPRF_CPRF4_VALUES_5_8'/>"
WRITE #1 "        <register address='0xc205474' value='0x" DATA.LONG(A:0x1205474) "' name='RPMH_CPRF_CPRF4_VALUES_5_9'/>"
WRITE #1 "        <register address='0xc205478' value='0x" DATA.LONG(A:0x1205478) "' name='RPMH_CPRF_CPRF4_VALUES_5_10'/>"
WRITE #1 "        <register address='0xc20547c' value='0x" DATA.LONG(A:0x120547c) "' name='RPMH_CPRF_CPRF4_VALUES_5_11'/>"
WRITE #1 "        <register address='0xc205480' value='0x" DATA.LONG(A:0x1205480) "' name='RPMH_CPRF_CPRF4_VALUES_5_12'/>"
WRITE #1 "        <register address='0xc205484' value='0x" DATA.LONG(A:0x1205484) "' name='RPMH_CPRF_CPRF4_VALUES_5_13'/>"
WRITE #1 "        <register address='0xc205488' value='0x" DATA.LONG(A:0x1205488) "' name='RPMH_CPRF_CPRF4_VALUES_5_14'/>"
WRITE #1 "        <register address='0xc20548c' value='0x" DATA.LONG(A:0x120548c) "' name='RPMH_CPRF_CPRF4_VALUES_5_15'/>"
WRITE #1 "        <register address='0xc206450' value='0x" DATA.LONG(A:0x1206450) "' name='RPMH_CPRF_CPRF5_VALUES_5_0'/>"
WRITE #1 "        <register address='0xc206454' value='0x" DATA.LONG(A:0x1206454) "' name='RPMH_CPRF_CPRF5_VALUES_5_1'/>"
WRITE #1 "        <register address='0xc206458' value='0x" DATA.LONG(A:0x1206458) "' name='RPMH_CPRF_CPRF5_VALUES_5_2'/>"
WRITE #1 "        <register address='0xc20645c' value='0x" DATA.LONG(A:0x120645c) "' name='RPMH_CPRF_CPRF5_VALUES_5_3'/>"
WRITE #1 "        <register address='0xc206460' value='0x" DATA.LONG(A:0x1206460) "' name='RPMH_CPRF_CPRF5_VALUES_5_4'/>"
WRITE #1 "        <register address='0xc206464' value='0x" DATA.LONG(A:0x1206464) "' name='RPMH_CPRF_CPRF5_VALUES_5_5'/>"
WRITE #1 "        <register address='0xc206468' value='0x" DATA.LONG(A:0x1206468) "' name='RPMH_CPRF_CPRF5_VALUES_5_6'/>"
WRITE #1 "        <register address='0xc20646c' value='0x" DATA.LONG(A:0x120646c) "' name='RPMH_CPRF_CPRF5_VALUES_5_7'/>"
WRITE #1 "        <register address='0xc206470' value='0x" DATA.LONG(A:0x1206470) "' name='RPMH_CPRF_CPRF5_VALUES_5_8'/>"
WRITE #1 "        <register address='0xc206474' value='0x" DATA.LONG(A:0x1206474) "' name='RPMH_CPRF_CPRF5_VALUES_5_9'/>"
WRITE #1 "        <register address='0xc206478' value='0x" DATA.LONG(A:0x1206478) "' name='RPMH_CPRF_CPRF5_VALUES_5_10'/>"
WRITE #1 "        <register address='0xc20647c' value='0x" DATA.LONG(A:0x120647c) "' name='RPMH_CPRF_CPRF5_VALUES_5_11'/>"
WRITE #1 "        <register address='0xc206480' value='0x" DATA.LONG(A:0x1206480) "' name='RPMH_CPRF_CPRF5_VALUES_5_12'/>"
WRITE #1 "        <register address='0xc206484' value='0x" DATA.LONG(A:0x1206484) "' name='RPMH_CPRF_CPRF5_VALUES_5_13'/>"
WRITE #1 "        <register address='0xc206488' value='0x" DATA.LONG(A:0x1206488) "' name='RPMH_CPRF_CPRF5_VALUES_5_14'/>"
WRITE #1 "        <register address='0xc20648c' value='0x" DATA.LONG(A:0x120648c) "' name='RPMH_CPRF_CPRF5_VALUES_5_15'/>"
WRITE #1 "        <register address='0xc20a000' value='0x" DATA.LONG(A:0x120a000) "' name='RPMH_CPRF_CPRF_VSENSE0_RESET'/>"
WRITE #1 "        <register address='0xc20a200' value='0x" DATA.LONG(A:0x120a200) "' name='RPMH_CPRF_CPRF_VSENSE1_RESET'/>"
WRITE #1 "        <register address='0xc20a400' value='0x" DATA.LONG(A:0x120a400) "' name='RPMH_CPRF_CPRF_VSENSE2_RESET'/>"
WRITE #1 "        <register address='0xc20a600' value='0x" DATA.LONG(A:0x120a600) "' name='RPMH_CPRF_CPRF_VSENSE3_RESET'/>"
WRITE #1 "        <register address='0xc20a800' value='0x" DATA.LONG(A:0x120a800) "' name='RPMH_CPRF_CPRF_VSENSE4_RESET'/>"
WRITE #1 "        <register address='0xc20aa00' value='0x" DATA.LONG(A:0x120aa00) "' name='RPMH_CPRF_CPRF_VSENSE5_RESET'/>"
WRITE #1 "        <register address='0xc20a004' value='0x" DATA.LONG(A:0x120a004) "' name='RPMH_CPRF_CPRF_VSENSE0_CTRL'/>"
WRITE #1 "        <register address='0xc20a204' value='0x" DATA.LONG(A:0x120a204) "' name='RPMH_CPRF_CPRF_VSENSE1_CTRL'/>"
WRITE #1 "        <register address='0xc20a404' value='0x" DATA.LONG(A:0x120a404) "' name='RPMH_CPRF_CPRF_VSENSE2_CTRL'/>"
WRITE #1 "        <register address='0xc20a604' value='0x" DATA.LONG(A:0x120a604) "' name='RPMH_CPRF_CPRF_VSENSE3_CTRL'/>"
WRITE #1 "        <register address='0xc20a804' value='0x" DATA.LONG(A:0x120a804) "' name='RPMH_CPRF_CPRF_VSENSE4_CTRL'/>"
WRITE #1 "        <register address='0xc20aa04' value='0x" DATA.LONG(A:0x120aa04) "' name='RPMH_CPRF_CPRF_VSENSE5_CTRL'/>"
WRITE #1 "        <register address='0xc20a008' value='0x" DATA.LONG(A:0x120a008) "' name='RPMH_CPRF_CPRF_VSENSE0_INITIAL_SETTINGS'/>"
WRITE #1 "        <register address='0xc20a208' value='0x" DATA.LONG(A:0x120a208) "' name='RPMH_CPRF_CPRF_VSENSE1_INITIAL_SETTINGS'/>"
WRITE #1 "        <register address='0xc20a408' value='0x" DATA.LONG(A:0x120a408) "' name='RPMH_CPRF_CPRF_VSENSE2_INITIAL_SETTINGS'/>"
WRITE #1 "        <register address='0xc20a608' value='0x" DATA.LONG(A:0x120a608) "' name='RPMH_CPRF_CPRF_VSENSE3_INITIAL_SETTINGS'/>"
WRITE #1 "        <register address='0xc20a808' value='0x" DATA.LONG(A:0x120a808) "' name='RPMH_CPRF_CPRF_VSENSE4_INITIAL_SETTINGS'/>"
WRITE #1 "        <register address='0xc20aa08' value='0x" DATA.LONG(A:0x120aa08) "' name='RPMH_CPRF_CPRF_VSENSE5_INITIAL_SETTINGS'/>"
WRITE #1 "        <register address='0xc20a00c' value='0x" DATA.LONG(A:0x120a00c) "' name='RPMH_CPRF_CPRF_VSENSE0_ENABLE'/>"
WRITE #1 "        <register address='0xc20a20c' value='0x" DATA.LONG(A:0x120a20c) "' name='RPMH_CPRF_CPRF_VSENSE1_ENABLE'/>"
WRITE #1 "        <register address='0xc20a40c' value='0x" DATA.LONG(A:0x120a40c) "' name='RPMH_CPRF_CPRF_VSENSE2_ENABLE'/>"
WRITE #1 "        <register address='0xc20a60c' value='0x" DATA.LONG(A:0x120a60c) "' name='RPMH_CPRF_CPRF_VSENSE3_ENABLE'/>"
WRITE #1 "        <register address='0xc20a80c' value='0x" DATA.LONG(A:0x120a80c) "' name='RPMH_CPRF_CPRF_VSENSE4_ENABLE'/>"
WRITE #1 "        <register address='0xc20aa0c' value='0x" DATA.LONG(A:0x120aa0c) "' name='RPMH_CPRF_CPRF_VSENSE5_ENABLE'/>"
WRITE #1 "        <register address='0xc20a010' value='0x" DATA.LONG(A:0x120a010) "' name='RPMH_CPRF_CPRF_VSENSE0_FORCE_SETTINGS'/>"
WRITE #1 "        <register address='0xc20a210' value='0x" DATA.LONG(A:0x120a210) "' name='RPMH_CPRF_CPRF_VSENSE1_FORCE_SETTINGS'/>"
WRITE #1 "        <register address='0xc20a410' value='0x" DATA.LONG(A:0x120a410) "' name='RPMH_CPRF_CPRF_VSENSE2_FORCE_SETTINGS'/>"
WRITE #1 "        <register address='0xc20a610' value='0x" DATA.LONG(A:0x120a610) "' name='RPMH_CPRF_CPRF_VSENSE3_FORCE_SETTINGS'/>"
WRITE #1 "        <register address='0xc20a810' value='0x" DATA.LONG(A:0x120a810) "' name='RPMH_CPRF_CPRF_VSENSE4_FORCE_SETTINGS'/>"
WRITE #1 "        <register address='0xc20aa10' value='0x" DATA.LONG(A:0x120aa10) "' name='RPMH_CPRF_CPRF_VSENSE5_FORCE_SETTINGS'/>"
WRITE #1 "        <register address='0xc20a014' value='0x" DATA.LONG(A:0x120a014) "' name='RPMH_CPRF_CPRF_VSENSE0_INTERRUPT_STATUS'/>"
WRITE #1 "        <register address='0xc20a214' value='0x" DATA.LONG(A:0x120a214) "' name='RPMH_CPRF_CPRF_VSENSE1_INTERRUPT_STATUS'/>"
WRITE #1 "        <register address='0xc20a414' value='0x" DATA.LONG(A:0x120a414) "' name='RPMH_CPRF_CPRF_VSENSE2_INTERRUPT_STATUS'/>"
WRITE #1 "        <register address='0xc20a614' value='0x" DATA.LONG(A:0x120a614) "' name='RPMH_CPRF_CPRF_VSENSE3_INTERRUPT_STATUS'/>"
WRITE #1 "        <register address='0xc20a814' value='0x" DATA.LONG(A:0x120a814) "' name='RPMH_CPRF_CPRF_VSENSE4_INTERRUPT_STATUS'/>"
WRITE #1 "        <register address='0xc20aa14' value='0x" DATA.LONG(A:0x120aa14) "' name='RPMH_CPRF_CPRF_VSENSE5_INTERRUPT_STATUS'/>"
WRITE #1 "        <register address='0xc20a018' value='0x" DATA.LONG(A:0x120a018) "' name='RPMH_CPRF_CPRF_VSENSE0_INTERRUPT_MASK'/>"
WRITE #1 "        <register address='0xc20a218' value='0x" DATA.LONG(A:0x120a218) "' name='RPMH_CPRF_CPRF_VSENSE1_INTERRUPT_MASK'/>"
WRITE #1 "        <register address='0xc20a418' value='0x" DATA.LONG(A:0x120a418) "' name='RPMH_CPRF_CPRF_VSENSE2_INTERRUPT_MASK'/>"
WRITE #1 "        <register address='0xc20a618' value='0x" DATA.LONG(A:0x120a618) "' name='RPMH_CPRF_CPRF_VSENSE3_INTERRUPT_MASK'/>"
WRITE #1 "        <register address='0xc20a818' value='0x" DATA.LONG(A:0x120a818) "' name='RPMH_CPRF_CPRF_VSENSE4_INTERRUPT_MASK'/>"
WRITE #1 "        <register address='0xc20aa18' value='0x" DATA.LONG(A:0x120aa18) "' name='RPMH_CPRF_CPRF_VSENSE5_INTERRUPT_MASK'/>"
WRITE #1 "        <register address='0xc20a01c' value='0x" DATA.LONG(A:0x120a01c) "' name='RPMH_CPRF_CPRF_VSENSE0_ARC_PR_WA'/>"
WRITE #1 "        <register address='0xc20a21c' value='0x" DATA.LONG(A:0x120a21c) "' name='RPMH_CPRF_CPRF_VSENSE1_ARC_PR_WA'/>"
WRITE #1 "        <register address='0xc20a41c' value='0x" DATA.LONG(A:0x120a41c) "' name='RPMH_CPRF_CPRF_VSENSE2_ARC_PR_WA'/>"
WRITE #1 "        <register address='0xc20a61c' value='0x" DATA.LONG(A:0x120a61c) "' name='RPMH_CPRF_CPRF_VSENSE3_ARC_PR_WA'/>"
WRITE #1 "        <register address='0xc20a81c' value='0x" DATA.LONG(A:0x120a81c) "' name='RPMH_CPRF_CPRF_VSENSE4_ARC_PR_WA'/>"
WRITE #1 "        <register address='0xc20aa1c' value='0x" DATA.LONG(A:0x120aa1c) "' name='RPMH_CPRF_CPRF_VSENSE5_ARC_PR_WA'/>"
WRITE #1 "        <register address='0xc20a020' value='0x" DATA.LONG(A:0x120a020) "' name='RPMH_CPRF_CPRF_VSENSE0_ARC_CXO_WA'/>"
WRITE #1 "        <register address='0xc20a220' value='0x" DATA.LONG(A:0x120a220) "' name='RPMH_CPRF_CPRF_VSENSE1_ARC_CXO_WA'/>"
WRITE #1 "        <register address='0xc20a420' value='0x" DATA.LONG(A:0x120a420) "' name='RPMH_CPRF_CPRF_VSENSE2_ARC_CXO_WA'/>"
WRITE #1 "        <register address='0xc20a620' value='0x" DATA.LONG(A:0x120a620) "' name='RPMH_CPRF_CPRF_VSENSE3_ARC_CXO_WA'/>"
WRITE #1 "        <register address='0xc20a820' value='0x" DATA.LONG(A:0x120a820) "' name='RPMH_CPRF_CPRF_VSENSE4_ARC_CXO_WA'/>"
WRITE #1 "        <register address='0xc20aa20' value='0x" DATA.LONG(A:0x120aa20) "' name='RPMH_CPRF_CPRF_VSENSE5_ARC_CXO_WA'/>"
WRITE #1 "        <register address='0xc20a024' value='0x" DATA.LONG(A:0x120a024) "' name='RPMH_CPRF_CPRF_VSENSE0_VALUES'/>"
WRITE #1 "        <register address='0xc20a224' value='0x" DATA.LONG(A:0x120a224) "' name='RPMH_CPRF_CPRF_VSENSE1_VALUES'/>"
WRITE #1 "        <register address='0xc20a424' value='0x" DATA.LONG(A:0x120a424) "' name='RPMH_CPRF_CPRF_VSENSE2_VALUES'/>"
WRITE #1 "        <register address='0xc20a624' value='0x" DATA.LONG(A:0x120a624) "' name='RPMH_CPRF_CPRF_VSENSE3_VALUES'/>"
WRITE #1 "        <register address='0xc20a824' value='0x" DATA.LONG(A:0x120a824) "' name='RPMH_CPRF_CPRF_VSENSE4_VALUES'/>"
WRITE #1 "        <register address='0xc20aa24' value='0x" DATA.LONG(A:0x120aa24) "' name='RPMH_CPRF_CPRF_VSENSE5_VALUES'/>"
WRITE #1 "        <register address='0xc20a028' value='0x" DATA.LONG(A:0x120a028) "' name='RPMH_CPRF_CPRF_VSENSE0_ON_SETTINGS'/>"
WRITE #1 "        <register address='0xc20a228' value='0x" DATA.LONG(A:0x120a228) "' name='RPMH_CPRF_CPRF_VSENSE1_ON_SETTINGS'/>"
WRITE #1 "        <register address='0xc20a428' value='0x" DATA.LONG(A:0x120a428) "' name='RPMH_CPRF_CPRF_VSENSE2_ON_SETTINGS'/>"
WRITE #1 "        <register address='0xc20a628' value='0x" DATA.LONG(A:0x120a628) "' name='RPMH_CPRF_CPRF_VSENSE3_ON_SETTINGS'/>"
WRITE #1 "        <register address='0xc20a828' value='0x" DATA.LONG(A:0x120a828) "' name='RPMH_CPRF_CPRF_VSENSE4_ON_SETTINGS'/>"
WRITE #1 "        <register address='0xc20aa28' value='0x" DATA.LONG(A:0x120aa28) "' name='RPMH_CPRF_CPRF_VSENSE5_ON_SETTINGS'/>"
WRITE #1 "        <register address='0xc20a02c' value='0x" DATA.LONG(A:0x120a02c) "' name='RPMH_CPRF_CPRF_VSENSE0_ARC_PR_BIT_ORDER'/>"
WRITE #1 "        <register address='0xc20a22c' value='0x" DATA.LONG(A:0x120a22c) "' name='RPMH_CPRF_CPRF_VSENSE1_ARC_PR_BIT_ORDER'/>"
WRITE #1 "        <register address='0xc20a42c' value='0x" DATA.LONG(A:0x120a42c) "' name='RPMH_CPRF_CPRF_VSENSE2_ARC_PR_BIT_ORDER'/>"
WRITE #1 "        <register address='0xc20a62c' value='0x" DATA.LONG(A:0x120a62c) "' name='RPMH_CPRF_CPRF_VSENSE3_ARC_PR_BIT_ORDER'/>"
WRITE #1 "        <register address='0xc20a82c' value='0x" DATA.LONG(A:0x120a82c) "' name='RPMH_CPRF_CPRF_VSENSE4_ARC_PR_BIT_ORDER'/>"
WRITE #1 "        <register address='0xc20aa2c' value='0x" DATA.LONG(A:0x120aa2c) "' name='RPMH_CPRF_CPRF_VSENSE5_ARC_PR_BIT_ORDER'/>"
WRITE #1 "        <register address='0xc20f000' value='0x" DATA.LONG(A:0x120f000) "' name='RPMH_CPRF_VRM_MESSAGE'/>"
WRITE #1 "    </chip>"
WRITE #1 "</hwioDump>"
CLOSE #1
PRINT "Register data sent to &file"

