
local &file
entry &infile
if "&infile"!=""
(
  &file="&infile"
)
else
(
  &file="c:\temp\hwiosave.xml"
)
print "Reading register values..."
OPEN #1 &file /Create

WRITE #1 "<?xml version='1.0' encoding='utf-8'?>"
WRITE #1 "<!-- This log file can be parsed at http://ipcatalog/swi/dump/parser -->"
WRITE #1 "<hwioDump version='1'>"
WRITE #1 "    <timestamp>" clock.date() " " clock.time() "</timestamp>"
WRITE #1 "    <generator>Trace32</generator>"
WRITE #1 "    <chip name='huracan_1.0' map='ARM_ADDRESS_FILE_SW' version='huracan_v1.0_p3q3r93'>"
WRITE #1 "        <register address='0xb200000' value='0x" DATA.LONG(A:0xb200000) "' name='RPMH_PDC_APPS_VOTE_CMP_DATA_DRV0'/>"
WRITE #1 "        <register address='0xb210000' value='0x" DATA.LONG(A:0xb210000) "' name='RPMH_PDC_APPS_VOTE_CMP_DATA_DRV1'/>"
WRITE #1 "        <register address='0xb200010' value='0x" DATA.LONG(A:0xb200010) "' name='RPMH_PDC_APPS_IRQ_ENABLE_BANK0_DRV0'/>"
WRITE #1 "        <register address='0xb200014' value='0x" DATA.LONG(A:0xb200014) "' name='RPMH_PDC_APPS_IRQ_ENABLE_BANK1_DRV0'/>"
WRITE #1 "        <register address='0xb210010' value='0x" DATA.LONG(A:0xb210010) "' name='RPMH_PDC_APPS_IRQ_ENABLE_BANK0_DRV1'/>"
WRITE #1 "        <register address='0xb210014' value='0x" DATA.LONG(A:0xb210014) "' name='RPMH_PDC_APPS_IRQ_ENABLE_BANK1_DRV1'/>"
WRITE #1 "        <register address='0xb200110' value='0x" DATA.LONG(A:0xb200110) "' name='RPMH_PDC_APPS_IRQ_0_CFG_DRV0'/>"
WRITE #1 "        <register address='0xb200114' value='0x" DATA.LONG(A:0xb200114) "' name='RPMH_PDC_APPS_IRQ_1_CFG_DRV0'/>"
WRITE #1 "        <register address='0xb200118' value='0x" DATA.LONG(A:0xb200118) "' name='RPMH_PDC_APPS_IRQ_2_CFG_DRV0'/>"
WRITE #1 "        <register address='0xb20011c' value='0x" DATA.LONG(A:0xb20011c) "' name='RPMH_PDC_APPS_IRQ_3_CFG_DRV0'/>"
WRITE #1 "        <register address='0xb200120' value='0x" DATA.LONG(A:0xb200120) "' name='RPMH_PDC_APPS_IRQ_4_CFG_DRV0'/>"
WRITE #1 "        <register address='0xb200124' value='0x" DATA.LONG(A:0xb200124) "' name='RPMH_PDC_APPS_IRQ_5_CFG_DRV0'/>"
WRITE #1 "        <register address='0xb200128' value='0x" DATA.LONG(A:0xb200128) "' name='RPMH_PDC_APPS_IRQ_6_CFG_DRV0'/>"
WRITE #1 "        <register address='0xb20012c' value='0x" DATA.LONG(A:0xb20012c) "' name='RPMH_PDC_APPS_IRQ_7_CFG_DRV0'/>"
WRITE #1 "        <register address='0xb200130' value='0x" DATA.LONG(A:0xb200130) "' name='RPMH_PDC_APPS_IRQ_8_CFG_DRV0'/>"
WRITE #1 "        <register address='0xb200134' value='0x" DATA.LONG(A:0xb200134) "' name='RPMH_PDC_APPS_IRQ_9_CFG_DRV0'/>"
WRITE #1 "        <register address='0xb200138' value='0x" DATA.LONG(A:0xb200138) "' name='RPMH_PDC_APPS_IRQ_10_CFG_DRV0'/>"
WRITE #1 "        <register address='0xb20013c' value='0x" DATA.LONG(A:0xb20013c) "' name='RPMH_PDC_APPS_IRQ_11_CFG_DRV0'/>"
WRITE #1 "        <register address='0xb200140' value='0x" DATA.LONG(A:0xb200140) "' name='RPMH_PDC_APPS_IRQ_12_CFG_DRV0'/>"
WRITE #1 "        <register address='0xb200144' value='0x" DATA.LONG(A:0xb200144) "' name='RPMH_PDC_APPS_IRQ_13_CFG_DRV0'/>"
WRITE #1 "        <register address='0xb200148' value='0x" DATA.LONG(A:0xb200148) "' name='RPMH_PDC_APPS_IRQ_14_CFG_DRV0'/>"
WRITE #1 "        <register address='0xb20014c' value='0x" DATA.LONG(A:0xb20014c) "' name='RPMH_PDC_APPS_IRQ_15_CFG_DRV0'/>"
WRITE #1 "        <register address='0xb200150' value='0x" DATA.LONG(A:0xb200150) "' name='RPMH_PDC_APPS_IRQ_16_CFG_DRV0'/>"
WRITE #1 "        <register address='0xb200154' value='0x" DATA.LONG(A:0xb200154) "' name='RPMH_PDC_APPS_IRQ_17_CFG_DRV0'/>"
WRITE #1 "        <register address='0xb200158' value='0x" DATA.LONG(A:0xb200158) "' name='RPMH_PDC_APPS_IRQ_18_CFG_DRV0'/>"
WRITE #1 "        <register address='0xb20015c' value='0x" DATA.LONG(A:0xb20015c) "' name='RPMH_PDC_APPS_IRQ_19_CFG_DRV0'/>"
WRITE #1 "        <register address='0xb200160' value='0x" DATA.LONG(A:0xb200160) "' name='RPMH_PDC_APPS_IRQ_20_CFG_DRV0'/>"
WRITE #1 "        <register address='0xb200164' value='0x" DATA.LONG(A:0xb200164) "' name='RPMH_PDC_APPS_IRQ_21_CFG_DRV0'/>"
WRITE #1 "        <register address='0xb200168' value='0x" DATA.LONG(A:0xb200168) "' name='RPMH_PDC_APPS_IRQ_22_CFG_DRV0'/>"
WRITE #1 "        <register address='0xb20016c' value='0x" DATA.LONG(A:0xb20016c) "' name='RPMH_PDC_APPS_IRQ_23_CFG_DRV0'/>"
WRITE #1 "        <register address='0xb200170' value='0x" DATA.LONG(A:0xb200170) "' name='RPMH_PDC_APPS_IRQ_24_CFG_DRV0'/>"
WRITE #1 "        <register address='0xb200174' value='0x" DATA.LONG(A:0xb200174) "' name='RPMH_PDC_APPS_IRQ_25_CFG_DRV0'/>"
WRITE #1 "        <register address='0xb200178' value='0x" DATA.LONG(A:0xb200178) "' name='RPMH_PDC_APPS_IRQ_26_CFG_DRV0'/>"
WRITE #1 "        <register address='0xb20017c' value='0x" DATA.LONG(A:0xb20017c) "' name='RPMH_PDC_APPS_IRQ_27_CFG_DRV0'/>"
WRITE #1 "        <register address='0xb200180' value='0x" DATA.LONG(A:0xb200180) "' name='RPMH_PDC_APPS_IRQ_28_CFG_DRV0'/>"
WRITE #1 "        <register address='0xb200184' value='0x" DATA.LONG(A:0xb200184) "' name='RPMH_PDC_APPS_IRQ_29_CFG_DRV0'/>"
WRITE #1 "        <register address='0xb200188' value='0x" DATA.LONG(A:0xb200188) "' name='RPMH_PDC_APPS_IRQ_30_CFG_DRV0'/>"
WRITE #1 "        <register address='0xb20018c' value='0x" DATA.LONG(A:0xb20018c) "' name='RPMH_PDC_APPS_IRQ_31_CFG_DRV0'/>"
WRITE #1 "        <register address='0xb200190' value='0x" DATA.LONG(A:0xb200190) "' name='RPMH_PDC_APPS_IRQ_32_CFG_DRV0'/>"
WRITE #1 "        <register address='0xb200194' value='0x" DATA.LONG(A:0xb200194) "' name='RPMH_PDC_APPS_IRQ_33_CFG_DRV0'/>"
WRITE #1 "        <register address='0xb200198' value='0x" DATA.LONG(A:0xb200198) "' name='RPMH_PDC_APPS_IRQ_34_CFG_DRV0'/>"
WRITE #1 "        <register address='0xb20019c' value='0x" DATA.LONG(A:0xb20019c) "' name='RPMH_PDC_APPS_IRQ_35_CFG_DRV0'/>"
WRITE #1 "        <register address='0xb2001a0' value='0x" DATA.LONG(A:0xb2001a0) "' name='RPMH_PDC_APPS_IRQ_36_CFG_DRV0'/>"
WRITE #1 "        <register address='0xb2001a4' value='0x" DATA.LONG(A:0xb2001a4) "' name='RPMH_PDC_APPS_IRQ_37_CFG_DRV0'/>"
WRITE #1 "        <register address='0xb2001a8' value='0x" DATA.LONG(A:0xb2001a8) "' name='RPMH_PDC_APPS_IRQ_38_CFG_DRV0'/>"
WRITE #1 "        <register address='0xb2001ac' value='0x" DATA.LONG(A:0xb2001ac) "' name='RPMH_PDC_APPS_IRQ_39_CFG_DRV0'/>"
WRITE #1 "        <register address='0xb2001b0' value='0x" DATA.LONG(A:0xb2001b0) "' name='RPMH_PDC_APPS_IRQ_40_CFG_DRV0'/>"
WRITE #1 "        <register address='0xb2001b4' value='0x" DATA.LONG(A:0xb2001b4) "' name='RPMH_PDC_APPS_IRQ_41_CFG_DRV0'/>"
WRITE #1 "        <register address='0xb2001b8' value='0x" DATA.LONG(A:0xb2001b8) "' name='RPMH_PDC_APPS_IRQ_42_CFG_DRV0'/>"
WRITE #1 "        <register address='0xb2001bc' value='0x" DATA.LONG(A:0xb2001bc) "' name='RPMH_PDC_APPS_IRQ_43_CFG_DRV0'/>"
WRITE #1 "        <register address='0xb2001c0' value='0x" DATA.LONG(A:0xb2001c0) "' name='RPMH_PDC_APPS_IRQ_44_CFG_DRV0'/>"
WRITE #1 "        <register address='0xb2001c4' value='0x" DATA.LONG(A:0xb2001c4) "' name='RPMH_PDC_APPS_IRQ_45_CFG_DRV0'/>"
WRITE #1 "        <register address='0xb2001c8' value='0x" DATA.LONG(A:0xb2001c8) "' name='RPMH_PDC_APPS_IRQ_46_CFG_DRV0'/>"
WRITE #1 "        <register address='0xb2001cc' value='0x" DATA.LONG(A:0xb2001cc) "' name='RPMH_PDC_APPS_IRQ_47_CFG_DRV0'/>"
WRITE #1 "        <register address='0xb2001d0' value='0x" DATA.LONG(A:0xb2001d0) "' name='RPMH_PDC_APPS_IRQ_48_CFG_DRV0'/>"
WRITE #1 "        <register address='0xb2001d4' value='0x" DATA.LONG(A:0xb2001d4) "' name='RPMH_PDC_APPS_IRQ_49_CFG_DRV0'/>"
WRITE #1 "        <register address='0xb2001d8' value='0x" DATA.LONG(A:0xb2001d8) "' name='RPMH_PDC_APPS_IRQ_50_CFG_DRV0'/>"
WRITE #1 "        <register address='0xb2001dc' value='0x" DATA.LONG(A:0xb2001dc) "' name='RPMH_PDC_APPS_IRQ_51_CFG_DRV0'/>"
WRITE #1 "        <register address='0xb210110' value='0x" DATA.LONG(A:0xb210110) "' name='RPMH_PDC_APPS_IRQ_0_CFG_DRV1'/>"
WRITE #1 "        <register address='0xb210114' value='0x" DATA.LONG(A:0xb210114) "' name='RPMH_PDC_APPS_IRQ_1_CFG_DRV1'/>"
WRITE #1 "        <register address='0xb210118' value='0x" DATA.LONG(A:0xb210118) "' name='RPMH_PDC_APPS_IRQ_2_CFG_DRV1'/>"
WRITE #1 "        <register address='0xb21011c' value='0x" DATA.LONG(A:0xb21011c) "' name='RPMH_PDC_APPS_IRQ_3_CFG_DRV1'/>"
WRITE #1 "        <register address='0xb210120' value='0x" DATA.LONG(A:0xb210120) "' name='RPMH_PDC_APPS_IRQ_4_CFG_DRV1'/>"
WRITE #1 "        <register address='0xb210124' value='0x" DATA.LONG(A:0xb210124) "' name='RPMH_PDC_APPS_IRQ_5_CFG_DRV1'/>"
WRITE #1 "        <register address='0xb210128' value='0x" DATA.LONG(A:0xb210128) "' name='RPMH_PDC_APPS_IRQ_6_CFG_DRV1'/>"
WRITE #1 "        <register address='0xb21012c' value='0x" DATA.LONG(A:0xb21012c) "' name='RPMH_PDC_APPS_IRQ_7_CFG_DRV1'/>"
WRITE #1 "        <register address='0xb210130' value='0x" DATA.LONG(A:0xb210130) "' name='RPMH_PDC_APPS_IRQ_8_CFG_DRV1'/>"
WRITE #1 "        <register address='0xb210134' value='0x" DATA.LONG(A:0xb210134) "' name='RPMH_PDC_APPS_IRQ_9_CFG_DRV1'/>"
WRITE #1 "        <register address='0xb210138' value='0x" DATA.LONG(A:0xb210138) "' name='RPMH_PDC_APPS_IRQ_10_CFG_DRV1'/>"
WRITE #1 "        <register address='0xb21013c' value='0x" DATA.LONG(A:0xb21013c) "' name='RPMH_PDC_APPS_IRQ_11_CFG_DRV1'/>"
WRITE #1 "        <register address='0xb210140' value='0x" DATA.LONG(A:0xb210140) "' name='RPMH_PDC_APPS_IRQ_12_CFG_DRV1'/>"
WRITE #1 "        <register address='0xb210144' value='0x" DATA.LONG(A:0xb210144) "' name='RPMH_PDC_APPS_IRQ_13_CFG_DRV1'/>"
WRITE #1 "        <register address='0xb210148' value='0x" DATA.LONG(A:0xb210148) "' name='RPMH_PDC_APPS_IRQ_14_CFG_DRV1'/>"
WRITE #1 "        <register address='0xb21014c' value='0x" DATA.LONG(A:0xb21014c) "' name='RPMH_PDC_APPS_IRQ_15_CFG_DRV1'/>"
WRITE #1 "        <register address='0xb210150' value='0x" DATA.LONG(A:0xb210150) "' name='RPMH_PDC_APPS_IRQ_16_CFG_DRV1'/>"
WRITE #1 "        <register address='0xb210154' value='0x" DATA.LONG(A:0xb210154) "' name='RPMH_PDC_APPS_IRQ_17_CFG_DRV1'/>"
WRITE #1 "        <register address='0xb210158' value='0x" DATA.LONG(A:0xb210158) "' name='RPMH_PDC_APPS_IRQ_18_CFG_DRV1'/>"
WRITE #1 "        <register address='0xb21015c' value='0x" DATA.LONG(A:0xb21015c) "' name='RPMH_PDC_APPS_IRQ_19_CFG_DRV1'/>"
WRITE #1 "        <register address='0xb210160' value='0x" DATA.LONG(A:0xb210160) "' name='RPMH_PDC_APPS_IRQ_20_CFG_DRV1'/>"
WRITE #1 "        <register address='0xb210164' value='0x" DATA.LONG(A:0xb210164) "' name='RPMH_PDC_APPS_IRQ_21_CFG_DRV1'/>"
WRITE #1 "        <register address='0xb210168' value='0x" DATA.LONG(A:0xb210168) "' name='RPMH_PDC_APPS_IRQ_22_CFG_DRV1'/>"
WRITE #1 "        <register address='0xb21016c' value='0x" DATA.LONG(A:0xb21016c) "' name='RPMH_PDC_APPS_IRQ_23_CFG_DRV1'/>"
WRITE #1 "        <register address='0xb210170' value='0x" DATA.LONG(A:0xb210170) "' name='RPMH_PDC_APPS_IRQ_24_CFG_DRV1'/>"
WRITE #1 "        <register address='0xb210174' value='0x" DATA.LONG(A:0xb210174) "' name='RPMH_PDC_APPS_IRQ_25_CFG_DRV1'/>"
WRITE #1 "        <register address='0xb210178' value='0x" DATA.LONG(A:0xb210178) "' name='RPMH_PDC_APPS_IRQ_26_CFG_DRV1'/>"
WRITE #1 "        <register address='0xb21017c' value='0x" DATA.LONG(A:0xb21017c) "' name='RPMH_PDC_APPS_IRQ_27_CFG_DRV1'/>"
WRITE #1 "        <register address='0xb210180' value='0x" DATA.LONG(A:0xb210180) "' name='RPMH_PDC_APPS_IRQ_28_CFG_DRV1'/>"
WRITE #1 "        <register address='0xb210184' value='0x" DATA.LONG(A:0xb210184) "' name='RPMH_PDC_APPS_IRQ_29_CFG_DRV1'/>"
WRITE #1 "        <register address='0xb210188' value='0x" DATA.LONG(A:0xb210188) "' name='RPMH_PDC_APPS_IRQ_30_CFG_DRV1'/>"
WRITE #1 "        <register address='0xb21018c' value='0x" DATA.LONG(A:0xb21018c) "' name='RPMH_PDC_APPS_IRQ_31_CFG_DRV1'/>"
WRITE #1 "        <register address='0xb210190' value='0x" DATA.LONG(A:0xb210190) "' name='RPMH_PDC_APPS_IRQ_32_CFG_DRV1'/>"
WRITE #1 "        <register address='0xb210194' value='0x" DATA.LONG(A:0xb210194) "' name='RPMH_PDC_APPS_IRQ_33_CFG_DRV1'/>"
WRITE #1 "        <register address='0xb210198' value='0x" DATA.LONG(A:0xb210198) "' name='RPMH_PDC_APPS_IRQ_34_CFG_DRV1'/>"
WRITE #1 "        <register address='0xb21019c' value='0x" DATA.LONG(A:0xb21019c) "' name='RPMH_PDC_APPS_IRQ_35_CFG_DRV1'/>"
WRITE #1 "        <register address='0xb2101a0' value='0x" DATA.LONG(A:0xb2101a0) "' name='RPMH_PDC_APPS_IRQ_36_CFG_DRV1'/>"
WRITE #1 "        <register address='0xb2101a4' value='0x" DATA.LONG(A:0xb2101a4) "' name='RPMH_PDC_APPS_IRQ_37_CFG_DRV1'/>"
WRITE #1 "        <register address='0xb2101a8' value='0x" DATA.LONG(A:0xb2101a8) "' name='RPMH_PDC_APPS_IRQ_38_CFG_DRV1'/>"
WRITE #1 "        <register address='0xb2101ac' value='0x" DATA.LONG(A:0xb2101ac) "' name='RPMH_PDC_APPS_IRQ_39_CFG_DRV1'/>"
WRITE #1 "        <register address='0xb2101b0' value='0x" DATA.LONG(A:0xb2101b0) "' name='RPMH_PDC_APPS_IRQ_40_CFG_DRV1'/>"
WRITE #1 "        <register address='0xb2101b4' value='0x" DATA.LONG(A:0xb2101b4) "' name='RPMH_PDC_APPS_IRQ_41_CFG_DRV1'/>"
WRITE #1 "        <register address='0xb2101b8' value='0x" DATA.LONG(A:0xb2101b8) "' name='RPMH_PDC_APPS_IRQ_42_CFG_DRV1'/>"
WRITE #1 "        <register address='0xb2101bc' value='0x" DATA.LONG(A:0xb2101bc) "' name='RPMH_PDC_APPS_IRQ_43_CFG_DRV1'/>"
WRITE #1 "        <register address='0xb2101c0' value='0x" DATA.LONG(A:0xb2101c0) "' name='RPMH_PDC_APPS_IRQ_44_CFG_DRV1'/>"
WRITE #1 "        <register address='0xb2101c4' value='0x" DATA.LONG(A:0xb2101c4) "' name='RPMH_PDC_APPS_IRQ_45_CFG_DRV1'/>"
WRITE #1 "        <register address='0xb2101c8' value='0x" DATA.LONG(A:0xb2101c8) "' name='RPMH_PDC_APPS_IRQ_46_CFG_DRV1'/>"
WRITE #1 "        <register address='0xb2101cc' value='0x" DATA.LONG(A:0xb2101cc) "' name='RPMH_PDC_APPS_IRQ_47_CFG_DRV1'/>"
WRITE #1 "        <register address='0xb2101d0' value='0x" DATA.LONG(A:0xb2101d0) "' name='RPMH_PDC_APPS_IRQ_48_CFG_DRV1'/>"
WRITE #1 "        <register address='0xb2101d4' value='0x" DATA.LONG(A:0xb2101d4) "' name='RPMH_PDC_APPS_IRQ_49_CFG_DRV1'/>"
WRITE #1 "        <register address='0xb2101d8' value='0x" DATA.LONG(A:0xb2101d8) "' name='RPMH_PDC_APPS_IRQ_50_CFG_DRV1'/>"
WRITE #1 "        <register address='0xb2101dc' value='0x" DATA.LONG(A:0xb2101dc) "' name='RPMH_PDC_APPS_IRQ_51_CFG_DRV1'/>"
WRITE #1 "        <register address='0xb200900' value='0x" DATA.LONG(A:0xb200900) "' name='RPMH_PDC_APPS_IRQ_STATUS_BANK0_DRV0'/>"
WRITE #1 "        <register address='0xb200904' value='0x" DATA.LONG(A:0xb200904) "' name='RPMH_PDC_APPS_IRQ_STATUS_BANK1_DRV0'/>"
WRITE #1 "        <register address='0xb210900' value='0x" DATA.LONG(A:0xb210900) "' name='RPMH_PDC_APPS_IRQ_STATUS_BANK0_DRV1'/>"
WRITE #1 "        <register address='0xb210904' value='0x" DATA.LONG(A:0xb210904) "' name='RPMH_PDC_APPS_IRQ_STATUS_BANK1_DRV1'/>"
WRITE #1 "        <register address='0xb201000' value='0x" DATA.LONG(A:0xb201000) "' name='RPMH_PDC_APPS_PDC_VERSION_DRV0'/>"
WRITE #1 "        <register address='0xb211000' value='0x" DATA.LONG(A:0xb211000) "' name='RPMH_PDC_APPS_PDC_VERSION_DRV1'/>"
WRITE #1 "        <register address='0xb201004' value='0x" DATA.LONG(A:0xb201004) "' name='RPMH_PDC_APPS_PDC_PARAM_RESOURCE_DRV0'/>"
WRITE #1 "        <register address='0xb211004' value='0x" DATA.LONG(A:0xb211004) "' name='RPMH_PDC_APPS_PDC_PARAM_RESOURCE_DRV1'/>"
WRITE #1 "        <register address='0xb201008' value='0x" DATA.LONG(A:0xb201008) "' name='RPMH_PDC_APPS_PDC_PARAM_SEQ_CONFIG_DRV0'/>"
WRITE #1 "        <register address='0xb211008' value='0x" DATA.LONG(A:0xb211008) "' name='RPMH_PDC_APPS_PDC_PARAM_SEQ_CONFIG_DRV1'/>"
WRITE #1 "        <register address='0xb20100c' value='0x" DATA.LONG(A:0xb20100c) "' name='RPMH_PDC_APPS_PDC_PARAM_IRQ_CONFIG_DRV0'/>"
WRITE #1 "        <register address='0xb21100c' value='0x" DATA.LONG(A:0xb21100c) "' name='RPMH_PDC_APPS_PDC_PARAM_IRQ_CONFIG_DRV1'/>"
WRITE #1 "        <register address='0xb201020' value='0x" DATA.LONG(A:0xb201020) "' name='RPMH_PDC_APPS_SEQ_BUSY_DRV0'/>"
WRITE #1 "        <register address='0xb211020' value='0x" DATA.LONG(A:0xb211020) "' name='RPMH_PDC_APPS_SEQ_BUSY_DRV1'/>"
WRITE #1 "        <register address='0xb201030' value='0x" DATA.LONG(A:0xb201030) "' name='RPMH_PDC_APPS_PDC_MODE_STATUS_DRV0'/>"
WRITE #1 "        <register address='0xb211030' value='0x" DATA.LONG(A:0xb211030) "' name='RPMH_PDC_APPS_PDC_MODE_STATUS_DRV1'/>"
WRITE #1 "        <register address='0xb201200' value='0x" DATA.LONG(A:0xb201200) "' name='RPMH_PDC_APPS_PROFILING_UNIT0_DRV0_OUTPUT'/>"
WRITE #1 "        <register address='0xb201214' value='0x" DATA.LONG(A:0xb201214) "' name='RPMH_PDC_APPS_PROFILING_UNIT1_DRV0_OUTPUT'/>"
WRITE #1 "        <register address='0xb201228' value='0x" DATA.LONG(A:0xb201228) "' name='RPMH_PDC_APPS_PROFILING_UNIT2_DRV0_OUTPUT'/>"
WRITE #1 "        <register address='0xb20123c' value='0x" DATA.LONG(A:0xb20123c) "' name='RPMH_PDC_APPS_PROFILING_UNIT3_DRV0_OUTPUT'/>"
WRITE #1 "        <register address='0xb201250' value='0x" DATA.LONG(A:0xb201250) "' name='RPMH_PDC_APPS_PROFILING_UNIT4_DRV0_OUTPUT'/>"
WRITE #1 "        <register address='0xb211200' value='0x" DATA.LONG(A:0xb211200) "' name='RPMH_PDC_APPS_PROFILING_UNIT0_DRV1_OUTPUT'/>"
WRITE #1 "        <register address='0xb211214' value='0x" DATA.LONG(A:0xb211214) "' name='RPMH_PDC_APPS_PROFILING_UNIT1_DRV1_OUTPUT'/>"
WRITE #1 "        <register address='0xb211228' value='0x" DATA.LONG(A:0xb211228) "' name='RPMH_PDC_APPS_PROFILING_UNIT2_DRV1_OUTPUT'/>"
WRITE #1 "        <register address='0xb21123c' value='0x" DATA.LONG(A:0xb21123c) "' name='RPMH_PDC_APPS_PROFILING_UNIT3_DRV1_OUTPUT'/>"
WRITE #1 "        <register address='0xb211250' value='0x" DATA.LONG(A:0xb211250) "' name='RPMH_PDC_APPS_PROFILING_UNIT4_DRV1_OUTPUT'/>"
WRITE #1 "        <register address='0xb201204' value='0x" DATA.LONG(A:0xb201204) "' name='RPMH_PDC_APPS_PROFILING_UNIT0_DRV0_TIMESTAMP_LO'/>"
WRITE #1 "        <register address='0xb201218' value='0x" DATA.LONG(A:0xb201218) "' name='RPMH_PDC_APPS_PROFILING_UNIT1_DRV0_TIMESTAMP_LO'/>"
WRITE #1 "        <register address='0xb20122c' value='0x" DATA.LONG(A:0xb20122c) "' name='RPMH_PDC_APPS_PROFILING_UNIT2_DRV0_TIMESTAMP_LO'/>"
WRITE #1 "        <register address='0xb201240' value='0x" DATA.LONG(A:0xb201240) "' name='RPMH_PDC_APPS_PROFILING_UNIT3_DRV0_TIMESTAMP_LO'/>"
WRITE #1 "        <register address='0xb201254' value='0x" DATA.LONG(A:0xb201254) "' name='RPMH_PDC_APPS_PROFILING_UNIT4_DRV0_TIMESTAMP_LO'/>"
WRITE #1 "        <register address='0xb211204' value='0x" DATA.LONG(A:0xb211204) "' name='RPMH_PDC_APPS_PROFILING_UNIT0_DRV1_TIMESTAMP_LO'/>"
WRITE #1 "        <register address='0xb211218' value='0x" DATA.LONG(A:0xb211218) "' name='RPMH_PDC_APPS_PROFILING_UNIT1_DRV1_TIMESTAMP_LO'/>"
WRITE #1 "        <register address='0xb21122c' value='0x" DATA.LONG(A:0xb21122c) "' name='RPMH_PDC_APPS_PROFILING_UNIT2_DRV1_TIMESTAMP_LO'/>"
WRITE #1 "        <register address='0xb211240' value='0x" DATA.LONG(A:0xb211240) "' name='RPMH_PDC_APPS_PROFILING_UNIT3_DRV1_TIMESTAMP_LO'/>"
WRITE #1 "        <register address='0xb211254' value='0x" DATA.LONG(A:0xb211254) "' name='RPMH_PDC_APPS_PROFILING_UNIT4_DRV1_TIMESTAMP_LO'/>"
WRITE #1 "        <register address='0xb201208' value='0x" DATA.LONG(A:0xb201208) "' name='RPMH_PDC_APPS_PROFILING_UNIT0_DRV0_TIMESTAMP_HI'/>"
WRITE #1 "        <register address='0xb20121c' value='0x" DATA.LONG(A:0xb20121c) "' name='RPMH_PDC_APPS_PROFILING_UNIT1_DRV0_TIMESTAMP_HI'/>"
WRITE #1 "        <register address='0xb201230' value='0x" DATA.LONG(A:0xb201230) "' name='RPMH_PDC_APPS_PROFILING_UNIT2_DRV0_TIMESTAMP_HI'/>"
WRITE #1 "        <register address='0xb201244' value='0x" DATA.LONG(A:0xb201244) "' name='RPMH_PDC_APPS_PROFILING_UNIT3_DRV0_TIMESTAMP_HI'/>"
WRITE #1 "        <register address='0xb201258' value='0x" DATA.LONG(A:0xb201258) "' name='RPMH_PDC_APPS_PROFILING_UNIT4_DRV0_TIMESTAMP_HI'/>"
WRITE #1 "        <register address='0xb211208' value='0x" DATA.LONG(A:0xb211208) "' name='RPMH_PDC_APPS_PROFILING_UNIT0_DRV1_TIMESTAMP_HI'/>"
WRITE #1 "        <register address='0xb21121c' value='0x" DATA.LONG(A:0xb21121c) "' name='RPMH_PDC_APPS_PROFILING_UNIT1_DRV1_TIMESTAMP_HI'/>"
WRITE #1 "        <register address='0xb211230' value='0x" DATA.LONG(A:0xb211230) "' name='RPMH_PDC_APPS_PROFILING_UNIT2_DRV1_TIMESTAMP_HI'/>"
WRITE #1 "        <register address='0xb211244' value='0x" DATA.LONG(A:0xb211244) "' name='RPMH_PDC_APPS_PROFILING_UNIT3_DRV1_TIMESTAMP_HI'/>"
WRITE #1 "        <register address='0xb211258' value='0x" DATA.LONG(A:0xb211258) "' name='RPMH_PDC_APPS_PROFILING_UNIT4_DRV1_TIMESTAMP_HI'/>"
WRITE #1 "        <register address='0xb201300' value='0x" DATA.LONG(A:0xb201300) "' name='RPMH_PDC_APPS_TCS0_DRV0_STATUS'/>"
WRITE #1 "        <register address='0xb2013c8' value='0x" DATA.LONG(A:0xb2013c8) "' name='RPMH_PDC_APPS_TCS1_DRV0_STATUS'/>"
WRITE #1 "        <register address='0xb201490' value='0x" DATA.LONG(A:0xb201490) "' name='RPMH_PDC_APPS_TCS2_DRV0_STATUS'/>"
WRITE #1 "        <register address='0xb201558' value='0x" DATA.LONG(A:0xb201558) "' name='RPMH_PDC_APPS_TCS3_DRV0_STATUS'/>"
WRITE #1 "        <register address='0xb211300' value='0x" DATA.LONG(A:0xb211300) "' name='RPMH_PDC_APPS_TCS0_DRV1_STATUS'/>"
WRITE #1 "        <register address='0xb2113c8' value='0x" DATA.LONG(A:0xb2113c8) "' name='RPMH_PDC_APPS_TCS1_DRV1_STATUS'/>"
WRITE #1 "        <register address='0xb211490' value='0x" DATA.LONG(A:0xb211490) "' name='RPMH_PDC_APPS_TCS2_DRV1_STATUS'/>"
WRITE #1 "        <register address='0xb211558' value='0x" DATA.LONG(A:0xb211558) "' name='RPMH_PDC_APPS_TCS3_DRV1_STATUS'/>"
WRITE #1 "        <register address='0xb201304' value='0x" DATA.LONG(A:0xb201304) "' name='RPMH_PDC_APPS_TCS0_CMD0_DRV0_STATUS'/>"
WRITE #1 "        <register address='0xb20130c' value='0x" DATA.LONG(A:0xb20130c) "' name='RPMH_PDC_APPS_TCS0_CMD1_DRV0_STATUS'/>"
WRITE #1 "        <register address='0xb201314' value='0x" DATA.LONG(A:0xb201314) "' name='RPMH_PDC_APPS_TCS0_CMD2_DRV0_STATUS'/>"
WRITE #1 "        <register address='0xb20131c' value='0x" DATA.LONG(A:0xb20131c) "' name='RPMH_PDC_APPS_TCS0_CMD3_DRV0_STATUS'/>"
WRITE #1 "        <register address='0xb2013cc' value='0x" DATA.LONG(A:0xb2013cc) "' name='RPMH_PDC_APPS_TCS1_CMD0_DRV0_STATUS'/>"
WRITE #1 "        <register address='0xb2013d4' value='0x" DATA.LONG(A:0xb2013d4) "' name='RPMH_PDC_APPS_TCS1_CMD1_DRV0_STATUS'/>"
WRITE #1 "        <register address='0xb2013dc' value='0x" DATA.LONG(A:0xb2013dc) "' name='RPMH_PDC_APPS_TCS1_CMD2_DRV0_STATUS'/>"
WRITE #1 "        <register address='0xb2013e4' value='0x" DATA.LONG(A:0xb2013e4) "' name='RPMH_PDC_APPS_TCS1_CMD3_DRV0_STATUS'/>"
WRITE #1 "        <register address='0xb201494' value='0x" DATA.LONG(A:0xb201494) "' name='RPMH_PDC_APPS_TCS2_CMD0_DRV0_STATUS'/>"
WRITE #1 "        <register address='0xb20149c' value='0x" DATA.LONG(A:0xb20149c) "' name='RPMH_PDC_APPS_TCS2_CMD1_DRV0_STATUS'/>"
WRITE #1 "        <register address='0xb2014a4' value='0x" DATA.LONG(A:0xb2014a4) "' name='RPMH_PDC_APPS_TCS2_CMD2_DRV0_STATUS'/>"
WRITE #1 "        <register address='0xb2014ac' value='0x" DATA.LONG(A:0xb2014ac) "' name='RPMH_PDC_APPS_TCS2_CMD3_DRV0_STATUS'/>"
WRITE #1 "        <register address='0xb20155c' value='0x" DATA.LONG(A:0xb20155c) "' name='RPMH_PDC_APPS_TCS3_CMD0_DRV0_STATUS'/>"
WRITE #1 "        <register address='0xb201564' value='0x" DATA.LONG(A:0xb201564) "' name='RPMH_PDC_APPS_TCS3_CMD1_DRV0_STATUS'/>"
WRITE #1 "        <register address='0xb20156c' value='0x" DATA.LONG(A:0xb20156c) "' name='RPMH_PDC_APPS_TCS3_CMD2_DRV0_STATUS'/>"
WRITE #1 "        <register address='0xb201574' value='0x" DATA.LONG(A:0xb201574) "' name='RPMH_PDC_APPS_TCS3_CMD3_DRV0_STATUS'/>"
WRITE #1 "        <register address='0xb211304' value='0x" DATA.LONG(A:0xb211304) "' name='RPMH_PDC_APPS_TCS0_CMD0_DRV1_STATUS'/>"
WRITE #1 "        <register address='0xb21130c' value='0x" DATA.LONG(A:0xb21130c) "' name='RPMH_PDC_APPS_TCS0_CMD1_DRV1_STATUS'/>"
WRITE #1 "        <register address='0xb211314' value='0x" DATA.LONG(A:0xb211314) "' name='RPMH_PDC_APPS_TCS0_CMD2_DRV1_STATUS'/>"
WRITE #1 "        <register address='0xb21131c' value='0x" DATA.LONG(A:0xb21131c) "' name='RPMH_PDC_APPS_TCS0_CMD3_DRV1_STATUS'/>"
WRITE #1 "        <register address='0xb2113cc' value='0x" DATA.LONG(A:0xb2113cc) "' name='RPMH_PDC_APPS_TCS1_CMD0_DRV1_STATUS'/>"
WRITE #1 "        <register address='0xb2113d4' value='0x" DATA.LONG(A:0xb2113d4) "' name='RPMH_PDC_APPS_TCS1_CMD1_DRV1_STATUS'/>"
WRITE #1 "        <register address='0xb2113dc' value='0x" DATA.LONG(A:0xb2113dc) "' name='RPMH_PDC_APPS_TCS1_CMD2_DRV1_STATUS'/>"
WRITE #1 "        <register address='0xb2113e4' value='0x" DATA.LONG(A:0xb2113e4) "' name='RPMH_PDC_APPS_TCS1_CMD3_DRV1_STATUS'/>"
WRITE #1 "        <register address='0xb211494' value='0x" DATA.LONG(A:0xb211494) "' name='RPMH_PDC_APPS_TCS2_CMD0_DRV1_STATUS'/>"
WRITE #1 "        <register address='0xb21149c' value='0x" DATA.LONG(A:0xb21149c) "' name='RPMH_PDC_APPS_TCS2_CMD1_DRV1_STATUS'/>"
WRITE #1 "        <register address='0xb2114a4' value='0x" DATA.LONG(A:0xb2114a4) "' name='RPMH_PDC_APPS_TCS2_CMD2_DRV1_STATUS'/>"
WRITE #1 "        <register address='0xb2114ac' value='0x" DATA.LONG(A:0xb2114ac) "' name='RPMH_PDC_APPS_TCS2_CMD3_DRV1_STATUS'/>"
WRITE #1 "        <register address='0xb21155c' value='0x" DATA.LONG(A:0xb21155c) "' name='RPMH_PDC_APPS_TCS3_CMD0_DRV1_STATUS'/>"
WRITE #1 "        <register address='0xb211564' value='0x" DATA.LONG(A:0xb211564) "' name='RPMH_PDC_APPS_TCS3_CMD1_DRV1_STATUS'/>"
WRITE #1 "        <register address='0xb21156c' value='0x" DATA.LONG(A:0xb21156c) "' name='RPMH_PDC_APPS_TCS3_CMD2_DRV1_STATUS'/>"
WRITE #1 "        <register address='0xb211574' value='0x" DATA.LONG(A:0xb211574) "' name='RPMH_PDC_APPS_TCS3_CMD3_DRV1_STATUS'/>"
WRITE #1 "        <register address='0xb204500' value='0x" DATA.LONG(A:0xb204500) "' name='RPMH_PDC_APPS_ENABLE_PDC'/>"
WRITE #1 "        <register address='0xb204510' value='0x" DATA.LONG(A:0xb204510) "' name='RPMH_PDC_APPS_TIMER_MATCH_VALUE_LO'/>"
WRITE #1 "        <register address='0xb204514' value='0x" DATA.LONG(A:0xb204514) "' name='RPMH_PDC_APPS_TIMER_MATCH_VALUE_HI'/>"
WRITE #1 "        <register address='0xb204518' value='0x" DATA.LONG(A:0xb204518) "' name='RPMH_PDC_APPS_TIMER_DISABLED_FOR_ARC'/>"
WRITE #1 "        <register address='0xb204520' value='0x" DATA.LONG(A:0xb204520) "' name='RPMH_PDC_APPS_SEQ_START_ADDR'/>"
WRITE #1 "        <register address='0xb204524' value='0x" DATA.LONG(A:0xb204524) "' name='RPMH_PDC_APPS_SEQ_OVERRIDE_START_ADDR'/>"
WRITE #1 "        <register address='0xb20452c' value='0x" DATA.LONG(A:0xb20452c) "' name='RPMH_PDC_APPS_SEQ_OVERRIDE_TRIGGER'/>"
WRITE #1 "        <register address='0xb204530' value='0x" DATA.LONG(A:0xb204530) "' name='RPMH_PDC_APPS_SEQ_PWR_CTRL_OVERRIDE_MASK'/>"
WRITE #1 "        <register address='0xb204534' value='0x" DATA.LONG(A:0xb204534) "' name='RPMH_PDC_APPS_SEQ_PWR_CTRL_OVERRIDE_VAL'/>"
WRITE #1 "        <register address='0xb204540' value='0x" DATA.LONG(A:0xb204540) "' name='RPMH_PDC_APPS_SEQ_WAIT_EVENT_OVERRIDE_MASK'/>"
WRITE #1 "        <register address='0xb204544' value='0x" DATA.LONG(A:0xb204544) "' name='RPMH_PDC_APPS_SEQ_WAIT_EVENT_OVERRIDE_VAL'/>"
WRITE #1 "        <register address='0xb204550' value='0x" DATA.LONG(A:0xb204550) "' name='RPMH_PDC_APPS_SEQ_BR_EVENT_OVERRIDE_MASK'/>"
WRITE #1 "        <register address='0xb204554' value='0x" DATA.LONG(A:0xb204554) "' name='RPMH_PDC_APPS_SEQ_BR_EVENT_OVERRIDE_VAL'/>"
WRITE #1 "        <register address='0xb204590' value='0x" DATA.LONG(A:0xb204590) "' name='RPMH_PDC_APPS_SEQ_CFG_BR_ADDR_0'/>"
WRITE #1 "        <register address='0xb204594' value='0x" DATA.LONG(A:0xb204594) "' name='RPMH_PDC_APPS_SEQ_CFG_BR_ADDR_1'/>"
WRITE #1 "        <register address='0xb204598' value='0x" DATA.LONG(A:0xb204598) "' name='RPMH_PDC_APPS_SEQ_CFG_BR_ADDR_2'/>"
WRITE #1 "        <register address='0xb20459c' value='0x" DATA.LONG(A:0xb20459c) "' name='RPMH_PDC_APPS_SEQ_CFG_BR_ADDR_3'/>"
WRITE #1 "        <register address='0xb2045a0' value='0x" DATA.LONG(A:0xb2045a0) "' name='RPMH_PDC_APPS_SEQ_CFG_DELAY_VAL_0'/>"
WRITE #1 "        <register address='0xb2045a4' value='0x" DATA.LONG(A:0xb2045a4) "' name='RPMH_PDC_APPS_SEQ_CFG_DELAY_VAL_1'/>"
WRITE #1 "        <register address='0xb2045a8' value='0x" DATA.LONG(A:0xb2045a8) "' name='RPMH_PDC_APPS_SEQ_CFG_DELAY_VAL_2'/>"
WRITE #1 "        <register address='0xb2045ac' value='0x" DATA.LONG(A:0xb2045ac) "' name='RPMH_PDC_APPS_SEQ_CFG_DELAY_VAL_3'/>"
WRITE #1 "        <register address='0xb2045b0' value='0x" DATA.LONG(A:0xb2045b0) "' name='RPMH_PDC_APPS_SEQ_CFG_DELAY_VAL_4'/>"
WRITE #1 "        <register address='0xb2045b4' value='0x" DATA.LONG(A:0xb2045b4) "' name='RPMH_PDC_APPS_SEQ_CFG_DELAY_VAL_5'/>"
WRITE #1 "        <register address='0xb2045b8' value='0x" DATA.LONG(A:0xb2045b8) "' name='RPMH_PDC_APPS_SEQ_CFG_DELAY_VAL_6'/>"
WRITE #1 "        <register address='0xb2045bc' value='0x" DATA.LONG(A:0xb2045bc) "' name='RPMH_PDC_APPS_SEQ_CFG_DELAY_VAL_7'/>"
WRITE #1 "        <register address='0xb2045c0' value='0x" DATA.LONG(A:0xb2045c0) "' name='RPMH_PDC_APPS_SEQ_CFG_DELAY_VAL_8'/>"
WRITE #1 "        <register address='0xb2045c4' value='0x" DATA.LONG(A:0xb2045c4) "' name='RPMH_PDC_APPS_SEQ_CFG_DELAY_VAL_9'/>"
WRITE #1 "        <register address='0xb2045c8' value='0x" DATA.LONG(A:0xb2045c8) "' name='RPMH_PDC_APPS_SEQ_CFG_DELAY_VAL_10'/>"
WRITE #1 "        <register address='0xb2045cc' value='0x" DATA.LONG(A:0xb2045cc) "' name='RPMH_PDC_APPS_SEQ_CFG_DELAY_VAL_11'/>"
WRITE #1 "        <register address='0xb2045d0' value='0x" DATA.LONG(A:0xb2045d0) "' name='RPMH_PDC_APPS_SEQ_CFG_DELAY_VAL_12'/>"
WRITE #1 "        <register address='0xb2045d4' value='0x" DATA.LONG(A:0xb2045d4) "' name='RPMH_PDC_APPS_SEQ_CFG_DELAY_VAL_13'/>"
WRITE #1 "        <register address='0xb2045d8' value='0x" DATA.LONG(A:0xb2045d8) "' name='RPMH_PDC_APPS_SEQ_CFG_DELAY_VAL_14'/>"
WRITE #1 "        <register address='0xb2045dc' value='0x" DATA.LONG(A:0xb2045dc) "' name='RPMH_PDC_APPS_SEQ_CFG_DELAY_VAL_15'/>"
WRITE #1 "        <register address='0xb204600' value='0x" DATA.LONG(A:0xb204600) "' name='RPMH_PDC_APPS_IRQ_0_OWNER'/>"
WRITE #1 "        <register address='0xb204604' value='0x" DATA.LONG(A:0xb204604) "' name='RPMH_PDC_APPS_IRQ_1_OWNER'/>"
WRITE #1 "        <register address='0xb204608' value='0x" DATA.LONG(A:0xb204608) "' name='RPMH_PDC_APPS_IRQ_2_OWNER'/>"
WRITE #1 "        <register address='0xb20460c' value='0x" DATA.LONG(A:0xb20460c) "' name='RPMH_PDC_APPS_IRQ_3_OWNER'/>"
WRITE #1 "        <register address='0xb204610' value='0x" DATA.LONG(A:0xb204610) "' name='RPMH_PDC_APPS_IRQ_4_OWNER'/>"
WRITE #1 "        <register address='0xb204614' value='0x" DATA.LONG(A:0xb204614) "' name='RPMH_PDC_APPS_IRQ_5_OWNER'/>"
WRITE #1 "        <register address='0xb204618' value='0x" DATA.LONG(A:0xb204618) "' name='RPMH_PDC_APPS_IRQ_6_OWNER'/>"
WRITE #1 "        <register address='0xb20461c' value='0x" DATA.LONG(A:0xb20461c) "' name='RPMH_PDC_APPS_IRQ_7_OWNER'/>"
WRITE #1 "        <register address='0xb204620' value='0x" DATA.LONG(A:0xb204620) "' name='RPMH_PDC_APPS_IRQ_8_OWNER'/>"
WRITE #1 "        <register address='0xb204624' value='0x" DATA.LONG(A:0xb204624) "' name='RPMH_PDC_APPS_IRQ_9_OWNER'/>"
WRITE #1 "        <register address='0xb204628' value='0x" DATA.LONG(A:0xb204628) "' name='RPMH_PDC_APPS_IRQ_10_OWNER'/>"
WRITE #1 "        <register address='0xb20462c' value='0x" DATA.LONG(A:0xb20462c) "' name='RPMH_PDC_APPS_IRQ_11_OWNER'/>"
WRITE #1 "        <register address='0xb204630' value='0x" DATA.LONG(A:0xb204630) "' name='RPMH_PDC_APPS_IRQ_12_OWNER'/>"
WRITE #1 "        <register address='0xb204634' value='0x" DATA.LONG(A:0xb204634) "' name='RPMH_PDC_APPS_IRQ_13_OWNER'/>"
WRITE #1 "        <register address='0xb204638' value='0x" DATA.LONG(A:0xb204638) "' name='RPMH_PDC_APPS_IRQ_14_OWNER'/>"
WRITE #1 "        <register address='0xb20463c' value='0x" DATA.LONG(A:0xb20463c) "' name='RPMH_PDC_APPS_IRQ_15_OWNER'/>"
WRITE #1 "        <register address='0xb204640' value='0x" DATA.LONG(A:0xb204640) "' name='RPMH_PDC_APPS_IRQ_16_OWNER'/>"
WRITE #1 "        <register address='0xb204644' value='0x" DATA.LONG(A:0xb204644) "' name='RPMH_PDC_APPS_IRQ_17_OWNER'/>"
WRITE #1 "        <register address='0xb204648' value='0x" DATA.LONG(A:0xb204648) "' name='RPMH_PDC_APPS_IRQ_18_OWNER'/>"
WRITE #1 "        <register address='0xb20464c' value='0x" DATA.LONG(A:0xb20464c) "' name='RPMH_PDC_APPS_IRQ_19_OWNER'/>"
WRITE #1 "        <register address='0xb204650' value='0x" DATA.LONG(A:0xb204650) "' name='RPMH_PDC_APPS_IRQ_20_OWNER'/>"
WRITE #1 "        <register address='0xb204654' value='0x" DATA.LONG(A:0xb204654) "' name='RPMH_PDC_APPS_IRQ_21_OWNER'/>"
WRITE #1 "        <register address='0xb204658' value='0x" DATA.LONG(A:0xb204658) "' name='RPMH_PDC_APPS_IRQ_22_OWNER'/>"
WRITE #1 "        <register address='0xb20465c' value='0x" DATA.LONG(A:0xb20465c) "' name='RPMH_PDC_APPS_IRQ_23_OWNER'/>"
WRITE #1 "        <register address='0xb204660' value='0x" DATA.LONG(A:0xb204660) "' name='RPMH_PDC_APPS_IRQ_24_OWNER'/>"
WRITE #1 "        <register address='0xb204664' value='0x" DATA.LONG(A:0xb204664) "' name='RPMH_PDC_APPS_IRQ_25_OWNER'/>"
WRITE #1 "        <register address='0xb204668' value='0x" DATA.LONG(A:0xb204668) "' name='RPMH_PDC_APPS_IRQ_26_OWNER'/>"
WRITE #1 "        <register address='0xb20466c' value='0x" DATA.LONG(A:0xb20466c) "' name='RPMH_PDC_APPS_IRQ_27_OWNER'/>"
WRITE #1 "        <register address='0xb204670' value='0x" DATA.LONG(A:0xb204670) "' name='RPMH_PDC_APPS_IRQ_28_OWNER'/>"
WRITE #1 "        <register address='0xb204674' value='0x" DATA.LONG(A:0xb204674) "' name='RPMH_PDC_APPS_IRQ_29_OWNER'/>"
WRITE #1 "        <register address='0xb204678' value='0x" DATA.LONG(A:0xb204678) "' name='RPMH_PDC_APPS_IRQ_30_OWNER'/>"
WRITE #1 "        <register address='0xb20467c' value='0x" DATA.LONG(A:0xb20467c) "' name='RPMH_PDC_APPS_IRQ_31_OWNER'/>"
WRITE #1 "        <register address='0xb204680' value='0x" DATA.LONG(A:0xb204680) "' name='RPMH_PDC_APPS_IRQ_32_OWNER'/>"
WRITE #1 "        <register address='0xb204684' value='0x" DATA.LONG(A:0xb204684) "' name='RPMH_PDC_APPS_IRQ_33_OWNER'/>"
WRITE #1 "        <register address='0xb204688' value='0x" DATA.LONG(A:0xb204688) "' name='RPMH_PDC_APPS_IRQ_34_OWNER'/>"
WRITE #1 "        <register address='0xb20468c' value='0x" DATA.LONG(A:0xb20468c) "' name='RPMH_PDC_APPS_IRQ_35_OWNER'/>"
WRITE #1 "        <register address='0xb204690' value='0x" DATA.LONG(A:0xb204690) "' name='RPMH_PDC_APPS_IRQ_36_OWNER'/>"
WRITE #1 "        <register address='0xb204694' value='0x" DATA.LONG(A:0xb204694) "' name='RPMH_PDC_APPS_IRQ_37_OWNER'/>"
WRITE #1 "        <register address='0xb204698' value='0x" DATA.LONG(A:0xb204698) "' name='RPMH_PDC_APPS_IRQ_38_OWNER'/>"
WRITE #1 "        <register address='0xb20469c' value='0x" DATA.LONG(A:0xb20469c) "' name='RPMH_PDC_APPS_IRQ_39_OWNER'/>"
WRITE #1 "        <register address='0xb2046a0' value='0x" DATA.LONG(A:0xb2046a0) "' name='RPMH_PDC_APPS_IRQ_40_OWNER'/>"
WRITE #1 "        <register address='0xb2046a4' value='0x" DATA.LONG(A:0xb2046a4) "' name='RPMH_PDC_APPS_IRQ_41_OWNER'/>"
WRITE #1 "        <register address='0xb2046a8' value='0x" DATA.LONG(A:0xb2046a8) "' name='RPMH_PDC_APPS_IRQ_42_OWNER'/>"
WRITE #1 "        <register address='0xb2046ac' value='0x" DATA.LONG(A:0xb2046ac) "' name='RPMH_PDC_APPS_IRQ_43_OWNER'/>"
WRITE #1 "        <register address='0xb2046b0' value='0x" DATA.LONG(A:0xb2046b0) "' name='RPMH_PDC_APPS_IRQ_44_OWNER'/>"
WRITE #1 "        <register address='0xb2046b4' value='0x" DATA.LONG(A:0xb2046b4) "' name='RPMH_PDC_APPS_IRQ_45_OWNER'/>"
WRITE #1 "        <register address='0xb2046b8' value='0x" DATA.LONG(A:0xb2046b8) "' name='RPMH_PDC_APPS_IRQ_46_OWNER'/>"
WRITE #1 "        <register address='0xb2046bc' value='0x" DATA.LONG(A:0xb2046bc) "' name='RPMH_PDC_APPS_IRQ_47_OWNER'/>"
WRITE #1 "        <register address='0xb2046c0' value='0x" DATA.LONG(A:0xb2046c0) "' name='RPMH_PDC_APPS_IRQ_48_OWNER'/>"
WRITE #1 "        <register address='0xb2046c4' value='0x" DATA.LONG(A:0xb2046c4) "' name='RPMH_PDC_APPS_IRQ_49_OWNER'/>"
WRITE #1 "        <register address='0xb2046c8' value='0x" DATA.LONG(A:0xb2046c8) "' name='RPMH_PDC_APPS_IRQ_50_OWNER'/>"
WRITE #1 "        <register address='0xb2046cc' value='0x" DATA.LONG(A:0xb2046cc) "' name='RPMH_PDC_APPS_IRQ_51_OWNER'/>"
WRITE #1 "        <register address='0xb204900' value='0x" DATA.LONG(A:0xb204900) "' name='RPMH_PDC_APPS_GP_IRQ_SELECT0'/>"
WRITE #1 "        <register address='0xb204914' value='0x" DATA.LONG(A:0xb204914) "' name='RPMH_PDC_APPS_GP_IRQ_SELECT1'/>"
WRITE #1 "        <register address='0xb204928' value='0x" DATA.LONG(A:0xb204928) "' name='RPMH_PDC_APPS_GP_IRQ_SELECT2'/>"
WRITE #1 "        <register address='0xb20493c' value='0x" DATA.LONG(A:0xb20493c) "' name='RPMH_PDC_APPS_GP_IRQ_SELECT3'/>"
WRITE #1 "        <register address='0xb204950' value='0x" DATA.LONG(A:0xb204950) "' name='RPMH_PDC_APPS_GP_IRQ_SELECT4'/>"
WRITE #1 "        <register address='0xb204964' value='0x" DATA.LONG(A:0xb204964) "' name='RPMH_PDC_APPS_GP_IRQ_SELECT5'/>"
WRITE #1 "        <register address='0xb204978' value='0x" DATA.LONG(A:0xb204978) "' name='RPMH_PDC_APPS_GP_IRQ_SELECT6'/>"
WRITE #1 "        <register address='0xb20498c' value='0x" DATA.LONG(A:0xb20498c) "' name='RPMH_PDC_APPS_GP_IRQ_SELECT7'/>"
WRITE #1 "        <register address='0xb2049a0' value='0x" DATA.LONG(A:0xb2049a0) "' name='RPMH_PDC_APPS_GP_IRQ_SELECT8'/>"
WRITE #1 "        <register address='0xb2049b4' value='0x" DATA.LONG(A:0xb2049b4) "' name='RPMH_PDC_APPS_GP_IRQ_SELECT9'/>"
WRITE #1 "        <register address='0xb2049c8' value='0x" DATA.LONG(A:0xb2049c8) "' name='RPMH_PDC_APPS_GP_IRQ_SELECT10'/>"
WRITE #1 "        <register address='0xb2049dc' value='0x" DATA.LONG(A:0xb2049dc) "' name='RPMH_PDC_APPS_GP_IRQ_SELECT11'/>"
WRITE #1 "        <register address='0xb2049f0' value='0x" DATA.LONG(A:0xb2049f0) "' name='RPMH_PDC_APPS_GP_IRQ_SELECT12'/>"
WRITE #1 "        <register address='0xb204a04' value='0x" DATA.LONG(A:0xb204a04) "' name='RPMH_PDC_APPS_GP_IRQ_SELECT13'/>"
WRITE #1 "        <register address='0xb204a18' value='0x" DATA.LONG(A:0xb204a18) "' name='RPMH_PDC_APPS_GP_IRQ_SELECT14'/>"
WRITE #1 "        <register address='0xb204a2c' value='0x" DATA.LONG(A:0xb204a2c) "' name='RPMH_PDC_APPS_GP_IRQ_SELECT15'/>"
WRITE #1 "        <register address='0xb204a40' value='0x" DATA.LONG(A:0xb204a40) "' name='RPMH_PDC_APPS_GP_IRQ_SELECT16'/>"
WRITE #1 "        <register address='0xb204a54' value='0x" DATA.LONG(A:0xb204a54) "' name='RPMH_PDC_APPS_GP_IRQ_SELECT17'/>"
WRITE #1 "        <register address='0xb204a68' value='0x" DATA.LONG(A:0xb204a68) "' name='RPMH_PDC_APPS_GP_IRQ_SELECT18'/>"
WRITE #1 "        <register address='0xb204a7c' value='0x" DATA.LONG(A:0xb204a7c) "' name='RPMH_PDC_APPS_GP_IRQ_SELECT19'/>"
WRITE #1 "        <register address='0xb204a90' value='0x" DATA.LONG(A:0xb204a90) "' name='RPMH_PDC_APPS_GP_IRQ_SELECT20'/>"
WRITE #1 "        <register address='0xb204aa4' value='0x" DATA.LONG(A:0xb204aa4) "' name='RPMH_PDC_APPS_GP_IRQ_SELECT21'/>"
WRITE #1 "        <register address='0xb204ab8' value='0x" DATA.LONG(A:0xb204ab8) "' name='RPMH_PDC_APPS_GP_IRQ_SELECT22'/>"
WRITE #1 "        <register address='0xb204acc' value='0x" DATA.LONG(A:0xb204acc) "' name='RPMH_PDC_APPS_GP_IRQ_SELECT23'/>"
WRITE #1 "        <register address='0xb204ae0' value='0x" DATA.LONG(A:0xb204ae0) "' name='RPMH_PDC_APPS_GP_IRQ_SELECT24'/>"
WRITE #1 "        <register address='0xb204af4' value='0x" DATA.LONG(A:0xb204af4) "' name='RPMH_PDC_APPS_GP_IRQ_SELECT25'/>"
WRITE #1 "        <register address='0xb204b08' value='0x" DATA.LONG(A:0xb204b08) "' name='RPMH_PDC_APPS_GP_IRQ_SELECT26'/>"
WRITE #1 "        <register address='0xb204b1c' value='0x" DATA.LONG(A:0xb204b1c) "' name='RPMH_PDC_APPS_GP_IRQ_SELECT27'/>"
WRITE #1 "        <register address='0xb204b30' value='0x" DATA.LONG(A:0xb204b30) "' name='RPMH_PDC_APPS_GP_IRQ_SELECT28'/>"
WRITE #1 "        <register address='0xb204b44' value='0x" DATA.LONG(A:0xb204b44) "' name='RPMH_PDC_APPS_GP_IRQ_SELECT29'/>"
WRITE #1 "        <register address='0xb204b58' value='0x" DATA.LONG(A:0xb204b58) "' name='RPMH_PDC_APPS_GP_IRQ_SELECT30'/>"
WRITE #1 "        <register address='0xb204b6c' value='0x" DATA.LONG(A:0xb204b6c) "' name='RPMH_PDC_APPS_GP_IRQ_SELECT31'/>"
WRITE #1 "        <register address='0xb205000' value='0x" DATA.LONG(A:0xb205000) "' name='RPMH_PDC_APPS_PROFILING_UNIT0_EN'/>"
WRITE #1 "        <register address='0xb205014' value='0x" DATA.LONG(A:0xb205014) "' name='RPMH_PDC_APPS_PROFILING_UNIT1_EN'/>"
WRITE #1 "        <register address='0xb205028' value='0x" DATA.LONG(A:0xb205028) "' name='RPMH_PDC_APPS_PROFILING_UNIT2_EN'/>"
WRITE #1 "        <register address='0xb20503c' value='0x" DATA.LONG(A:0xb20503c) "' name='RPMH_PDC_APPS_PROFILING_UNIT3_EN'/>"
WRITE #1 "        <register address='0xb205050' value='0x" DATA.LONG(A:0xb205050) "' name='RPMH_PDC_APPS_PROFILING_UNIT4_EN'/>"
WRITE #1 "        <register address='0xb205500' value='0x" DATA.LONG(A:0xb205500) "' name='RPMH_PDC_APPS_TCS0_CONTROL'/>"
WRITE #1 "        <register address='0xb2055c8' value='0x" DATA.LONG(A:0xb2055c8) "' name='RPMH_PDC_APPS_TCS1_CONTROL'/>"
WRITE #1 "        <register address='0xb205690' value='0x" DATA.LONG(A:0xb205690) "' name='RPMH_PDC_APPS_TCS2_CONTROL'/>"
WRITE #1 "        <register address='0xb205758' value='0x" DATA.LONG(A:0xb205758) "' name='RPMH_PDC_APPS_TCS3_CONTROL'/>"
WRITE #1 "        <register address='0xb205504' value='0x" DATA.LONG(A:0xb205504) "' name='RPMH_PDC_APPS_TCS0_CMD_ENABLE_BANK'/>"
WRITE #1 "        <register address='0xb2055cc' value='0x" DATA.LONG(A:0xb2055cc) "' name='RPMH_PDC_APPS_TCS1_CMD_ENABLE_BANK'/>"
WRITE #1 "        <register address='0xb205694' value='0x" DATA.LONG(A:0xb205694) "' name='RPMH_PDC_APPS_TCS2_CMD_ENABLE_BANK'/>"
WRITE #1 "        <register address='0xb20575c' value='0x" DATA.LONG(A:0xb20575c) "' name='RPMH_PDC_APPS_TCS3_CMD_ENABLE_BANK'/>"
WRITE #1 "        <register address='0xb205508' value='0x" DATA.LONG(A:0xb205508) "' name='RPMH_PDC_APPS_TCS0_CMD_WAIT_FOR_CMPL_BANK'/>"
WRITE #1 "        <register address='0xb2055d0' value='0x" DATA.LONG(A:0xb2055d0) "' name='RPMH_PDC_APPS_TCS1_CMD_WAIT_FOR_CMPL_BANK'/>"
WRITE #1 "        <register address='0xb205698' value='0x" DATA.LONG(A:0xb205698) "' name='RPMH_PDC_APPS_TCS2_CMD_WAIT_FOR_CMPL_BANK'/>"
WRITE #1 "        <register address='0xb205760' value='0x" DATA.LONG(A:0xb205760) "' name='RPMH_PDC_APPS_TCS3_CMD_WAIT_FOR_CMPL_BANK'/>"
WRITE #1 "        <register address='0xb20550c' value='0x" DATA.LONG(A:0xb20550c) "' name='RPMH_PDC_APPS_TCS0_CMD0_MSGID'/>"
WRITE #1 "        <register address='0xb20551c' value='0x" DATA.LONG(A:0xb20551c) "' name='RPMH_PDC_APPS_TCS0_CMD1_MSGID'/>"
WRITE #1 "        <register address='0xb20552c' value='0x" DATA.LONG(A:0xb20552c) "' name='RPMH_PDC_APPS_TCS0_CMD2_MSGID'/>"
WRITE #1 "        <register address='0xb20553c' value='0x" DATA.LONG(A:0xb20553c) "' name='RPMH_PDC_APPS_TCS0_CMD3_MSGID'/>"
WRITE #1 "        <register address='0xb2055d4' value='0x" DATA.LONG(A:0xb2055d4) "' name='RPMH_PDC_APPS_TCS1_CMD0_MSGID'/>"
WRITE #1 "        <register address='0xb2055e4' value='0x" DATA.LONG(A:0xb2055e4) "' name='RPMH_PDC_APPS_TCS1_CMD1_MSGID'/>"
WRITE #1 "        <register address='0xb2055f4' value='0x" DATA.LONG(A:0xb2055f4) "' name='RPMH_PDC_APPS_TCS1_CMD2_MSGID'/>"
WRITE #1 "        <register address='0xb205604' value='0x" DATA.LONG(A:0xb205604) "' name='RPMH_PDC_APPS_TCS1_CMD3_MSGID'/>"
WRITE #1 "        <register address='0xb20569c' value='0x" DATA.LONG(A:0xb20569c) "' name='RPMH_PDC_APPS_TCS2_CMD0_MSGID'/>"
WRITE #1 "        <register address='0xb2056ac' value='0x" DATA.LONG(A:0xb2056ac) "' name='RPMH_PDC_APPS_TCS2_CMD1_MSGID'/>"
WRITE #1 "        <register address='0xb2056bc' value='0x" DATA.LONG(A:0xb2056bc) "' name='RPMH_PDC_APPS_TCS2_CMD2_MSGID'/>"
WRITE #1 "        <register address='0xb2056cc' value='0x" DATA.LONG(A:0xb2056cc) "' name='RPMH_PDC_APPS_TCS2_CMD3_MSGID'/>"
WRITE #1 "        <register address='0xb205764' value='0x" DATA.LONG(A:0xb205764) "' name='RPMH_PDC_APPS_TCS3_CMD0_MSGID'/>"
WRITE #1 "        <register address='0xb205774' value='0x" DATA.LONG(A:0xb205774) "' name='RPMH_PDC_APPS_TCS3_CMD1_MSGID'/>"
WRITE #1 "        <register address='0xb205784' value='0x" DATA.LONG(A:0xb205784) "' name='RPMH_PDC_APPS_TCS3_CMD2_MSGID'/>"
WRITE #1 "        <register address='0xb205794' value='0x" DATA.LONG(A:0xb205794) "' name='RPMH_PDC_APPS_TCS3_CMD3_MSGID'/>"
WRITE #1 "        <register address='0xb205510' value='0x" DATA.LONG(A:0xb205510) "' name='RPMH_PDC_APPS_TCS0_CMD0_ADDR'/>"
WRITE #1 "        <register address='0xb205520' value='0x" DATA.LONG(A:0xb205520) "' name='RPMH_PDC_APPS_TCS0_CMD1_ADDR'/>"
WRITE #1 "        <register address='0xb205530' value='0x" DATA.LONG(A:0xb205530) "' name='RPMH_PDC_APPS_TCS0_CMD2_ADDR'/>"
WRITE #1 "        <register address='0xb205540' value='0x" DATA.LONG(A:0xb205540) "' name='RPMH_PDC_APPS_TCS0_CMD3_ADDR'/>"
WRITE #1 "        <register address='0xb2055d8' value='0x" DATA.LONG(A:0xb2055d8) "' name='RPMH_PDC_APPS_TCS1_CMD0_ADDR'/>"
WRITE #1 "        <register address='0xb2055e8' value='0x" DATA.LONG(A:0xb2055e8) "' name='RPMH_PDC_APPS_TCS1_CMD1_ADDR'/>"
WRITE #1 "        <register address='0xb2055f8' value='0x" DATA.LONG(A:0xb2055f8) "' name='RPMH_PDC_APPS_TCS1_CMD2_ADDR'/>"
WRITE #1 "        <register address='0xb205608' value='0x" DATA.LONG(A:0xb205608) "' name='RPMH_PDC_APPS_TCS1_CMD3_ADDR'/>"
WRITE #1 "        <register address='0xb2056a0' value='0x" DATA.LONG(A:0xb2056a0) "' name='RPMH_PDC_APPS_TCS2_CMD0_ADDR'/>"
WRITE #1 "        <register address='0xb2056b0' value='0x" DATA.LONG(A:0xb2056b0) "' name='RPMH_PDC_APPS_TCS2_CMD1_ADDR'/>"
WRITE #1 "        <register address='0xb2056c0' value='0x" DATA.LONG(A:0xb2056c0) "' name='RPMH_PDC_APPS_TCS2_CMD2_ADDR'/>"
WRITE #1 "        <register address='0xb2056d0' value='0x" DATA.LONG(A:0xb2056d0) "' name='RPMH_PDC_APPS_TCS2_CMD3_ADDR'/>"
WRITE #1 "        <register address='0xb205768' value='0x" DATA.LONG(A:0xb205768) "' name='RPMH_PDC_APPS_TCS3_CMD0_ADDR'/>"
WRITE #1 "        <register address='0xb205778' value='0x" DATA.LONG(A:0xb205778) "' name='RPMH_PDC_APPS_TCS3_CMD1_ADDR'/>"
WRITE #1 "        <register address='0xb205788' value='0x" DATA.LONG(A:0xb205788) "' name='RPMH_PDC_APPS_TCS3_CMD2_ADDR'/>"
WRITE #1 "        <register address='0xb205798' value='0x" DATA.LONG(A:0xb205798) "' name='RPMH_PDC_APPS_TCS3_CMD3_ADDR'/>"
WRITE #1 "        <register address='0xb205514' value='0x" DATA.LONG(A:0xb205514) "' name='RPMH_PDC_APPS_TCS0_CMD0_DATA'/>"
WRITE #1 "        <register address='0xb205524' value='0x" DATA.LONG(A:0xb205524) "' name='RPMH_PDC_APPS_TCS0_CMD1_DATA'/>"
WRITE #1 "        <register address='0xb205534' value='0x" DATA.LONG(A:0xb205534) "' name='RPMH_PDC_APPS_TCS0_CMD2_DATA'/>"
WRITE #1 "        <register address='0xb205544' value='0x" DATA.LONG(A:0xb205544) "' name='RPMH_PDC_APPS_TCS0_CMD3_DATA'/>"
WRITE #1 "        <register address='0xb2055dc' value='0x" DATA.LONG(A:0xb2055dc) "' name='RPMH_PDC_APPS_TCS1_CMD0_DATA'/>"
WRITE #1 "        <register address='0xb2055ec' value='0x" DATA.LONG(A:0xb2055ec) "' name='RPMH_PDC_APPS_TCS1_CMD1_DATA'/>"
WRITE #1 "        <register address='0xb2055fc' value='0x" DATA.LONG(A:0xb2055fc) "' name='RPMH_PDC_APPS_TCS1_CMD2_DATA'/>"
WRITE #1 "        <register address='0xb20560c' value='0x" DATA.LONG(A:0xb20560c) "' name='RPMH_PDC_APPS_TCS1_CMD3_DATA'/>"
WRITE #1 "        <register address='0xb2056a4' value='0x" DATA.LONG(A:0xb2056a4) "' name='RPMH_PDC_APPS_TCS2_CMD0_DATA'/>"
WRITE #1 "        <register address='0xb2056b4' value='0x" DATA.LONG(A:0xb2056b4) "' name='RPMH_PDC_APPS_TCS2_CMD1_DATA'/>"
WRITE #1 "        <register address='0xb2056c4' value='0x" DATA.LONG(A:0xb2056c4) "' name='RPMH_PDC_APPS_TCS2_CMD2_DATA'/>"
WRITE #1 "        <register address='0xb2056d4' value='0x" DATA.LONG(A:0xb2056d4) "' name='RPMH_PDC_APPS_TCS2_CMD3_DATA'/>"
WRITE #1 "        <register address='0xb20576c' value='0x" DATA.LONG(A:0xb20576c) "' name='RPMH_PDC_APPS_TCS3_CMD0_DATA'/>"
WRITE #1 "        <register address='0xb20577c' value='0x" DATA.LONG(A:0xb20577c) "' name='RPMH_PDC_APPS_TCS3_CMD1_DATA'/>"
WRITE #1 "        <register address='0xb20578c' value='0x" DATA.LONG(A:0xb20578c) "' name='RPMH_PDC_APPS_TCS3_CMD2_DATA'/>"
WRITE #1 "        <register address='0xb20579c' value='0x" DATA.LONG(A:0xb20579c) "' name='RPMH_PDC_APPS_TCS3_CMD3_DATA'/>"
WRITE #1 "        <register address='0xb220000' value='0x" DATA.LONG(A:0xb220000) "' name='RPMH_PDC_AOP_VOTE_CMP_DATA_DRV0'/>"
WRITE #1 "        <register address='0xb220010' value='0x" DATA.LONG(A:0xb220010) "' name='RPMH_PDC_AOP_IRQ_ENABLE_BANK0_DRV0'/>"
WRITE #1 "        <register address='0xb220110' value='0x" DATA.LONG(A:0xb220110) "' name='RPMH_PDC_AOP_IRQ_0_CFG_DRV0'/>"
WRITE #1 "        <register address='0xb220114' value='0x" DATA.LONG(A:0xb220114) "' name='RPMH_PDC_AOP_IRQ_1_CFG_DRV0'/>"
WRITE #1 "        <register address='0xb220118' value='0x" DATA.LONG(A:0xb220118) "' name='RPMH_PDC_AOP_IRQ_2_CFG_DRV0'/>"
WRITE #1 "        <register address='0xb22011c' value='0x" DATA.LONG(A:0xb22011c) "' name='RPMH_PDC_AOP_IRQ_3_CFG_DRV0'/>"
WRITE #1 "        <register address='0xb220120' value='0x" DATA.LONG(A:0xb220120) "' name='RPMH_PDC_AOP_IRQ_4_CFG_DRV0'/>"
WRITE #1 "        <register address='0xb220124' value='0x" DATA.LONG(A:0xb220124) "' name='RPMH_PDC_AOP_IRQ_5_CFG_DRV0'/>"
WRITE #1 "        <register address='0xb220128' value='0x" DATA.LONG(A:0xb220128) "' name='RPMH_PDC_AOP_IRQ_6_CFG_DRV0'/>"
WRITE #1 "        <register address='0xb22012c' value='0x" DATA.LONG(A:0xb22012c) "' name='RPMH_PDC_AOP_IRQ_7_CFG_DRV0'/>"
WRITE #1 "        <register address='0xb220130' value='0x" DATA.LONG(A:0xb220130) "' name='RPMH_PDC_AOP_IRQ_8_CFG_DRV0'/>"
WRITE #1 "        <register address='0xb220134' value='0x" DATA.LONG(A:0xb220134) "' name='RPMH_PDC_AOP_IRQ_9_CFG_DRV0'/>"
WRITE #1 "        <register address='0xb220138' value='0x" DATA.LONG(A:0xb220138) "' name='RPMH_PDC_AOP_IRQ_10_CFG_DRV0'/>"
WRITE #1 "        <register address='0xb22013c' value='0x" DATA.LONG(A:0xb22013c) "' name='RPMH_PDC_AOP_IRQ_11_CFG_DRV0'/>"
WRITE #1 "        <register address='0xb220140' value='0x" DATA.LONG(A:0xb220140) "' name='RPMH_PDC_AOP_IRQ_12_CFG_DRV0'/>"
WRITE #1 "        <register address='0xb220144' value='0x" DATA.LONG(A:0xb220144) "' name='RPMH_PDC_AOP_IRQ_13_CFG_DRV0'/>"
WRITE #1 "        <register address='0xb220148' value='0x" DATA.LONG(A:0xb220148) "' name='RPMH_PDC_AOP_IRQ_14_CFG_DRV0'/>"
WRITE #1 "        <register address='0xb22014c' value='0x" DATA.LONG(A:0xb22014c) "' name='RPMH_PDC_AOP_IRQ_15_CFG_DRV0'/>"
WRITE #1 "        <register address='0xb220150' value='0x" DATA.LONG(A:0xb220150) "' name='RPMH_PDC_AOP_IRQ_16_CFG_DRV0'/>"
WRITE #1 "        <register address='0xb220154' value='0x" DATA.LONG(A:0xb220154) "' name='RPMH_PDC_AOP_IRQ_17_CFG_DRV0'/>"
WRITE #1 "        <register address='0xb220158' value='0x" DATA.LONG(A:0xb220158) "' name='RPMH_PDC_AOP_IRQ_18_CFG_DRV0'/>"
WRITE #1 "        <register address='0xb22015c' value='0x" DATA.LONG(A:0xb22015c) "' name='RPMH_PDC_AOP_IRQ_19_CFG_DRV0'/>"
WRITE #1 "        <register address='0xb220160' value='0x" DATA.LONG(A:0xb220160) "' name='RPMH_PDC_AOP_IRQ_20_CFG_DRV0'/>"
WRITE #1 "        <register address='0xb220164' value='0x" DATA.LONG(A:0xb220164) "' name='RPMH_PDC_AOP_IRQ_21_CFG_DRV0'/>"
WRITE #1 "        <register address='0xb220168' value='0x" DATA.LONG(A:0xb220168) "' name='RPMH_PDC_AOP_IRQ_22_CFG_DRV0'/>"
WRITE #1 "        <register address='0xb22016c' value='0x" DATA.LONG(A:0xb22016c) "' name='RPMH_PDC_AOP_IRQ_23_CFG_DRV0'/>"
WRITE #1 "        <register address='0xb220170' value='0x" DATA.LONG(A:0xb220170) "' name='RPMH_PDC_AOP_IRQ_24_CFG_DRV0'/>"
WRITE #1 "        <register address='0xb220900' value='0x" DATA.LONG(A:0xb220900) "' name='RPMH_PDC_AOP_IRQ_STATUS_BANK0_DRV0'/>"
WRITE #1 "        <register address='0xb221000' value='0x" DATA.LONG(A:0xb221000) "' name='RPMH_PDC_AOP_PDC_VERSION_DRV0'/>"
WRITE #1 "        <register address='0xb221004' value='0x" DATA.LONG(A:0xb221004) "' name='RPMH_PDC_AOP_PDC_PARAM_RESOURCE_DRV0'/>"
WRITE #1 "        <register address='0xb221008' value='0x" DATA.LONG(A:0xb221008) "' name='RPMH_PDC_AOP_PDC_PARAM_SEQ_CONFIG_DRV0'/>"
WRITE #1 "        <register address='0xb22100c' value='0x" DATA.LONG(A:0xb22100c) "' name='RPMH_PDC_AOP_PDC_PARAM_IRQ_CONFIG_DRV0'/>"
WRITE #1 "        <register address='0xb221020' value='0x" DATA.LONG(A:0xb221020) "' name='RPMH_PDC_AOP_SEQ_BUSY_DRV0'/>"
WRITE #1 "        <register address='0xb221030' value='0x" DATA.LONG(A:0xb221030) "' name='RPMH_PDC_AOP_PDC_MODE_STATUS_DRV0'/>"
WRITE #1 "        <register address='0xb221200' value='0x" DATA.LONG(A:0xb221200) "' name='RPMH_PDC_AOP_PROFILING_UNIT0_DRV0_OUTPUT'/>"
WRITE #1 "        <register address='0xb221214' value='0x" DATA.LONG(A:0xb221214) "' name='RPMH_PDC_AOP_PROFILING_UNIT1_DRV0_OUTPUT'/>"
WRITE #1 "        <register address='0xb221228' value='0x" DATA.LONG(A:0xb221228) "' name='RPMH_PDC_AOP_PROFILING_UNIT2_DRV0_OUTPUT'/>"
WRITE #1 "        <register address='0xb22123c' value='0x" DATA.LONG(A:0xb22123c) "' name='RPMH_PDC_AOP_PROFILING_UNIT3_DRV0_OUTPUT'/>"
WRITE #1 "        <register address='0xb221250' value='0x" DATA.LONG(A:0xb221250) "' name='RPMH_PDC_AOP_PROFILING_UNIT4_DRV0_OUTPUT'/>"
WRITE #1 "        <register address='0xb221204' value='0x" DATA.LONG(A:0xb221204) "' name='RPMH_PDC_AOP_PROFILING_UNIT0_DRV0_TIMESTAMP_LO'/>"
WRITE #1 "        <register address='0xb221218' value='0x" DATA.LONG(A:0xb221218) "' name='RPMH_PDC_AOP_PROFILING_UNIT1_DRV0_TIMESTAMP_LO'/>"
WRITE #1 "        <register address='0xb22122c' value='0x" DATA.LONG(A:0xb22122c) "' name='RPMH_PDC_AOP_PROFILING_UNIT2_DRV0_TIMESTAMP_LO'/>"
WRITE #1 "        <register address='0xb221240' value='0x" DATA.LONG(A:0xb221240) "' name='RPMH_PDC_AOP_PROFILING_UNIT3_DRV0_TIMESTAMP_LO'/>"
WRITE #1 "        <register address='0xb221254' value='0x" DATA.LONG(A:0xb221254) "' name='RPMH_PDC_AOP_PROFILING_UNIT4_DRV0_TIMESTAMP_LO'/>"
WRITE #1 "        <register address='0xb221208' value='0x" DATA.LONG(A:0xb221208) "' name='RPMH_PDC_AOP_PROFILING_UNIT0_DRV0_TIMESTAMP_HI'/>"
WRITE #1 "        <register address='0xb22121c' value='0x" DATA.LONG(A:0xb22121c) "' name='RPMH_PDC_AOP_PROFILING_UNIT1_DRV0_TIMESTAMP_HI'/>"
WRITE #1 "        <register address='0xb221230' value='0x" DATA.LONG(A:0xb221230) "' name='RPMH_PDC_AOP_PROFILING_UNIT2_DRV0_TIMESTAMP_HI'/>"
WRITE #1 "        <register address='0xb221244' value='0x" DATA.LONG(A:0xb221244) "' name='RPMH_PDC_AOP_PROFILING_UNIT3_DRV0_TIMESTAMP_HI'/>"
WRITE #1 "        <register address='0xb221258' value='0x" DATA.LONG(A:0xb221258) "' name='RPMH_PDC_AOP_PROFILING_UNIT4_DRV0_TIMESTAMP_HI'/>"
WRITE #1 "        <register address='0xb221300' value='0x" DATA.LONG(A:0xb221300) "' name='RPMH_PDC_AOP_TCS0_DRV0_STATUS'/>"
WRITE #1 "        <register address='0xb2213c8' value='0x" DATA.LONG(A:0xb2213c8) "' name='RPMH_PDC_AOP_TCS1_DRV0_STATUS'/>"
WRITE #1 "        <register address='0xb221490' value='0x" DATA.LONG(A:0xb221490) "' name='RPMH_PDC_AOP_TCS2_DRV0_STATUS'/>"
WRITE #1 "        <register address='0xb221558' value='0x" DATA.LONG(A:0xb221558) "' name='RPMH_PDC_AOP_TCS3_DRV0_STATUS'/>"
WRITE #1 "        <register address='0xb221304' value='0x" DATA.LONG(A:0xb221304) "' name='RPMH_PDC_AOP_TCS0_CMD0_DRV0_STATUS'/>"
WRITE #1 "        <register address='0xb22130c' value='0x" DATA.LONG(A:0xb22130c) "' name='RPMH_PDC_AOP_TCS0_CMD1_DRV0_STATUS'/>"
WRITE #1 "        <register address='0xb221314' value='0x" DATA.LONG(A:0xb221314) "' name='RPMH_PDC_AOP_TCS0_CMD2_DRV0_STATUS'/>"
WRITE #1 "        <register address='0xb22131c' value='0x" DATA.LONG(A:0xb22131c) "' name='RPMH_PDC_AOP_TCS0_CMD3_DRV0_STATUS'/>"
WRITE #1 "        <register address='0xb2213cc' value='0x" DATA.LONG(A:0xb2213cc) "' name='RPMH_PDC_AOP_TCS1_CMD0_DRV0_STATUS'/>"
WRITE #1 "        <register address='0xb2213d4' value='0x" DATA.LONG(A:0xb2213d4) "' name='RPMH_PDC_AOP_TCS1_CMD1_DRV0_STATUS'/>"
WRITE #1 "        <register address='0xb2213dc' value='0x" DATA.LONG(A:0xb2213dc) "' name='RPMH_PDC_AOP_TCS1_CMD2_DRV0_STATUS'/>"
WRITE #1 "        <register address='0xb2213e4' value='0x" DATA.LONG(A:0xb2213e4) "' name='RPMH_PDC_AOP_TCS1_CMD3_DRV0_STATUS'/>"
WRITE #1 "        <register address='0xb221494' value='0x" DATA.LONG(A:0xb221494) "' name='RPMH_PDC_AOP_TCS2_CMD0_DRV0_STATUS'/>"
WRITE #1 "        <register address='0xb22149c' value='0x" DATA.LONG(A:0xb22149c) "' name='RPMH_PDC_AOP_TCS2_CMD1_DRV0_STATUS'/>"
WRITE #1 "        <register address='0xb2214a4' value='0x" DATA.LONG(A:0xb2214a4) "' name='RPMH_PDC_AOP_TCS2_CMD2_DRV0_STATUS'/>"
WRITE #1 "        <register address='0xb2214ac' value='0x" DATA.LONG(A:0xb2214ac) "' name='RPMH_PDC_AOP_TCS2_CMD3_DRV0_STATUS'/>"
WRITE #1 "        <register address='0xb22155c' value='0x" DATA.LONG(A:0xb22155c) "' name='RPMH_PDC_AOP_TCS3_CMD0_DRV0_STATUS'/>"
WRITE #1 "        <register address='0xb221564' value='0x" DATA.LONG(A:0xb221564) "' name='RPMH_PDC_AOP_TCS3_CMD1_DRV0_STATUS'/>"
WRITE #1 "        <register address='0xb22156c' value='0x" DATA.LONG(A:0xb22156c) "' name='RPMH_PDC_AOP_TCS3_CMD2_DRV0_STATUS'/>"
WRITE #1 "        <register address='0xb221574' value='0x" DATA.LONG(A:0xb221574) "' name='RPMH_PDC_AOP_TCS3_CMD3_DRV0_STATUS'/>"
WRITE #1 "        <register address='0xb224500' value='0x" DATA.LONG(A:0xb224500) "' name='RPMH_PDC_AOP_ENABLE_PDC'/>"
WRITE #1 "        <register address='0xb224510' value='0x" DATA.LONG(A:0xb224510) "' name='RPMH_PDC_AOP_TIMER_MATCH_VALUE_LO'/>"
WRITE #1 "        <register address='0xb224514' value='0x" DATA.LONG(A:0xb224514) "' name='RPMH_PDC_AOP_TIMER_MATCH_VALUE_HI'/>"
WRITE #1 "        <register address='0xb224518' value='0x" DATA.LONG(A:0xb224518) "' name='RPMH_PDC_AOP_TIMER_DISABLED_FOR_ARC'/>"
WRITE #1 "        <register address='0xb224520' value='0x" DATA.LONG(A:0xb224520) "' name='RPMH_PDC_AOP_SEQ_START_ADDR'/>"
WRITE #1 "        <register address='0xb224524' value='0x" DATA.LONG(A:0xb224524) "' name='RPMH_PDC_AOP_SEQ_OVERRIDE_START_ADDR'/>"
WRITE #1 "        <register address='0xb22452c' value='0x" DATA.LONG(A:0xb22452c) "' name='RPMH_PDC_AOP_SEQ_OVERRIDE_TRIGGER'/>"
WRITE #1 "        <register address='0xb224530' value='0x" DATA.LONG(A:0xb224530) "' name='RPMH_PDC_AOP_SEQ_PWR_CTRL_OVERRIDE_MASK'/>"
WRITE #1 "        <register address='0xb224534' value='0x" DATA.LONG(A:0xb224534) "' name='RPMH_PDC_AOP_SEQ_PWR_CTRL_OVERRIDE_VAL'/>"
WRITE #1 "        <register address='0xb224540' value='0x" DATA.LONG(A:0xb224540) "' name='RPMH_PDC_AOP_SEQ_WAIT_EVENT_OVERRIDE_MASK'/>"
WRITE #1 "        <register address='0xb224544' value='0x" DATA.LONG(A:0xb224544) "' name='RPMH_PDC_AOP_SEQ_WAIT_EVENT_OVERRIDE_VAL'/>"
WRITE #1 "        <register address='0xb224550' value='0x" DATA.LONG(A:0xb224550) "' name='RPMH_PDC_AOP_SEQ_BR_EVENT_OVERRIDE_MASK'/>"
WRITE #1 "        <register address='0xb224554' value='0x" DATA.LONG(A:0xb224554) "' name='RPMH_PDC_AOP_SEQ_BR_EVENT_OVERRIDE_VAL'/>"
WRITE #1 "        <register address='0xb224590' value='0x" DATA.LONG(A:0xb224590) "' name='RPMH_PDC_AOP_SEQ_CFG_BR_ADDR_0'/>"
WRITE #1 "        <register address='0xb224594' value='0x" DATA.LONG(A:0xb224594) "' name='RPMH_PDC_AOP_SEQ_CFG_BR_ADDR_1'/>"
WRITE #1 "        <register address='0xb224598' value='0x" DATA.LONG(A:0xb224598) "' name='RPMH_PDC_AOP_SEQ_CFG_BR_ADDR_2'/>"
WRITE #1 "        <register address='0xb22459c' value='0x" DATA.LONG(A:0xb22459c) "' name='RPMH_PDC_AOP_SEQ_CFG_BR_ADDR_3'/>"
WRITE #1 "        <register address='0xb2245a0' value='0x" DATA.LONG(A:0xb2245a0) "' name='RPMH_PDC_AOP_SEQ_CFG_DELAY_VAL_0'/>"
WRITE #1 "        <register address='0xb2245a4' value='0x" DATA.LONG(A:0xb2245a4) "' name='RPMH_PDC_AOP_SEQ_CFG_DELAY_VAL_1'/>"
WRITE #1 "        <register address='0xb2245a8' value='0x" DATA.LONG(A:0xb2245a8) "' name='RPMH_PDC_AOP_SEQ_CFG_DELAY_VAL_2'/>"
WRITE #1 "        <register address='0xb2245ac' value='0x" DATA.LONG(A:0xb2245ac) "' name='RPMH_PDC_AOP_SEQ_CFG_DELAY_VAL_3'/>"
WRITE #1 "        <register address='0xb2245b0' value='0x" DATA.LONG(A:0xb2245b0) "' name='RPMH_PDC_AOP_SEQ_CFG_DELAY_VAL_4'/>"
WRITE #1 "        <register address='0xb2245b4' value='0x" DATA.LONG(A:0xb2245b4) "' name='RPMH_PDC_AOP_SEQ_CFG_DELAY_VAL_5'/>"
WRITE #1 "        <register address='0xb2245b8' value='0x" DATA.LONG(A:0xb2245b8) "' name='RPMH_PDC_AOP_SEQ_CFG_DELAY_VAL_6'/>"
WRITE #1 "        <register address='0xb2245bc' value='0x" DATA.LONG(A:0xb2245bc) "' name='RPMH_PDC_AOP_SEQ_CFG_DELAY_VAL_7'/>"
WRITE #1 "        <register address='0xb2245c0' value='0x" DATA.LONG(A:0xb2245c0) "' name='RPMH_PDC_AOP_SEQ_CFG_DELAY_VAL_8'/>"
WRITE #1 "        <register address='0xb2245c4' value='0x" DATA.LONG(A:0xb2245c4) "' name='RPMH_PDC_AOP_SEQ_CFG_DELAY_VAL_9'/>"
WRITE #1 "        <register address='0xb2245c8' value='0x" DATA.LONG(A:0xb2245c8) "' name='RPMH_PDC_AOP_SEQ_CFG_DELAY_VAL_10'/>"
WRITE #1 "        <register address='0xb2245cc' value='0x" DATA.LONG(A:0xb2245cc) "' name='RPMH_PDC_AOP_SEQ_CFG_DELAY_VAL_11'/>"
WRITE #1 "        <register address='0xb2245d0' value='0x" DATA.LONG(A:0xb2245d0) "' name='RPMH_PDC_AOP_SEQ_CFG_DELAY_VAL_12'/>"
WRITE #1 "        <register address='0xb2245d4' value='0x" DATA.LONG(A:0xb2245d4) "' name='RPMH_PDC_AOP_SEQ_CFG_DELAY_VAL_13'/>"
WRITE #1 "        <register address='0xb2245d8' value='0x" DATA.LONG(A:0xb2245d8) "' name='RPMH_PDC_AOP_SEQ_CFG_DELAY_VAL_14'/>"
WRITE #1 "        <register address='0xb2245dc' value='0x" DATA.LONG(A:0xb2245dc) "' name='RPMH_PDC_AOP_SEQ_CFG_DELAY_VAL_15'/>"
WRITE #1 "        <register address='0xb224900' value='0x" DATA.LONG(A:0xb224900) "' name='RPMH_PDC_AOP_GP_IRQ_SELECT0'/>"
WRITE #1 "        <register address='0xb224914' value='0x" DATA.LONG(A:0xb224914) "' name='RPMH_PDC_AOP_GP_IRQ_SELECT1'/>"
WRITE #1 "        <register address='0xb224928' value='0x" DATA.LONG(A:0xb224928) "' name='RPMH_PDC_AOP_GP_IRQ_SELECT2'/>"
WRITE #1 "        <register address='0xb22493c' value='0x" DATA.LONG(A:0xb22493c) "' name='RPMH_PDC_AOP_GP_IRQ_SELECT3'/>"
WRITE #1 "        <register address='0xb224950' value='0x" DATA.LONG(A:0xb224950) "' name='RPMH_PDC_AOP_GP_IRQ_SELECT4'/>"
WRITE #1 "        <register address='0xb224964' value='0x" DATA.LONG(A:0xb224964) "' name='RPMH_PDC_AOP_GP_IRQ_SELECT5'/>"
WRITE #1 "        <register address='0xb224978' value='0x" DATA.LONG(A:0xb224978) "' name='RPMH_PDC_AOP_GP_IRQ_SELECT6'/>"
WRITE #1 "        <register address='0xb22498c' value='0x" DATA.LONG(A:0xb22498c) "' name='RPMH_PDC_AOP_GP_IRQ_SELECT7'/>"
WRITE #1 "        <register address='0xb2249a0' value='0x" DATA.LONG(A:0xb2249a0) "' name='RPMH_PDC_AOP_GP_IRQ_SELECT8'/>"
WRITE #1 "        <register address='0xb2249b4' value='0x" DATA.LONG(A:0xb2249b4) "' name='RPMH_PDC_AOP_GP_IRQ_SELECT9'/>"
WRITE #1 "        <register address='0xb225000' value='0x" DATA.LONG(A:0xb225000) "' name='RPMH_PDC_AOP_PROFILING_UNIT0_EN'/>"
WRITE #1 "        <register address='0xb225014' value='0x" DATA.LONG(A:0xb225014) "' name='RPMH_PDC_AOP_PROFILING_UNIT1_EN'/>"
WRITE #1 "        <register address='0xb225028' value='0x" DATA.LONG(A:0xb225028) "' name='RPMH_PDC_AOP_PROFILING_UNIT2_EN'/>"
WRITE #1 "        <register address='0xb22503c' value='0x" DATA.LONG(A:0xb22503c) "' name='RPMH_PDC_AOP_PROFILING_UNIT3_EN'/>"
WRITE #1 "        <register address='0xb225050' value='0x" DATA.LONG(A:0xb225050) "' name='RPMH_PDC_AOP_PROFILING_UNIT4_EN'/>"
WRITE #1 "        <register address='0xb225500' value='0x" DATA.LONG(A:0xb225500) "' name='RPMH_PDC_AOP_TCS0_CONTROL'/>"
WRITE #1 "        <register address='0xb2255c8' value='0x" DATA.LONG(A:0xb2255c8) "' name='RPMH_PDC_AOP_TCS1_CONTROL'/>"
WRITE #1 "        <register address='0xb225690' value='0x" DATA.LONG(A:0xb225690) "' name='RPMH_PDC_AOP_TCS2_CONTROL'/>"
WRITE #1 "        <register address='0xb225758' value='0x" DATA.LONG(A:0xb225758) "' name='RPMH_PDC_AOP_TCS3_CONTROL'/>"
WRITE #1 "        <register address='0xb225504' value='0x" DATA.LONG(A:0xb225504) "' name='RPMH_PDC_AOP_TCS0_CMD_ENABLE_BANK'/>"
WRITE #1 "        <register address='0xb2255cc' value='0x" DATA.LONG(A:0xb2255cc) "' name='RPMH_PDC_AOP_TCS1_CMD_ENABLE_BANK'/>"
WRITE #1 "        <register address='0xb225694' value='0x" DATA.LONG(A:0xb225694) "' name='RPMH_PDC_AOP_TCS2_CMD_ENABLE_BANK'/>"
WRITE #1 "        <register address='0xb22575c' value='0x" DATA.LONG(A:0xb22575c) "' name='RPMH_PDC_AOP_TCS3_CMD_ENABLE_BANK'/>"
WRITE #1 "        <register address='0xb225508' value='0x" DATA.LONG(A:0xb225508) "' name='RPMH_PDC_AOP_TCS0_CMD_WAIT_FOR_CMPL_BANK'/>"
WRITE #1 "        <register address='0xb2255d0' value='0x" DATA.LONG(A:0xb2255d0) "' name='RPMH_PDC_AOP_TCS1_CMD_WAIT_FOR_CMPL_BANK'/>"
WRITE #1 "        <register address='0xb225698' value='0x" DATA.LONG(A:0xb225698) "' name='RPMH_PDC_AOP_TCS2_CMD_WAIT_FOR_CMPL_BANK'/>"
WRITE #1 "        <register address='0xb225760' value='0x" DATA.LONG(A:0xb225760) "' name='RPMH_PDC_AOP_TCS3_CMD_WAIT_FOR_CMPL_BANK'/>"
WRITE #1 "        <register address='0xb22550c' value='0x" DATA.LONG(A:0xb22550c) "' name='RPMH_PDC_AOP_TCS0_CMD0_MSGID'/>"
WRITE #1 "        <register address='0xb22551c' value='0x" DATA.LONG(A:0xb22551c) "' name='RPMH_PDC_AOP_TCS0_CMD1_MSGID'/>"
WRITE #1 "        <register address='0xb22552c' value='0x" DATA.LONG(A:0xb22552c) "' name='RPMH_PDC_AOP_TCS0_CMD2_MSGID'/>"
WRITE #1 "        <register address='0xb22553c' value='0x" DATA.LONG(A:0xb22553c) "' name='RPMH_PDC_AOP_TCS0_CMD3_MSGID'/>"
WRITE #1 "        <register address='0xb2255d4' value='0x" DATA.LONG(A:0xb2255d4) "' name='RPMH_PDC_AOP_TCS1_CMD0_MSGID'/>"
WRITE #1 "        <register address='0xb2255e4' value='0x" DATA.LONG(A:0xb2255e4) "' name='RPMH_PDC_AOP_TCS1_CMD1_MSGID'/>"
WRITE #1 "        <register address='0xb2255f4' value='0x" DATA.LONG(A:0xb2255f4) "' name='RPMH_PDC_AOP_TCS1_CMD2_MSGID'/>"
WRITE #1 "        <register address='0xb225604' value='0x" DATA.LONG(A:0xb225604) "' name='RPMH_PDC_AOP_TCS1_CMD3_MSGID'/>"
WRITE #1 "        <register address='0xb22569c' value='0x" DATA.LONG(A:0xb22569c) "' name='RPMH_PDC_AOP_TCS2_CMD0_MSGID'/>"
WRITE #1 "        <register address='0xb2256ac' value='0x" DATA.LONG(A:0xb2256ac) "' name='RPMH_PDC_AOP_TCS2_CMD1_MSGID'/>"
WRITE #1 "        <register address='0xb2256bc' value='0x" DATA.LONG(A:0xb2256bc) "' name='RPMH_PDC_AOP_TCS2_CMD2_MSGID'/>"
WRITE #1 "        <register address='0xb2256cc' value='0x" DATA.LONG(A:0xb2256cc) "' name='RPMH_PDC_AOP_TCS2_CMD3_MSGID'/>"
WRITE #1 "        <register address='0xb225764' value='0x" DATA.LONG(A:0xb225764) "' name='RPMH_PDC_AOP_TCS3_CMD0_MSGID'/>"
WRITE #1 "        <register address='0xb225774' value='0x" DATA.LONG(A:0xb225774) "' name='RPMH_PDC_AOP_TCS3_CMD1_MSGID'/>"
WRITE #1 "        <register address='0xb225784' value='0x" DATA.LONG(A:0xb225784) "' name='RPMH_PDC_AOP_TCS3_CMD2_MSGID'/>"
WRITE #1 "        <register address='0xb225794' value='0x" DATA.LONG(A:0xb225794) "' name='RPMH_PDC_AOP_TCS3_CMD3_MSGID'/>"
WRITE #1 "        <register address='0xb225510' value='0x" DATA.LONG(A:0xb225510) "' name='RPMH_PDC_AOP_TCS0_CMD0_ADDR'/>"
WRITE #1 "        <register address='0xb225520' value='0x" DATA.LONG(A:0xb225520) "' name='RPMH_PDC_AOP_TCS0_CMD1_ADDR'/>"
WRITE #1 "        <register address='0xb225530' value='0x" DATA.LONG(A:0xb225530) "' name='RPMH_PDC_AOP_TCS0_CMD2_ADDR'/>"
WRITE #1 "        <register address='0xb225540' value='0x" DATA.LONG(A:0xb225540) "' name='RPMH_PDC_AOP_TCS0_CMD3_ADDR'/>"
WRITE #1 "        <register address='0xb2255d8' value='0x" DATA.LONG(A:0xb2255d8) "' name='RPMH_PDC_AOP_TCS1_CMD0_ADDR'/>"
WRITE #1 "        <register address='0xb2255e8' value='0x" DATA.LONG(A:0xb2255e8) "' name='RPMH_PDC_AOP_TCS1_CMD1_ADDR'/>"
WRITE #1 "        <register address='0xb2255f8' value='0x" DATA.LONG(A:0xb2255f8) "' name='RPMH_PDC_AOP_TCS1_CMD2_ADDR'/>"
WRITE #1 "        <register address='0xb225608' value='0x" DATA.LONG(A:0xb225608) "' name='RPMH_PDC_AOP_TCS1_CMD3_ADDR'/>"
WRITE #1 "        <register address='0xb2256a0' value='0x" DATA.LONG(A:0xb2256a0) "' name='RPMH_PDC_AOP_TCS2_CMD0_ADDR'/>"
WRITE #1 "        <register address='0xb2256b0' value='0x" DATA.LONG(A:0xb2256b0) "' name='RPMH_PDC_AOP_TCS2_CMD1_ADDR'/>"
WRITE #1 "        <register address='0xb2256c0' value='0x" DATA.LONG(A:0xb2256c0) "' name='RPMH_PDC_AOP_TCS2_CMD2_ADDR'/>"
WRITE #1 "        <register address='0xb2256d0' value='0x" DATA.LONG(A:0xb2256d0) "' name='RPMH_PDC_AOP_TCS2_CMD3_ADDR'/>"
WRITE #1 "        <register address='0xb225768' value='0x" DATA.LONG(A:0xb225768) "' name='RPMH_PDC_AOP_TCS3_CMD0_ADDR'/>"
WRITE #1 "        <register address='0xb225778' value='0x" DATA.LONG(A:0xb225778) "' name='RPMH_PDC_AOP_TCS3_CMD1_ADDR'/>"
WRITE #1 "        <register address='0xb225788' value='0x" DATA.LONG(A:0xb225788) "' name='RPMH_PDC_AOP_TCS3_CMD2_ADDR'/>"
WRITE #1 "        <register address='0xb225798' value='0x" DATA.LONG(A:0xb225798) "' name='RPMH_PDC_AOP_TCS3_CMD3_ADDR'/>"
WRITE #1 "        <register address='0xb225514' value='0x" DATA.LONG(A:0xb225514) "' name='RPMH_PDC_AOP_TCS0_CMD0_DATA'/>"
WRITE #1 "        <register address='0xb225524' value='0x" DATA.LONG(A:0xb225524) "' name='RPMH_PDC_AOP_TCS0_CMD1_DATA'/>"
WRITE #1 "        <register address='0xb225534' value='0x" DATA.LONG(A:0xb225534) "' name='RPMH_PDC_AOP_TCS0_CMD2_DATA'/>"
WRITE #1 "        <register address='0xb225544' value='0x" DATA.LONG(A:0xb225544) "' name='RPMH_PDC_AOP_TCS0_CMD3_DATA'/>"
WRITE #1 "        <register address='0xb2255dc' value='0x" DATA.LONG(A:0xb2255dc) "' name='RPMH_PDC_AOP_TCS1_CMD0_DATA'/>"
WRITE #1 "        <register address='0xb2255ec' value='0x" DATA.LONG(A:0xb2255ec) "' name='RPMH_PDC_AOP_TCS1_CMD1_DATA'/>"
WRITE #1 "        <register address='0xb2255fc' value='0x" DATA.LONG(A:0xb2255fc) "' name='RPMH_PDC_AOP_TCS1_CMD2_DATA'/>"
WRITE #1 "        <register address='0xb22560c' value='0x" DATA.LONG(A:0xb22560c) "' name='RPMH_PDC_AOP_TCS1_CMD3_DATA'/>"
WRITE #1 "        <register address='0xb2256a4' value='0x" DATA.LONG(A:0xb2256a4) "' name='RPMH_PDC_AOP_TCS2_CMD0_DATA'/>"
WRITE #1 "        <register address='0xb2256b4' value='0x" DATA.LONG(A:0xb2256b4) "' name='RPMH_PDC_AOP_TCS2_CMD1_DATA'/>"
WRITE #1 "        <register address='0xb2256c4' value='0x" DATA.LONG(A:0xb2256c4) "' name='RPMH_PDC_AOP_TCS2_CMD2_DATA'/>"
WRITE #1 "        <register address='0xb2256d4' value='0x" DATA.LONG(A:0xb2256d4) "' name='RPMH_PDC_AOP_TCS2_CMD3_DATA'/>"
WRITE #1 "        <register address='0xb22576c' value='0x" DATA.LONG(A:0xb22576c) "' name='RPMH_PDC_AOP_TCS3_CMD0_DATA'/>"
WRITE #1 "        <register address='0xb22577c' value='0x" DATA.LONG(A:0xb22577c) "' name='RPMH_PDC_AOP_TCS3_CMD1_DATA'/>"
WRITE #1 "        <register address='0xb22578c' value='0x" DATA.LONG(A:0xb22578c) "' name='RPMH_PDC_AOP_TCS3_CMD2_DATA'/>"
WRITE #1 "        <register address='0xb22579c' value='0x" DATA.LONG(A:0xb22579c) "' name='RPMH_PDC_AOP_TCS3_CMD3_DATA'/>"
WRITE #1 "        <register address='0xb230000' value='0x" DATA.LONG(A:0xb230000) "' name='RPMH_PDC_DEBUG_VOTE_CMP_DATA_DRV0'/>"
WRITE #1 "        <register address='0xb230010' value='0x" DATA.LONG(A:0xb230010) "' name='RPMH_PDC_DEBUG_IRQ_ENABLE_BANK0_DRV0'/>"
WRITE #1 "        <register address='0xb230110' value='0x" DATA.LONG(A:0xb230110) "' name='RPMH_PDC_DEBUG_IRQ_0_CFG_DRV0'/>"
WRITE #1 "        <register address='0xb230900' value='0x" DATA.LONG(A:0xb230900) "' name='RPMH_PDC_DEBUG_IRQ_STATUS_BANK0_DRV0'/>"
WRITE #1 "        <register address='0xb231000' value='0x" DATA.LONG(A:0xb231000) "' name='RPMH_PDC_DEBUG_PDC_VERSION_DRV0'/>"
WRITE #1 "        <register address='0xb231004' value='0x" DATA.LONG(A:0xb231004) "' name='RPMH_PDC_DEBUG_PDC_PARAM_RESOURCE_DRV0'/>"
WRITE #1 "        <register address='0xb231008' value='0x" DATA.LONG(A:0xb231008) "' name='RPMH_PDC_DEBUG_PDC_PARAM_SEQ_CONFIG_DRV0'/>"
WRITE #1 "        <register address='0xb23100c' value='0x" DATA.LONG(A:0xb23100c) "' name='RPMH_PDC_DEBUG_PDC_PARAM_IRQ_CONFIG_DRV0'/>"
WRITE #1 "        <register address='0xb231020' value='0x" DATA.LONG(A:0xb231020) "' name='RPMH_PDC_DEBUG_SEQ_BUSY_DRV0'/>"
WRITE #1 "        <register address='0xb231030' value='0x" DATA.LONG(A:0xb231030) "' name='RPMH_PDC_DEBUG_PDC_MODE_STATUS_DRV0'/>"
WRITE #1 "        <register address='0xb231300' value='0x" DATA.LONG(A:0xb231300) "' name='RPMH_PDC_DEBUG_TCS0_DRV0_STATUS'/>"
WRITE #1 "        <register address='0xb2313c8' value='0x" DATA.LONG(A:0xb2313c8) "' name='RPMH_PDC_DEBUG_TCS1_DRV0_STATUS'/>"
WRITE #1 "        <register address='0xb231490' value='0x" DATA.LONG(A:0xb231490) "' name='RPMH_PDC_DEBUG_TCS2_DRV0_STATUS'/>"
WRITE #1 "        <register address='0xb231558' value='0x" DATA.LONG(A:0xb231558) "' name='RPMH_PDC_DEBUG_TCS3_DRV0_STATUS'/>"
WRITE #1 "        <register address='0xb231304' value='0x" DATA.LONG(A:0xb231304) "' name='RPMH_PDC_DEBUG_TCS0_CMD0_DRV0_STATUS'/>"
WRITE #1 "        <register address='0xb23130c' value='0x" DATA.LONG(A:0xb23130c) "' name='RPMH_PDC_DEBUG_TCS0_CMD1_DRV0_STATUS'/>"
WRITE #1 "        <register address='0xb231314' value='0x" DATA.LONG(A:0xb231314) "' name='RPMH_PDC_DEBUG_TCS0_CMD2_DRV0_STATUS'/>"
WRITE #1 "        <register address='0xb23131c' value='0x" DATA.LONG(A:0xb23131c) "' name='RPMH_PDC_DEBUG_TCS0_CMD3_DRV0_STATUS'/>"
WRITE #1 "        <register address='0xb2313cc' value='0x" DATA.LONG(A:0xb2313cc) "' name='RPMH_PDC_DEBUG_TCS1_CMD0_DRV0_STATUS'/>"
WRITE #1 "        <register address='0xb2313d4' value='0x" DATA.LONG(A:0xb2313d4) "' name='RPMH_PDC_DEBUG_TCS1_CMD1_DRV0_STATUS'/>"
WRITE #1 "        <register address='0xb2313dc' value='0x" DATA.LONG(A:0xb2313dc) "' name='RPMH_PDC_DEBUG_TCS1_CMD2_DRV0_STATUS'/>"
WRITE #1 "        <register address='0xb2313e4' value='0x" DATA.LONG(A:0xb2313e4) "' name='RPMH_PDC_DEBUG_TCS1_CMD3_DRV0_STATUS'/>"
WRITE #1 "        <register address='0xb231494' value='0x" DATA.LONG(A:0xb231494) "' name='RPMH_PDC_DEBUG_TCS2_CMD0_DRV0_STATUS'/>"
WRITE #1 "        <register address='0xb23149c' value='0x" DATA.LONG(A:0xb23149c) "' name='RPMH_PDC_DEBUG_TCS2_CMD1_DRV0_STATUS'/>"
WRITE #1 "        <register address='0xb2314a4' value='0x" DATA.LONG(A:0xb2314a4) "' name='RPMH_PDC_DEBUG_TCS2_CMD2_DRV0_STATUS'/>"
WRITE #1 "        <register address='0xb2314ac' value='0x" DATA.LONG(A:0xb2314ac) "' name='RPMH_PDC_DEBUG_TCS2_CMD3_DRV0_STATUS'/>"
WRITE #1 "        <register address='0xb23155c' value='0x" DATA.LONG(A:0xb23155c) "' name='RPMH_PDC_DEBUG_TCS3_CMD0_DRV0_STATUS'/>"
WRITE #1 "        <register address='0xb231564' value='0x" DATA.LONG(A:0xb231564) "' name='RPMH_PDC_DEBUG_TCS3_CMD1_DRV0_STATUS'/>"
WRITE #1 "        <register address='0xb23156c' value='0x" DATA.LONG(A:0xb23156c) "' name='RPMH_PDC_DEBUG_TCS3_CMD2_DRV0_STATUS'/>"
WRITE #1 "        <register address='0xb231574' value='0x" DATA.LONG(A:0xb231574) "' name='RPMH_PDC_DEBUG_TCS3_CMD3_DRV0_STATUS'/>"
WRITE #1 "        <register address='0xb234500' value='0x" DATA.LONG(A:0xb234500) "' name='RPMH_PDC_DEBUG_ENABLE_PDC'/>"
WRITE #1 "        <register address='0xb234510' value='0x" DATA.LONG(A:0xb234510) "' name='RPMH_PDC_DEBUG_TIMER_MATCH_VALUE_LO'/>"
WRITE #1 "        <register address='0xb234514' value='0x" DATA.LONG(A:0xb234514) "' name='RPMH_PDC_DEBUG_TIMER_MATCH_VALUE_HI'/>"
WRITE #1 "        <register address='0xb234518' value='0x" DATA.LONG(A:0xb234518) "' name='RPMH_PDC_DEBUG_TIMER_DISABLED_FOR_ARC'/>"
WRITE #1 "        <register address='0xb234520' value='0x" DATA.LONG(A:0xb234520) "' name='RPMH_PDC_DEBUG_SEQ_START_ADDR'/>"
WRITE #1 "        <register address='0xb234524' value='0x" DATA.LONG(A:0xb234524) "' name='RPMH_PDC_DEBUG_SEQ_OVERRIDE_START_ADDR'/>"
WRITE #1 "        <register address='0xb23452c' value='0x" DATA.LONG(A:0xb23452c) "' name='RPMH_PDC_DEBUG_SEQ_OVERRIDE_TRIGGER'/>"
WRITE #1 "        <register address='0xb234530' value='0x" DATA.LONG(A:0xb234530) "' name='RPMH_PDC_DEBUG_SEQ_PWR_CTRL_OVERRIDE_MASK'/>"
WRITE #1 "        <register address='0xb234534' value='0x" DATA.LONG(A:0xb234534) "' name='RPMH_PDC_DEBUG_SEQ_PWR_CTRL_OVERRIDE_VAL'/>"
WRITE #1 "        <register address='0xb234540' value='0x" DATA.LONG(A:0xb234540) "' name='RPMH_PDC_DEBUG_SEQ_WAIT_EVENT_OVERRIDE_MASK'/>"
WRITE #1 "        <register address='0xb234544' value='0x" DATA.LONG(A:0xb234544) "' name='RPMH_PDC_DEBUG_SEQ_WAIT_EVENT_OVERRIDE_VAL'/>"
WRITE #1 "        <register address='0xb234550' value='0x" DATA.LONG(A:0xb234550) "' name='RPMH_PDC_DEBUG_SEQ_BR_EVENT_OVERRIDE_MASK'/>"
WRITE #1 "        <register address='0xb234554' value='0x" DATA.LONG(A:0xb234554) "' name='RPMH_PDC_DEBUG_SEQ_BR_EVENT_OVERRIDE_VAL'/>"
WRITE #1 "        <register address='0xb234590' value='0x" DATA.LONG(A:0xb234590) "' name='RPMH_PDC_DEBUG_SEQ_CFG_BR_ADDR_0'/>"
WRITE #1 "        <register address='0xb234594' value='0x" DATA.LONG(A:0xb234594) "' name='RPMH_PDC_DEBUG_SEQ_CFG_BR_ADDR_1'/>"
WRITE #1 "        <register address='0xb234598' value='0x" DATA.LONG(A:0xb234598) "' name='RPMH_PDC_DEBUG_SEQ_CFG_BR_ADDR_2'/>"
WRITE #1 "        <register address='0xb23459c' value='0x" DATA.LONG(A:0xb23459c) "' name='RPMH_PDC_DEBUG_SEQ_CFG_BR_ADDR_3'/>"
WRITE #1 "        <register address='0xb2345a0' value='0x" DATA.LONG(A:0xb2345a0) "' name='RPMH_PDC_DEBUG_SEQ_CFG_DELAY_VAL_0'/>"
WRITE #1 "        <register address='0xb2345a4' value='0x" DATA.LONG(A:0xb2345a4) "' name='RPMH_PDC_DEBUG_SEQ_CFG_DELAY_VAL_1'/>"
WRITE #1 "        <register address='0xb2345a8' value='0x" DATA.LONG(A:0xb2345a8) "' name='RPMH_PDC_DEBUG_SEQ_CFG_DELAY_VAL_2'/>"
WRITE #1 "        <register address='0xb2345ac' value='0x" DATA.LONG(A:0xb2345ac) "' name='RPMH_PDC_DEBUG_SEQ_CFG_DELAY_VAL_3'/>"
WRITE #1 "        <register address='0xb2345b0' value='0x" DATA.LONG(A:0xb2345b0) "' name='RPMH_PDC_DEBUG_SEQ_CFG_DELAY_VAL_4'/>"
WRITE #1 "        <register address='0xb2345b4' value='0x" DATA.LONG(A:0xb2345b4) "' name='RPMH_PDC_DEBUG_SEQ_CFG_DELAY_VAL_5'/>"
WRITE #1 "        <register address='0xb2345b8' value='0x" DATA.LONG(A:0xb2345b8) "' name='RPMH_PDC_DEBUG_SEQ_CFG_DELAY_VAL_6'/>"
WRITE #1 "        <register address='0xb2345bc' value='0x" DATA.LONG(A:0xb2345bc) "' name='RPMH_PDC_DEBUG_SEQ_CFG_DELAY_VAL_7'/>"
WRITE #1 "        <register address='0xb2345c0' value='0x" DATA.LONG(A:0xb2345c0) "' name='RPMH_PDC_DEBUG_SEQ_CFG_DELAY_VAL_8'/>"
WRITE #1 "        <register address='0xb2345c4' value='0x" DATA.LONG(A:0xb2345c4) "' name='RPMH_PDC_DEBUG_SEQ_CFG_DELAY_VAL_9'/>"
WRITE #1 "        <register address='0xb2345c8' value='0x" DATA.LONG(A:0xb2345c8) "' name='RPMH_PDC_DEBUG_SEQ_CFG_DELAY_VAL_10'/>"
WRITE #1 "        <register address='0xb2345cc' value='0x" DATA.LONG(A:0xb2345cc) "' name='RPMH_PDC_DEBUG_SEQ_CFG_DELAY_VAL_11'/>"
WRITE #1 "        <register address='0xb2345d0' value='0x" DATA.LONG(A:0xb2345d0) "' name='RPMH_PDC_DEBUG_SEQ_CFG_DELAY_VAL_12'/>"
WRITE #1 "        <register address='0xb2345d4' value='0x" DATA.LONG(A:0xb2345d4) "' name='RPMH_PDC_DEBUG_SEQ_CFG_DELAY_VAL_13'/>"
WRITE #1 "        <register address='0xb2345d8' value='0x" DATA.LONG(A:0xb2345d8) "' name='RPMH_PDC_DEBUG_SEQ_CFG_DELAY_VAL_14'/>"
WRITE #1 "        <register address='0xb2345dc' value='0x" DATA.LONG(A:0xb2345dc) "' name='RPMH_PDC_DEBUG_SEQ_CFG_DELAY_VAL_15'/>"
WRITE #1 "        <register address='0xb235500' value='0x" DATA.LONG(A:0xb235500) "' name='RPMH_PDC_DEBUG_TCS0_CONTROL'/>"
WRITE #1 "        <register address='0xb2355c8' value='0x" DATA.LONG(A:0xb2355c8) "' name='RPMH_PDC_DEBUG_TCS1_CONTROL'/>"
WRITE #1 "        <register address='0xb235690' value='0x" DATA.LONG(A:0xb235690) "' name='RPMH_PDC_DEBUG_TCS2_CONTROL'/>"
WRITE #1 "        <register address='0xb235758' value='0x" DATA.LONG(A:0xb235758) "' name='RPMH_PDC_DEBUG_TCS3_CONTROL'/>"
WRITE #1 "        <register address='0xb235504' value='0x" DATA.LONG(A:0xb235504) "' name='RPMH_PDC_DEBUG_TCS0_CMD_ENABLE_BANK'/>"
WRITE #1 "        <register address='0xb2355cc' value='0x" DATA.LONG(A:0xb2355cc) "' name='RPMH_PDC_DEBUG_TCS1_CMD_ENABLE_BANK'/>"
WRITE #1 "        <register address='0xb235694' value='0x" DATA.LONG(A:0xb235694) "' name='RPMH_PDC_DEBUG_TCS2_CMD_ENABLE_BANK'/>"
WRITE #1 "        <register address='0xb23575c' value='0x" DATA.LONG(A:0xb23575c) "' name='RPMH_PDC_DEBUG_TCS3_CMD_ENABLE_BANK'/>"
WRITE #1 "        <register address='0xb235508' value='0x" DATA.LONG(A:0xb235508) "' name='RPMH_PDC_DEBUG_TCS0_CMD_WAIT_FOR_CMPL_BANK'/>"
WRITE #1 "        <register address='0xb2355d0' value='0x" DATA.LONG(A:0xb2355d0) "' name='RPMH_PDC_DEBUG_TCS1_CMD_WAIT_FOR_CMPL_BANK'/>"
WRITE #1 "        <register address='0xb235698' value='0x" DATA.LONG(A:0xb235698) "' name='RPMH_PDC_DEBUG_TCS2_CMD_WAIT_FOR_CMPL_BANK'/>"
WRITE #1 "        <register address='0xb235760' value='0x" DATA.LONG(A:0xb235760) "' name='RPMH_PDC_DEBUG_TCS3_CMD_WAIT_FOR_CMPL_BANK'/>"
WRITE #1 "        <register address='0xb23550c' value='0x" DATA.LONG(A:0xb23550c) "' name='RPMH_PDC_DEBUG_TCS0_CMD0_MSGID'/>"
WRITE #1 "        <register address='0xb23551c' value='0x" DATA.LONG(A:0xb23551c) "' name='RPMH_PDC_DEBUG_TCS0_CMD1_MSGID'/>"
WRITE #1 "        <register address='0xb23552c' value='0x" DATA.LONG(A:0xb23552c) "' name='RPMH_PDC_DEBUG_TCS0_CMD2_MSGID'/>"
WRITE #1 "        <register address='0xb23553c' value='0x" DATA.LONG(A:0xb23553c) "' name='RPMH_PDC_DEBUG_TCS0_CMD3_MSGID'/>"
WRITE #1 "        <register address='0xb2355d4' value='0x" DATA.LONG(A:0xb2355d4) "' name='RPMH_PDC_DEBUG_TCS1_CMD0_MSGID'/>"
WRITE #1 "        <register address='0xb2355e4' value='0x" DATA.LONG(A:0xb2355e4) "' name='RPMH_PDC_DEBUG_TCS1_CMD1_MSGID'/>"
WRITE #1 "        <register address='0xb2355f4' value='0x" DATA.LONG(A:0xb2355f4) "' name='RPMH_PDC_DEBUG_TCS1_CMD2_MSGID'/>"
WRITE #1 "        <register address='0xb235604' value='0x" DATA.LONG(A:0xb235604) "' name='RPMH_PDC_DEBUG_TCS1_CMD3_MSGID'/>"
WRITE #1 "        <register address='0xb23569c' value='0x" DATA.LONG(A:0xb23569c) "' name='RPMH_PDC_DEBUG_TCS2_CMD0_MSGID'/>"
WRITE #1 "        <register address='0xb2356ac' value='0x" DATA.LONG(A:0xb2356ac) "' name='RPMH_PDC_DEBUG_TCS2_CMD1_MSGID'/>"
WRITE #1 "        <register address='0xb2356bc' value='0x" DATA.LONG(A:0xb2356bc) "' name='RPMH_PDC_DEBUG_TCS2_CMD2_MSGID'/>"
WRITE #1 "        <register address='0xb2356cc' value='0x" DATA.LONG(A:0xb2356cc) "' name='RPMH_PDC_DEBUG_TCS2_CMD3_MSGID'/>"
WRITE #1 "        <register address='0xb235764' value='0x" DATA.LONG(A:0xb235764) "' name='RPMH_PDC_DEBUG_TCS3_CMD0_MSGID'/>"
WRITE #1 "        <register address='0xb235774' value='0x" DATA.LONG(A:0xb235774) "' name='RPMH_PDC_DEBUG_TCS3_CMD1_MSGID'/>"
WRITE #1 "        <register address='0xb235784' value='0x" DATA.LONG(A:0xb235784) "' name='RPMH_PDC_DEBUG_TCS3_CMD2_MSGID'/>"
WRITE #1 "        <register address='0xb235794' value='0x" DATA.LONG(A:0xb235794) "' name='RPMH_PDC_DEBUG_TCS3_CMD3_MSGID'/>"
WRITE #1 "        <register address='0xb235510' value='0x" DATA.LONG(A:0xb235510) "' name='RPMH_PDC_DEBUG_TCS0_CMD0_ADDR'/>"
WRITE #1 "        <register address='0xb235520' value='0x" DATA.LONG(A:0xb235520) "' name='RPMH_PDC_DEBUG_TCS0_CMD1_ADDR'/>"
WRITE #1 "        <register address='0xb235530' value='0x" DATA.LONG(A:0xb235530) "' name='RPMH_PDC_DEBUG_TCS0_CMD2_ADDR'/>"
WRITE #1 "        <register address='0xb235540' value='0x" DATA.LONG(A:0xb235540) "' name='RPMH_PDC_DEBUG_TCS0_CMD3_ADDR'/>"
WRITE #1 "        <register address='0xb2355d8' value='0x" DATA.LONG(A:0xb2355d8) "' name='RPMH_PDC_DEBUG_TCS1_CMD0_ADDR'/>"
WRITE #1 "        <register address='0xb2355e8' value='0x" DATA.LONG(A:0xb2355e8) "' name='RPMH_PDC_DEBUG_TCS1_CMD1_ADDR'/>"
WRITE #1 "        <register address='0xb2355f8' value='0x" DATA.LONG(A:0xb2355f8) "' name='RPMH_PDC_DEBUG_TCS1_CMD2_ADDR'/>"
WRITE #1 "        <register address='0xb235608' value='0x" DATA.LONG(A:0xb235608) "' name='RPMH_PDC_DEBUG_TCS1_CMD3_ADDR'/>"
WRITE #1 "        <register address='0xb2356a0' value='0x" DATA.LONG(A:0xb2356a0) "' name='RPMH_PDC_DEBUG_TCS2_CMD0_ADDR'/>"
WRITE #1 "        <register address='0xb2356b0' value='0x" DATA.LONG(A:0xb2356b0) "' name='RPMH_PDC_DEBUG_TCS2_CMD1_ADDR'/>"
WRITE #1 "        <register address='0xb2356c0' value='0x" DATA.LONG(A:0xb2356c0) "' name='RPMH_PDC_DEBUG_TCS2_CMD2_ADDR'/>"
WRITE #1 "        <register address='0xb2356d0' value='0x" DATA.LONG(A:0xb2356d0) "' name='RPMH_PDC_DEBUG_TCS2_CMD3_ADDR'/>"
WRITE #1 "        <register address='0xb235768' value='0x" DATA.LONG(A:0xb235768) "' name='RPMH_PDC_DEBUG_TCS3_CMD0_ADDR'/>"
WRITE #1 "        <register address='0xb235778' value='0x" DATA.LONG(A:0xb235778) "' name='RPMH_PDC_DEBUG_TCS3_CMD1_ADDR'/>"
WRITE #1 "        <register address='0xb235788' value='0x" DATA.LONG(A:0xb235788) "' name='RPMH_PDC_DEBUG_TCS3_CMD2_ADDR'/>"
WRITE #1 "        <register address='0xb235798' value='0x" DATA.LONG(A:0xb235798) "' name='RPMH_PDC_DEBUG_TCS3_CMD3_ADDR'/>"
WRITE #1 "        <register address='0xb235514' value='0x" DATA.LONG(A:0xb235514) "' name='RPMH_PDC_DEBUG_TCS0_CMD0_DATA'/>"
WRITE #1 "        <register address='0xb235524' value='0x" DATA.LONG(A:0xb235524) "' name='RPMH_PDC_DEBUG_TCS0_CMD1_DATA'/>"
WRITE #1 "        <register address='0xb235534' value='0x" DATA.LONG(A:0xb235534) "' name='RPMH_PDC_DEBUG_TCS0_CMD2_DATA'/>"
WRITE #1 "        <register address='0xb235544' value='0x" DATA.LONG(A:0xb235544) "' name='RPMH_PDC_DEBUG_TCS0_CMD3_DATA'/>"
WRITE #1 "        <register address='0xb2355dc' value='0x" DATA.LONG(A:0xb2355dc) "' name='RPMH_PDC_DEBUG_TCS1_CMD0_DATA'/>"
WRITE #1 "        <register address='0xb2355ec' value='0x" DATA.LONG(A:0xb2355ec) "' name='RPMH_PDC_DEBUG_TCS1_CMD1_DATA'/>"
WRITE #1 "        <register address='0xb2355fc' value='0x" DATA.LONG(A:0xb2355fc) "' name='RPMH_PDC_DEBUG_TCS1_CMD2_DATA'/>"
WRITE #1 "        <register address='0xb23560c' value='0x" DATA.LONG(A:0xb23560c) "' name='RPMH_PDC_DEBUG_TCS1_CMD3_DATA'/>"
WRITE #1 "        <register address='0xb2356a4' value='0x" DATA.LONG(A:0xb2356a4) "' name='RPMH_PDC_DEBUG_TCS2_CMD0_DATA'/>"
WRITE #1 "        <register address='0xb2356b4' value='0x" DATA.LONG(A:0xb2356b4) "' name='RPMH_PDC_DEBUG_TCS2_CMD1_DATA'/>"
WRITE #1 "        <register address='0xb2356c4' value='0x" DATA.LONG(A:0xb2356c4) "' name='RPMH_PDC_DEBUG_TCS2_CMD2_DATA'/>"
WRITE #1 "        <register address='0xb2356d4' value='0x" DATA.LONG(A:0xb2356d4) "' name='RPMH_PDC_DEBUG_TCS2_CMD3_DATA'/>"
WRITE #1 "        <register address='0xb23576c' value='0x" DATA.LONG(A:0xb23576c) "' name='RPMH_PDC_DEBUG_TCS3_CMD0_DATA'/>"
WRITE #1 "        <register address='0xb23577c' value='0x" DATA.LONG(A:0xb23577c) "' name='RPMH_PDC_DEBUG_TCS3_CMD1_DATA'/>"
WRITE #1 "        <register address='0xb23578c' value='0x" DATA.LONG(A:0xb23578c) "' name='RPMH_PDC_DEBUG_TCS3_CMD2_DATA'/>"
WRITE #1 "        <register address='0xb23579c' value='0x" DATA.LONG(A:0xb23579c) "' name='RPMH_PDC_DEBUG_TCS3_CMD3_DATA'/>"
WRITE #1 "        <register address='0xb240000' value='0x" DATA.LONG(A:0xb240000) "' name='RPMH_PDC_MODEM_VOTE_CMP_DATA_DRV0'/>"
WRITE #1 "        <register address='0xb250000' value='0x" DATA.LONG(A:0xb250000) "' name='RPMH_PDC_MODEM_VOTE_CMP_DATA_DRV1'/>"
WRITE #1 "        <register address='0xb240010' value='0x" DATA.LONG(A:0xb240010) "' name='RPMH_PDC_MODEM_IRQ_ENABLE_BANK0_DRV0'/>"
WRITE #1 "        <register address='0xb240014' value='0x" DATA.LONG(A:0xb240014) "' name='RPMH_PDC_MODEM_IRQ_ENABLE_BANK1_DRV0'/>"
WRITE #1 "        <register address='0xb250010' value='0x" DATA.LONG(A:0xb250010) "' name='RPMH_PDC_MODEM_IRQ_ENABLE_BANK0_DRV1'/>"
WRITE #1 "        <register address='0xb250014' value='0x" DATA.LONG(A:0xb250014) "' name='RPMH_PDC_MODEM_IRQ_ENABLE_BANK1_DRV1'/>"
WRITE #1 "        <register address='0xb240110' value='0x" DATA.LONG(A:0xb240110) "' name='RPMH_PDC_MODEM_IRQ_0_CFG_DRV0'/>"
WRITE #1 "        <register address='0xb240114' value='0x" DATA.LONG(A:0xb240114) "' name='RPMH_PDC_MODEM_IRQ_1_CFG_DRV0'/>"
WRITE #1 "        <register address='0xb240118' value='0x" DATA.LONG(A:0xb240118) "' name='RPMH_PDC_MODEM_IRQ_2_CFG_DRV0'/>"
WRITE #1 "        <register address='0xb24011c' value='0x" DATA.LONG(A:0xb24011c) "' name='RPMH_PDC_MODEM_IRQ_3_CFG_DRV0'/>"
WRITE #1 "        <register address='0xb240120' value='0x" DATA.LONG(A:0xb240120) "' name='RPMH_PDC_MODEM_IRQ_4_CFG_DRV0'/>"
WRITE #1 "        <register address='0xb240124' value='0x" DATA.LONG(A:0xb240124) "' name='RPMH_PDC_MODEM_IRQ_5_CFG_DRV0'/>"
WRITE #1 "        <register address='0xb240128' value='0x" DATA.LONG(A:0xb240128) "' name='RPMH_PDC_MODEM_IRQ_6_CFG_DRV0'/>"
WRITE #1 "        <register address='0xb24012c' value='0x" DATA.LONG(A:0xb24012c) "' name='RPMH_PDC_MODEM_IRQ_7_CFG_DRV0'/>"
WRITE #1 "        <register address='0xb240130' value='0x" DATA.LONG(A:0xb240130) "' name='RPMH_PDC_MODEM_IRQ_8_CFG_DRV0'/>"
WRITE #1 "        <register address='0xb240134' value='0x" DATA.LONG(A:0xb240134) "' name='RPMH_PDC_MODEM_IRQ_9_CFG_DRV0'/>"
WRITE #1 "        <register address='0xb240138' value='0x" DATA.LONG(A:0xb240138) "' name='RPMH_PDC_MODEM_IRQ_10_CFG_DRV0'/>"
WRITE #1 "        <register address='0xb24013c' value='0x" DATA.LONG(A:0xb24013c) "' name='RPMH_PDC_MODEM_IRQ_11_CFG_DRV0'/>"
WRITE #1 "        <register address='0xb240140' value='0x" DATA.LONG(A:0xb240140) "' name='RPMH_PDC_MODEM_IRQ_12_CFG_DRV0'/>"
WRITE #1 "        <register address='0xb240144' value='0x" DATA.LONG(A:0xb240144) "' name='RPMH_PDC_MODEM_IRQ_13_CFG_DRV0'/>"
WRITE #1 "        <register address='0xb240148' value='0x" DATA.LONG(A:0xb240148) "' name='RPMH_PDC_MODEM_IRQ_14_CFG_DRV0'/>"
WRITE #1 "        <register address='0xb24014c' value='0x" DATA.LONG(A:0xb24014c) "' name='RPMH_PDC_MODEM_IRQ_15_CFG_DRV0'/>"
WRITE #1 "        <register address='0xb240150' value='0x" DATA.LONG(A:0xb240150) "' name='RPMH_PDC_MODEM_IRQ_16_CFG_DRV0'/>"
WRITE #1 "        <register address='0xb240154' value='0x" DATA.LONG(A:0xb240154) "' name='RPMH_PDC_MODEM_IRQ_17_CFG_DRV0'/>"
WRITE #1 "        <register address='0xb240158' value='0x" DATA.LONG(A:0xb240158) "' name='RPMH_PDC_MODEM_IRQ_18_CFG_DRV0'/>"
WRITE #1 "        <register address='0xb24015c' value='0x" DATA.LONG(A:0xb24015c) "' name='RPMH_PDC_MODEM_IRQ_19_CFG_DRV0'/>"
WRITE #1 "        <register address='0xb240160' value='0x" DATA.LONG(A:0xb240160) "' name='RPMH_PDC_MODEM_IRQ_20_CFG_DRV0'/>"
WRITE #1 "        <register address='0xb240164' value='0x" DATA.LONG(A:0xb240164) "' name='RPMH_PDC_MODEM_IRQ_21_CFG_DRV0'/>"
WRITE #1 "        <register address='0xb240168' value='0x" DATA.LONG(A:0xb240168) "' name='RPMH_PDC_MODEM_IRQ_22_CFG_DRV0'/>"
WRITE #1 "        <register address='0xb24016c' value='0x" DATA.LONG(A:0xb24016c) "' name='RPMH_PDC_MODEM_IRQ_23_CFG_DRV0'/>"
WRITE #1 "        <register address='0xb240170' value='0x" DATA.LONG(A:0xb240170) "' name='RPMH_PDC_MODEM_IRQ_24_CFG_DRV0'/>"
WRITE #1 "        <register address='0xb240174' value='0x" DATA.LONG(A:0xb240174) "' name='RPMH_PDC_MODEM_IRQ_25_CFG_DRV0'/>"
WRITE #1 "        <register address='0xb240178' value='0x" DATA.LONG(A:0xb240178) "' name='RPMH_PDC_MODEM_IRQ_26_CFG_DRV0'/>"
WRITE #1 "        <register address='0xb24017c' value='0x" DATA.LONG(A:0xb24017c) "' name='RPMH_PDC_MODEM_IRQ_27_CFG_DRV0'/>"
WRITE #1 "        <register address='0xb240180' value='0x" DATA.LONG(A:0xb240180) "' name='RPMH_PDC_MODEM_IRQ_28_CFG_DRV0'/>"
WRITE #1 "        <register address='0xb240184' value='0x" DATA.LONG(A:0xb240184) "' name='RPMH_PDC_MODEM_IRQ_29_CFG_DRV0'/>"
WRITE #1 "        <register address='0xb240188' value='0x" DATA.LONG(A:0xb240188) "' name='RPMH_PDC_MODEM_IRQ_30_CFG_DRV0'/>"
WRITE #1 "        <register address='0xb24018c' value='0x" DATA.LONG(A:0xb24018c) "' name='RPMH_PDC_MODEM_IRQ_31_CFG_DRV0'/>"
WRITE #1 "        <register address='0xb240190' value='0x" DATA.LONG(A:0xb240190) "' name='RPMH_PDC_MODEM_IRQ_32_CFG_DRV0'/>"
WRITE #1 "        <register address='0xb240194' value='0x" DATA.LONG(A:0xb240194) "' name='RPMH_PDC_MODEM_IRQ_33_CFG_DRV0'/>"
WRITE #1 "        <register address='0xb240198' value='0x" DATA.LONG(A:0xb240198) "' name='RPMH_PDC_MODEM_IRQ_34_CFG_DRV0'/>"
WRITE #1 "        <register address='0xb24019c' value='0x" DATA.LONG(A:0xb24019c) "' name='RPMH_PDC_MODEM_IRQ_35_CFG_DRV0'/>"
WRITE #1 "        <register address='0xb2401a0' value='0x" DATA.LONG(A:0xb2401a0) "' name='RPMH_PDC_MODEM_IRQ_36_CFG_DRV0'/>"
WRITE #1 "        <register address='0xb2401a4' value='0x" DATA.LONG(A:0xb2401a4) "' name='RPMH_PDC_MODEM_IRQ_37_CFG_DRV0'/>"
WRITE #1 "        <register address='0xb2401a8' value='0x" DATA.LONG(A:0xb2401a8) "' name='RPMH_PDC_MODEM_IRQ_38_CFG_DRV0'/>"
WRITE #1 "        <register address='0xb2401ac' value='0x" DATA.LONG(A:0xb2401ac) "' name='RPMH_PDC_MODEM_IRQ_39_CFG_DRV0'/>"
WRITE #1 "        <register address='0xb2401b0' value='0x" DATA.LONG(A:0xb2401b0) "' name='RPMH_PDC_MODEM_IRQ_40_CFG_DRV0'/>"
WRITE #1 "        <register address='0xb2401b4' value='0x" DATA.LONG(A:0xb2401b4) "' name='RPMH_PDC_MODEM_IRQ_41_CFG_DRV0'/>"
WRITE #1 "        <register address='0xb2401b8' value='0x" DATA.LONG(A:0xb2401b8) "' name='RPMH_PDC_MODEM_IRQ_42_CFG_DRV0'/>"
WRITE #1 "        <register address='0xb2401bc' value='0x" DATA.LONG(A:0xb2401bc) "' name='RPMH_PDC_MODEM_IRQ_43_CFG_DRV0'/>"
WRITE #1 "        <register address='0xb2401c0' value='0x" DATA.LONG(A:0xb2401c0) "' name='RPMH_PDC_MODEM_IRQ_44_CFG_DRV0'/>"
WRITE #1 "        <register address='0xb250110' value='0x" DATA.LONG(A:0xb250110) "' name='RPMH_PDC_MODEM_IRQ_0_CFG_DRV1'/>"
WRITE #1 "        <register address='0xb250114' value='0x" DATA.LONG(A:0xb250114) "' name='RPMH_PDC_MODEM_IRQ_1_CFG_DRV1'/>"
WRITE #1 "        <register address='0xb250118' value='0x" DATA.LONG(A:0xb250118) "' name='RPMH_PDC_MODEM_IRQ_2_CFG_DRV1'/>"
WRITE #1 "        <register address='0xb25011c' value='0x" DATA.LONG(A:0xb25011c) "' name='RPMH_PDC_MODEM_IRQ_3_CFG_DRV1'/>"
WRITE #1 "        <register address='0xb250120' value='0x" DATA.LONG(A:0xb250120) "' name='RPMH_PDC_MODEM_IRQ_4_CFG_DRV1'/>"
WRITE #1 "        <register address='0xb250124' value='0x" DATA.LONG(A:0xb250124) "' name='RPMH_PDC_MODEM_IRQ_5_CFG_DRV1'/>"
WRITE #1 "        <register address='0xb250128' value='0x" DATA.LONG(A:0xb250128) "' name='RPMH_PDC_MODEM_IRQ_6_CFG_DRV1'/>"
WRITE #1 "        <register address='0xb25012c' value='0x" DATA.LONG(A:0xb25012c) "' name='RPMH_PDC_MODEM_IRQ_7_CFG_DRV1'/>"
WRITE #1 "        <register address='0xb250130' value='0x" DATA.LONG(A:0xb250130) "' name='RPMH_PDC_MODEM_IRQ_8_CFG_DRV1'/>"
WRITE #1 "        <register address='0xb250134' value='0x" DATA.LONG(A:0xb250134) "' name='RPMH_PDC_MODEM_IRQ_9_CFG_DRV1'/>"
WRITE #1 "        <register address='0xb250138' value='0x" DATA.LONG(A:0xb250138) "' name='RPMH_PDC_MODEM_IRQ_10_CFG_DRV1'/>"
WRITE #1 "        <register address='0xb25013c' value='0x" DATA.LONG(A:0xb25013c) "' name='RPMH_PDC_MODEM_IRQ_11_CFG_DRV1'/>"
WRITE #1 "        <register address='0xb250140' value='0x" DATA.LONG(A:0xb250140) "' name='RPMH_PDC_MODEM_IRQ_12_CFG_DRV1'/>"
WRITE #1 "        <register address='0xb250144' value='0x" DATA.LONG(A:0xb250144) "' name='RPMH_PDC_MODEM_IRQ_13_CFG_DRV1'/>"
WRITE #1 "        <register address='0xb250148' value='0x" DATA.LONG(A:0xb250148) "' name='RPMH_PDC_MODEM_IRQ_14_CFG_DRV1'/>"
WRITE #1 "        <register address='0xb25014c' value='0x" DATA.LONG(A:0xb25014c) "' name='RPMH_PDC_MODEM_IRQ_15_CFG_DRV1'/>"
WRITE #1 "        <register address='0xb250150' value='0x" DATA.LONG(A:0xb250150) "' name='RPMH_PDC_MODEM_IRQ_16_CFG_DRV1'/>"
WRITE #1 "        <register address='0xb250154' value='0x" DATA.LONG(A:0xb250154) "' name='RPMH_PDC_MODEM_IRQ_17_CFG_DRV1'/>"
WRITE #1 "        <register address='0xb250158' value='0x" DATA.LONG(A:0xb250158) "' name='RPMH_PDC_MODEM_IRQ_18_CFG_DRV1'/>"
WRITE #1 "        <register address='0xb25015c' value='0x" DATA.LONG(A:0xb25015c) "' name='RPMH_PDC_MODEM_IRQ_19_CFG_DRV1'/>"
WRITE #1 "        <register address='0xb250160' value='0x" DATA.LONG(A:0xb250160) "' name='RPMH_PDC_MODEM_IRQ_20_CFG_DRV1'/>"
WRITE #1 "        <register address='0xb250164' value='0x" DATA.LONG(A:0xb250164) "' name='RPMH_PDC_MODEM_IRQ_21_CFG_DRV1'/>"
WRITE #1 "        <register address='0xb250168' value='0x" DATA.LONG(A:0xb250168) "' name='RPMH_PDC_MODEM_IRQ_22_CFG_DRV1'/>"
WRITE #1 "        <register address='0xb25016c' value='0x" DATA.LONG(A:0xb25016c) "' name='RPMH_PDC_MODEM_IRQ_23_CFG_DRV1'/>"
WRITE #1 "        <register address='0xb250170' value='0x" DATA.LONG(A:0xb250170) "' name='RPMH_PDC_MODEM_IRQ_24_CFG_DRV1'/>"
WRITE #1 "        <register address='0xb250174' value='0x" DATA.LONG(A:0xb250174) "' name='RPMH_PDC_MODEM_IRQ_25_CFG_DRV1'/>"
WRITE #1 "        <register address='0xb250178' value='0x" DATA.LONG(A:0xb250178) "' name='RPMH_PDC_MODEM_IRQ_26_CFG_DRV1'/>"
WRITE #1 "        <register address='0xb25017c' value='0x" DATA.LONG(A:0xb25017c) "' name='RPMH_PDC_MODEM_IRQ_27_CFG_DRV1'/>"
WRITE #1 "        <register address='0xb250180' value='0x" DATA.LONG(A:0xb250180) "' name='RPMH_PDC_MODEM_IRQ_28_CFG_DRV1'/>"
WRITE #1 "        <register address='0xb250184' value='0x" DATA.LONG(A:0xb250184) "' name='RPMH_PDC_MODEM_IRQ_29_CFG_DRV1'/>"
WRITE #1 "        <register address='0xb250188' value='0x" DATA.LONG(A:0xb250188) "' name='RPMH_PDC_MODEM_IRQ_30_CFG_DRV1'/>"
WRITE #1 "        <register address='0xb25018c' value='0x" DATA.LONG(A:0xb25018c) "' name='RPMH_PDC_MODEM_IRQ_31_CFG_DRV1'/>"
WRITE #1 "        <register address='0xb250190' value='0x" DATA.LONG(A:0xb250190) "' name='RPMH_PDC_MODEM_IRQ_32_CFG_DRV1'/>"
WRITE #1 "        <register address='0xb250194' value='0x" DATA.LONG(A:0xb250194) "' name='RPMH_PDC_MODEM_IRQ_33_CFG_DRV1'/>"
WRITE #1 "        <register address='0xb250198' value='0x" DATA.LONG(A:0xb250198) "' name='RPMH_PDC_MODEM_IRQ_34_CFG_DRV1'/>"
WRITE #1 "        <register address='0xb25019c' value='0x" DATA.LONG(A:0xb25019c) "' name='RPMH_PDC_MODEM_IRQ_35_CFG_DRV1'/>"
WRITE #1 "        <register address='0xb2501a0' value='0x" DATA.LONG(A:0xb2501a0) "' name='RPMH_PDC_MODEM_IRQ_36_CFG_DRV1'/>"
WRITE #1 "        <register address='0xb2501a4' value='0x" DATA.LONG(A:0xb2501a4) "' name='RPMH_PDC_MODEM_IRQ_37_CFG_DRV1'/>"
WRITE #1 "        <register address='0xb2501a8' value='0x" DATA.LONG(A:0xb2501a8) "' name='RPMH_PDC_MODEM_IRQ_38_CFG_DRV1'/>"
WRITE #1 "        <register address='0xb2501ac' value='0x" DATA.LONG(A:0xb2501ac) "' name='RPMH_PDC_MODEM_IRQ_39_CFG_DRV1'/>"
WRITE #1 "        <register address='0xb2501b0' value='0x" DATA.LONG(A:0xb2501b0) "' name='RPMH_PDC_MODEM_IRQ_40_CFG_DRV1'/>"
WRITE #1 "        <register address='0xb2501b4' value='0x" DATA.LONG(A:0xb2501b4) "' name='RPMH_PDC_MODEM_IRQ_41_CFG_DRV1'/>"
WRITE #1 "        <register address='0xb2501b8' value='0x" DATA.LONG(A:0xb2501b8) "' name='RPMH_PDC_MODEM_IRQ_42_CFG_DRV1'/>"
WRITE #1 "        <register address='0xb2501bc' value='0x" DATA.LONG(A:0xb2501bc) "' name='RPMH_PDC_MODEM_IRQ_43_CFG_DRV1'/>"
WRITE #1 "        <register address='0xb2501c0' value='0x" DATA.LONG(A:0xb2501c0) "' name='RPMH_PDC_MODEM_IRQ_44_CFG_DRV1'/>"
WRITE #1 "        <register address='0xb240900' value='0x" DATA.LONG(A:0xb240900) "' name='RPMH_PDC_MODEM_IRQ_STATUS_BANK0_DRV0'/>"
WRITE #1 "        <register address='0xb240904' value='0x" DATA.LONG(A:0xb240904) "' name='RPMH_PDC_MODEM_IRQ_STATUS_BANK1_DRV0'/>"
WRITE #1 "        <register address='0xb250900' value='0x" DATA.LONG(A:0xb250900) "' name='RPMH_PDC_MODEM_IRQ_STATUS_BANK0_DRV1'/>"
WRITE #1 "        <register address='0xb250904' value='0x" DATA.LONG(A:0xb250904) "' name='RPMH_PDC_MODEM_IRQ_STATUS_BANK1_DRV1'/>"
WRITE #1 "        <register address='0xb241000' value='0x" DATA.LONG(A:0xb241000) "' name='RPMH_PDC_MODEM_PDC_VERSION_DRV0'/>"
WRITE #1 "        <register address='0xb251000' value='0x" DATA.LONG(A:0xb251000) "' name='RPMH_PDC_MODEM_PDC_VERSION_DRV1'/>"
WRITE #1 "        <register address='0xb241004' value='0x" DATA.LONG(A:0xb241004) "' name='RPMH_PDC_MODEM_PDC_PARAM_RESOURCE_DRV0'/>"
WRITE #1 "        <register address='0xb251004' value='0x" DATA.LONG(A:0xb251004) "' name='RPMH_PDC_MODEM_PDC_PARAM_RESOURCE_DRV1'/>"
WRITE #1 "        <register address='0xb241008' value='0x" DATA.LONG(A:0xb241008) "' name='RPMH_PDC_MODEM_PDC_PARAM_SEQ_CONFIG_DRV0'/>"
WRITE #1 "        <register address='0xb251008' value='0x" DATA.LONG(A:0xb251008) "' name='RPMH_PDC_MODEM_PDC_PARAM_SEQ_CONFIG_DRV1'/>"
WRITE #1 "        <register address='0xb24100c' value='0x" DATA.LONG(A:0xb24100c) "' name='RPMH_PDC_MODEM_PDC_PARAM_IRQ_CONFIG_DRV0'/>"
WRITE #1 "        <register address='0xb25100c' value='0x" DATA.LONG(A:0xb25100c) "' name='RPMH_PDC_MODEM_PDC_PARAM_IRQ_CONFIG_DRV1'/>"
WRITE #1 "        <register address='0xb241020' value='0x" DATA.LONG(A:0xb241020) "' name='RPMH_PDC_MODEM_SEQ_BUSY_DRV0'/>"
WRITE #1 "        <register address='0xb251020' value='0x" DATA.LONG(A:0xb251020) "' name='RPMH_PDC_MODEM_SEQ_BUSY_DRV1'/>"
WRITE #1 "        <register address='0xb241030' value='0x" DATA.LONG(A:0xb241030) "' name='RPMH_PDC_MODEM_PDC_MODE_STATUS_DRV0'/>"
WRITE #1 "        <register address='0xb251030' value='0x" DATA.LONG(A:0xb251030) "' name='RPMH_PDC_MODEM_PDC_MODE_STATUS_DRV1'/>"
WRITE #1 "        <register address='0xb241200' value='0x" DATA.LONG(A:0xb241200) "' name='RPMH_PDC_MODEM_PROFILING_UNIT0_DRV0_OUTPUT'/>"
WRITE #1 "        <register address='0xb241214' value='0x" DATA.LONG(A:0xb241214) "' name='RPMH_PDC_MODEM_PROFILING_UNIT1_DRV0_OUTPUT'/>"
WRITE #1 "        <register address='0xb241228' value='0x" DATA.LONG(A:0xb241228) "' name='RPMH_PDC_MODEM_PROFILING_UNIT2_DRV0_OUTPUT'/>"
WRITE #1 "        <register address='0xb24123c' value='0x" DATA.LONG(A:0xb24123c) "' name='RPMH_PDC_MODEM_PROFILING_UNIT3_DRV0_OUTPUT'/>"
WRITE #1 "        <register address='0xb241250' value='0x" DATA.LONG(A:0xb241250) "' name='RPMH_PDC_MODEM_PROFILING_UNIT4_DRV0_OUTPUT'/>"
WRITE #1 "        <register address='0xb251200' value='0x" DATA.LONG(A:0xb251200) "' name='RPMH_PDC_MODEM_PROFILING_UNIT0_DRV1_OUTPUT'/>"
WRITE #1 "        <register address='0xb251214' value='0x" DATA.LONG(A:0xb251214) "' name='RPMH_PDC_MODEM_PROFILING_UNIT1_DRV1_OUTPUT'/>"
WRITE #1 "        <register address='0xb251228' value='0x" DATA.LONG(A:0xb251228) "' name='RPMH_PDC_MODEM_PROFILING_UNIT2_DRV1_OUTPUT'/>"
WRITE #1 "        <register address='0xb25123c' value='0x" DATA.LONG(A:0xb25123c) "' name='RPMH_PDC_MODEM_PROFILING_UNIT3_DRV1_OUTPUT'/>"
WRITE #1 "        <register address='0xb251250' value='0x" DATA.LONG(A:0xb251250) "' name='RPMH_PDC_MODEM_PROFILING_UNIT4_DRV1_OUTPUT'/>"
WRITE #1 "        <register address='0xb241204' value='0x" DATA.LONG(A:0xb241204) "' name='RPMH_PDC_MODEM_PROFILING_UNIT0_DRV0_TIMESTAMP_LO'/>"
WRITE #1 "        <register address='0xb241218' value='0x" DATA.LONG(A:0xb241218) "' name='RPMH_PDC_MODEM_PROFILING_UNIT1_DRV0_TIMESTAMP_LO'/>"
WRITE #1 "        <register address='0xb24122c' value='0x" DATA.LONG(A:0xb24122c) "' name='RPMH_PDC_MODEM_PROFILING_UNIT2_DRV0_TIMESTAMP_LO'/>"
WRITE #1 "        <register address='0xb241240' value='0x" DATA.LONG(A:0xb241240) "' name='RPMH_PDC_MODEM_PROFILING_UNIT3_DRV0_TIMESTAMP_LO'/>"
WRITE #1 "        <register address='0xb241254' value='0x" DATA.LONG(A:0xb241254) "' name='RPMH_PDC_MODEM_PROFILING_UNIT4_DRV0_TIMESTAMP_LO'/>"
WRITE #1 "        <register address='0xb251204' value='0x" DATA.LONG(A:0xb251204) "' name='RPMH_PDC_MODEM_PROFILING_UNIT0_DRV1_TIMESTAMP_LO'/>"
WRITE #1 "        <register address='0xb251218' value='0x" DATA.LONG(A:0xb251218) "' name='RPMH_PDC_MODEM_PROFILING_UNIT1_DRV1_TIMESTAMP_LO'/>"
WRITE #1 "        <register address='0xb25122c' value='0x" DATA.LONG(A:0xb25122c) "' name='RPMH_PDC_MODEM_PROFILING_UNIT2_DRV1_TIMESTAMP_LO'/>"
WRITE #1 "        <register address='0xb251240' value='0x" DATA.LONG(A:0xb251240) "' name='RPMH_PDC_MODEM_PROFILING_UNIT3_DRV1_TIMESTAMP_LO'/>"
WRITE #1 "        <register address='0xb251254' value='0x" DATA.LONG(A:0xb251254) "' name='RPMH_PDC_MODEM_PROFILING_UNIT4_DRV1_TIMESTAMP_LO'/>"
WRITE #1 "        <register address='0xb241208' value='0x" DATA.LONG(A:0xb241208) "' name='RPMH_PDC_MODEM_PROFILING_UNIT0_DRV0_TIMESTAMP_HI'/>"
WRITE #1 "        <register address='0xb24121c' value='0x" DATA.LONG(A:0xb24121c) "' name='RPMH_PDC_MODEM_PROFILING_UNIT1_DRV0_TIMESTAMP_HI'/>"
WRITE #1 "        <register address='0xb241230' value='0x" DATA.LONG(A:0xb241230) "' name='RPMH_PDC_MODEM_PROFILING_UNIT2_DRV0_TIMESTAMP_HI'/>"
WRITE #1 "        <register address='0xb241244' value='0x" DATA.LONG(A:0xb241244) "' name='RPMH_PDC_MODEM_PROFILING_UNIT3_DRV0_TIMESTAMP_HI'/>"
WRITE #1 "        <register address='0xb241258' value='0x" DATA.LONG(A:0xb241258) "' name='RPMH_PDC_MODEM_PROFILING_UNIT4_DRV0_TIMESTAMP_HI'/>"
WRITE #1 "        <register address='0xb251208' value='0x" DATA.LONG(A:0xb251208) "' name='RPMH_PDC_MODEM_PROFILING_UNIT0_DRV1_TIMESTAMP_HI'/>"
WRITE #1 "        <register address='0xb25121c' value='0x" DATA.LONG(A:0xb25121c) "' name='RPMH_PDC_MODEM_PROFILING_UNIT1_DRV1_TIMESTAMP_HI'/>"
WRITE #1 "        <register address='0xb251230' value='0x" DATA.LONG(A:0xb251230) "' name='RPMH_PDC_MODEM_PROFILING_UNIT2_DRV1_TIMESTAMP_HI'/>"
WRITE #1 "        <register address='0xb251244' value='0x" DATA.LONG(A:0xb251244) "' name='RPMH_PDC_MODEM_PROFILING_UNIT3_DRV1_TIMESTAMP_HI'/>"
WRITE #1 "        <register address='0xb251258' value='0x" DATA.LONG(A:0xb251258) "' name='RPMH_PDC_MODEM_PROFILING_UNIT4_DRV1_TIMESTAMP_HI'/>"
WRITE #1 "        <register address='0xb241300' value='0x" DATA.LONG(A:0xb241300) "' name='RPMH_PDC_MODEM_TCS0_DRV0_STATUS'/>"
WRITE #1 "        <register address='0xb2413c8' value='0x" DATA.LONG(A:0xb2413c8) "' name='RPMH_PDC_MODEM_TCS1_DRV0_STATUS'/>"
WRITE #1 "        <register address='0xb241490' value='0x" DATA.LONG(A:0xb241490) "' name='RPMH_PDC_MODEM_TCS2_DRV0_STATUS'/>"
WRITE #1 "        <register address='0xb251300' value='0x" DATA.LONG(A:0xb251300) "' name='RPMH_PDC_MODEM_TCS0_DRV1_STATUS'/>"
WRITE #1 "        <register address='0xb2513c8' value='0x" DATA.LONG(A:0xb2513c8) "' name='RPMH_PDC_MODEM_TCS1_DRV1_STATUS'/>"
WRITE #1 "        <register address='0xb251490' value='0x" DATA.LONG(A:0xb251490) "' name='RPMH_PDC_MODEM_TCS2_DRV1_STATUS'/>"
WRITE #1 "        <register address='0xb241304' value='0x" DATA.LONG(A:0xb241304) "' name='RPMH_PDC_MODEM_TCS0_CMD0_DRV0_STATUS'/>"
WRITE #1 "        <register address='0xb24130c' value='0x" DATA.LONG(A:0xb24130c) "' name='RPMH_PDC_MODEM_TCS0_CMD1_DRV0_STATUS'/>"
WRITE #1 "        <register address='0xb241314' value='0x" DATA.LONG(A:0xb241314) "' name='RPMH_PDC_MODEM_TCS0_CMD2_DRV0_STATUS'/>"
WRITE #1 "        <register address='0xb24131c' value='0x" DATA.LONG(A:0xb24131c) "' name='RPMH_PDC_MODEM_TCS0_CMD3_DRV0_STATUS'/>"
WRITE #1 "        <register address='0xb2413cc' value='0x" DATA.LONG(A:0xb2413cc) "' name='RPMH_PDC_MODEM_TCS1_CMD0_DRV0_STATUS'/>"
WRITE #1 "        <register address='0xb2413d4' value='0x" DATA.LONG(A:0xb2413d4) "' name='RPMH_PDC_MODEM_TCS1_CMD1_DRV0_STATUS'/>"
WRITE #1 "        <register address='0xb2413dc' value='0x" DATA.LONG(A:0xb2413dc) "' name='RPMH_PDC_MODEM_TCS1_CMD2_DRV0_STATUS'/>"
WRITE #1 "        <register address='0xb2413e4' value='0x" DATA.LONG(A:0xb2413e4) "' name='RPMH_PDC_MODEM_TCS1_CMD3_DRV0_STATUS'/>"
WRITE #1 "        <register address='0xb241494' value='0x" DATA.LONG(A:0xb241494) "' name='RPMH_PDC_MODEM_TCS2_CMD0_DRV0_STATUS'/>"
WRITE #1 "        <register address='0xb24149c' value='0x" DATA.LONG(A:0xb24149c) "' name='RPMH_PDC_MODEM_TCS2_CMD1_DRV0_STATUS'/>"
WRITE #1 "        <register address='0xb2414a4' value='0x" DATA.LONG(A:0xb2414a4) "' name='RPMH_PDC_MODEM_TCS2_CMD2_DRV0_STATUS'/>"
WRITE #1 "        <register address='0xb2414ac' value='0x" DATA.LONG(A:0xb2414ac) "' name='RPMH_PDC_MODEM_TCS2_CMD3_DRV0_STATUS'/>"
WRITE #1 "        <register address='0xb251304' value='0x" DATA.LONG(A:0xb251304) "' name='RPMH_PDC_MODEM_TCS0_CMD0_DRV1_STATUS'/>"
WRITE #1 "        <register address='0xb25130c' value='0x" DATA.LONG(A:0xb25130c) "' name='RPMH_PDC_MODEM_TCS0_CMD1_DRV1_STATUS'/>"
WRITE #1 "        <register address='0xb251314' value='0x" DATA.LONG(A:0xb251314) "' name='RPMH_PDC_MODEM_TCS0_CMD2_DRV1_STATUS'/>"
WRITE #1 "        <register address='0xb25131c' value='0x" DATA.LONG(A:0xb25131c) "' name='RPMH_PDC_MODEM_TCS0_CMD3_DRV1_STATUS'/>"
WRITE #1 "        <register address='0xb2513cc' value='0x" DATA.LONG(A:0xb2513cc) "' name='RPMH_PDC_MODEM_TCS1_CMD0_DRV1_STATUS'/>"
WRITE #1 "        <register address='0xb2513d4' value='0x" DATA.LONG(A:0xb2513d4) "' name='RPMH_PDC_MODEM_TCS1_CMD1_DRV1_STATUS'/>"
WRITE #1 "        <register address='0xb2513dc' value='0x" DATA.LONG(A:0xb2513dc) "' name='RPMH_PDC_MODEM_TCS1_CMD2_DRV1_STATUS'/>"
WRITE #1 "        <register address='0xb2513e4' value='0x" DATA.LONG(A:0xb2513e4) "' name='RPMH_PDC_MODEM_TCS1_CMD3_DRV1_STATUS'/>"
WRITE #1 "        <register address='0xb251494' value='0x" DATA.LONG(A:0xb251494) "' name='RPMH_PDC_MODEM_TCS2_CMD0_DRV1_STATUS'/>"
WRITE #1 "        <register address='0xb25149c' value='0x" DATA.LONG(A:0xb25149c) "' name='RPMH_PDC_MODEM_TCS2_CMD1_DRV1_STATUS'/>"
WRITE #1 "        <register address='0xb2514a4' value='0x" DATA.LONG(A:0xb2514a4) "' name='RPMH_PDC_MODEM_TCS2_CMD2_DRV1_STATUS'/>"
WRITE #1 "        <register address='0xb2514ac' value='0x" DATA.LONG(A:0xb2514ac) "' name='RPMH_PDC_MODEM_TCS2_CMD3_DRV1_STATUS'/>"
WRITE #1 "        <register address='0xb244500' value='0x" DATA.LONG(A:0xb244500) "' name='RPMH_PDC_MODEM_ENABLE_PDC'/>"
WRITE #1 "        <register address='0xb244510' value='0x" DATA.LONG(A:0xb244510) "' name='RPMH_PDC_MODEM_TIMER_MATCH_VALUE_LO'/>"
WRITE #1 "        <register address='0xb244514' value='0x" DATA.LONG(A:0xb244514) "' name='RPMH_PDC_MODEM_TIMER_MATCH_VALUE_HI'/>"
WRITE #1 "        <register address='0xb244518' value='0x" DATA.LONG(A:0xb244518) "' name='RPMH_PDC_MODEM_TIMER_DISABLED_FOR_ARC'/>"
WRITE #1 "        <register address='0xb244520' value='0x" DATA.LONG(A:0xb244520) "' name='RPMH_PDC_MODEM_SEQ_START_ADDR'/>"
WRITE #1 "        <register address='0xb244524' value='0x" DATA.LONG(A:0xb244524) "' name='RPMH_PDC_MODEM_SEQ_OVERRIDE_START_ADDR'/>"
WRITE #1 "        <register address='0xb24452c' value='0x" DATA.LONG(A:0xb24452c) "' name='RPMH_PDC_MODEM_SEQ_OVERRIDE_TRIGGER'/>"
WRITE #1 "        <register address='0xb244530' value='0x" DATA.LONG(A:0xb244530) "' name='RPMH_PDC_MODEM_SEQ_PWR_CTRL_OVERRIDE_MASK'/>"
WRITE #1 "        <register address='0xb244534' value='0x" DATA.LONG(A:0xb244534) "' name='RPMH_PDC_MODEM_SEQ_PWR_CTRL_OVERRIDE_VAL'/>"
WRITE #1 "        <register address='0xb244540' value='0x" DATA.LONG(A:0xb244540) "' name='RPMH_PDC_MODEM_SEQ_WAIT_EVENT_OVERRIDE_MASK'/>"
WRITE #1 "        <register address='0xb244544' value='0x" DATA.LONG(A:0xb244544) "' name='RPMH_PDC_MODEM_SEQ_WAIT_EVENT_OVERRIDE_VAL'/>"
WRITE #1 "        <register address='0xb244550' value='0x" DATA.LONG(A:0xb244550) "' name='RPMH_PDC_MODEM_SEQ_BR_EVENT_OVERRIDE_MASK'/>"
WRITE #1 "        <register address='0xb244554' value='0x" DATA.LONG(A:0xb244554) "' name='RPMH_PDC_MODEM_SEQ_BR_EVENT_OVERRIDE_VAL'/>"
WRITE #1 "        <register address='0xb244590' value='0x" DATA.LONG(A:0xb244590) "' name='RPMH_PDC_MODEM_SEQ_CFG_BR_ADDR_0'/>"
WRITE #1 "        <register address='0xb244594' value='0x" DATA.LONG(A:0xb244594) "' name='RPMH_PDC_MODEM_SEQ_CFG_BR_ADDR_1'/>"
WRITE #1 "        <register address='0xb244598' value='0x" DATA.LONG(A:0xb244598) "' name='RPMH_PDC_MODEM_SEQ_CFG_BR_ADDR_2'/>"
WRITE #1 "        <register address='0xb24459c' value='0x" DATA.LONG(A:0xb24459c) "' name='RPMH_PDC_MODEM_SEQ_CFG_BR_ADDR_3'/>"
WRITE #1 "        <register address='0xb2445a0' value='0x" DATA.LONG(A:0xb2445a0) "' name='RPMH_PDC_MODEM_SEQ_CFG_DELAY_VAL_0'/>"
WRITE #1 "        <register address='0xb2445a4' value='0x" DATA.LONG(A:0xb2445a4) "' name='RPMH_PDC_MODEM_SEQ_CFG_DELAY_VAL_1'/>"
WRITE #1 "        <register address='0xb2445a8' value='0x" DATA.LONG(A:0xb2445a8) "' name='RPMH_PDC_MODEM_SEQ_CFG_DELAY_VAL_2'/>"
WRITE #1 "        <register address='0xb2445ac' value='0x" DATA.LONG(A:0xb2445ac) "' name='RPMH_PDC_MODEM_SEQ_CFG_DELAY_VAL_3'/>"
WRITE #1 "        <register address='0xb2445b0' value='0x" DATA.LONG(A:0xb2445b0) "' name='RPMH_PDC_MODEM_SEQ_CFG_DELAY_VAL_4'/>"
WRITE #1 "        <register address='0xb2445b4' value='0x" DATA.LONG(A:0xb2445b4) "' name='RPMH_PDC_MODEM_SEQ_CFG_DELAY_VAL_5'/>"
WRITE #1 "        <register address='0xb2445b8' value='0x" DATA.LONG(A:0xb2445b8) "' name='RPMH_PDC_MODEM_SEQ_CFG_DELAY_VAL_6'/>"
WRITE #1 "        <register address='0xb2445bc' value='0x" DATA.LONG(A:0xb2445bc) "' name='RPMH_PDC_MODEM_SEQ_CFG_DELAY_VAL_7'/>"
WRITE #1 "        <register address='0xb2445c0' value='0x" DATA.LONG(A:0xb2445c0) "' name='RPMH_PDC_MODEM_SEQ_CFG_DELAY_VAL_8'/>"
WRITE #1 "        <register address='0xb2445c4' value='0x" DATA.LONG(A:0xb2445c4) "' name='RPMH_PDC_MODEM_SEQ_CFG_DELAY_VAL_9'/>"
WRITE #1 "        <register address='0xb2445c8' value='0x" DATA.LONG(A:0xb2445c8) "' name='RPMH_PDC_MODEM_SEQ_CFG_DELAY_VAL_10'/>"
WRITE #1 "        <register address='0xb2445cc' value='0x" DATA.LONG(A:0xb2445cc) "' name='RPMH_PDC_MODEM_SEQ_CFG_DELAY_VAL_11'/>"
WRITE #1 "        <register address='0xb2445d0' value='0x" DATA.LONG(A:0xb2445d0) "' name='RPMH_PDC_MODEM_SEQ_CFG_DELAY_VAL_12'/>"
WRITE #1 "        <register address='0xb2445d4' value='0x" DATA.LONG(A:0xb2445d4) "' name='RPMH_PDC_MODEM_SEQ_CFG_DELAY_VAL_13'/>"
WRITE #1 "        <register address='0xb2445d8' value='0x" DATA.LONG(A:0xb2445d8) "' name='RPMH_PDC_MODEM_SEQ_CFG_DELAY_VAL_14'/>"
WRITE #1 "        <register address='0xb2445dc' value='0x" DATA.LONG(A:0xb2445dc) "' name='RPMH_PDC_MODEM_SEQ_CFG_DELAY_VAL_15'/>"
WRITE #1 "        <register address='0xb244600' value='0x" DATA.LONG(A:0xb244600) "' name='RPMH_PDC_MODEM_IRQ_0_OWNER'/>"
WRITE #1 "        <register address='0xb244604' value='0x" DATA.LONG(A:0xb244604) "' name='RPMH_PDC_MODEM_IRQ_1_OWNER'/>"
WRITE #1 "        <register address='0xb244608' value='0x" DATA.LONG(A:0xb244608) "' name='RPMH_PDC_MODEM_IRQ_2_OWNER'/>"
WRITE #1 "        <register address='0xb24460c' value='0x" DATA.LONG(A:0xb24460c) "' name='RPMH_PDC_MODEM_IRQ_3_OWNER'/>"
WRITE #1 "        <register address='0xb244610' value='0x" DATA.LONG(A:0xb244610) "' name='RPMH_PDC_MODEM_IRQ_4_OWNER'/>"
WRITE #1 "        <register address='0xb244614' value='0x" DATA.LONG(A:0xb244614) "' name='RPMH_PDC_MODEM_IRQ_5_OWNER'/>"
WRITE #1 "        <register address='0xb244618' value='0x" DATA.LONG(A:0xb244618) "' name='RPMH_PDC_MODEM_IRQ_6_OWNER'/>"
WRITE #1 "        <register address='0xb24461c' value='0x" DATA.LONG(A:0xb24461c) "' name='RPMH_PDC_MODEM_IRQ_7_OWNER'/>"
WRITE #1 "        <register address='0xb244620' value='0x" DATA.LONG(A:0xb244620) "' name='RPMH_PDC_MODEM_IRQ_8_OWNER'/>"
WRITE #1 "        <register address='0xb244624' value='0x" DATA.LONG(A:0xb244624) "' name='RPMH_PDC_MODEM_IRQ_9_OWNER'/>"
WRITE #1 "        <register address='0xb244628' value='0x" DATA.LONG(A:0xb244628) "' name='RPMH_PDC_MODEM_IRQ_10_OWNER'/>"
WRITE #1 "        <register address='0xb24462c' value='0x" DATA.LONG(A:0xb24462c) "' name='RPMH_PDC_MODEM_IRQ_11_OWNER'/>"
WRITE #1 "        <register address='0xb244630' value='0x" DATA.LONG(A:0xb244630) "' name='RPMH_PDC_MODEM_IRQ_12_OWNER'/>"
WRITE #1 "        <register address='0xb244634' value='0x" DATA.LONG(A:0xb244634) "' name='RPMH_PDC_MODEM_IRQ_13_OWNER'/>"
WRITE #1 "        <register address='0xb244638' value='0x" DATA.LONG(A:0xb244638) "' name='RPMH_PDC_MODEM_IRQ_14_OWNER'/>"
WRITE #1 "        <register address='0xb24463c' value='0x" DATA.LONG(A:0xb24463c) "' name='RPMH_PDC_MODEM_IRQ_15_OWNER'/>"
WRITE #1 "        <register address='0xb244640' value='0x" DATA.LONG(A:0xb244640) "' name='RPMH_PDC_MODEM_IRQ_16_OWNER'/>"
WRITE #1 "        <register address='0xb244644' value='0x" DATA.LONG(A:0xb244644) "' name='RPMH_PDC_MODEM_IRQ_17_OWNER'/>"
WRITE #1 "        <register address='0xb244648' value='0x" DATA.LONG(A:0xb244648) "' name='RPMH_PDC_MODEM_IRQ_18_OWNER'/>"
WRITE #1 "        <register address='0xb24464c' value='0x" DATA.LONG(A:0xb24464c) "' name='RPMH_PDC_MODEM_IRQ_19_OWNER'/>"
WRITE #1 "        <register address='0xb244650' value='0x" DATA.LONG(A:0xb244650) "' name='RPMH_PDC_MODEM_IRQ_20_OWNER'/>"
WRITE #1 "        <register address='0xb244654' value='0x" DATA.LONG(A:0xb244654) "' name='RPMH_PDC_MODEM_IRQ_21_OWNER'/>"
WRITE #1 "        <register address='0xb244658' value='0x" DATA.LONG(A:0xb244658) "' name='RPMH_PDC_MODEM_IRQ_22_OWNER'/>"
WRITE #1 "        <register address='0xb24465c' value='0x" DATA.LONG(A:0xb24465c) "' name='RPMH_PDC_MODEM_IRQ_23_OWNER'/>"
WRITE #1 "        <register address='0xb244660' value='0x" DATA.LONG(A:0xb244660) "' name='RPMH_PDC_MODEM_IRQ_24_OWNER'/>"
WRITE #1 "        <register address='0xb244664' value='0x" DATA.LONG(A:0xb244664) "' name='RPMH_PDC_MODEM_IRQ_25_OWNER'/>"
WRITE #1 "        <register address='0xb244668' value='0x" DATA.LONG(A:0xb244668) "' name='RPMH_PDC_MODEM_IRQ_26_OWNER'/>"
WRITE #1 "        <register address='0xb24466c' value='0x" DATA.LONG(A:0xb24466c) "' name='RPMH_PDC_MODEM_IRQ_27_OWNER'/>"
WRITE #1 "        <register address='0xb244670' value='0x" DATA.LONG(A:0xb244670) "' name='RPMH_PDC_MODEM_IRQ_28_OWNER'/>"
WRITE #1 "        <register address='0xb244674' value='0x" DATA.LONG(A:0xb244674) "' name='RPMH_PDC_MODEM_IRQ_29_OWNER'/>"
WRITE #1 "        <register address='0xb244678' value='0x" DATA.LONG(A:0xb244678) "' name='RPMH_PDC_MODEM_IRQ_30_OWNER'/>"
WRITE #1 "        <register address='0xb24467c' value='0x" DATA.LONG(A:0xb24467c) "' name='RPMH_PDC_MODEM_IRQ_31_OWNER'/>"
WRITE #1 "        <register address='0xb244680' value='0x" DATA.LONG(A:0xb244680) "' name='RPMH_PDC_MODEM_IRQ_32_OWNER'/>"
WRITE #1 "        <register address='0xb244684' value='0x" DATA.LONG(A:0xb244684) "' name='RPMH_PDC_MODEM_IRQ_33_OWNER'/>"
WRITE #1 "        <register address='0xb244688' value='0x" DATA.LONG(A:0xb244688) "' name='RPMH_PDC_MODEM_IRQ_34_OWNER'/>"
WRITE #1 "        <register address='0xb24468c' value='0x" DATA.LONG(A:0xb24468c) "' name='RPMH_PDC_MODEM_IRQ_35_OWNER'/>"
WRITE #1 "        <register address='0xb244690' value='0x" DATA.LONG(A:0xb244690) "' name='RPMH_PDC_MODEM_IRQ_36_OWNER'/>"
WRITE #1 "        <register address='0xb244694' value='0x" DATA.LONG(A:0xb244694) "' name='RPMH_PDC_MODEM_IRQ_37_OWNER'/>"
WRITE #1 "        <register address='0xb244698' value='0x" DATA.LONG(A:0xb244698) "' name='RPMH_PDC_MODEM_IRQ_38_OWNER'/>"
WRITE #1 "        <register address='0xb24469c' value='0x" DATA.LONG(A:0xb24469c) "' name='RPMH_PDC_MODEM_IRQ_39_OWNER'/>"
WRITE #1 "        <register address='0xb2446a0' value='0x" DATA.LONG(A:0xb2446a0) "' name='RPMH_PDC_MODEM_IRQ_40_OWNER'/>"
WRITE #1 "        <register address='0xb2446a4' value='0x" DATA.LONG(A:0xb2446a4) "' name='RPMH_PDC_MODEM_IRQ_41_OWNER'/>"
WRITE #1 "        <register address='0xb2446a8' value='0x" DATA.LONG(A:0xb2446a8) "' name='RPMH_PDC_MODEM_IRQ_42_OWNER'/>"
WRITE #1 "        <register address='0xb2446ac' value='0x" DATA.LONG(A:0xb2446ac) "' name='RPMH_PDC_MODEM_IRQ_43_OWNER'/>"
WRITE #1 "        <register address='0xb2446b0' value='0x" DATA.LONG(A:0xb2446b0) "' name='RPMH_PDC_MODEM_IRQ_44_OWNER'/>"
WRITE #1 "        <register address='0xb244900' value='0x" DATA.LONG(A:0xb244900) "' name='RPMH_PDC_MODEM_GP_IRQ_SELECT0'/>"
WRITE #1 "        <register address='0xb244914' value='0x" DATA.LONG(A:0xb244914) "' name='RPMH_PDC_MODEM_GP_IRQ_SELECT1'/>"
WRITE #1 "        <register address='0xb244928' value='0x" DATA.LONG(A:0xb244928) "' name='RPMH_PDC_MODEM_GP_IRQ_SELECT2'/>"
WRITE #1 "        <register address='0xb24493c' value='0x" DATA.LONG(A:0xb24493c) "' name='RPMH_PDC_MODEM_GP_IRQ_SELECT3'/>"
WRITE #1 "        <register address='0xb244950' value='0x" DATA.LONG(A:0xb244950) "' name='RPMH_PDC_MODEM_GP_IRQ_SELECT4'/>"
WRITE #1 "        <register address='0xb244964' value='0x" DATA.LONG(A:0xb244964) "' name='RPMH_PDC_MODEM_GP_IRQ_SELECT5'/>"
WRITE #1 "        <register address='0xb244978' value='0x" DATA.LONG(A:0xb244978) "' name='RPMH_PDC_MODEM_GP_IRQ_SELECT6'/>"
WRITE #1 "        <register address='0xb24498c' value='0x" DATA.LONG(A:0xb24498c) "' name='RPMH_PDC_MODEM_GP_IRQ_SELECT7'/>"
WRITE #1 "        <register address='0xb2449a0' value='0x" DATA.LONG(A:0xb2449a0) "' name='RPMH_PDC_MODEM_GP_IRQ_SELECT8'/>"
WRITE #1 "        <register address='0xb2449b4' value='0x" DATA.LONG(A:0xb2449b4) "' name='RPMH_PDC_MODEM_GP_IRQ_SELECT9'/>"
WRITE #1 "        <register address='0xb2449c8' value='0x" DATA.LONG(A:0xb2449c8) "' name='RPMH_PDC_MODEM_GP_IRQ_SELECT10'/>"
WRITE #1 "        <register address='0xb2449dc' value='0x" DATA.LONG(A:0xb2449dc) "' name='RPMH_PDC_MODEM_GP_IRQ_SELECT11'/>"
WRITE #1 "        <register address='0xb2449f0' value='0x" DATA.LONG(A:0xb2449f0) "' name='RPMH_PDC_MODEM_GP_IRQ_SELECT12'/>"
WRITE #1 "        <register address='0xb244a04' value='0x" DATA.LONG(A:0xb244a04) "' name='RPMH_PDC_MODEM_GP_IRQ_SELECT13'/>"
WRITE #1 "        <register address='0xb244a18' value='0x" DATA.LONG(A:0xb244a18) "' name='RPMH_PDC_MODEM_GP_IRQ_SELECT14'/>"
WRITE #1 "        <register address='0xb244a2c' value='0x" DATA.LONG(A:0xb244a2c) "' name='RPMH_PDC_MODEM_GP_IRQ_SELECT15'/>"
WRITE #1 "        <register address='0xb244a40' value='0x" DATA.LONG(A:0xb244a40) "' name='RPMH_PDC_MODEM_GP_IRQ_SELECT16'/>"
WRITE #1 "        <register address='0xb244a54' value='0x" DATA.LONG(A:0xb244a54) "' name='RPMH_PDC_MODEM_GP_IRQ_SELECT17'/>"
WRITE #1 "        <register address='0xb244a68' value='0x" DATA.LONG(A:0xb244a68) "' name='RPMH_PDC_MODEM_GP_IRQ_SELECT18'/>"
WRITE #1 "        <register address='0xb244a7c' value='0x" DATA.LONG(A:0xb244a7c) "' name='RPMH_PDC_MODEM_GP_IRQ_SELECT19'/>"
WRITE #1 "        <register address='0xb244a90' value='0x" DATA.LONG(A:0xb244a90) "' name='RPMH_PDC_MODEM_GP_IRQ_SELECT20'/>"
WRITE #1 "        <register address='0xb244aa4' value='0x" DATA.LONG(A:0xb244aa4) "' name='RPMH_PDC_MODEM_GP_IRQ_SELECT21'/>"
WRITE #1 "        <register address='0xb244ab8' value='0x" DATA.LONG(A:0xb244ab8) "' name='RPMH_PDC_MODEM_GP_IRQ_SELECT22'/>"
WRITE #1 "        <register address='0xb244acc' value='0x" DATA.LONG(A:0xb244acc) "' name='RPMH_PDC_MODEM_GP_IRQ_SELECT23'/>"
WRITE #1 "        <register address='0xb244ae0' value='0x" DATA.LONG(A:0xb244ae0) "' name='RPMH_PDC_MODEM_GP_IRQ_SELECT24'/>"
WRITE #1 "        <register address='0xb244af4' value='0x" DATA.LONG(A:0xb244af4) "' name='RPMH_PDC_MODEM_GP_IRQ_SELECT25'/>"
WRITE #1 "        <register address='0xb244b08' value='0x" DATA.LONG(A:0xb244b08) "' name='RPMH_PDC_MODEM_GP_IRQ_SELECT26'/>"
WRITE #1 "        <register address='0xb244b1c' value='0x" DATA.LONG(A:0xb244b1c) "' name='RPMH_PDC_MODEM_GP_IRQ_SELECT27'/>"
WRITE #1 "        <register address='0xb244b30' value='0x" DATA.LONG(A:0xb244b30) "' name='RPMH_PDC_MODEM_GP_IRQ_SELECT28'/>"
WRITE #1 "        <register address='0xb244b44' value='0x" DATA.LONG(A:0xb244b44) "' name='RPMH_PDC_MODEM_GP_IRQ_SELECT29'/>"
WRITE #1 "        <register address='0xb245000' value='0x" DATA.LONG(A:0xb245000) "' name='RPMH_PDC_MODEM_PROFILING_UNIT0_EN'/>"
WRITE #1 "        <register address='0xb245014' value='0x" DATA.LONG(A:0xb245014) "' name='RPMH_PDC_MODEM_PROFILING_UNIT1_EN'/>"
WRITE #1 "        <register address='0xb245028' value='0x" DATA.LONG(A:0xb245028) "' name='RPMH_PDC_MODEM_PROFILING_UNIT2_EN'/>"
WRITE #1 "        <register address='0xb24503c' value='0x" DATA.LONG(A:0xb24503c) "' name='RPMH_PDC_MODEM_PROFILING_UNIT3_EN'/>"
WRITE #1 "        <register address='0xb245050' value='0x" DATA.LONG(A:0xb245050) "' name='RPMH_PDC_MODEM_PROFILING_UNIT4_EN'/>"
WRITE #1 "        <register address='0xb245500' value='0x" DATA.LONG(A:0xb245500) "' name='RPMH_PDC_MODEM_TCS0_CONTROL'/>"
WRITE #1 "        <register address='0xb2455c8' value='0x" DATA.LONG(A:0xb2455c8) "' name='RPMH_PDC_MODEM_TCS1_CONTROL'/>"
WRITE #1 "        <register address='0xb245690' value='0x" DATA.LONG(A:0xb245690) "' name='RPMH_PDC_MODEM_TCS2_CONTROL'/>"
WRITE #1 "        <register address='0xb245504' value='0x" DATA.LONG(A:0xb245504) "' name='RPMH_PDC_MODEM_TCS0_CMD_ENABLE_BANK'/>"
WRITE #1 "        <register address='0xb2455cc' value='0x" DATA.LONG(A:0xb2455cc) "' name='RPMH_PDC_MODEM_TCS1_CMD_ENABLE_BANK'/>"
WRITE #1 "        <register address='0xb245694' value='0x" DATA.LONG(A:0xb245694) "' name='RPMH_PDC_MODEM_TCS2_CMD_ENABLE_BANK'/>"
WRITE #1 "        <register address='0xb245508' value='0x" DATA.LONG(A:0xb245508) "' name='RPMH_PDC_MODEM_TCS0_CMD_WAIT_FOR_CMPL_BANK'/>"
WRITE #1 "        <register address='0xb2455d0' value='0x" DATA.LONG(A:0xb2455d0) "' name='RPMH_PDC_MODEM_TCS1_CMD_WAIT_FOR_CMPL_BANK'/>"
WRITE #1 "        <register address='0xb245698' value='0x" DATA.LONG(A:0xb245698) "' name='RPMH_PDC_MODEM_TCS2_CMD_WAIT_FOR_CMPL_BANK'/>"
WRITE #1 "        <register address='0xb24550c' value='0x" DATA.LONG(A:0xb24550c) "' name='RPMH_PDC_MODEM_TCS0_CMD0_MSGID'/>"
WRITE #1 "        <register address='0xb24551c' value='0x" DATA.LONG(A:0xb24551c) "' name='RPMH_PDC_MODEM_TCS0_CMD1_MSGID'/>"
WRITE #1 "        <register address='0xb24552c' value='0x" DATA.LONG(A:0xb24552c) "' name='RPMH_PDC_MODEM_TCS0_CMD2_MSGID'/>"
WRITE #1 "        <register address='0xb24553c' value='0x" DATA.LONG(A:0xb24553c) "' name='RPMH_PDC_MODEM_TCS0_CMD3_MSGID'/>"
WRITE #1 "        <register address='0xb2455d4' value='0x" DATA.LONG(A:0xb2455d4) "' name='RPMH_PDC_MODEM_TCS1_CMD0_MSGID'/>"
WRITE #1 "        <register address='0xb2455e4' value='0x" DATA.LONG(A:0xb2455e4) "' name='RPMH_PDC_MODEM_TCS1_CMD1_MSGID'/>"
WRITE #1 "        <register address='0xb2455f4' value='0x" DATA.LONG(A:0xb2455f4) "' name='RPMH_PDC_MODEM_TCS1_CMD2_MSGID'/>"
WRITE #1 "        <register address='0xb245604' value='0x" DATA.LONG(A:0xb245604) "' name='RPMH_PDC_MODEM_TCS1_CMD3_MSGID'/>"
WRITE #1 "        <register address='0xb24569c' value='0x" DATA.LONG(A:0xb24569c) "' name='RPMH_PDC_MODEM_TCS2_CMD0_MSGID'/>"
WRITE #1 "        <register address='0xb2456ac' value='0x" DATA.LONG(A:0xb2456ac) "' name='RPMH_PDC_MODEM_TCS2_CMD1_MSGID'/>"
WRITE #1 "        <register address='0xb2456bc' value='0x" DATA.LONG(A:0xb2456bc) "' name='RPMH_PDC_MODEM_TCS2_CMD2_MSGID'/>"
WRITE #1 "        <register address='0xb2456cc' value='0x" DATA.LONG(A:0xb2456cc) "' name='RPMH_PDC_MODEM_TCS2_CMD3_MSGID'/>"
WRITE #1 "        <register address='0xb245510' value='0x" DATA.LONG(A:0xb245510) "' name='RPMH_PDC_MODEM_TCS0_CMD0_ADDR'/>"
WRITE #1 "        <register address='0xb245520' value='0x" DATA.LONG(A:0xb245520) "' name='RPMH_PDC_MODEM_TCS0_CMD1_ADDR'/>"
WRITE #1 "        <register address='0xb245530' value='0x" DATA.LONG(A:0xb245530) "' name='RPMH_PDC_MODEM_TCS0_CMD2_ADDR'/>"
WRITE #1 "        <register address='0xb245540' value='0x" DATA.LONG(A:0xb245540) "' name='RPMH_PDC_MODEM_TCS0_CMD3_ADDR'/>"
WRITE #1 "        <register address='0xb2455d8' value='0x" DATA.LONG(A:0xb2455d8) "' name='RPMH_PDC_MODEM_TCS1_CMD0_ADDR'/>"
WRITE #1 "        <register address='0xb2455e8' value='0x" DATA.LONG(A:0xb2455e8) "' name='RPMH_PDC_MODEM_TCS1_CMD1_ADDR'/>"
WRITE #1 "        <register address='0xb2455f8' value='0x" DATA.LONG(A:0xb2455f8) "' name='RPMH_PDC_MODEM_TCS1_CMD2_ADDR'/>"
WRITE #1 "        <register address='0xb245608' value='0x" DATA.LONG(A:0xb245608) "' name='RPMH_PDC_MODEM_TCS1_CMD3_ADDR'/>"
WRITE #1 "        <register address='0xb2456a0' value='0x" DATA.LONG(A:0xb2456a0) "' name='RPMH_PDC_MODEM_TCS2_CMD0_ADDR'/>"
WRITE #1 "        <register address='0xb2456b0' value='0x" DATA.LONG(A:0xb2456b0) "' name='RPMH_PDC_MODEM_TCS2_CMD1_ADDR'/>"
WRITE #1 "        <register address='0xb2456c0' value='0x" DATA.LONG(A:0xb2456c0) "' name='RPMH_PDC_MODEM_TCS2_CMD2_ADDR'/>"
WRITE #1 "        <register address='0xb2456d0' value='0x" DATA.LONG(A:0xb2456d0) "' name='RPMH_PDC_MODEM_TCS2_CMD3_ADDR'/>"
WRITE #1 "        <register address='0xb245514' value='0x" DATA.LONG(A:0xb245514) "' name='RPMH_PDC_MODEM_TCS0_CMD0_DATA'/>"
WRITE #1 "        <register address='0xb245524' value='0x" DATA.LONG(A:0xb245524) "' name='RPMH_PDC_MODEM_TCS0_CMD1_DATA'/>"
WRITE #1 "        <register address='0xb245534' value='0x" DATA.LONG(A:0xb245534) "' name='RPMH_PDC_MODEM_TCS0_CMD2_DATA'/>"
WRITE #1 "        <register address='0xb245544' value='0x" DATA.LONG(A:0xb245544) "' name='RPMH_PDC_MODEM_TCS0_CMD3_DATA'/>"
WRITE #1 "        <register address='0xb2455dc' value='0x" DATA.LONG(A:0xb2455dc) "' name='RPMH_PDC_MODEM_TCS1_CMD0_DATA'/>"
WRITE #1 "        <register address='0xb2455ec' value='0x" DATA.LONG(A:0xb2455ec) "' name='RPMH_PDC_MODEM_TCS1_CMD1_DATA'/>"
WRITE #1 "        <register address='0xb2455fc' value='0x" DATA.LONG(A:0xb2455fc) "' name='RPMH_PDC_MODEM_TCS1_CMD2_DATA'/>"
WRITE #1 "        <register address='0xb24560c' value='0x" DATA.LONG(A:0xb24560c) "' name='RPMH_PDC_MODEM_TCS1_CMD3_DATA'/>"
WRITE #1 "        <register address='0xb2456a4' value='0x" DATA.LONG(A:0xb2456a4) "' name='RPMH_PDC_MODEM_TCS2_CMD0_DATA'/>"
WRITE #1 "        <register address='0xb2456b4' value='0x" DATA.LONG(A:0xb2456b4) "' name='RPMH_PDC_MODEM_TCS2_CMD1_DATA'/>"
WRITE #1 "        <register address='0xb2456c4' value='0x" DATA.LONG(A:0xb2456c4) "' name='RPMH_PDC_MODEM_TCS2_CMD2_DATA'/>"
WRITE #1 "        <register address='0xb2456d4' value='0x" DATA.LONG(A:0xb2456d4) "' name='RPMH_PDC_MODEM_TCS2_CMD3_DATA'/>"
WRITE #1 "        <register address='0xb2e0020' value='0x" DATA.LONG(A:0xb2e0020) "' name='RPMH_PDC_APPS_PDC_RSC_DRV_ID0'/>"
WRITE #1 "        <register address='0xb2e0024' value='0x" DATA.LONG(A:0xb2e0024) "' name='RPMH_PDC_APPS_PDC_RSC_DRV_ID1'/>"
WRITE #1 "        <register address='0xb2e0040' value='0x" DATA.LONG(A:0xb2e0040) "' name='RPMH_PDC_AOP_PDC_RSC_DRV_ID0'/>"
WRITE #1 "        <register address='0xb2e0050' value='0x" DATA.LONG(A:0xb2e0050) "' name='RPMH_PDC_DEBUG_PDC_RSC_DRV_ID0'/>"
WRITE #1 "        <register address='0xb2e0060' value='0x" DATA.LONG(A:0xb2e0060) "' name='RPMH_PDC_MODEM_PDC_RSC_DRV_ID0'/>"
WRITE #1 "        <register address='0xb2e0064' value='0x" DATA.LONG(A:0xb2e0064) "' name='RPMH_PDC_MODEM_PDC_RSC_DRV_ID1'/>"
WRITE #1 "        <register address='0xb2e0100' value='0x" DATA.LONG(A:0xb2e0100) "' name='RPMH_PDC_SYNC_RESET'/>"
WRITE #1 "        <register address='0xb2e0140' value='0x" DATA.LONG(A:0xb2e0140) "' name='RPMH_PDC_EPCB_TIMEOUT_THRESHOLD'/>"
WRITE #1 "        <register address='0xb2e0150' value='0x" DATA.LONG(A:0xb2e0150) "' name='RPMH_PDC_EPCB_TIMEOUT_IRQ_EN_BANK0'/>"
WRITE #1 "        <register address='0xb2e0160' value='0x" DATA.LONG(A:0xb2e0160) "' name='RPMH_PDC_EPCB_TIMEOUT_IRQ_STATUS_BANK0'/>"
WRITE #1 "        <register address='0xb2e0170' value='0x" DATA.LONG(A:0xb2e0170) "' name='RPMH_PDC_EPCB_TIMEOUT_IRQ_CLEAR_BANK0'/>"
WRITE #1 "        <register address='0xb2e0200' value='0x" DATA.LONG(A:0xb2e0200) "' name='RPMH_PDC_AOP_IRQ_EN_BANK0'/>"
WRITE #1 "        <register address='0xb2e0210' value='0x" DATA.LONG(A:0xb2e0210) "' name='RPMH_PDC_AOP_IRQ_STATUS_BANK0'/>"
WRITE #1 "        <register address='0xb2e0214' value='0x" DATA.LONG(A:0xb2e0214) "' name='RPMH_PDC_AOP_IRQ_RAW_STATUS_BANK0'/>"
WRITE #1 "        <register address='0xb2e0218' value='0x" DATA.LONG(A:0xb2e0218) "' name='RPMH_PDC_AOP_IRQ_CLEAR_BANK0'/>"
WRITE #1 "        <register address='0xb2e0220' value='0x" DATA.LONG(A:0xb2e0220) "' name='RPMH_PDC_AOP_SEQ_RESUME_BANK0'/>"
WRITE #1 "        <register address='0xb2e0230' value='0x" DATA.LONG(A:0xb2e0230) "' name='RPMH_PDC_AOP_SEQ_RESUME_ONCE_BANK0'/>"
WRITE #1 "        <register address='0xb2e0300' value='0x" DATA.LONG(A:0xb2e0300) "' name='RPMH_PDC_SOC_SLEEP_LOCK_MASK_BANK0'/>"
WRITE #1 "        <register address='0xb2e0310' value='0x" DATA.LONG(A:0xb2e0310) "' name='RPMH_PDC_SOC_SLEEP_LOCK_STATUS_BANK0'/>"
WRITE #1 "        <register address='0xb2e0320' value='0x" DATA.LONG(A:0xb2e0320) "' name='RPMH_PDC_CX_COLLAPSE_LOCK_MASK_BANK0'/>"
WRITE #1 "        <register address='0xb2e0330' value='0x" DATA.LONG(A:0xb2e0330) "' name='RPMH_PDC_CX_COLLAPSE_LOCK_STATUS_BANK0'/>"
WRITE #1 "        <register address='0xb2e0340' value='0x" DATA.LONG(A:0xb2e0340) "' name='RPMH_PDC_DBG_RSRC_REL_LOCK_MASK_BANK0'/>"
WRITE #1 "        <register address='0xb2e0350' value='0x" DATA.LONG(A:0xb2e0350) "' name='RPMH_PDC_DBG_RSRC_REL_LOCK_STATUS_BANK0'/>"
WRITE #1 "        <register address='0xb2e0400' value='0x" DATA.LONG(A:0xb2e0400) "' name='RPMH_PDC_DBG_BUS_CONTROL'/>"
WRITE #1 "        <register address='0xb400000' value='0x" DATA.LONG(A:0xb400000) "' name='RPMH_PDC_APPS_SEQ_MEM_0'/>"
WRITE #1 "        <register address='0xb400004' value='0x" DATA.LONG(A:0xb400004) "' name='RPMH_PDC_APPS_SEQ_MEM_1'/>"
WRITE #1 "        <register address='0xb400008' value='0x" DATA.LONG(A:0xb400008) "' name='RPMH_PDC_APPS_SEQ_MEM_2'/>"
WRITE #1 "        <register address='0xb40000c' value='0x" DATA.LONG(A:0xb40000c) "' name='RPMH_PDC_APPS_SEQ_MEM_3'/>"
WRITE #1 "        <register address='0xb400010' value='0x" DATA.LONG(A:0xb400010) "' name='RPMH_PDC_APPS_SEQ_MEM_4'/>"
WRITE #1 "        <register address='0xb400014' value='0x" DATA.LONG(A:0xb400014) "' name='RPMH_PDC_APPS_SEQ_MEM_5'/>"
WRITE #1 "        <register address='0xb400018' value='0x" DATA.LONG(A:0xb400018) "' name='RPMH_PDC_APPS_SEQ_MEM_6'/>"
WRITE #1 "        <register address='0xb40001c' value='0x" DATA.LONG(A:0xb40001c) "' name='RPMH_PDC_APPS_SEQ_MEM_7'/>"
WRITE #1 "        <register address='0xb400020' value='0x" DATA.LONG(A:0xb400020) "' name='RPMH_PDC_APPS_SEQ_MEM_8'/>"
WRITE #1 "        <register address='0xb400024' value='0x" DATA.LONG(A:0xb400024) "' name='RPMH_PDC_APPS_SEQ_MEM_9'/>"
WRITE #1 "        <register address='0xb400028' value='0x" DATA.LONG(A:0xb400028) "' name='RPMH_PDC_APPS_SEQ_MEM_10'/>"
WRITE #1 "        <register address='0xb40002c' value='0x" DATA.LONG(A:0xb40002c) "' name='RPMH_PDC_APPS_SEQ_MEM_11'/>"
WRITE #1 "        <register address='0xb400030' value='0x" DATA.LONG(A:0xb400030) "' name='RPMH_PDC_APPS_SEQ_MEM_12'/>"
WRITE #1 "        <register address='0xb400034' value='0x" DATA.LONG(A:0xb400034) "' name='RPMH_PDC_APPS_SEQ_MEM_13'/>"
WRITE #1 "        <register address='0xb400038' value='0x" DATA.LONG(A:0xb400038) "' name='RPMH_PDC_APPS_SEQ_MEM_14'/>"
WRITE #1 "        <register address='0xb40003c' value='0x" DATA.LONG(A:0xb40003c) "' name='RPMH_PDC_APPS_SEQ_MEM_15'/>"
WRITE #1 "        <register address='0xb400040' value='0x" DATA.LONG(A:0xb400040) "' name='RPMH_PDC_APPS_SEQ_MEM_16'/>"
WRITE #1 "        <register address='0xb400044' value='0x" DATA.LONG(A:0xb400044) "' name='RPMH_PDC_APPS_SEQ_MEM_17'/>"
WRITE #1 "        <register address='0xb400048' value='0x" DATA.LONG(A:0xb400048) "' name='RPMH_PDC_APPS_SEQ_MEM_18'/>"
WRITE #1 "        <register address='0xb40004c' value='0x" DATA.LONG(A:0xb40004c) "' name='RPMH_PDC_APPS_SEQ_MEM_19'/>"
WRITE #1 "        <register address='0xb400050' value='0x" DATA.LONG(A:0xb400050) "' name='RPMH_PDC_APPS_SEQ_MEM_20'/>"
WRITE #1 "        <register address='0xb400054' value='0x" DATA.LONG(A:0xb400054) "' name='RPMH_PDC_APPS_SEQ_MEM_21'/>"
WRITE #1 "        <register address='0xb400058' value='0x" DATA.LONG(A:0xb400058) "' name='RPMH_PDC_APPS_SEQ_MEM_22'/>"
WRITE #1 "        <register address='0xb40005c' value='0x" DATA.LONG(A:0xb40005c) "' name='RPMH_PDC_APPS_SEQ_MEM_23'/>"
WRITE #1 "        <register address='0xb400060' value='0x" DATA.LONG(A:0xb400060) "' name='RPMH_PDC_APPS_SEQ_MEM_24'/>"
WRITE #1 "        <register address='0xb400064' value='0x" DATA.LONG(A:0xb400064) "' name='RPMH_PDC_APPS_SEQ_MEM_25'/>"
WRITE #1 "        <register address='0xb400068' value='0x" DATA.LONG(A:0xb400068) "' name='RPMH_PDC_APPS_SEQ_MEM_26'/>"
WRITE #1 "        <register address='0xb40006c' value='0x" DATA.LONG(A:0xb40006c) "' name='RPMH_PDC_APPS_SEQ_MEM_27'/>"
WRITE #1 "        <register address='0xb400070' value='0x" DATA.LONG(A:0xb400070) "' name='RPMH_PDC_APPS_SEQ_MEM_28'/>"
WRITE #1 "        <register address='0xb400074' value='0x" DATA.LONG(A:0xb400074) "' name='RPMH_PDC_APPS_SEQ_MEM_29'/>"
WRITE #1 "        <register address='0xb400078' value='0x" DATA.LONG(A:0xb400078) "' name='RPMH_PDC_APPS_SEQ_MEM_30'/>"
WRITE #1 "        <register address='0xb40007c' value='0x" DATA.LONG(A:0xb40007c) "' name='RPMH_PDC_APPS_SEQ_MEM_31'/>"
WRITE #1 "        <register address='0xb400080' value='0x" DATA.LONG(A:0xb400080) "' name='RPMH_PDC_APPS_SEQ_MEM_32'/>"
WRITE #1 "        <register address='0xb400084' value='0x" DATA.LONG(A:0xb400084) "' name='RPMH_PDC_APPS_SEQ_MEM_33'/>"
WRITE #1 "        <register address='0xb400088' value='0x" DATA.LONG(A:0xb400088) "' name='RPMH_PDC_APPS_SEQ_MEM_34'/>"
WRITE #1 "        <register address='0xb40008c' value='0x" DATA.LONG(A:0xb40008c) "' name='RPMH_PDC_APPS_SEQ_MEM_35'/>"
WRITE #1 "        <register address='0xb400090' value='0x" DATA.LONG(A:0xb400090) "' name='RPMH_PDC_APPS_SEQ_MEM_36'/>"
WRITE #1 "        <register address='0xb400094' value='0x" DATA.LONG(A:0xb400094) "' name='RPMH_PDC_APPS_SEQ_MEM_37'/>"
WRITE #1 "        <register address='0xb400098' value='0x" DATA.LONG(A:0xb400098) "' name='RPMH_PDC_APPS_SEQ_MEM_38'/>"
WRITE #1 "        <register address='0xb40009c' value='0x" DATA.LONG(A:0xb40009c) "' name='RPMH_PDC_APPS_SEQ_MEM_39'/>"
WRITE #1 "        <register address='0xb4000a0' value='0x" DATA.LONG(A:0xb4000a0) "' name='RPMH_PDC_APPS_SEQ_MEM_40'/>"
WRITE #1 "        <register address='0xb4000a4' value='0x" DATA.LONG(A:0xb4000a4) "' name='RPMH_PDC_APPS_SEQ_MEM_41'/>"
WRITE #1 "        <register address='0xb4000a8' value='0x" DATA.LONG(A:0xb4000a8) "' name='RPMH_PDC_APPS_SEQ_MEM_42'/>"
WRITE #1 "        <register address='0xb4000ac' value='0x" DATA.LONG(A:0xb4000ac) "' name='RPMH_PDC_APPS_SEQ_MEM_43'/>"
WRITE #1 "        <register address='0xb4000b0' value='0x" DATA.LONG(A:0xb4000b0) "' name='RPMH_PDC_APPS_SEQ_MEM_44'/>"
WRITE #1 "        <register address='0xb4000b4' value='0x" DATA.LONG(A:0xb4000b4) "' name='RPMH_PDC_APPS_SEQ_MEM_45'/>"
WRITE #1 "        <register address='0xb4000b8' value='0x" DATA.LONG(A:0xb4000b8) "' name='RPMH_PDC_APPS_SEQ_MEM_46'/>"
WRITE #1 "        <register address='0xb4000bc' value='0x" DATA.LONG(A:0xb4000bc) "' name='RPMH_PDC_APPS_SEQ_MEM_47'/>"
WRITE #1 "        <register address='0xb420000' value='0x" DATA.LONG(A:0xb420000) "' name='RPMH_PDC_AOP_SEQ_MEM_0'/>"
WRITE #1 "        <register address='0xb420004' value='0x" DATA.LONG(A:0xb420004) "' name='RPMH_PDC_AOP_SEQ_MEM_1'/>"
WRITE #1 "        <register address='0xb420008' value='0x" DATA.LONG(A:0xb420008) "' name='RPMH_PDC_AOP_SEQ_MEM_2'/>"
WRITE #1 "        <register address='0xb42000c' value='0x" DATA.LONG(A:0xb42000c) "' name='RPMH_PDC_AOP_SEQ_MEM_3'/>"
WRITE #1 "        <register address='0xb420010' value='0x" DATA.LONG(A:0xb420010) "' name='RPMH_PDC_AOP_SEQ_MEM_4'/>"
WRITE #1 "        <register address='0xb420014' value='0x" DATA.LONG(A:0xb420014) "' name='RPMH_PDC_AOP_SEQ_MEM_5'/>"
WRITE #1 "        <register address='0xb420018' value='0x" DATA.LONG(A:0xb420018) "' name='RPMH_PDC_AOP_SEQ_MEM_6'/>"
WRITE #1 "        <register address='0xb42001c' value='0x" DATA.LONG(A:0xb42001c) "' name='RPMH_PDC_AOP_SEQ_MEM_7'/>"
WRITE #1 "        <register address='0xb420020' value='0x" DATA.LONG(A:0xb420020) "' name='RPMH_PDC_AOP_SEQ_MEM_8'/>"
WRITE #1 "        <register address='0xb420024' value='0x" DATA.LONG(A:0xb420024) "' name='RPMH_PDC_AOP_SEQ_MEM_9'/>"
WRITE #1 "        <register address='0xb420028' value='0x" DATA.LONG(A:0xb420028) "' name='RPMH_PDC_AOP_SEQ_MEM_10'/>"
WRITE #1 "        <register address='0xb42002c' value='0x" DATA.LONG(A:0xb42002c) "' name='RPMH_PDC_AOP_SEQ_MEM_11'/>"
WRITE #1 "        <register address='0xb420030' value='0x" DATA.LONG(A:0xb420030) "' name='RPMH_PDC_AOP_SEQ_MEM_12'/>"
WRITE #1 "        <register address='0xb420034' value='0x" DATA.LONG(A:0xb420034) "' name='RPMH_PDC_AOP_SEQ_MEM_13'/>"
WRITE #1 "        <register address='0xb420038' value='0x" DATA.LONG(A:0xb420038) "' name='RPMH_PDC_AOP_SEQ_MEM_14'/>"
WRITE #1 "        <register address='0xb42003c' value='0x" DATA.LONG(A:0xb42003c) "' name='RPMH_PDC_AOP_SEQ_MEM_15'/>"
WRITE #1 "        <register address='0xb420040' value='0x" DATA.LONG(A:0xb420040) "' name='RPMH_PDC_AOP_SEQ_MEM_16'/>"
WRITE #1 "        <register address='0xb420044' value='0x" DATA.LONG(A:0xb420044) "' name='RPMH_PDC_AOP_SEQ_MEM_17'/>"
WRITE #1 "        <register address='0xb420048' value='0x" DATA.LONG(A:0xb420048) "' name='RPMH_PDC_AOP_SEQ_MEM_18'/>"
WRITE #1 "        <register address='0xb42004c' value='0x" DATA.LONG(A:0xb42004c) "' name='RPMH_PDC_AOP_SEQ_MEM_19'/>"
WRITE #1 "        <register address='0xb420050' value='0x" DATA.LONG(A:0xb420050) "' name='RPMH_PDC_AOP_SEQ_MEM_20'/>"
WRITE #1 "        <register address='0xb420054' value='0x" DATA.LONG(A:0xb420054) "' name='RPMH_PDC_AOP_SEQ_MEM_21'/>"
WRITE #1 "        <register address='0xb420058' value='0x" DATA.LONG(A:0xb420058) "' name='RPMH_PDC_AOP_SEQ_MEM_22'/>"
WRITE #1 "        <register address='0xb42005c' value='0x" DATA.LONG(A:0xb42005c) "' name='RPMH_PDC_AOP_SEQ_MEM_23'/>"
WRITE #1 "        <register address='0xb430000' value='0x" DATA.LONG(A:0xb430000) "' name='RPMH_PDC_DEBUG_SEQ_MEM_0'/>"
WRITE #1 "        <register address='0xb430004' value='0x" DATA.LONG(A:0xb430004) "' name='RPMH_PDC_DEBUG_SEQ_MEM_1'/>"
WRITE #1 "        <register address='0xb430008' value='0x" DATA.LONG(A:0xb430008) "' name='RPMH_PDC_DEBUG_SEQ_MEM_2'/>"
WRITE #1 "        <register address='0xb43000c' value='0x" DATA.LONG(A:0xb43000c) "' name='RPMH_PDC_DEBUG_SEQ_MEM_3'/>"
WRITE #1 "        <register address='0xb430010' value='0x" DATA.LONG(A:0xb430010) "' name='RPMH_PDC_DEBUG_SEQ_MEM_4'/>"
WRITE #1 "        <register address='0xb430014' value='0x" DATA.LONG(A:0xb430014) "' name='RPMH_PDC_DEBUG_SEQ_MEM_5'/>"
WRITE #1 "        <register address='0xb430018' value='0x" DATA.LONG(A:0xb430018) "' name='RPMH_PDC_DEBUG_SEQ_MEM_6'/>"
WRITE #1 "        <register address='0xb43001c' value='0x" DATA.LONG(A:0xb43001c) "' name='RPMH_PDC_DEBUG_SEQ_MEM_7'/>"
WRITE #1 "        <register address='0xb430020' value='0x" DATA.LONG(A:0xb430020) "' name='RPMH_PDC_DEBUG_SEQ_MEM_8'/>"
WRITE #1 "        <register address='0xb430024' value='0x" DATA.LONG(A:0xb430024) "' name='RPMH_PDC_DEBUG_SEQ_MEM_9'/>"
WRITE #1 "        <register address='0xb430028' value='0x" DATA.LONG(A:0xb430028) "' name='RPMH_PDC_DEBUG_SEQ_MEM_10'/>"
WRITE #1 "        <register address='0xb43002c' value='0x" DATA.LONG(A:0xb43002c) "' name='RPMH_PDC_DEBUG_SEQ_MEM_11'/>"
WRITE #1 "        <register address='0xb430030' value='0x" DATA.LONG(A:0xb430030) "' name='RPMH_PDC_DEBUG_SEQ_MEM_12'/>"
WRITE #1 "        <register address='0xb430034' value='0x" DATA.LONG(A:0xb430034) "' name='RPMH_PDC_DEBUG_SEQ_MEM_13'/>"
WRITE #1 "        <register address='0xb430038' value='0x" DATA.LONG(A:0xb430038) "' name='RPMH_PDC_DEBUG_SEQ_MEM_14'/>"
WRITE #1 "        <register address='0xb43003c' value='0x" DATA.LONG(A:0xb43003c) "' name='RPMH_PDC_DEBUG_SEQ_MEM_15'/>"
WRITE #1 "        <register address='0xb430040' value='0x" DATA.LONG(A:0xb430040) "' name='RPMH_PDC_DEBUG_SEQ_MEM_16'/>"
WRITE #1 "        <register address='0xb430044' value='0x" DATA.LONG(A:0xb430044) "' name='RPMH_PDC_DEBUG_SEQ_MEM_17'/>"
WRITE #1 "        <register address='0xb430048' value='0x" DATA.LONG(A:0xb430048) "' name='RPMH_PDC_DEBUG_SEQ_MEM_18'/>"
WRITE #1 "        <register address='0xb43004c' value='0x" DATA.LONG(A:0xb43004c) "' name='RPMH_PDC_DEBUG_SEQ_MEM_19'/>"
WRITE #1 "        <register address='0xb430050' value='0x" DATA.LONG(A:0xb430050) "' name='RPMH_PDC_DEBUG_SEQ_MEM_20'/>"
WRITE #1 "        <register address='0xb430054' value='0x" DATA.LONG(A:0xb430054) "' name='RPMH_PDC_DEBUG_SEQ_MEM_21'/>"
WRITE #1 "        <register address='0xb430058' value='0x" DATA.LONG(A:0xb430058) "' name='RPMH_PDC_DEBUG_SEQ_MEM_22'/>"
WRITE #1 "        <register address='0xb43005c' value='0x" DATA.LONG(A:0xb43005c) "' name='RPMH_PDC_DEBUG_SEQ_MEM_23'/>"
WRITE #1 "        <register address='0xb440000' value='0x" DATA.LONG(A:0xb440000) "' name='RPMH_PDC_MODEM_SEQ_MEM_0'/>"
WRITE #1 "        <register address='0xb440004' value='0x" DATA.LONG(A:0xb440004) "' name='RPMH_PDC_MODEM_SEQ_MEM_1'/>"
WRITE #1 "        <register address='0xb440008' value='0x" DATA.LONG(A:0xb440008) "' name='RPMH_PDC_MODEM_SEQ_MEM_2'/>"
WRITE #1 "        <register address='0xb44000c' value='0x" DATA.LONG(A:0xb44000c) "' name='RPMH_PDC_MODEM_SEQ_MEM_3'/>"
WRITE #1 "        <register address='0xb440010' value='0x" DATA.LONG(A:0xb440010) "' name='RPMH_PDC_MODEM_SEQ_MEM_4'/>"
WRITE #1 "        <register address='0xb440014' value='0x" DATA.LONG(A:0xb440014) "' name='RPMH_PDC_MODEM_SEQ_MEM_5'/>"
WRITE #1 "        <register address='0xb440018' value='0x" DATA.LONG(A:0xb440018) "' name='RPMH_PDC_MODEM_SEQ_MEM_6'/>"
WRITE #1 "        <register address='0xb44001c' value='0x" DATA.LONG(A:0xb44001c) "' name='RPMH_PDC_MODEM_SEQ_MEM_7'/>"
WRITE #1 "        <register address='0xb440020' value='0x" DATA.LONG(A:0xb440020) "' name='RPMH_PDC_MODEM_SEQ_MEM_8'/>"
WRITE #1 "        <register address='0xb440024' value='0x" DATA.LONG(A:0xb440024) "' name='RPMH_PDC_MODEM_SEQ_MEM_9'/>"
WRITE #1 "        <register address='0xb440028' value='0x" DATA.LONG(A:0xb440028) "' name='RPMH_PDC_MODEM_SEQ_MEM_10'/>"
WRITE #1 "        <register address='0xb44002c' value='0x" DATA.LONG(A:0xb44002c) "' name='RPMH_PDC_MODEM_SEQ_MEM_11'/>"
WRITE #1 "        <register address='0xb440030' value='0x" DATA.LONG(A:0xb440030) "' name='RPMH_PDC_MODEM_SEQ_MEM_12'/>"
WRITE #1 "        <register address='0xb440034' value='0x" DATA.LONG(A:0xb440034) "' name='RPMH_PDC_MODEM_SEQ_MEM_13'/>"
WRITE #1 "        <register address='0xb440038' value='0x" DATA.LONG(A:0xb440038) "' name='RPMH_PDC_MODEM_SEQ_MEM_14'/>"
WRITE #1 "        <register address='0xb44003c' value='0x" DATA.LONG(A:0xb44003c) "' name='RPMH_PDC_MODEM_SEQ_MEM_15'/>"
WRITE #1 "        <register address='0xb440040' value='0x" DATA.LONG(A:0xb440040) "' name='RPMH_PDC_MODEM_SEQ_MEM_16'/>"
WRITE #1 "        <register address='0xb440044' value='0x" DATA.LONG(A:0xb440044) "' name='RPMH_PDC_MODEM_SEQ_MEM_17'/>"
WRITE #1 "        <register address='0xb440048' value='0x" DATA.LONG(A:0xb440048) "' name='RPMH_PDC_MODEM_SEQ_MEM_18'/>"
WRITE #1 "        <register address='0xb44004c' value='0x" DATA.LONG(A:0xb44004c) "' name='RPMH_PDC_MODEM_SEQ_MEM_19'/>"
WRITE #1 "        <register address='0xb440050' value='0x" DATA.LONG(A:0xb440050) "' name='RPMH_PDC_MODEM_SEQ_MEM_20'/>"
WRITE #1 "        <register address='0xb440054' value='0x" DATA.LONG(A:0xb440054) "' name='RPMH_PDC_MODEM_SEQ_MEM_21'/>"
WRITE #1 "        <register address='0xb440058' value='0x" DATA.LONG(A:0xb440058) "' name='RPMH_PDC_MODEM_SEQ_MEM_22'/>"
WRITE #1 "        <register address='0xb44005c' value='0x" DATA.LONG(A:0xb44005c) "' name='RPMH_PDC_MODEM_SEQ_MEM_23'/>"
WRITE #1 "        <register address='0xb600000' value='0x" DATA.LONG(A:0xb600000) "' name='RPMH_ARC_DRV0_RM0_VOTE'/>"
WRITE #1 "        <register address='0xb600010' value='0x" DATA.LONG(A:0xb600010) "' name='RPMH_ARC_DRV0_RM1_VOTE'/>"
WRITE #1 "        <register address='0xb600020' value='0x" DATA.LONG(A:0xb600020) "' name='RPMH_ARC_DRV0_RM2_VOTE'/>"
WRITE #1 "        <register address='0xb600030' value='0x" DATA.LONG(A:0xb600030) "' name='RPMH_ARC_DRV0_RM3_VOTE'/>"
WRITE #1 "        <register address='0xb600040' value='0x" DATA.LONG(A:0xb600040) "' name='RPMH_ARC_DRV0_RM4_VOTE'/>"
WRITE #1 "        <register address='0xb600050' value='0x" DATA.LONG(A:0xb600050) "' name='RPMH_ARC_DRV0_RM5_VOTE'/>"
WRITE #1 "        <register address='0xb600060' value='0x" DATA.LONG(A:0xb600060) "' name='RPMH_ARC_DRV0_RM6_VOTE'/>"
WRITE #1 "        <register address='0xb610000' value='0x" DATA.LONG(A:0xb610000) "' name='RPMH_ARC_DRV1_RM0_VOTE'/>"
WRITE #1 "        <register address='0xb610010' value='0x" DATA.LONG(A:0xb610010) "' name='RPMH_ARC_DRV1_RM1_VOTE'/>"
WRITE #1 "        <register address='0xb610020' value='0x" DATA.LONG(A:0xb610020) "' name='RPMH_ARC_DRV1_RM2_VOTE'/>"
WRITE #1 "        <register address='0xb610030' value='0x" DATA.LONG(A:0xb610030) "' name='RPMH_ARC_DRV1_RM3_VOTE'/>"
WRITE #1 "        <register address='0xb610040' value='0x" DATA.LONG(A:0xb610040) "' name='RPMH_ARC_DRV1_RM4_VOTE'/>"
WRITE #1 "        <register address='0xb610050' value='0x" DATA.LONG(A:0xb610050) "' name='RPMH_ARC_DRV1_RM5_VOTE'/>"
WRITE #1 "        <register address='0xb610060' value='0x" DATA.LONG(A:0xb610060) "' name='RPMH_ARC_DRV1_RM6_VOTE'/>"
WRITE #1 "        <register address='0xb620000' value='0x" DATA.LONG(A:0xb620000) "' name='RPMH_ARC_DRV2_RM0_VOTE'/>"
WRITE #1 "        <register address='0xb620010' value='0x" DATA.LONG(A:0xb620010) "' name='RPMH_ARC_DRV2_RM1_VOTE'/>"
WRITE #1 "        <register address='0xb620020' value='0x" DATA.LONG(A:0xb620020) "' name='RPMH_ARC_DRV2_RM2_VOTE'/>"
WRITE #1 "        <register address='0xb620030' value='0x" DATA.LONG(A:0xb620030) "' name='RPMH_ARC_DRV2_RM3_VOTE'/>"
WRITE #1 "        <register address='0xb620040' value='0x" DATA.LONG(A:0xb620040) "' name='RPMH_ARC_DRV2_RM4_VOTE'/>"
WRITE #1 "        <register address='0xb620050' value='0x" DATA.LONG(A:0xb620050) "' name='RPMH_ARC_DRV2_RM5_VOTE'/>"
WRITE #1 "        <register address='0xb620060' value='0x" DATA.LONG(A:0xb620060) "' name='RPMH_ARC_DRV2_RM6_VOTE'/>"
WRITE #1 "        <register address='0xb630000' value='0x" DATA.LONG(A:0xb630000) "' name='RPMH_ARC_DRV3_RM0_VOTE'/>"
WRITE #1 "        <register address='0xb630010' value='0x" DATA.LONG(A:0xb630010) "' name='RPMH_ARC_DRV3_RM1_VOTE'/>"
WRITE #1 "        <register address='0xb630020' value='0x" DATA.LONG(A:0xb630020) "' name='RPMH_ARC_DRV3_RM2_VOTE'/>"
WRITE #1 "        <register address='0xb630030' value='0x" DATA.LONG(A:0xb630030) "' name='RPMH_ARC_DRV3_RM3_VOTE'/>"
WRITE #1 "        <register address='0xb630040' value='0x" DATA.LONG(A:0xb630040) "' name='RPMH_ARC_DRV3_RM4_VOTE'/>"
WRITE #1 "        <register address='0xb630050' value='0x" DATA.LONG(A:0xb630050) "' name='RPMH_ARC_DRV3_RM5_VOTE'/>"
WRITE #1 "        <register address='0xb630060' value='0x" DATA.LONG(A:0xb630060) "' name='RPMH_ARC_DRV3_RM6_VOTE'/>"
WRITE #1 "        <register address='0xb640000' value='0x" DATA.LONG(A:0xb640000) "' name='RPMH_ARC_DRV4_RM0_VOTE'/>"
WRITE #1 "        <register address='0xb640010' value='0x" DATA.LONG(A:0xb640010) "' name='RPMH_ARC_DRV4_RM1_VOTE'/>"
WRITE #1 "        <register address='0xb640020' value='0x" DATA.LONG(A:0xb640020) "' name='RPMH_ARC_DRV4_RM2_VOTE'/>"
WRITE #1 "        <register address='0xb640030' value='0x" DATA.LONG(A:0xb640030) "' name='RPMH_ARC_DRV4_RM3_VOTE'/>"
WRITE #1 "        <register address='0xb640040' value='0x" DATA.LONG(A:0xb640040) "' name='RPMH_ARC_DRV4_RM4_VOTE'/>"
WRITE #1 "        <register address='0xb640050' value='0x" DATA.LONG(A:0xb640050) "' name='RPMH_ARC_DRV4_RM5_VOTE'/>"
WRITE #1 "        <register address='0xb640060' value='0x" DATA.LONG(A:0xb640060) "' name='RPMH_ARC_DRV4_RM6_VOTE'/>"
WRITE #1 "        <register address='0xb650000' value='0x" DATA.LONG(A:0xb650000) "' name='RPMH_ARC_DRV5_RM0_VOTE'/>"
WRITE #1 "        <register address='0xb650010' value='0x" DATA.LONG(A:0xb650010) "' name='RPMH_ARC_DRV5_RM1_VOTE'/>"
WRITE #1 "        <register address='0xb650020' value='0x" DATA.LONG(A:0xb650020) "' name='RPMH_ARC_DRV5_RM2_VOTE'/>"
WRITE #1 "        <register address='0xb650030' value='0x" DATA.LONG(A:0xb650030) "' name='RPMH_ARC_DRV5_RM3_VOTE'/>"
WRITE #1 "        <register address='0xb650040' value='0x" DATA.LONG(A:0xb650040) "' name='RPMH_ARC_DRV5_RM4_VOTE'/>"
WRITE #1 "        <register address='0xb650050' value='0x" DATA.LONG(A:0xb650050) "' name='RPMH_ARC_DRV5_RM5_VOTE'/>"
WRITE #1 "        <register address='0xb650060' value='0x" DATA.LONG(A:0xb650060) "' name='RPMH_ARC_DRV5_RM6_VOTE'/>"
WRITE #1 "        <register address='0xb7e0000' value='0x" DATA.LONG(A:0xb7e0000) "' name='RPMH_ARC_BCM_DRV0_RM0_VOTE'/>"
WRITE #1 "        <register address='0xb7e0010' value='0x" DATA.LONG(A:0xb7e0010) "' name='RPMH_ARC_BCM_DRV0_RM1_VOTE'/>"
WRITE #1 "        <register address='0xb7e0020' value='0x" DATA.LONG(A:0xb7e0020) "' name='RPMH_ARC_BCM_DRV0_RM2_VOTE'/>"
WRITE #1 "        <register address='0xb7e0030' value='0x" DATA.LONG(A:0xb7e0030) "' name='RPMH_ARC_BCM_DRV0_RM3_VOTE'/>"
WRITE #1 "        <register address='0xb7e0040' value='0x" DATA.LONG(A:0xb7e0040) "' name='RPMH_ARC_BCM_DRV0_RM4_VOTE'/>"
WRITE #1 "        <register address='0xb7e0050' value='0x" DATA.LONG(A:0xb7e0050) "' name='RPMH_ARC_BCM_DRV0_RM5_VOTE'/>"
WRITE #1 "        <register address='0xb7e0060' value='0x" DATA.LONG(A:0xb7e0060) "' name='RPMH_ARC_BCM_DRV0_RM6_VOTE'/>"
WRITE #1 "        <register address='0xb7e1000' value='0x" DATA.LONG(A:0xb7e1000) "' name='RPMH_ARC_BCM_DRV1_RM0_VOTE'/>"
WRITE #1 "        <register address='0xb7e1010' value='0x" DATA.LONG(A:0xb7e1010) "' name='RPMH_ARC_BCM_DRV1_RM1_VOTE'/>"
WRITE #1 "        <register address='0xb7e1020' value='0x" DATA.LONG(A:0xb7e1020) "' name='RPMH_ARC_BCM_DRV1_RM2_VOTE'/>"
WRITE #1 "        <register address='0xb7e1030' value='0x" DATA.LONG(A:0xb7e1030) "' name='RPMH_ARC_BCM_DRV1_RM3_VOTE'/>"
WRITE #1 "        <register address='0xb7e1040' value='0x" DATA.LONG(A:0xb7e1040) "' name='RPMH_ARC_BCM_DRV1_RM4_VOTE'/>"
WRITE #1 "        <register address='0xb7e1050' value='0x" DATA.LONG(A:0xb7e1050) "' name='RPMH_ARC_BCM_DRV1_RM5_VOTE'/>"
WRITE #1 "        <register address='0xb7e1060' value='0x" DATA.LONG(A:0xb7e1060) "' name='RPMH_ARC_BCM_DRV1_RM6_VOTE'/>"
WRITE #1 "        <register address='0xb7e2000' value='0x" DATA.LONG(A:0xb7e2000) "' name='RPMH_ARC_BCM_DRV2_RM0_VOTE'/>"
WRITE #1 "        <register address='0xb7e2010' value='0x" DATA.LONG(A:0xb7e2010) "' name='RPMH_ARC_BCM_DRV2_RM1_VOTE'/>"
WRITE #1 "        <register address='0xb7e2020' value='0x" DATA.LONG(A:0xb7e2020) "' name='RPMH_ARC_BCM_DRV2_RM2_VOTE'/>"
WRITE #1 "        <register address='0xb7e2030' value='0x" DATA.LONG(A:0xb7e2030) "' name='RPMH_ARC_BCM_DRV2_RM3_VOTE'/>"
WRITE #1 "        <register address='0xb7e2040' value='0x" DATA.LONG(A:0xb7e2040) "' name='RPMH_ARC_BCM_DRV2_RM4_VOTE'/>"
WRITE #1 "        <register address='0xb7e2050' value='0x" DATA.LONG(A:0xb7e2050) "' name='RPMH_ARC_BCM_DRV2_RM5_VOTE'/>"
WRITE #1 "        <register address='0xb7e2060' value='0x" DATA.LONG(A:0xb7e2060) "' name='RPMH_ARC_BCM_DRV2_RM6_VOTE'/>"
WRITE #1 "        <register address='0xb7e3000' value='0x" DATA.LONG(A:0xb7e3000) "' name='RPMH_ARC_BCM_DRV3_RM0_VOTE'/>"
WRITE #1 "        <register address='0xb7e3010' value='0x" DATA.LONG(A:0xb7e3010) "' name='RPMH_ARC_BCM_DRV3_RM1_VOTE'/>"
WRITE #1 "        <register address='0xb7e3020' value='0x" DATA.LONG(A:0xb7e3020) "' name='RPMH_ARC_BCM_DRV3_RM2_VOTE'/>"
WRITE #1 "        <register address='0xb7e3030' value='0x" DATA.LONG(A:0xb7e3030) "' name='RPMH_ARC_BCM_DRV3_RM3_VOTE'/>"
WRITE #1 "        <register address='0xb7e3040' value='0x" DATA.LONG(A:0xb7e3040) "' name='RPMH_ARC_BCM_DRV3_RM4_VOTE'/>"
WRITE #1 "        <register address='0xb7e3050' value='0x" DATA.LONG(A:0xb7e3050) "' name='RPMH_ARC_BCM_DRV3_RM5_VOTE'/>"
WRITE #1 "        <register address='0xb7e3060' value='0x" DATA.LONG(A:0xb7e3060) "' name='RPMH_ARC_BCM_DRV3_RM6_VOTE'/>"
WRITE #1 "        <register address='0xb7e4000' value='0x" DATA.LONG(A:0xb7e4000) "' name='RPMH_ARC_BCM_DRV4_RM0_VOTE'/>"
WRITE #1 "        <register address='0xb7e4010' value='0x" DATA.LONG(A:0xb7e4010) "' name='RPMH_ARC_BCM_DRV4_RM1_VOTE'/>"
WRITE #1 "        <register address='0xb7e4020' value='0x" DATA.LONG(A:0xb7e4020) "' name='RPMH_ARC_BCM_DRV4_RM2_VOTE'/>"
WRITE #1 "        <register address='0xb7e4030' value='0x" DATA.LONG(A:0xb7e4030) "' name='RPMH_ARC_BCM_DRV4_RM3_VOTE'/>"
WRITE #1 "        <register address='0xb7e4040' value='0x" DATA.LONG(A:0xb7e4040) "' name='RPMH_ARC_BCM_DRV4_RM4_VOTE'/>"
WRITE #1 "        <register address='0xb7e4050' value='0x" DATA.LONG(A:0xb7e4050) "' name='RPMH_ARC_BCM_DRV4_RM5_VOTE'/>"
WRITE #1 "        <register address='0xb7e4060' value='0x" DATA.LONG(A:0xb7e4060) "' name='RPMH_ARC_BCM_DRV4_RM6_VOTE'/>"
WRITE #1 "        <register address='0xb7e5000' value='0x" DATA.LONG(A:0xb7e5000) "' name='RPMH_ARC_BCM_DRV5_RM0_VOTE'/>"
WRITE #1 "        <register address='0xb7e5010' value='0x" DATA.LONG(A:0xb7e5010) "' name='RPMH_ARC_BCM_DRV5_RM1_VOTE'/>"
WRITE #1 "        <register address='0xb7e5020' value='0x" DATA.LONG(A:0xb7e5020) "' name='RPMH_ARC_BCM_DRV5_RM2_VOTE'/>"
WRITE #1 "        <register address='0xb7e5030' value='0x" DATA.LONG(A:0xb7e5030) "' name='RPMH_ARC_BCM_DRV5_RM3_VOTE'/>"
WRITE #1 "        <register address='0xb7e5040' value='0x" DATA.LONG(A:0xb7e5040) "' name='RPMH_ARC_BCM_DRV5_RM4_VOTE'/>"
WRITE #1 "        <register address='0xb7e5050' value='0x" DATA.LONG(A:0xb7e5050) "' name='RPMH_ARC_BCM_DRV5_RM5_VOTE'/>"
WRITE #1 "        <register address='0xb7e5060' value='0x" DATA.LONG(A:0xb7e5060) "' name='RPMH_ARC_BCM_DRV5_RM6_VOTE'/>"
WRITE #1 "        <register address='0xb7e6000' value='0x" DATA.LONG(A:0xb7e6000) "' name='RPMH_ARC_BCM_DRV6_RM0_VOTE'/>"
WRITE #1 "        <register address='0xb7e6010' value='0x" DATA.LONG(A:0xb7e6010) "' name='RPMH_ARC_BCM_DRV6_RM1_VOTE'/>"
WRITE #1 "        <register address='0xb7e6020' value='0x" DATA.LONG(A:0xb7e6020) "' name='RPMH_ARC_BCM_DRV6_RM2_VOTE'/>"
WRITE #1 "        <register address='0xb7e6030' value='0x" DATA.LONG(A:0xb7e6030) "' name='RPMH_ARC_BCM_DRV6_RM3_VOTE'/>"
WRITE #1 "        <register address='0xb7e6040' value='0x" DATA.LONG(A:0xb7e6040) "' name='RPMH_ARC_BCM_DRV6_RM4_VOTE'/>"
WRITE #1 "        <register address='0xb7e6050' value='0x" DATA.LONG(A:0xb7e6050) "' name='RPMH_ARC_BCM_DRV6_RM5_VOTE'/>"
WRITE #1 "        <register address='0xb7e6060' value='0x" DATA.LONG(A:0xb7e6060) "' name='RPMH_ARC_BCM_DRV6_RM6_VOTE'/>"
WRITE #1 "        <register address='0xb7e7000' value='0x" DATA.LONG(A:0xb7e7000) "' name='RPMH_ARC_BCM_DRV7_RM0_VOTE'/>"
WRITE #1 "        <register address='0xb7e7010' value='0x" DATA.LONG(A:0xb7e7010) "' name='RPMH_ARC_BCM_DRV7_RM1_VOTE'/>"
WRITE #1 "        <register address='0xb7e7020' value='0x" DATA.LONG(A:0xb7e7020) "' name='RPMH_ARC_BCM_DRV7_RM2_VOTE'/>"
WRITE #1 "        <register address='0xb7e7030' value='0x" DATA.LONG(A:0xb7e7030) "' name='RPMH_ARC_BCM_DRV7_RM3_VOTE'/>"
WRITE #1 "        <register address='0xb7e7040' value='0x" DATA.LONG(A:0xb7e7040) "' name='RPMH_ARC_BCM_DRV7_RM4_VOTE'/>"
WRITE #1 "        <register address='0xb7e7050' value='0x" DATA.LONG(A:0xb7e7050) "' name='RPMH_ARC_BCM_DRV7_RM5_VOTE'/>"
WRITE #1 "        <register address='0xb7e7060' value='0x" DATA.LONG(A:0xb7e7060) "' name='RPMH_ARC_BCM_DRV7_RM6_VOTE'/>"
WRITE #1 "        <register address='0xb7e8000' value='0x" DATA.LONG(A:0xb7e8000) "' name='RPMH_ARC_BCM_DRV8_RM0_VOTE'/>"
WRITE #1 "        <register address='0xb7e8010' value='0x" DATA.LONG(A:0xb7e8010) "' name='RPMH_ARC_BCM_DRV8_RM1_VOTE'/>"
WRITE #1 "        <register address='0xb7e8020' value='0x" DATA.LONG(A:0xb7e8020) "' name='RPMH_ARC_BCM_DRV8_RM2_VOTE'/>"
WRITE #1 "        <register address='0xb7e8030' value='0x" DATA.LONG(A:0xb7e8030) "' name='RPMH_ARC_BCM_DRV8_RM3_VOTE'/>"
WRITE #1 "        <register address='0xb7e8040' value='0x" DATA.LONG(A:0xb7e8040) "' name='RPMH_ARC_BCM_DRV8_RM4_VOTE'/>"
WRITE #1 "        <register address='0xb7e8050' value='0x" DATA.LONG(A:0xb7e8050) "' name='RPMH_ARC_BCM_DRV8_RM5_VOTE'/>"
WRITE #1 "        <register address='0xb7e8060' value='0x" DATA.LONG(A:0xb7e8060) "' name='RPMH_ARC_BCM_DRV8_RM6_VOTE'/>"
WRITE #1 "        <register address='0xb7e9000' value='0x" DATA.LONG(A:0xb7e9000) "' name='RPMH_ARC_BCM_DRV9_RM0_VOTE'/>"
WRITE #1 "        <register address='0xb7e9010' value='0x" DATA.LONG(A:0xb7e9010) "' name='RPMH_ARC_BCM_DRV9_RM1_VOTE'/>"
WRITE #1 "        <register address='0xb7e9020' value='0x" DATA.LONG(A:0xb7e9020) "' name='RPMH_ARC_BCM_DRV9_RM2_VOTE'/>"
WRITE #1 "        <register address='0xb7e9030' value='0x" DATA.LONG(A:0xb7e9030) "' name='RPMH_ARC_BCM_DRV9_RM3_VOTE'/>"
WRITE #1 "        <register address='0xb7e9040' value='0x" DATA.LONG(A:0xb7e9040) "' name='RPMH_ARC_BCM_DRV9_RM4_VOTE'/>"
WRITE #1 "        <register address='0xb7e9050' value='0x" DATA.LONG(A:0xb7e9050) "' name='RPMH_ARC_BCM_DRV9_RM5_VOTE'/>"
WRITE #1 "        <register address='0xb7e9060' value='0x" DATA.LONG(A:0xb7e9060) "' name='RPMH_ARC_BCM_DRV9_RM6_VOTE'/>"
WRITE #1 "        <register address='0xb7ea000' value='0x" DATA.LONG(A:0xb7ea000) "' name='RPMH_ARC_BCM_DRV10_RM0_VOTE'/>"
WRITE #1 "        <register address='0xb7ea010' value='0x" DATA.LONG(A:0xb7ea010) "' name='RPMH_ARC_BCM_DRV10_RM1_VOTE'/>"
WRITE #1 "        <register address='0xb7ea020' value='0x" DATA.LONG(A:0xb7ea020) "' name='RPMH_ARC_BCM_DRV10_RM2_VOTE'/>"
WRITE #1 "        <register address='0xb7ea030' value='0x" DATA.LONG(A:0xb7ea030) "' name='RPMH_ARC_BCM_DRV10_RM3_VOTE'/>"
WRITE #1 "        <register address='0xb7ea040' value='0x" DATA.LONG(A:0xb7ea040) "' name='RPMH_ARC_BCM_DRV10_RM4_VOTE'/>"
WRITE #1 "        <register address='0xb7ea050' value='0x" DATA.LONG(A:0xb7ea050) "' name='RPMH_ARC_BCM_DRV10_RM5_VOTE'/>"
WRITE #1 "        <register address='0xb7ea060' value='0x" DATA.LONG(A:0xb7ea060) "' name='RPMH_ARC_BCM_DRV10_RM6_VOTE'/>"
WRITE #1 "        <register address='0xb7eb000' value='0x" DATA.LONG(A:0xb7eb000) "' name='RPMH_ARC_BCM_DRV11_RM0_VOTE'/>"
WRITE #1 "        <register address='0xb7eb010' value='0x" DATA.LONG(A:0xb7eb010) "' name='RPMH_ARC_BCM_DRV11_RM1_VOTE'/>"
WRITE #1 "        <register address='0xb7eb020' value='0x" DATA.LONG(A:0xb7eb020) "' name='RPMH_ARC_BCM_DRV11_RM2_VOTE'/>"
WRITE #1 "        <register address='0xb7eb030' value='0x" DATA.LONG(A:0xb7eb030) "' name='RPMH_ARC_BCM_DRV11_RM3_VOTE'/>"
WRITE #1 "        <register address='0xb7eb040' value='0x" DATA.LONG(A:0xb7eb040) "' name='RPMH_ARC_BCM_DRV11_RM4_VOTE'/>"
WRITE #1 "        <register address='0xb7eb050' value='0x" DATA.LONG(A:0xb7eb050) "' name='RPMH_ARC_BCM_DRV11_RM5_VOTE'/>"
WRITE #1 "        <register address='0xb7eb060' value='0x" DATA.LONG(A:0xb7eb060) "' name='RPMH_ARC_BCM_DRV11_RM6_VOTE'/>"
WRITE #1 "        <register address='0xb7ec000' value='0x" DATA.LONG(A:0xb7ec000) "' name='RPMH_ARC_BCM_DRV12_RM0_VOTE'/>"
WRITE #1 "        <register address='0xb7ec010' value='0x" DATA.LONG(A:0xb7ec010) "' name='RPMH_ARC_BCM_DRV12_RM1_VOTE'/>"
WRITE #1 "        <register address='0xb7ec020' value='0x" DATA.LONG(A:0xb7ec020) "' name='RPMH_ARC_BCM_DRV12_RM2_VOTE'/>"
WRITE #1 "        <register address='0xb7ec030' value='0x" DATA.LONG(A:0xb7ec030) "' name='RPMH_ARC_BCM_DRV12_RM3_VOTE'/>"
WRITE #1 "        <register address='0xb7ec040' value='0x" DATA.LONG(A:0xb7ec040) "' name='RPMH_ARC_BCM_DRV12_RM4_VOTE'/>"
WRITE #1 "        <register address='0xb7ec050' value='0x" DATA.LONG(A:0xb7ec050) "' name='RPMH_ARC_BCM_DRV12_RM5_VOTE'/>"
WRITE #1 "        <register address='0xb7ec060' value='0x" DATA.LONG(A:0xb7ec060) "' name='RPMH_ARC_BCM_DRV12_RM6_VOTE'/>"
WRITE #1 "        <register address='0xb7ed000' value='0x" DATA.LONG(A:0xb7ed000) "' name='RPMH_ARC_BCM_DRV13_RM0_VOTE'/>"
WRITE #1 "        <register address='0xb7ed010' value='0x" DATA.LONG(A:0xb7ed010) "' name='RPMH_ARC_BCM_DRV13_RM1_VOTE'/>"
WRITE #1 "        <register address='0xb7ed020' value='0x" DATA.LONG(A:0xb7ed020) "' name='RPMH_ARC_BCM_DRV13_RM2_VOTE'/>"
WRITE #1 "        <register address='0xb7ed030' value='0x" DATA.LONG(A:0xb7ed030) "' name='RPMH_ARC_BCM_DRV13_RM3_VOTE'/>"
WRITE #1 "        <register address='0xb7ed040' value='0x" DATA.LONG(A:0xb7ed040) "' name='RPMH_ARC_BCM_DRV13_RM4_VOTE'/>"
WRITE #1 "        <register address='0xb7ed050' value='0x" DATA.LONG(A:0xb7ed050) "' name='RPMH_ARC_BCM_DRV13_RM5_VOTE'/>"
WRITE #1 "        <register address='0xb7ed060' value='0x" DATA.LONG(A:0xb7ed060) "' name='RPMH_ARC_BCM_DRV13_RM6_VOTE'/>"
WRITE #1 "        <register address='0xb7ee000' value='0x" DATA.LONG(A:0xb7ee000) "' name='RPMH_ARC_BCM_DRV14_RM0_VOTE'/>"
WRITE #1 "        <register address='0xb7ee010' value='0x" DATA.LONG(A:0xb7ee010) "' name='RPMH_ARC_BCM_DRV14_RM1_VOTE'/>"
WRITE #1 "        <register address='0xb7ee020' value='0x" DATA.LONG(A:0xb7ee020) "' name='RPMH_ARC_BCM_DRV14_RM2_VOTE'/>"
WRITE #1 "        <register address='0xb7ee030' value='0x" DATA.LONG(A:0xb7ee030) "' name='RPMH_ARC_BCM_DRV14_RM3_VOTE'/>"
WRITE #1 "        <register address='0xb7ee040' value='0x" DATA.LONG(A:0xb7ee040) "' name='RPMH_ARC_BCM_DRV14_RM4_VOTE'/>"
WRITE #1 "        <register address='0xb7ee050' value='0x" DATA.LONG(A:0xb7ee050) "' name='RPMH_ARC_BCM_DRV14_RM5_VOTE'/>"
WRITE #1 "        <register address='0xb7ee060' value='0x" DATA.LONG(A:0xb7ee060) "' name='RPMH_ARC_BCM_DRV14_RM6_VOTE'/>"
WRITE #1 "        <register address='0xb7ef000' value='0x" DATA.LONG(A:0xb7ef000) "' name='RPMH_ARC_BCM_DRV15_RM0_VOTE'/>"
WRITE #1 "        <register address='0xb7ef010' value='0x" DATA.LONG(A:0xb7ef010) "' name='RPMH_ARC_BCM_DRV15_RM1_VOTE'/>"
WRITE #1 "        <register address='0xb7ef020' value='0x" DATA.LONG(A:0xb7ef020) "' name='RPMH_ARC_BCM_DRV15_RM2_VOTE'/>"
WRITE #1 "        <register address='0xb7ef030' value='0x" DATA.LONG(A:0xb7ef030) "' name='RPMH_ARC_BCM_DRV15_RM3_VOTE'/>"
WRITE #1 "        <register address='0xb7ef040' value='0x" DATA.LONG(A:0xb7ef040) "' name='RPMH_ARC_BCM_DRV15_RM4_VOTE'/>"
WRITE #1 "        <register address='0xb7ef050' value='0x" DATA.LONG(A:0xb7ef050) "' name='RPMH_ARC_BCM_DRV15_RM5_VOTE'/>"
WRITE #1 "        <register address='0xb7ef060' value='0x" DATA.LONG(A:0xb7ef060) "' name='RPMH_ARC_BCM_DRV15_RM6_VOTE'/>"
WRITE #1 "        <register address='0xb600004' value='0x" DATA.LONG(A:0xb600004) "' name='RPMH_ARC_DRV0_RM0_TIMER'/>"
WRITE #1 "        <register address='0xb600014' value='0x" DATA.LONG(A:0xb600014) "' name='RPMH_ARC_DRV0_RM1_TIMER'/>"
WRITE #1 "        <register address='0xb600024' value='0x" DATA.LONG(A:0xb600024) "' name='RPMH_ARC_DRV0_RM2_TIMER'/>"
WRITE #1 "        <register address='0xb600034' value='0x" DATA.LONG(A:0xb600034) "' name='RPMH_ARC_DRV0_RM3_TIMER'/>"
WRITE #1 "        <register address='0xb600044' value='0x" DATA.LONG(A:0xb600044) "' name='RPMH_ARC_DRV0_RM4_TIMER'/>"
WRITE #1 "        <register address='0xb600054' value='0x" DATA.LONG(A:0xb600054) "' name='RPMH_ARC_DRV0_RM5_TIMER'/>"
WRITE #1 "        <register address='0xb600064' value='0x" DATA.LONG(A:0xb600064) "' name='RPMH_ARC_DRV0_RM6_TIMER'/>"
WRITE #1 "        <register address='0xb610004' value='0x" DATA.LONG(A:0xb610004) "' name='RPMH_ARC_DRV1_RM0_TIMER'/>"
WRITE #1 "        <register address='0xb610014' value='0x" DATA.LONG(A:0xb610014) "' name='RPMH_ARC_DRV1_RM1_TIMER'/>"
WRITE #1 "        <register address='0xb610024' value='0x" DATA.LONG(A:0xb610024) "' name='RPMH_ARC_DRV1_RM2_TIMER'/>"
WRITE #1 "        <register address='0xb610034' value='0x" DATA.LONG(A:0xb610034) "' name='RPMH_ARC_DRV1_RM3_TIMER'/>"
WRITE #1 "        <register address='0xb610044' value='0x" DATA.LONG(A:0xb610044) "' name='RPMH_ARC_DRV1_RM4_TIMER'/>"
WRITE #1 "        <register address='0xb610054' value='0x" DATA.LONG(A:0xb610054) "' name='RPMH_ARC_DRV1_RM5_TIMER'/>"
WRITE #1 "        <register address='0xb610064' value='0x" DATA.LONG(A:0xb610064) "' name='RPMH_ARC_DRV1_RM6_TIMER'/>"
WRITE #1 "        <register address='0xb620004' value='0x" DATA.LONG(A:0xb620004) "' name='RPMH_ARC_DRV2_RM0_TIMER'/>"
WRITE #1 "        <register address='0xb620014' value='0x" DATA.LONG(A:0xb620014) "' name='RPMH_ARC_DRV2_RM1_TIMER'/>"
WRITE #1 "        <register address='0xb620024' value='0x" DATA.LONG(A:0xb620024) "' name='RPMH_ARC_DRV2_RM2_TIMER'/>"
WRITE #1 "        <register address='0xb620034' value='0x" DATA.LONG(A:0xb620034) "' name='RPMH_ARC_DRV2_RM3_TIMER'/>"
WRITE #1 "        <register address='0xb620044' value='0x" DATA.LONG(A:0xb620044) "' name='RPMH_ARC_DRV2_RM4_TIMER'/>"
WRITE #1 "        <register address='0xb620054' value='0x" DATA.LONG(A:0xb620054) "' name='RPMH_ARC_DRV2_RM5_TIMER'/>"
WRITE #1 "        <register address='0xb620064' value='0x" DATA.LONG(A:0xb620064) "' name='RPMH_ARC_DRV2_RM6_TIMER'/>"
WRITE #1 "        <register address='0xb630004' value='0x" DATA.LONG(A:0xb630004) "' name='RPMH_ARC_DRV3_RM0_TIMER'/>"
WRITE #1 "        <register address='0xb630014' value='0x" DATA.LONG(A:0xb630014) "' name='RPMH_ARC_DRV3_RM1_TIMER'/>"
WRITE #1 "        <register address='0xb630024' value='0x" DATA.LONG(A:0xb630024) "' name='RPMH_ARC_DRV3_RM2_TIMER'/>"
WRITE #1 "        <register address='0xb630034' value='0x" DATA.LONG(A:0xb630034) "' name='RPMH_ARC_DRV3_RM3_TIMER'/>"
WRITE #1 "        <register address='0xb630044' value='0x" DATA.LONG(A:0xb630044) "' name='RPMH_ARC_DRV3_RM4_TIMER'/>"
WRITE #1 "        <register address='0xb630054' value='0x" DATA.LONG(A:0xb630054) "' name='RPMH_ARC_DRV3_RM5_TIMER'/>"
WRITE #1 "        <register address='0xb630064' value='0x" DATA.LONG(A:0xb630064) "' name='RPMH_ARC_DRV3_RM6_TIMER'/>"
WRITE #1 "        <register address='0xb640004' value='0x" DATA.LONG(A:0xb640004) "' name='RPMH_ARC_DRV4_RM0_TIMER'/>"
WRITE #1 "        <register address='0xb640014' value='0x" DATA.LONG(A:0xb640014) "' name='RPMH_ARC_DRV4_RM1_TIMER'/>"
WRITE #1 "        <register address='0xb640024' value='0x" DATA.LONG(A:0xb640024) "' name='RPMH_ARC_DRV4_RM2_TIMER'/>"
WRITE #1 "        <register address='0xb640034' value='0x" DATA.LONG(A:0xb640034) "' name='RPMH_ARC_DRV4_RM3_TIMER'/>"
WRITE #1 "        <register address='0xb640044' value='0x" DATA.LONG(A:0xb640044) "' name='RPMH_ARC_DRV4_RM4_TIMER'/>"
WRITE #1 "        <register address='0xb640054' value='0x" DATA.LONG(A:0xb640054) "' name='RPMH_ARC_DRV4_RM5_TIMER'/>"
WRITE #1 "        <register address='0xb640064' value='0x" DATA.LONG(A:0xb640064) "' name='RPMH_ARC_DRV4_RM6_TIMER'/>"
WRITE #1 "        <register address='0xb650004' value='0x" DATA.LONG(A:0xb650004) "' name='RPMH_ARC_DRV5_RM0_TIMER'/>"
WRITE #1 "        <register address='0xb650014' value='0x" DATA.LONG(A:0xb650014) "' name='RPMH_ARC_DRV5_RM1_TIMER'/>"
WRITE #1 "        <register address='0xb650024' value='0x" DATA.LONG(A:0xb650024) "' name='RPMH_ARC_DRV5_RM2_TIMER'/>"
WRITE #1 "        <register address='0xb650034' value='0x" DATA.LONG(A:0xb650034) "' name='RPMH_ARC_DRV5_RM3_TIMER'/>"
WRITE #1 "        <register address='0xb650044' value='0x" DATA.LONG(A:0xb650044) "' name='RPMH_ARC_DRV5_RM4_TIMER'/>"
WRITE #1 "        <register address='0xb650054' value='0x" DATA.LONG(A:0xb650054) "' name='RPMH_ARC_DRV5_RM5_TIMER'/>"
WRITE #1 "        <register address='0xb650064' value='0x" DATA.LONG(A:0xb650064) "' name='RPMH_ARC_DRV5_RM6_TIMER'/>"
WRITE #1 "        <register address='0xb600008' value='0x" DATA.LONG(A:0xb600008) "' name='RPMH_ARC_DRV0_RM0_SHADOW_STATUS'/>"
WRITE #1 "        <register address='0xb600018' value='0x" DATA.LONG(A:0xb600018) "' name='RPMH_ARC_DRV0_RM1_SHADOW_STATUS'/>"
WRITE #1 "        <register address='0xb600028' value='0x" DATA.LONG(A:0xb600028) "' name='RPMH_ARC_DRV0_RM2_SHADOW_STATUS'/>"
WRITE #1 "        <register address='0xb600038' value='0x" DATA.LONG(A:0xb600038) "' name='RPMH_ARC_DRV0_RM3_SHADOW_STATUS'/>"
WRITE #1 "        <register address='0xb600048' value='0x" DATA.LONG(A:0xb600048) "' name='RPMH_ARC_DRV0_RM4_SHADOW_STATUS'/>"
WRITE #1 "        <register address='0xb600058' value='0x" DATA.LONG(A:0xb600058) "' name='RPMH_ARC_DRV0_RM5_SHADOW_STATUS'/>"
WRITE #1 "        <register address='0xb600068' value='0x" DATA.LONG(A:0xb600068) "' name='RPMH_ARC_DRV0_RM6_SHADOW_STATUS'/>"
WRITE #1 "        <register address='0xb610008' value='0x" DATA.LONG(A:0xb610008) "' name='RPMH_ARC_DRV1_RM0_SHADOW_STATUS'/>"
WRITE #1 "        <register address='0xb610018' value='0x" DATA.LONG(A:0xb610018) "' name='RPMH_ARC_DRV1_RM1_SHADOW_STATUS'/>"
WRITE #1 "        <register address='0xb610028' value='0x" DATA.LONG(A:0xb610028) "' name='RPMH_ARC_DRV1_RM2_SHADOW_STATUS'/>"
WRITE #1 "        <register address='0xb610038' value='0x" DATA.LONG(A:0xb610038) "' name='RPMH_ARC_DRV1_RM3_SHADOW_STATUS'/>"
WRITE #1 "        <register address='0xb610048' value='0x" DATA.LONG(A:0xb610048) "' name='RPMH_ARC_DRV1_RM4_SHADOW_STATUS'/>"
WRITE #1 "        <register address='0xb610058' value='0x" DATA.LONG(A:0xb610058) "' name='RPMH_ARC_DRV1_RM5_SHADOW_STATUS'/>"
WRITE #1 "        <register address='0xb610068' value='0x" DATA.LONG(A:0xb610068) "' name='RPMH_ARC_DRV1_RM6_SHADOW_STATUS'/>"
WRITE #1 "        <register address='0xb620008' value='0x" DATA.LONG(A:0xb620008) "' name='RPMH_ARC_DRV2_RM0_SHADOW_STATUS'/>"
WRITE #1 "        <register address='0xb620018' value='0x" DATA.LONG(A:0xb620018) "' name='RPMH_ARC_DRV2_RM1_SHADOW_STATUS'/>"
WRITE #1 "        <register address='0xb620028' value='0x" DATA.LONG(A:0xb620028) "' name='RPMH_ARC_DRV2_RM2_SHADOW_STATUS'/>"
WRITE #1 "        <register address='0xb620038' value='0x" DATA.LONG(A:0xb620038) "' name='RPMH_ARC_DRV2_RM3_SHADOW_STATUS'/>"
WRITE #1 "        <register address='0xb620048' value='0x" DATA.LONG(A:0xb620048) "' name='RPMH_ARC_DRV2_RM4_SHADOW_STATUS'/>"
WRITE #1 "        <register address='0xb620058' value='0x" DATA.LONG(A:0xb620058) "' name='RPMH_ARC_DRV2_RM5_SHADOW_STATUS'/>"
WRITE #1 "        <register address='0xb620068' value='0x" DATA.LONG(A:0xb620068) "' name='RPMH_ARC_DRV2_RM6_SHADOW_STATUS'/>"
WRITE #1 "        <register address='0xb630008' value='0x" DATA.LONG(A:0xb630008) "' name='RPMH_ARC_DRV3_RM0_SHADOW_STATUS'/>"
WRITE #1 "        <register address='0xb630018' value='0x" DATA.LONG(A:0xb630018) "' name='RPMH_ARC_DRV3_RM1_SHADOW_STATUS'/>"
WRITE #1 "        <register address='0xb630028' value='0x" DATA.LONG(A:0xb630028) "' name='RPMH_ARC_DRV3_RM2_SHADOW_STATUS'/>"
WRITE #1 "        <register address='0xb630038' value='0x" DATA.LONG(A:0xb630038) "' name='RPMH_ARC_DRV3_RM3_SHADOW_STATUS'/>"
WRITE #1 "        <register address='0xb630048' value='0x" DATA.LONG(A:0xb630048) "' name='RPMH_ARC_DRV3_RM4_SHADOW_STATUS'/>"
WRITE #1 "        <register address='0xb630058' value='0x" DATA.LONG(A:0xb630058) "' name='RPMH_ARC_DRV3_RM5_SHADOW_STATUS'/>"
WRITE #1 "        <register address='0xb630068' value='0x" DATA.LONG(A:0xb630068) "' name='RPMH_ARC_DRV3_RM6_SHADOW_STATUS'/>"
WRITE #1 "        <register address='0xb640008' value='0x" DATA.LONG(A:0xb640008) "' name='RPMH_ARC_DRV4_RM0_SHADOW_STATUS'/>"
WRITE #1 "        <register address='0xb640018' value='0x" DATA.LONG(A:0xb640018) "' name='RPMH_ARC_DRV4_RM1_SHADOW_STATUS'/>"
WRITE #1 "        <register address='0xb640028' value='0x" DATA.LONG(A:0xb640028) "' name='RPMH_ARC_DRV4_RM2_SHADOW_STATUS'/>"
WRITE #1 "        <register address='0xb640038' value='0x" DATA.LONG(A:0xb640038) "' name='RPMH_ARC_DRV4_RM3_SHADOW_STATUS'/>"
WRITE #1 "        <register address='0xb640048' value='0x" DATA.LONG(A:0xb640048) "' name='RPMH_ARC_DRV4_RM4_SHADOW_STATUS'/>"
WRITE #1 "        <register address='0xb640058' value='0x" DATA.LONG(A:0xb640058) "' name='RPMH_ARC_DRV4_RM5_SHADOW_STATUS'/>"
WRITE #1 "        <register address='0xb640068' value='0x" DATA.LONG(A:0xb640068) "' name='RPMH_ARC_DRV4_RM6_SHADOW_STATUS'/>"
WRITE #1 "        <register address='0xb650008' value='0x" DATA.LONG(A:0xb650008) "' name='RPMH_ARC_DRV5_RM0_SHADOW_STATUS'/>"
WRITE #1 "        <register address='0xb650018' value='0x" DATA.LONG(A:0xb650018) "' name='RPMH_ARC_DRV5_RM1_SHADOW_STATUS'/>"
WRITE #1 "        <register address='0xb650028' value='0x" DATA.LONG(A:0xb650028) "' name='RPMH_ARC_DRV5_RM2_SHADOW_STATUS'/>"
WRITE #1 "        <register address='0xb650038' value='0x" DATA.LONG(A:0xb650038) "' name='RPMH_ARC_DRV5_RM3_SHADOW_STATUS'/>"
WRITE #1 "        <register address='0xb650048' value='0x" DATA.LONG(A:0xb650048) "' name='RPMH_ARC_DRV5_RM4_SHADOW_STATUS'/>"
WRITE #1 "        <register address='0xb650058' value='0x" DATA.LONG(A:0xb650058) "' name='RPMH_ARC_DRV5_RM5_SHADOW_STATUS'/>"
WRITE #1 "        <register address='0xb650068' value='0x" DATA.LONG(A:0xb650068) "' name='RPMH_ARC_DRV5_RM6_SHADOW_STATUS'/>"
WRITE #1 "        <register address='0xb7e0008' value='0x" DATA.LONG(A:0xb7e0008) "' name='RPMH_ARC_BCM_DRV0_RM0_SHADOW_STATUS'/>"
WRITE #1 "        <register address='0xb7e0018' value='0x" DATA.LONG(A:0xb7e0018) "' name='RPMH_ARC_BCM_DRV0_RM1_SHADOW_STATUS'/>"
WRITE #1 "        <register address='0xb7e0028' value='0x" DATA.LONG(A:0xb7e0028) "' name='RPMH_ARC_BCM_DRV0_RM2_SHADOW_STATUS'/>"
WRITE #1 "        <register address='0xb7e0038' value='0x" DATA.LONG(A:0xb7e0038) "' name='RPMH_ARC_BCM_DRV0_RM3_SHADOW_STATUS'/>"
WRITE #1 "        <register address='0xb7e0048' value='0x" DATA.LONG(A:0xb7e0048) "' name='RPMH_ARC_BCM_DRV0_RM4_SHADOW_STATUS'/>"
WRITE #1 "        <register address='0xb7e0058' value='0x" DATA.LONG(A:0xb7e0058) "' name='RPMH_ARC_BCM_DRV0_RM5_SHADOW_STATUS'/>"
WRITE #1 "        <register address='0xb7e0068' value='0x" DATA.LONG(A:0xb7e0068) "' name='RPMH_ARC_BCM_DRV0_RM6_SHADOW_STATUS'/>"
WRITE #1 "        <register address='0xb7e1008' value='0x" DATA.LONG(A:0xb7e1008) "' name='RPMH_ARC_BCM_DRV1_RM0_SHADOW_STATUS'/>"
WRITE #1 "        <register address='0xb7e1018' value='0x" DATA.LONG(A:0xb7e1018) "' name='RPMH_ARC_BCM_DRV1_RM1_SHADOW_STATUS'/>"
WRITE #1 "        <register address='0xb7e1028' value='0x" DATA.LONG(A:0xb7e1028) "' name='RPMH_ARC_BCM_DRV1_RM2_SHADOW_STATUS'/>"
WRITE #1 "        <register address='0xb7e1038' value='0x" DATA.LONG(A:0xb7e1038) "' name='RPMH_ARC_BCM_DRV1_RM3_SHADOW_STATUS'/>"
WRITE #1 "        <register address='0xb7e1048' value='0x" DATA.LONG(A:0xb7e1048) "' name='RPMH_ARC_BCM_DRV1_RM4_SHADOW_STATUS'/>"
WRITE #1 "        <register address='0xb7e1058' value='0x" DATA.LONG(A:0xb7e1058) "' name='RPMH_ARC_BCM_DRV1_RM5_SHADOW_STATUS'/>"
WRITE #1 "        <register address='0xb7e1068' value='0x" DATA.LONG(A:0xb7e1068) "' name='RPMH_ARC_BCM_DRV1_RM6_SHADOW_STATUS'/>"
WRITE #1 "        <register address='0xb7e2008' value='0x" DATA.LONG(A:0xb7e2008) "' name='RPMH_ARC_BCM_DRV2_RM0_SHADOW_STATUS'/>"
WRITE #1 "        <register address='0xb7e2018' value='0x" DATA.LONG(A:0xb7e2018) "' name='RPMH_ARC_BCM_DRV2_RM1_SHADOW_STATUS'/>"
WRITE #1 "        <register address='0xb7e2028' value='0x" DATA.LONG(A:0xb7e2028) "' name='RPMH_ARC_BCM_DRV2_RM2_SHADOW_STATUS'/>"
WRITE #1 "        <register address='0xb7e2038' value='0x" DATA.LONG(A:0xb7e2038) "' name='RPMH_ARC_BCM_DRV2_RM3_SHADOW_STATUS'/>"
WRITE #1 "        <register address='0xb7e2048' value='0x" DATA.LONG(A:0xb7e2048) "' name='RPMH_ARC_BCM_DRV2_RM4_SHADOW_STATUS'/>"
WRITE #1 "        <register address='0xb7e2058' value='0x" DATA.LONG(A:0xb7e2058) "' name='RPMH_ARC_BCM_DRV2_RM5_SHADOW_STATUS'/>"
WRITE #1 "        <register address='0xb7e2068' value='0x" DATA.LONG(A:0xb7e2068) "' name='RPMH_ARC_BCM_DRV2_RM6_SHADOW_STATUS'/>"
WRITE #1 "        <register address='0xb7e3008' value='0x" DATA.LONG(A:0xb7e3008) "' name='RPMH_ARC_BCM_DRV3_RM0_SHADOW_STATUS'/>"
WRITE #1 "        <register address='0xb7e3018' value='0x" DATA.LONG(A:0xb7e3018) "' name='RPMH_ARC_BCM_DRV3_RM1_SHADOW_STATUS'/>"
WRITE #1 "        <register address='0xb7e3028' value='0x" DATA.LONG(A:0xb7e3028) "' name='RPMH_ARC_BCM_DRV3_RM2_SHADOW_STATUS'/>"
WRITE #1 "        <register address='0xb7e3038' value='0x" DATA.LONG(A:0xb7e3038) "' name='RPMH_ARC_BCM_DRV3_RM3_SHADOW_STATUS'/>"
WRITE #1 "        <register address='0xb7e3048' value='0x" DATA.LONG(A:0xb7e3048) "' name='RPMH_ARC_BCM_DRV3_RM4_SHADOW_STATUS'/>"
WRITE #1 "        <register address='0xb7e3058' value='0x" DATA.LONG(A:0xb7e3058) "' name='RPMH_ARC_BCM_DRV3_RM5_SHADOW_STATUS'/>"
WRITE #1 "        <register address='0xb7e3068' value='0x" DATA.LONG(A:0xb7e3068) "' name='RPMH_ARC_BCM_DRV3_RM6_SHADOW_STATUS'/>"
WRITE #1 "        <register address='0xb7e4008' value='0x" DATA.LONG(A:0xb7e4008) "' name='RPMH_ARC_BCM_DRV4_RM0_SHADOW_STATUS'/>"
WRITE #1 "        <register address='0xb7e4018' value='0x" DATA.LONG(A:0xb7e4018) "' name='RPMH_ARC_BCM_DRV4_RM1_SHADOW_STATUS'/>"
WRITE #1 "        <register address='0xb7e4028' value='0x" DATA.LONG(A:0xb7e4028) "' name='RPMH_ARC_BCM_DRV4_RM2_SHADOW_STATUS'/>"
WRITE #1 "        <register address='0xb7e4038' value='0x" DATA.LONG(A:0xb7e4038) "' name='RPMH_ARC_BCM_DRV4_RM3_SHADOW_STATUS'/>"
WRITE #1 "        <register address='0xb7e4048' value='0x" DATA.LONG(A:0xb7e4048) "' name='RPMH_ARC_BCM_DRV4_RM4_SHADOW_STATUS'/>"
WRITE #1 "        <register address='0xb7e4058' value='0x" DATA.LONG(A:0xb7e4058) "' name='RPMH_ARC_BCM_DRV4_RM5_SHADOW_STATUS'/>"
WRITE #1 "        <register address='0xb7e4068' value='0x" DATA.LONG(A:0xb7e4068) "' name='RPMH_ARC_BCM_DRV4_RM6_SHADOW_STATUS'/>"
WRITE #1 "        <register address='0xb7e5008' value='0x" DATA.LONG(A:0xb7e5008) "' name='RPMH_ARC_BCM_DRV5_RM0_SHADOW_STATUS'/>"
WRITE #1 "        <register address='0xb7e5018' value='0x" DATA.LONG(A:0xb7e5018) "' name='RPMH_ARC_BCM_DRV5_RM1_SHADOW_STATUS'/>"
WRITE #1 "        <register address='0xb7e5028' value='0x" DATA.LONG(A:0xb7e5028) "' name='RPMH_ARC_BCM_DRV5_RM2_SHADOW_STATUS'/>"
WRITE #1 "        <register address='0xb7e5038' value='0x" DATA.LONG(A:0xb7e5038) "' name='RPMH_ARC_BCM_DRV5_RM3_SHADOW_STATUS'/>"
WRITE #1 "        <register address='0xb7e5048' value='0x" DATA.LONG(A:0xb7e5048) "' name='RPMH_ARC_BCM_DRV5_RM4_SHADOW_STATUS'/>"
WRITE #1 "        <register address='0xb7e5058' value='0x" DATA.LONG(A:0xb7e5058) "' name='RPMH_ARC_BCM_DRV5_RM5_SHADOW_STATUS'/>"
WRITE #1 "        <register address='0xb7e5068' value='0x" DATA.LONG(A:0xb7e5068) "' name='RPMH_ARC_BCM_DRV5_RM6_SHADOW_STATUS'/>"
WRITE #1 "        <register address='0xb7e6008' value='0x" DATA.LONG(A:0xb7e6008) "' name='RPMH_ARC_BCM_DRV6_RM0_SHADOW_STATUS'/>"
WRITE #1 "        <register address='0xb7e6018' value='0x" DATA.LONG(A:0xb7e6018) "' name='RPMH_ARC_BCM_DRV6_RM1_SHADOW_STATUS'/>"
WRITE #1 "        <register address='0xb7e6028' value='0x" DATA.LONG(A:0xb7e6028) "' name='RPMH_ARC_BCM_DRV6_RM2_SHADOW_STATUS'/>"
WRITE #1 "        <register address='0xb7e6038' value='0x" DATA.LONG(A:0xb7e6038) "' name='RPMH_ARC_BCM_DRV6_RM3_SHADOW_STATUS'/>"
WRITE #1 "        <register address='0xb7e6048' value='0x" DATA.LONG(A:0xb7e6048) "' name='RPMH_ARC_BCM_DRV6_RM4_SHADOW_STATUS'/>"
WRITE #1 "        <register address='0xb7e6058' value='0x" DATA.LONG(A:0xb7e6058) "' name='RPMH_ARC_BCM_DRV6_RM5_SHADOW_STATUS'/>"
WRITE #1 "        <register address='0xb7e6068' value='0x" DATA.LONG(A:0xb7e6068) "' name='RPMH_ARC_BCM_DRV6_RM6_SHADOW_STATUS'/>"
WRITE #1 "        <register address='0xb7e7008' value='0x" DATA.LONG(A:0xb7e7008) "' name='RPMH_ARC_BCM_DRV7_RM0_SHADOW_STATUS'/>"
WRITE #1 "        <register address='0xb7e7018' value='0x" DATA.LONG(A:0xb7e7018) "' name='RPMH_ARC_BCM_DRV7_RM1_SHADOW_STATUS'/>"
WRITE #1 "        <register address='0xb7e7028' value='0x" DATA.LONG(A:0xb7e7028) "' name='RPMH_ARC_BCM_DRV7_RM2_SHADOW_STATUS'/>"
WRITE #1 "        <register address='0xb7e7038' value='0x" DATA.LONG(A:0xb7e7038) "' name='RPMH_ARC_BCM_DRV7_RM3_SHADOW_STATUS'/>"
WRITE #1 "        <register address='0xb7e7048' value='0x" DATA.LONG(A:0xb7e7048) "' name='RPMH_ARC_BCM_DRV7_RM4_SHADOW_STATUS'/>"
WRITE #1 "        <register address='0xb7e7058' value='0x" DATA.LONG(A:0xb7e7058) "' name='RPMH_ARC_BCM_DRV7_RM5_SHADOW_STATUS'/>"
WRITE #1 "        <register address='0xb7e7068' value='0x" DATA.LONG(A:0xb7e7068) "' name='RPMH_ARC_BCM_DRV7_RM6_SHADOW_STATUS'/>"
WRITE #1 "        <register address='0xb7e8008' value='0x" DATA.LONG(A:0xb7e8008) "' name='RPMH_ARC_BCM_DRV8_RM0_SHADOW_STATUS'/>"
WRITE #1 "        <register address='0xb7e8018' value='0x" DATA.LONG(A:0xb7e8018) "' name='RPMH_ARC_BCM_DRV8_RM1_SHADOW_STATUS'/>"
WRITE #1 "        <register address='0xb7e8028' value='0x" DATA.LONG(A:0xb7e8028) "' name='RPMH_ARC_BCM_DRV8_RM2_SHADOW_STATUS'/>"
WRITE #1 "        <register address='0xb7e8038' value='0x" DATA.LONG(A:0xb7e8038) "' name='RPMH_ARC_BCM_DRV8_RM3_SHADOW_STATUS'/>"
WRITE #1 "        <register address='0xb7e8048' value='0x" DATA.LONG(A:0xb7e8048) "' name='RPMH_ARC_BCM_DRV8_RM4_SHADOW_STATUS'/>"
WRITE #1 "        <register address='0xb7e8058' value='0x" DATA.LONG(A:0xb7e8058) "' name='RPMH_ARC_BCM_DRV8_RM5_SHADOW_STATUS'/>"
WRITE #1 "        <register address='0xb7e8068' value='0x" DATA.LONG(A:0xb7e8068) "' name='RPMH_ARC_BCM_DRV8_RM6_SHADOW_STATUS'/>"
WRITE #1 "        <register address='0xb7e9008' value='0x" DATA.LONG(A:0xb7e9008) "' name='RPMH_ARC_BCM_DRV9_RM0_SHADOW_STATUS'/>"
WRITE #1 "        <register address='0xb7e9018' value='0x" DATA.LONG(A:0xb7e9018) "' name='RPMH_ARC_BCM_DRV9_RM1_SHADOW_STATUS'/>"
WRITE #1 "        <register address='0xb7e9028' value='0x" DATA.LONG(A:0xb7e9028) "' name='RPMH_ARC_BCM_DRV9_RM2_SHADOW_STATUS'/>"
WRITE #1 "        <register address='0xb7e9038' value='0x" DATA.LONG(A:0xb7e9038) "' name='RPMH_ARC_BCM_DRV9_RM3_SHADOW_STATUS'/>"
WRITE #1 "        <register address='0xb7e9048' value='0x" DATA.LONG(A:0xb7e9048) "' name='RPMH_ARC_BCM_DRV9_RM4_SHADOW_STATUS'/>"
WRITE #1 "        <register address='0xb7e9058' value='0x" DATA.LONG(A:0xb7e9058) "' name='RPMH_ARC_BCM_DRV9_RM5_SHADOW_STATUS'/>"
WRITE #1 "        <register address='0xb7e9068' value='0x" DATA.LONG(A:0xb7e9068) "' name='RPMH_ARC_BCM_DRV9_RM6_SHADOW_STATUS'/>"
WRITE #1 "        <register address='0xb7ea008' value='0x" DATA.LONG(A:0xb7ea008) "' name='RPMH_ARC_BCM_DRV10_RM0_SHADOW_STATUS'/>"
WRITE #1 "        <register address='0xb7ea018' value='0x" DATA.LONG(A:0xb7ea018) "' name='RPMH_ARC_BCM_DRV10_RM1_SHADOW_STATUS'/>"
WRITE #1 "        <register address='0xb7ea028' value='0x" DATA.LONG(A:0xb7ea028) "' name='RPMH_ARC_BCM_DRV10_RM2_SHADOW_STATUS'/>"
WRITE #1 "        <register address='0xb7ea038' value='0x" DATA.LONG(A:0xb7ea038) "' name='RPMH_ARC_BCM_DRV10_RM3_SHADOW_STATUS'/>"
WRITE #1 "        <register address='0xb7ea048' value='0x" DATA.LONG(A:0xb7ea048) "' name='RPMH_ARC_BCM_DRV10_RM4_SHADOW_STATUS'/>"
WRITE #1 "        <register address='0xb7ea058' value='0x" DATA.LONG(A:0xb7ea058) "' name='RPMH_ARC_BCM_DRV10_RM5_SHADOW_STATUS'/>"
WRITE #1 "        <register address='0xb7ea068' value='0x" DATA.LONG(A:0xb7ea068) "' name='RPMH_ARC_BCM_DRV10_RM6_SHADOW_STATUS'/>"
WRITE #1 "        <register address='0xb7eb008' value='0x" DATA.LONG(A:0xb7eb008) "' name='RPMH_ARC_BCM_DRV11_RM0_SHADOW_STATUS'/>"
WRITE #1 "        <register address='0xb7eb018' value='0x" DATA.LONG(A:0xb7eb018) "' name='RPMH_ARC_BCM_DRV11_RM1_SHADOW_STATUS'/>"
WRITE #1 "        <register address='0xb7eb028' value='0x" DATA.LONG(A:0xb7eb028) "' name='RPMH_ARC_BCM_DRV11_RM2_SHADOW_STATUS'/>"
WRITE #1 "        <register address='0xb7eb038' value='0x" DATA.LONG(A:0xb7eb038) "' name='RPMH_ARC_BCM_DRV11_RM3_SHADOW_STATUS'/>"
WRITE #1 "        <register address='0xb7eb048' value='0x" DATA.LONG(A:0xb7eb048) "' name='RPMH_ARC_BCM_DRV11_RM4_SHADOW_STATUS'/>"
WRITE #1 "        <register address='0xb7eb058' value='0x" DATA.LONG(A:0xb7eb058) "' name='RPMH_ARC_BCM_DRV11_RM5_SHADOW_STATUS'/>"
WRITE #1 "        <register address='0xb7eb068' value='0x" DATA.LONG(A:0xb7eb068) "' name='RPMH_ARC_BCM_DRV11_RM6_SHADOW_STATUS'/>"
WRITE #1 "        <register address='0xb7ec008' value='0x" DATA.LONG(A:0xb7ec008) "' name='RPMH_ARC_BCM_DRV12_RM0_SHADOW_STATUS'/>"
WRITE #1 "        <register address='0xb7ec018' value='0x" DATA.LONG(A:0xb7ec018) "' name='RPMH_ARC_BCM_DRV12_RM1_SHADOW_STATUS'/>"
WRITE #1 "        <register address='0xb7ec028' value='0x" DATA.LONG(A:0xb7ec028) "' name='RPMH_ARC_BCM_DRV12_RM2_SHADOW_STATUS'/>"
WRITE #1 "        <register address='0xb7ec038' value='0x" DATA.LONG(A:0xb7ec038) "' name='RPMH_ARC_BCM_DRV12_RM3_SHADOW_STATUS'/>"
WRITE #1 "        <register address='0xb7ec048' value='0x" DATA.LONG(A:0xb7ec048) "' name='RPMH_ARC_BCM_DRV12_RM4_SHADOW_STATUS'/>"
WRITE #1 "        <register address='0xb7ec058' value='0x" DATA.LONG(A:0xb7ec058) "' name='RPMH_ARC_BCM_DRV12_RM5_SHADOW_STATUS'/>"
WRITE #1 "        <register address='0xb7ec068' value='0x" DATA.LONG(A:0xb7ec068) "' name='RPMH_ARC_BCM_DRV12_RM6_SHADOW_STATUS'/>"
WRITE #1 "        <register address='0xb7ed008' value='0x" DATA.LONG(A:0xb7ed008) "' name='RPMH_ARC_BCM_DRV13_RM0_SHADOW_STATUS'/>"
WRITE #1 "        <register address='0xb7ed018' value='0x" DATA.LONG(A:0xb7ed018) "' name='RPMH_ARC_BCM_DRV13_RM1_SHADOW_STATUS'/>"
WRITE #1 "        <register address='0xb7ed028' value='0x" DATA.LONG(A:0xb7ed028) "' name='RPMH_ARC_BCM_DRV13_RM2_SHADOW_STATUS'/>"
WRITE #1 "        <register address='0xb7ed038' value='0x" DATA.LONG(A:0xb7ed038) "' name='RPMH_ARC_BCM_DRV13_RM3_SHADOW_STATUS'/>"
WRITE #1 "        <register address='0xb7ed048' value='0x" DATA.LONG(A:0xb7ed048) "' name='RPMH_ARC_BCM_DRV13_RM4_SHADOW_STATUS'/>"
WRITE #1 "        <register address='0xb7ed058' value='0x" DATA.LONG(A:0xb7ed058) "' name='RPMH_ARC_BCM_DRV13_RM5_SHADOW_STATUS'/>"
WRITE #1 "        <register address='0xb7ed068' value='0x" DATA.LONG(A:0xb7ed068) "' name='RPMH_ARC_BCM_DRV13_RM6_SHADOW_STATUS'/>"
WRITE #1 "        <register address='0xb7ee008' value='0x" DATA.LONG(A:0xb7ee008) "' name='RPMH_ARC_BCM_DRV14_RM0_SHADOW_STATUS'/>"
WRITE #1 "        <register address='0xb7ee018' value='0x" DATA.LONG(A:0xb7ee018) "' name='RPMH_ARC_BCM_DRV14_RM1_SHADOW_STATUS'/>"
WRITE #1 "        <register address='0xb7ee028' value='0x" DATA.LONG(A:0xb7ee028) "' name='RPMH_ARC_BCM_DRV14_RM2_SHADOW_STATUS'/>"
WRITE #1 "        <register address='0xb7ee038' value='0x" DATA.LONG(A:0xb7ee038) "' name='RPMH_ARC_BCM_DRV14_RM3_SHADOW_STATUS'/>"
WRITE #1 "        <register address='0xb7ee048' value='0x" DATA.LONG(A:0xb7ee048) "' name='RPMH_ARC_BCM_DRV14_RM4_SHADOW_STATUS'/>"
WRITE #1 "        <register address='0xb7ee058' value='0x" DATA.LONG(A:0xb7ee058) "' name='RPMH_ARC_BCM_DRV14_RM5_SHADOW_STATUS'/>"
WRITE #1 "        <register address='0xb7ee068' value='0x" DATA.LONG(A:0xb7ee068) "' name='RPMH_ARC_BCM_DRV14_RM6_SHADOW_STATUS'/>"
WRITE #1 "        <register address='0xb7ef008' value='0x" DATA.LONG(A:0xb7ef008) "' name='RPMH_ARC_BCM_DRV15_RM0_SHADOW_STATUS'/>"
WRITE #1 "        <register address='0xb7ef018' value='0x" DATA.LONG(A:0xb7ef018) "' name='RPMH_ARC_BCM_DRV15_RM1_SHADOW_STATUS'/>"
WRITE #1 "        <register address='0xb7ef028' value='0x" DATA.LONG(A:0xb7ef028) "' name='RPMH_ARC_BCM_DRV15_RM2_SHADOW_STATUS'/>"
WRITE #1 "        <register address='0xb7ef038' value='0x" DATA.LONG(A:0xb7ef038) "' name='RPMH_ARC_BCM_DRV15_RM3_SHADOW_STATUS'/>"
WRITE #1 "        <register address='0xb7ef048' value='0x" DATA.LONG(A:0xb7ef048) "' name='RPMH_ARC_BCM_DRV15_RM4_SHADOW_STATUS'/>"
WRITE #1 "        <register address='0xb7ef058' value='0x" DATA.LONG(A:0xb7ef058) "' name='RPMH_ARC_BCM_DRV15_RM5_SHADOW_STATUS'/>"
WRITE #1 "        <register address='0xb7ef068' value='0x" DATA.LONG(A:0xb7ef068) "' name='RPMH_ARC_BCM_DRV15_RM6_SHADOW_STATUS'/>"
WRITE #1 "        <register address='0xb7f0000' value='0x" DATA.LONG(A:0xb7f0000) "' name='RPMH_ARC_RM0_CTRL'/>"
WRITE #1 "        <register address='0xb7f0004' value='0x" DATA.LONG(A:0xb7f0004) "' name='RPMH_ARC_RM1_CTRL'/>"
WRITE #1 "        <register address='0xb7f0008' value='0x" DATA.LONG(A:0xb7f0008) "' name='RPMH_ARC_RM2_CTRL'/>"
WRITE #1 "        <register address='0xb7f000c' value='0x" DATA.LONG(A:0xb7f000c) "' name='RPMH_ARC_RM3_CTRL'/>"
WRITE #1 "        <register address='0xb7f0010' value='0x" DATA.LONG(A:0xb7f0010) "' name='RPMH_ARC_RM4_CTRL'/>"
WRITE #1 "        <register address='0xb7f0014' value='0x" DATA.LONG(A:0xb7f0014) "' name='RPMH_ARC_RM5_CTRL'/>"
WRITE #1 "        <register address='0xb7f0018' value='0x" DATA.LONG(A:0xb7f0018) "' name='RPMH_ARC_RM6_CTRL'/>"
WRITE #1 "        <register address='0xb7f0040' value='0x" DATA.LONG(A:0xb7f0040) "' name='RPMH_ARC_RM0_AGGR_BLOCK_EN'/>"
WRITE #1 "        <register address='0xb7f0044' value='0x" DATA.LONG(A:0xb7f0044) "' name='RPMH_ARC_RM1_AGGR_BLOCK_EN'/>"
WRITE #1 "        <register address='0xb7f0048' value='0x" DATA.LONG(A:0xb7f0048) "' name='RPMH_ARC_RM2_AGGR_BLOCK_EN'/>"
WRITE #1 "        <register address='0xb7f004c' value='0x" DATA.LONG(A:0xb7f004c) "' name='RPMH_ARC_RM3_AGGR_BLOCK_EN'/>"
WRITE #1 "        <register address='0xb7f0050' value='0x" DATA.LONG(A:0xb7f0050) "' name='RPMH_ARC_RM4_AGGR_BLOCK_EN'/>"
WRITE #1 "        <register address='0xb7f0054' value='0x" DATA.LONG(A:0xb7f0054) "' name='RPMH_ARC_RM5_AGGR_BLOCK_EN'/>"
WRITE #1 "        <register address='0xb7f0058' value='0x" DATA.LONG(A:0xb7f0058) "' name='RPMH_ARC_RM6_AGGR_BLOCK_EN'/>"
WRITE #1 "        <register address='0xb7f0080' value='0x" DATA.LONG(A:0xb7f0080) "' name='RPMH_ARC_RM0_AGGR_UNBLOCK'/>"
WRITE #1 "        <register address='0xb7f0084' value='0x" DATA.LONG(A:0xb7f0084) "' name='RPMH_ARC_RM1_AGGR_UNBLOCK'/>"
WRITE #1 "        <register address='0xb7f0088' value='0x" DATA.LONG(A:0xb7f0088) "' name='RPMH_ARC_RM2_AGGR_UNBLOCK'/>"
WRITE #1 "        <register address='0xb7f008c' value='0x" DATA.LONG(A:0xb7f008c) "' name='RPMH_ARC_RM3_AGGR_UNBLOCK'/>"
WRITE #1 "        <register address='0xb7f0090' value='0x" DATA.LONG(A:0xb7f0090) "' name='RPMH_ARC_RM4_AGGR_UNBLOCK'/>"
WRITE #1 "        <register address='0xb7f0094' value='0x" DATA.LONG(A:0xb7f0094) "' name='RPMH_ARC_RM5_AGGR_UNBLOCK'/>"
WRITE #1 "        <register address='0xb7f0098' value='0x" DATA.LONG(A:0xb7f0098) "' name='RPMH_ARC_RM6_AGGR_UNBLOCK'/>"
WRITE #1 "        <register address='0xb7f00c0' value='0x" DATA.LONG(A:0xb7f00c0) "' name='RPMH_ARC_RM0_OPERATIONAL_LEVEL'/>"
WRITE #1 "        <register address='0xb7f00c4' value='0x" DATA.LONG(A:0xb7f00c4) "' name='RPMH_ARC_RM1_OPERATIONAL_LEVEL'/>"
WRITE #1 "        <register address='0xb7f00c8' value='0x" DATA.LONG(A:0xb7f00c8) "' name='RPMH_ARC_RM2_OPERATIONAL_LEVEL'/>"
WRITE #1 "        <register address='0xb7f00cc' value='0x" DATA.LONG(A:0xb7f00cc) "' name='RPMH_ARC_RM3_OPERATIONAL_LEVEL'/>"
WRITE #1 "        <register address='0xb7f00d0' value='0x" DATA.LONG(A:0xb7f00d0) "' name='RPMH_ARC_RM4_OPERATIONAL_LEVEL'/>"
WRITE #1 "        <register address='0xb7f00d4' value='0x" DATA.LONG(A:0xb7f00d4) "' name='RPMH_ARC_RM5_OPERATIONAL_LEVEL'/>"
WRITE #1 "        <register address='0xb7f00d8' value='0x" DATA.LONG(A:0xb7f00d8) "' name='RPMH_ARC_RM6_OPERATIONAL_LEVEL'/>"
WRITE #1 "        <register address='0xb7f0100' value='0x" DATA.LONG(A:0xb7f0100) "' name='RPMH_ARC_RM0_MIN_IDLE_TIME_SOLVING_LOW'/>"
WRITE #1 "        <register address='0xb7f0104' value='0x" DATA.LONG(A:0xb7f0104) "' name='RPMH_ARC_RM1_MIN_IDLE_TIME_SOLVING_LOW'/>"
WRITE #1 "        <register address='0xb7f0108' value='0x" DATA.LONG(A:0xb7f0108) "' name='RPMH_ARC_RM2_MIN_IDLE_TIME_SOLVING_LOW'/>"
WRITE #1 "        <register address='0xb7f010c' value='0x" DATA.LONG(A:0xb7f010c) "' name='RPMH_ARC_RM3_MIN_IDLE_TIME_SOLVING_LOW'/>"
WRITE #1 "        <register address='0xb7f0110' value='0x" DATA.LONG(A:0xb7f0110) "' name='RPMH_ARC_RM4_MIN_IDLE_TIME_SOLVING_LOW'/>"
WRITE #1 "        <register address='0xb7f0114' value='0x" DATA.LONG(A:0xb7f0114) "' name='RPMH_ARC_RM5_MIN_IDLE_TIME_SOLVING_LOW'/>"
WRITE #1 "        <register address='0xb7f0118' value='0x" DATA.LONG(A:0xb7f0118) "' name='RPMH_ARC_RM6_MIN_IDLE_TIME_SOLVING_LOW'/>"
WRITE #1 "        <register address='0xb7f0140' value='0x" DATA.LONG(A:0xb7f0140) "' name='RPMH_ARC_RM0_MIN_IDLE_TIME_SOLVING_HIGH'/>"
WRITE #1 "        <register address='0xb7f0144' value='0x" DATA.LONG(A:0xb7f0144) "' name='RPMH_ARC_RM1_MIN_IDLE_TIME_SOLVING_HIGH'/>"
WRITE #1 "        <register address='0xb7f0148' value='0x" DATA.LONG(A:0xb7f0148) "' name='RPMH_ARC_RM2_MIN_IDLE_TIME_SOLVING_HIGH'/>"
WRITE #1 "        <register address='0xb7f014c' value='0x" DATA.LONG(A:0xb7f014c) "' name='RPMH_ARC_RM3_MIN_IDLE_TIME_SOLVING_HIGH'/>"
WRITE #1 "        <register address='0xb7f0150' value='0x" DATA.LONG(A:0xb7f0150) "' name='RPMH_ARC_RM4_MIN_IDLE_TIME_SOLVING_HIGH'/>"
WRITE #1 "        <register address='0xb7f0154' value='0x" DATA.LONG(A:0xb7f0154) "' name='RPMH_ARC_RM5_MIN_IDLE_TIME_SOLVING_HIGH'/>"
WRITE #1 "        <register address='0xb7f0158' value='0x" DATA.LONG(A:0xb7f0158) "' name='RPMH_ARC_RM6_MIN_IDLE_TIME_SOLVING_HIGH'/>"
WRITE #1 "        <register address='0xb7f0180' value='0x" DATA.LONG(A:0xb7f0180) "' name='RPMH_ARC_RM0_WAKEUP_TIMER_STATUS_LOW'/>"
WRITE #1 "        <register address='0xb7f0184' value='0x" DATA.LONG(A:0xb7f0184) "' name='RPMH_ARC_RM1_WAKEUP_TIMER_STATUS_LOW'/>"
WRITE #1 "        <register address='0xb7f0188' value='0x" DATA.LONG(A:0xb7f0188) "' name='RPMH_ARC_RM2_WAKEUP_TIMER_STATUS_LOW'/>"
WRITE #1 "        <register address='0xb7f018c' value='0x" DATA.LONG(A:0xb7f018c) "' name='RPMH_ARC_RM3_WAKEUP_TIMER_STATUS_LOW'/>"
WRITE #1 "        <register address='0xb7f0190' value='0x" DATA.LONG(A:0xb7f0190) "' name='RPMH_ARC_RM4_WAKEUP_TIMER_STATUS_LOW'/>"
WRITE #1 "        <register address='0xb7f0194' value='0x" DATA.LONG(A:0xb7f0194) "' name='RPMH_ARC_RM5_WAKEUP_TIMER_STATUS_LOW'/>"
WRITE #1 "        <register address='0xb7f0198' value='0x" DATA.LONG(A:0xb7f0198) "' name='RPMH_ARC_RM6_WAKEUP_TIMER_STATUS_LOW'/>"
WRITE #1 "        <register address='0xb7f01c0' value='0x" DATA.LONG(A:0xb7f01c0) "' name='RPMH_ARC_RM0_WAKEUP_TIMER_STATUS_HIGH'/>"
WRITE #1 "        <register address='0xb7f01c4' value='0x" DATA.LONG(A:0xb7f01c4) "' name='RPMH_ARC_RM1_WAKEUP_TIMER_STATUS_HIGH'/>"
WRITE #1 "        <register address='0xb7f01c8' value='0x" DATA.LONG(A:0xb7f01c8) "' name='RPMH_ARC_RM2_WAKEUP_TIMER_STATUS_HIGH'/>"
WRITE #1 "        <register address='0xb7f01cc' value='0x" DATA.LONG(A:0xb7f01cc) "' name='RPMH_ARC_RM3_WAKEUP_TIMER_STATUS_HIGH'/>"
WRITE #1 "        <register address='0xb7f01d0' value='0x" DATA.LONG(A:0xb7f01d0) "' name='RPMH_ARC_RM4_WAKEUP_TIMER_STATUS_HIGH'/>"
WRITE #1 "        <register address='0xb7f01d4' value='0x" DATA.LONG(A:0xb7f01d4) "' name='RPMH_ARC_RM5_WAKEUP_TIMER_STATUS_HIGH'/>"
WRITE #1 "        <register address='0xb7f01d8' value='0x" DATA.LONG(A:0xb7f01d8) "' name='RPMH_ARC_RM6_WAKEUP_TIMER_STATUS_HIGH'/>"
WRITE #1 "        <register address='0xb7f2240' value='0x" DATA.LONG(A:0xb7f2240) "' name='RPMH_ARC_RM0_SEQ_UP_BR_EVENT'/>"
WRITE #1 "        <register address='0xb7f2244' value='0x" DATA.LONG(A:0xb7f2244) "' name='RPMH_ARC_RM1_SEQ_UP_BR_EVENT'/>"
WRITE #1 "        <register address='0xb7f2248' value='0x" DATA.LONG(A:0xb7f2248) "' name='RPMH_ARC_RM2_SEQ_UP_BR_EVENT'/>"
WRITE #1 "        <register address='0xb7f224c' value='0x" DATA.LONG(A:0xb7f224c) "' name='RPMH_ARC_RM3_SEQ_UP_BR_EVENT'/>"
WRITE #1 "        <register address='0xb7f2250' value='0x" DATA.LONG(A:0xb7f2250) "' name='RPMH_ARC_RM4_SEQ_UP_BR_EVENT'/>"
WRITE #1 "        <register address='0xb7f2254' value='0x" DATA.LONG(A:0xb7f2254) "' name='RPMH_ARC_RM5_SEQ_UP_BR_EVENT'/>"
WRITE #1 "        <register address='0xb7f2258' value='0x" DATA.LONG(A:0xb7f2258) "' name='RPMH_ARC_RM6_SEQ_UP_BR_EVENT'/>"
WRITE #1 "        <register address='0xb7f22c0' value='0x" DATA.LONG(A:0xb7f22c0) "' name='RPMH_ARC_RM0_SEQ_DOWN_BR_EVENT'/>"
WRITE #1 "        <register address='0xb7f22c4' value='0x" DATA.LONG(A:0xb7f22c4) "' name='RPMH_ARC_RM1_SEQ_DOWN_BR_EVENT'/>"
WRITE #1 "        <register address='0xb7f22c8' value='0x" DATA.LONG(A:0xb7f22c8) "' name='RPMH_ARC_RM2_SEQ_DOWN_BR_EVENT'/>"
WRITE #1 "        <register address='0xb7f22cc' value='0x" DATA.LONG(A:0xb7f22cc) "' name='RPMH_ARC_RM3_SEQ_DOWN_BR_EVENT'/>"
WRITE #1 "        <register address='0xb7f22d0' value='0x" DATA.LONG(A:0xb7f22d0) "' name='RPMH_ARC_RM4_SEQ_DOWN_BR_EVENT'/>"
WRITE #1 "        <register address='0xb7f22d4' value='0x" DATA.LONG(A:0xb7f22d4) "' name='RPMH_ARC_RM5_SEQ_DOWN_BR_EVENT'/>"
WRITE #1 "        <register address='0xb7f22d8' value='0x" DATA.LONG(A:0xb7f22d8) "' name='RPMH_ARC_RM6_SEQ_DOWN_BR_EVENT'/>"
WRITE #1 "        <register address='0xb7f2340' value='0x" DATA.LONG(A:0xb7f2340) "' name='RPMH_ARC_RM0_SEQ_SW_CONF_EVENT'/>"
WRITE #1 "        <register address='0xb7f2344' value='0x" DATA.LONG(A:0xb7f2344) "' name='RPMH_ARC_RM1_SEQ_SW_CONF_EVENT'/>"
WRITE #1 "        <register address='0xb7f2348' value='0x" DATA.LONG(A:0xb7f2348) "' name='RPMH_ARC_RM2_SEQ_SW_CONF_EVENT'/>"
WRITE #1 "        <register address='0xb7f234c' value='0x" DATA.LONG(A:0xb7f234c) "' name='RPMH_ARC_RM3_SEQ_SW_CONF_EVENT'/>"
WRITE #1 "        <register address='0xb7f2350' value='0x" DATA.LONG(A:0xb7f2350) "' name='RPMH_ARC_RM4_SEQ_SW_CONF_EVENT'/>"
WRITE #1 "        <register address='0xb7f2354' value='0x" DATA.LONG(A:0xb7f2354) "' name='RPMH_ARC_RM5_SEQ_SW_CONF_EVENT'/>"
WRITE #1 "        <register address='0xb7f2358' value='0x" DATA.LONG(A:0xb7f2358) "' name='RPMH_ARC_RM6_SEQ_SW_CONF_EVENT'/>"
WRITE #1 "        <register address='0xb7f2440' value='0x" DATA.LONG(A:0xb7f2440) "' name='RPMH_ARC_RM0_SEQ_UP_START_ADDR'/>"
WRITE #1 "        <register address='0xb7f2480' value='0x" DATA.LONG(A:0xb7f2480) "' name='RPMH_ARC_RM1_SEQ_UP_START_ADDR'/>"
WRITE #1 "        <register address='0xb7f24c0' value='0x" DATA.LONG(A:0xb7f24c0) "' name='RPMH_ARC_RM2_SEQ_UP_START_ADDR'/>"
WRITE #1 "        <register address='0xb7f2500' value='0x" DATA.LONG(A:0xb7f2500) "' name='RPMH_ARC_RM3_SEQ_UP_START_ADDR'/>"
WRITE #1 "        <register address='0xb7f2540' value='0x" DATA.LONG(A:0xb7f2540) "' name='RPMH_ARC_RM4_SEQ_UP_START_ADDR'/>"
WRITE #1 "        <register address='0xb7f2580' value='0x" DATA.LONG(A:0xb7f2580) "' name='RPMH_ARC_RM5_SEQ_UP_START_ADDR'/>"
WRITE #1 "        <register address='0xb7f25c0' value='0x" DATA.LONG(A:0xb7f25c0) "' name='RPMH_ARC_RM6_SEQ_UP_START_ADDR'/>"
WRITE #1 "        <register address='0xb7f2700' value='0x" DATA.LONG(A:0xb7f2700) "' name='RPMH_ARC_RM0_SEQ_DOWN_START_ADDR'/>"
WRITE #1 "        <register address='0xb7f2740' value='0x" DATA.LONG(A:0xb7f2740) "' name='RPMH_ARC_RM1_SEQ_DOWN_START_ADDR'/>"
WRITE #1 "        <register address='0xb7f2780' value='0x" DATA.LONG(A:0xb7f2780) "' name='RPMH_ARC_RM2_SEQ_DOWN_START_ADDR'/>"
WRITE #1 "        <register address='0xb7f27c0' value='0x" DATA.LONG(A:0xb7f27c0) "' name='RPMH_ARC_RM3_SEQ_DOWN_START_ADDR'/>"
WRITE #1 "        <register address='0xb7f2800' value='0x" DATA.LONG(A:0xb7f2800) "' name='RPMH_ARC_RM4_SEQ_DOWN_START_ADDR'/>"
WRITE #1 "        <register address='0xb7f2840' value='0x" DATA.LONG(A:0xb7f2840) "' name='RPMH_ARC_RM5_SEQ_DOWN_START_ADDR'/>"
WRITE #1 "        <register address='0xb7f2880' value='0x" DATA.LONG(A:0xb7f2880) "' name='RPMH_ARC_RM6_SEQ_DOWN_START_ADDR'/>"
WRITE #1 "        <register address='0xb7f2a00' value='0x" DATA.LONG(A:0xb7f2a00) "' name='RPMH_ARC_RM0_SEQ_DELAY0'/>"
WRITE #1 "        <register address='0xb7f2a04' value='0x" DATA.LONG(A:0xb7f2a04) "' name='RPMH_ARC_RM0_SEQ_DELAY1'/>"
WRITE #1 "        <register address='0xb7f2a08' value='0x" DATA.LONG(A:0xb7f2a08) "' name='RPMH_ARC_RM0_SEQ_DELAY2'/>"
WRITE #1 "        <register address='0xb7f2a0c' value='0x" DATA.LONG(A:0xb7f2a0c) "' name='RPMH_ARC_RM0_SEQ_DELAY3'/>"
WRITE #1 "        <register address='0xb7f2a40' value='0x" DATA.LONG(A:0xb7f2a40) "' name='RPMH_ARC_RM1_SEQ_DELAY0'/>"
WRITE #1 "        <register address='0xb7f2a44' value='0x" DATA.LONG(A:0xb7f2a44) "' name='RPMH_ARC_RM1_SEQ_DELAY1'/>"
WRITE #1 "        <register address='0xb7f2a48' value='0x" DATA.LONG(A:0xb7f2a48) "' name='RPMH_ARC_RM1_SEQ_DELAY2'/>"
WRITE #1 "        <register address='0xb7f2a4c' value='0x" DATA.LONG(A:0xb7f2a4c) "' name='RPMH_ARC_RM1_SEQ_DELAY3'/>"
WRITE #1 "        <register address='0xb7f2a80' value='0x" DATA.LONG(A:0xb7f2a80) "' name='RPMH_ARC_RM2_SEQ_DELAY0'/>"
WRITE #1 "        <register address='0xb7f2a84' value='0x" DATA.LONG(A:0xb7f2a84) "' name='RPMH_ARC_RM2_SEQ_DELAY1'/>"
WRITE #1 "        <register address='0xb7f2a88' value='0x" DATA.LONG(A:0xb7f2a88) "' name='RPMH_ARC_RM2_SEQ_DELAY2'/>"
WRITE #1 "        <register address='0xb7f2a8c' value='0x" DATA.LONG(A:0xb7f2a8c) "' name='RPMH_ARC_RM2_SEQ_DELAY3'/>"
WRITE #1 "        <register address='0xb7f2ac0' value='0x" DATA.LONG(A:0xb7f2ac0) "' name='RPMH_ARC_RM3_SEQ_DELAY0'/>"
WRITE #1 "        <register address='0xb7f2ac4' value='0x" DATA.LONG(A:0xb7f2ac4) "' name='RPMH_ARC_RM3_SEQ_DELAY1'/>"
WRITE #1 "        <register address='0xb7f2ac8' value='0x" DATA.LONG(A:0xb7f2ac8) "' name='RPMH_ARC_RM3_SEQ_DELAY2'/>"
WRITE #1 "        <register address='0xb7f2acc' value='0x" DATA.LONG(A:0xb7f2acc) "' name='RPMH_ARC_RM3_SEQ_DELAY3'/>"
WRITE #1 "        <register address='0xb7f2b00' value='0x" DATA.LONG(A:0xb7f2b00) "' name='RPMH_ARC_RM4_SEQ_DELAY0'/>"
WRITE #1 "        <register address='0xb7f2b04' value='0x" DATA.LONG(A:0xb7f2b04) "' name='RPMH_ARC_RM4_SEQ_DELAY1'/>"
WRITE #1 "        <register address='0xb7f2b08' value='0x" DATA.LONG(A:0xb7f2b08) "' name='RPMH_ARC_RM4_SEQ_DELAY2'/>"
WRITE #1 "        <register address='0xb7f2b0c' value='0x" DATA.LONG(A:0xb7f2b0c) "' name='RPMH_ARC_RM4_SEQ_DELAY3'/>"
WRITE #1 "        <register address='0xb7f2b40' value='0x" DATA.LONG(A:0xb7f2b40) "' name='RPMH_ARC_RM5_SEQ_DELAY0'/>"
WRITE #1 "        <register address='0xb7f2b44' value='0x" DATA.LONG(A:0xb7f2b44) "' name='RPMH_ARC_RM5_SEQ_DELAY1'/>"
WRITE #1 "        <register address='0xb7f2b48' value='0x" DATA.LONG(A:0xb7f2b48) "' name='RPMH_ARC_RM5_SEQ_DELAY2'/>"
WRITE #1 "        <register address='0xb7f2b4c' value='0x" DATA.LONG(A:0xb7f2b4c) "' name='RPMH_ARC_RM5_SEQ_DELAY3'/>"
WRITE #1 "        <register address='0xb7f2b80' value='0x" DATA.LONG(A:0xb7f2b80) "' name='RPMH_ARC_RM6_SEQ_DELAY0'/>"
WRITE #1 "        <register address='0xb7f2b84' value='0x" DATA.LONG(A:0xb7f2b84) "' name='RPMH_ARC_RM6_SEQ_DELAY1'/>"
WRITE #1 "        <register address='0xb7f2b88' value='0x" DATA.LONG(A:0xb7f2b88) "' name='RPMH_ARC_RM6_SEQ_DELAY2'/>"
WRITE #1 "        <register address='0xb7f2b8c' value='0x" DATA.LONG(A:0xb7f2b8c) "' name='RPMH_ARC_RM6_SEQ_DELAY3'/>"
WRITE #1 "        <register address='0xb7f3a00' value='0x" DATA.LONG(A:0xb7f3a00) "' name='RPMH_ARC_RM0_SOLVER_TABLE_MODE0'/>"
WRITE #1 "        <register address='0xb7f3a04' value='0x" DATA.LONG(A:0xb7f3a04) "' name='RPMH_ARC_RM0_SOLVER_TABLE_MODE1'/>"
WRITE #1 "        <register address='0xb7f3a08' value='0x" DATA.LONG(A:0xb7f3a08) "' name='RPMH_ARC_RM0_SOLVER_TABLE_MODE2'/>"
WRITE #1 "        <register address='0xb7f3a0c' value='0x" DATA.LONG(A:0xb7f3a0c) "' name='RPMH_ARC_RM0_SOLVER_TABLE_MODE3'/>"
WRITE #1 "        <register address='0xb7f3a10' value='0x" DATA.LONG(A:0xb7f3a10) "' name='RPMH_ARC_RM0_SOLVER_TABLE_MODE4'/>"
WRITE #1 "        <register address='0xb7f3a14' value='0x" DATA.LONG(A:0xb7f3a14) "' name='RPMH_ARC_RM0_SOLVER_TABLE_MODE5'/>"
WRITE #1 "        <register address='0xb7f3a40' value='0x" DATA.LONG(A:0xb7f3a40) "' name='RPMH_ARC_RM1_SOLVER_TABLE_MODE0'/>"
WRITE #1 "        <register address='0xb7f3a44' value='0x" DATA.LONG(A:0xb7f3a44) "' name='RPMH_ARC_RM1_SOLVER_TABLE_MODE1'/>"
WRITE #1 "        <register address='0xb7f3a48' value='0x" DATA.LONG(A:0xb7f3a48) "' name='RPMH_ARC_RM1_SOLVER_TABLE_MODE2'/>"
WRITE #1 "        <register address='0xb7f3a4c' value='0x" DATA.LONG(A:0xb7f3a4c) "' name='RPMH_ARC_RM1_SOLVER_TABLE_MODE3'/>"
WRITE #1 "        <register address='0xb7f3a50' value='0x" DATA.LONG(A:0xb7f3a50) "' name='RPMH_ARC_RM1_SOLVER_TABLE_MODE4'/>"
WRITE #1 "        <register address='0xb7f3a54' value='0x" DATA.LONG(A:0xb7f3a54) "' name='RPMH_ARC_RM1_SOLVER_TABLE_MODE5'/>"
WRITE #1 "        <register address='0xb7f3a80' value='0x" DATA.LONG(A:0xb7f3a80) "' name='RPMH_ARC_RM2_SOLVER_TABLE_MODE0'/>"
WRITE #1 "        <register address='0xb7f3a84' value='0x" DATA.LONG(A:0xb7f3a84) "' name='RPMH_ARC_RM2_SOLVER_TABLE_MODE1'/>"
WRITE #1 "        <register address='0xb7f3a88' value='0x" DATA.LONG(A:0xb7f3a88) "' name='RPMH_ARC_RM2_SOLVER_TABLE_MODE2'/>"
WRITE #1 "        <register address='0xb7f3a8c' value='0x" DATA.LONG(A:0xb7f3a8c) "' name='RPMH_ARC_RM2_SOLVER_TABLE_MODE3'/>"
WRITE #1 "        <register address='0xb7f3a90' value='0x" DATA.LONG(A:0xb7f3a90) "' name='RPMH_ARC_RM2_SOLVER_TABLE_MODE4'/>"
WRITE #1 "        <register address='0xb7f3a94' value='0x" DATA.LONG(A:0xb7f3a94) "' name='RPMH_ARC_RM2_SOLVER_TABLE_MODE5'/>"
WRITE #1 "        <register address='0xb7f3ac0' value='0x" DATA.LONG(A:0xb7f3ac0) "' name='RPMH_ARC_RM3_SOLVER_TABLE_MODE0'/>"
WRITE #1 "        <register address='0xb7f3ac4' value='0x" DATA.LONG(A:0xb7f3ac4) "' name='RPMH_ARC_RM3_SOLVER_TABLE_MODE1'/>"
WRITE #1 "        <register address='0xb7f3ac8' value='0x" DATA.LONG(A:0xb7f3ac8) "' name='RPMH_ARC_RM3_SOLVER_TABLE_MODE2'/>"
WRITE #1 "        <register address='0xb7f3acc' value='0x" DATA.LONG(A:0xb7f3acc) "' name='RPMH_ARC_RM3_SOLVER_TABLE_MODE3'/>"
WRITE #1 "        <register address='0xb7f3ad0' value='0x" DATA.LONG(A:0xb7f3ad0) "' name='RPMH_ARC_RM3_SOLVER_TABLE_MODE4'/>"
WRITE #1 "        <register address='0xb7f3ad4' value='0x" DATA.LONG(A:0xb7f3ad4) "' name='RPMH_ARC_RM3_SOLVER_TABLE_MODE5'/>"
WRITE #1 "        <register address='0xb7f3b00' value='0x" DATA.LONG(A:0xb7f3b00) "' name='RPMH_ARC_RM4_SOLVER_TABLE_MODE0'/>"
WRITE #1 "        <register address='0xb7f3b04' value='0x" DATA.LONG(A:0xb7f3b04) "' name='RPMH_ARC_RM4_SOLVER_TABLE_MODE1'/>"
WRITE #1 "        <register address='0xb7f3b08' value='0x" DATA.LONG(A:0xb7f3b08) "' name='RPMH_ARC_RM4_SOLVER_TABLE_MODE2'/>"
WRITE #1 "        <register address='0xb7f3b0c' value='0x" DATA.LONG(A:0xb7f3b0c) "' name='RPMH_ARC_RM4_SOLVER_TABLE_MODE3'/>"
WRITE #1 "        <register address='0xb7f3b10' value='0x" DATA.LONG(A:0xb7f3b10) "' name='RPMH_ARC_RM4_SOLVER_TABLE_MODE4'/>"
WRITE #1 "        <register address='0xb7f3b14' value='0x" DATA.LONG(A:0xb7f3b14) "' name='RPMH_ARC_RM4_SOLVER_TABLE_MODE5'/>"
WRITE #1 "        <register address='0xb7f3b40' value='0x" DATA.LONG(A:0xb7f3b40) "' name='RPMH_ARC_RM5_SOLVER_TABLE_MODE0'/>"
WRITE #1 "        <register address='0xb7f3b44' value='0x" DATA.LONG(A:0xb7f3b44) "' name='RPMH_ARC_RM5_SOLVER_TABLE_MODE1'/>"
WRITE #1 "        <register address='0xb7f3b48' value='0x" DATA.LONG(A:0xb7f3b48) "' name='RPMH_ARC_RM5_SOLVER_TABLE_MODE2'/>"
WRITE #1 "        <register address='0xb7f3b4c' value='0x" DATA.LONG(A:0xb7f3b4c) "' name='RPMH_ARC_RM5_SOLVER_TABLE_MODE3'/>"
WRITE #1 "        <register address='0xb7f3b50' value='0x" DATA.LONG(A:0xb7f3b50) "' name='RPMH_ARC_RM5_SOLVER_TABLE_MODE4'/>"
WRITE #1 "        <register address='0xb7f3b54' value='0x" DATA.LONG(A:0xb7f3b54) "' name='RPMH_ARC_RM5_SOLVER_TABLE_MODE5'/>"
WRITE #1 "        <register address='0xb7f3b80' value='0x" DATA.LONG(A:0xb7f3b80) "' name='RPMH_ARC_RM6_SOLVER_TABLE_MODE0'/>"
WRITE #1 "        <register address='0xb7f3b84' value='0x" DATA.LONG(A:0xb7f3b84) "' name='RPMH_ARC_RM6_SOLVER_TABLE_MODE1'/>"
WRITE #1 "        <register address='0xb7f3b88' value='0x" DATA.LONG(A:0xb7f3b88) "' name='RPMH_ARC_RM6_SOLVER_TABLE_MODE2'/>"
WRITE #1 "        <register address='0xb7f3b8c' value='0x" DATA.LONG(A:0xb7f3b8c) "' name='RPMH_ARC_RM6_SOLVER_TABLE_MODE3'/>"
WRITE #1 "        <register address='0xb7f3b90' value='0x" DATA.LONG(A:0xb7f3b90) "' name='RPMH_ARC_RM6_SOLVER_TABLE_MODE4'/>"
WRITE #1 "        <register address='0xb7f3b94' value='0x" DATA.LONG(A:0xb7f3b94) "' name='RPMH_ARC_RM6_SOLVER_TABLE_MODE5'/>"
WRITE #1 "        <register address='0xb7f4100' value='0x" DATA.LONG(A:0xb7f4100) "' name='RPMH_ARC_RM0_SOLVER_TABLE_MIN_SLEEP_TIME0'/>"
WRITE #1 "        <register address='0xb7f4104' value='0x" DATA.LONG(A:0xb7f4104) "' name='RPMH_ARC_RM0_SOLVER_TABLE_MIN_SLEEP_TIME1'/>"
WRITE #1 "        <register address='0xb7f4108' value='0x" DATA.LONG(A:0xb7f4108) "' name='RPMH_ARC_RM0_SOLVER_TABLE_MIN_SLEEP_TIME2'/>"
WRITE #1 "        <register address='0xb7f410c' value='0x" DATA.LONG(A:0xb7f410c) "' name='RPMH_ARC_RM0_SOLVER_TABLE_MIN_SLEEP_TIME3'/>"
WRITE #1 "        <register address='0xb7f4110' value='0x" DATA.LONG(A:0xb7f4110) "' name='RPMH_ARC_RM0_SOLVER_TABLE_MIN_SLEEP_TIME4'/>"
WRITE #1 "        <register address='0xb7f4114' value='0x" DATA.LONG(A:0xb7f4114) "' name='RPMH_ARC_RM0_SOLVER_TABLE_MIN_SLEEP_TIME5'/>"
WRITE #1 "        <register address='0xb7f4140' value='0x" DATA.LONG(A:0xb7f4140) "' name='RPMH_ARC_RM1_SOLVER_TABLE_MIN_SLEEP_TIME0'/>"
WRITE #1 "        <register address='0xb7f4144' value='0x" DATA.LONG(A:0xb7f4144) "' name='RPMH_ARC_RM1_SOLVER_TABLE_MIN_SLEEP_TIME1'/>"
WRITE #1 "        <register address='0xb7f4148' value='0x" DATA.LONG(A:0xb7f4148) "' name='RPMH_ARC_RM1_SOLVER_TABLE_MIN_SLEEP_TIME2'/>"
WRITE #1 "        <register address='0xb7f414c' value='0x" DATA.LONG(A:0xb7f414c) "' name='RPMH_ARC_RM1_SOLVER_TABLE_MIN_SLEEP_TIME3'/>"
WRITE #1 "        <register address='0xb7f4150' value='0x" DATA.LONG(A:0xb7f4150) "' name='RPMH_ARC_RM1_SOLVER_TABLE_MIN_SLEEP_TIME4'/>"
WRITE #1 "        <register address='0xb7f4154' value='0x" DATA.LONG(A:0xb7f4154) "' name='RPMH_ARC_RM1_SOLVER_TABLE_MIN_SLEEP_TIME5'/>"
WRITE #1 "        <register address='0xb7f4180' value='0x" DATA.LONG(A:0xb7f4180) "' name='RPMH_ARC_RM2_SOLVER_TABLE_MIN_SLEEP_TIME0'/>"
WRITE #1 "        <register address='0xb7f4184' value='0x" DATA.LONG(A:0xb7f4184) "' name='RPMH_ARC_RM2_SOLVER_TABLE_MIN_SLEEP_TIME1'/>"
WRITE #1 "        <register address='0xb7f4188' value='0x" DATA.LONG(A:0xb7f4188) "' name='RPMH_ARC_RM2_SOLVER_TABLE_MIN_SLEEP_TIME2'/>"
WRITE #1 "        <register address='0xb7f418c' value='0x" DATA.LONG(A:0xb7f418c) "' name='RPMH_ARC_RM2_SOLVER_TABLE_MIN_SLEEP_TIME3'/>"
WRITE #1 "        <register address='0xb7f4190' value='0x" DATA.LONG(A:0xb7f4190) "' name='RPMH_ARC_RM2_SOLVER_TABLE_MIN_SLEEP_TIME4'/>"
WRITE #1 "        <register address='0xb7f4194' value='0x" DATA.LONG(A:0xb7f4194) "' name='RPMH_ARC_RM2_SOLVER_TABLE_MIN_SLEEP_TIME5'/>"
WRITE #1 "        <register address='0xb7f41c0' value='0x" DATA.LONG(A:0xb7f41c0) "' name='RPMH_ARC_RM3_SOLVER_TABLE_MIN_SLEEP_TIME0'/>"
WRITE #1 "        <register address='0xb7f41c4' value='0x" DATA.LONG(A:0xb7f41c4) "' name='RPMH_ARC_RM3_SOLVER_TABLE_MIN_SLEEP_TIME1'/>"
WRITE #1 "        <register address='0xb7f41c8' value='0x" DATA.LONG(A:0xb7f41c8) "' name='RPMH_ARC_RM3_SOLVER_TABLE_MIN_SLEEP_TIME2'/>"
WRITE #1 "        <register address='0xb7f41cc' value='0x" DATA.LONG(A:0xb7f41cc) "' name='RPMH_ARC_RM3_SOLVER_TABLE_MIN_SLEEP_TIME3'/>"
WRITE #1 "        <register address='0xb7f41d0' value='0x" DATA.LONG(A:0xb7f41d0) "' name='RPMH_ARC_RM3_SOLVER_TABLE_MIN_SLEEP_TIME4'/>"
WRITE #1 "        <register address='0xb7f41d4' value='0x" DATA.LONG(A:0xb7f41d4) "' name='RPMH_ARC_RM3_SOLVER_TABLE_MIN_SLEEP_TIME5'/>"
WRITE #1 "        <register address='0xb7f4200' value='0x" DATA.LONG(A:0xb7f4200) "' name='RPMH_ARC_RM4_SOLVER_TABLE_MIN_SLEEP_TIME0'/>"
WRITE #1 "        <register address='0xb7f4204' value='0x" DATA.LONG(A:0xb7f4204) "' name='RPMH_ARC_RM4_SOLVER_TABLE_MIN_SLEEP_TIME1'/>"
WRITE #1 "        <register address='0xb7f4208' value='0x" DATA.LONG(A:0xb7f4208) "' name='RPMH_ARC_RM4_SOLVER_TABLE_MIN_SLEEP_TIME2'/>"
WRITE #1 "        <register address='0xb7f420c' value='0x" DATA.LONG(A:0xb7f420c) "' name='RPMH_ARC_RM4_SOLVER_TABLE_MIN_SLEEP_TIME3'/>"
WRITE #1 "        <register address='0xb7f4210' value='0x" DATA.LONG(A:0xb7f4210) "' name='RPMH_ARC_RM4_SOLVER_TABLE_MIN_SLEEP_TIME4'/>"
WRITE #1 "        <register address='0xb7f4214' value='0x" DATA.LONG(A:0xb7f4214) "' name='RPMH_ARC_RM4_SOLVER_TABLE_MIN_SLEEP_TIME5'/>"
WRITE #1 "        <register address='0xb7f4240' value='0x" DATA.LONG(A:0xb7f4240) "' name='RPMH_ARC_RM5_SOLVER_TABLE_MIN_SLEEP_TIME0'/>"
WRITE #1 "        <register address='0xb7f4244' value='0x" DATA.LONG(A:0xb7f4244) "' name='RPMH_ARC_RM5_SOLVER_TABLE_MIN_SLEEP_TIME1'/>"
WRITE #1 "        <register address='0xb7f4248' value='0x" DATA.LONG(A:0xb7f4248) "' name='RPMH_ARC_RM5_SOLVER_TABLE_MIN_SLEEP_TIME2'/>"
WRITE #1 "        <register address='0xb7f424c' value='0x" DATA.LONG(A:0xb7f424c) "' name='RPMH_ARC_RM5_SOLVER_TABLE_MIN_SLEEP_TIME3'/>"
WRITE #1 "        <register address='0xb7f4250' value='0x" DATA.LONG(A:0xb7f4250) "' name='RPMH_ARC_RM5_SOLVER_TABLE_MIN_SLEEP_TIME4'/>"
WRITE #1 "        <register address='0xb7f4254' value='0x" DATA.LONG(A:0xb7f4254) "' name='RPMH_ARC_RM5_SOLVER_TABLE_MIN_SLEEP_TIME5'/>"
WRITE #1 "        <register address='0xb7f4280' value='0x" DATA.LONG(A:0xb7f4280) "' name='RPMH_ARC_RM6_SOLVER_TABLE_MIN_SLEEP_TIME0'/>"
WRITE #1 "        <register address='0xb7f4284' value='0x" DATA.LONG(A:0xb7f4284) "' name='RPMH_ARC_RM6_SOLVER_TABLE_MIN_SLEEP_TIME1'/>"
WRITE #1 "        <register address='0xb7f4288' value='0x" DATA.LONG(A:0xb7f4288) "' name='RPMH_ARC_RM6_SOLVER_TABLE_MIN_SLEEP_TIME2'/>"
WRITE #1 "        <register address='0xb7f428c' value='0x" DATA.LONG(A:0xb7f428c) "' name='RPMH_ARC_RM6_SOLVER_TABLE_MIN_SLEEP_TIME3'/>"
WRITE #1 "        <register address='0xb7f4290' value='0x" DATA.LONG(A:0xb7f4290) "' name='RPMH_ARC_RM6_SOLVER_TABLE_MIN_SLEEP_TIME4'/>"
WRITE #1 "        <register address='0xb7f4294' value='0x" DATA.LONG(A:0xb7f4294) "' name='RPMH_ARC_RM6_SOLVER_TABLE_MIN_SLEEP_TIME5'/>"
WRITE #1 "        <register address='0xb7f4500' value='0x" DATA.LONG(A:0xb7f4500) "' name='RPMH_ARC_RM0_SEQUENCER_STATUS_CSR'/>"
WRITE #1 "        <register address='0xb7f4540' value='0x" DATA.LONG(A:0xb7f4540) "' name='RPMH_ARC_RM1_SEQUENCER_STATUS_CSR'/>"
WRITE #1 "        <register address='0xb7f4580' value='0x" DATA.LONG(A:0xb7f4580) "' name='RPMH_ARC_RM2_SEQUENCER_STATUS_CSR'/>"
WRITE #1 "        <register address='0xb7f45c0' value='0x" DATA.LONG(A:0xb7f45c0) "' name='RPMH_ARC_RM3_SEQUENCER_STATUS_CSR'/>"
WRITE #1 "        <register address='0xb7f4600' value='0x" DATA.LONG(A:0xb7f4600) "' name='RPMH_ARC_RM4_SEQUENCER_STATUS_CSR'/>"
WRITE #1 "        <register address='0xb7f4640' value='0x" DATA.LONG(A:0xb7f4640) "' name='RPMH_ARC_RM5_SEQUENCER_STATUS_CSR'/>"
WRITE #1 "        <register address='0xb7f4680' value='0x" DATA.LONG(A:0xb7f4680) "' name='RPMH_ARC_RM6_SEQUENCER_STATUS_CSR'/>"
WRITE #1 "        <register address='0xb7f5000' value='0x" DATA.LONG(A:0xb7f5000) "' name='RPMH_ARC_RM0_ALLOWED_THERMAL_OL_MASK'/>"
WRITE #1 "        <register address='0xb7f5040' value='0x" DATA.LONG(A:0xb7f5040) "' name='RPMH_ARC_RM1_ALLOWED_THERMAL_OL_MASK'/>"
WRITE #1 "        <register address='0xb7f5080' value='0x" DATA.LONG(A:0xb7f5080) "' name='RPMH_ARC_RM2_ALLOWED_THERMAL_OL_MASK'/>"
WRITE #1 "        <register address='0xb7f50c0' value='0x" DATA.LONG(A:0xb7f50c0) "' name='RPMH_ARC_RM3_ALLOWED_THERMAL_OL_MASK'/>"
WRITE #1 "        <register address='0xb7f5100' value='0x" DATA.LONG(A:0xb7f5100) "' name='RPMH_ARC_RM4_ALLOWED_THERMAL_OL_MASK'/>"
WRITE #1 "        <register address='0xb7f5140' value='0x" DATA.LONG(A:0xb7f5140) "' name='RPMH_ARC_RM5_ALLOWED_THERMAL_OL_MASK'/>"
WRITE #1 "        <register address='0xb7f5180' value='0x" DATA.LONG(A:0xb7f5180) "' name='RPMH_ARC_RM6_ALLOWED_THERMAL_OL_MASK'/>"
WRITE #1 "        <register address='0xb7f5004' value='0x" DATA.LONG(A:0xb7f5004) "' name='RPMH_ARC_RM0_ALLOWED_NORMAL_OL_MASK'/>"
WRITE #1 "        <register address='0xb7f5044' value='0x" DATA.LONG(A:0xb7f5044) "' name='RPMH_ARC_RM1_ALLOWED_NORMAL_OL_MASK'/>"
WRITE #1 "        <register address='0xb7f5084' value='0x" DATA.LONG(A:0xb7f5084) "' name='RPMH_ARC_RM2_ALLOWED_NORMAL_OL_MASK'/>"
WRITE #1 "        <register address='0xb7f50c4' value='0x" DATA.LONG(A:0xb7f50c4) "' name='RPMH_ARC_RM3_ALLOWED_NORMAL_OL_MASK'/>"
WRITE #1 "        <register address='0xb7f5104' value='0x" DATA.LONG(A:0xb7f5104) "' name='RPMH_ARC_RM4_ALLOWED_NORMAL_OL_MASK'/>"
WRITE #1 "        <register address='0xb7f5144' value='0x" DATA.LONG(A:0xb7f5144) "' name='RPMH_ARC_RM5_ALLOWED_NORMAL_OL_MASK'/>"
WRITE #1 "        <register address='0xb7f5184' value='0x" DATA.LONG(A:0xb7f5184) "' name='RPMH_ARC_RM6_ALLOWED_NORMAL_OL_MASK'/>"
WRITE #1 "        <register address='0xb7f5008' value='0x" DATA.LONG(A:0xb7f5008) "' name='RPMH_ARC_RM0_ALLOWED_OL_MODE'/>"
WRITE #1 "        <register address='0xb7f5048' value='0x" DATA.LONG(A:0xb7f5048) "' name='RPMH_ARC_RM1_ALLOWED_OL_MODE'/>"
WRITE #1 "        <register address='0xb7f5088' value='0x" DATA.LONG(A:0xb7f5088) "' name='RPMH_ARC_RM2_ALLOWED_OL_MODE'/>"
WRITE #1 "        <register address='0xb7f50c8' value='0x" DATA.LONG(A:0xb7f50c8) "' name='RPMH_ARC_RM3_ALLOWED_OL_MODE'/>"
WRITE #1 "        <register address='0xb7f5108' value='0x" DATA.LONG(A:0xb7f5108) "' name='RPMH_ARC_RM4_ALLOWED_OL_MODE'/>"
WRITE #1 "        <register address='0xb7f5148' value='0x" DATA.LONG(A:0xb7f5148) "' name='RPMH_ARC_RM5_ALLOWED_OL_MODE'/>"
WRITE #1 "        <register address='0xb7f5188' value='0x" DATA.LONG(A:0xb7f5188) "' name='RPMH_ARC_RM6_ALLOWED_OL_MODE'/>"
WRITE #1 "        <register address='0xb7f500c' value='0x" DATA.LONG(A:0xb7f500c) "' name='RPMH_ARC_RM0_THERMAL_MODE_SEL'/>"
WRITE #1 "        <register address='0xb7f504c' value='0x" DATA.LONG(A:0xb7f504c) "' name='RPMH_ARC_RM1_THERMAL_MODE_SEL'/>"
WRITE #1 "        <register address='0xb7f508c' value='0x" DATA.LONG(A:0xb7f508c) "' name='RPMH_ARC_RM2_THERMAL_MODE_SEL'/>"
WRITE #1 "        <register address='0xb7f50cc' value='0x" DATA.LONG(A:0xb7f50cc) "' name='RPMH_ARC_RM3_THERMAL_MODE_SEL'/>"
WRITE #1 "        <register address='0xb7f510c' value='0x" DATA.LONG(A:0xb7f510c) "' name='RPMH_ARC_RM4_THERMAL_MODE_SEL'/>"
WRITE #1 "        <register address='0xb7f514c' value='0x" DATA.LONG(A:0xb7f514c) "' name='RPMH_ARC_RM5_THERMAL_MODE_SEL'/>"
WRITE #1 "        <register address='0xb7f518c' value='0x" DATA.LONG(A:0xb7f518c) "' name='RPMH_ARC_RM6_THERMAL_MODE_SEL'/>"
WRITE #1 "        <register address='0xb7f5010' value='0x" DATA.LONG(A:0xb7f5010) "' name='RPMH_ARC_RM0_ADDITIONAL_BACKOFF_TIME'/>"
WRITE #1 "        <register address='0xb7f5050' value='0x" DATA.LONG(A:0xb7f5050) "' name='RPMH_ARC_RM1_ADDITIONAL_BACKOFF_TIME'/>"
WRITE #1 "        <register address='0xb7f5090' value='0x" DATA.LONG(A:0xb7f5090) "' name='RPMH_ARC_RM2_ADDITIONAL_BACKOFF_TIME'/>"
WRITE #1 "        <register address='0xb7f50d0' value='0x" DATA.LONG(A:0xb7f50d0) "' name='RPMH_ARC_RM3_ADDITIONAL_BACKOFF_TIME'/>"
WRITE #1 "        <register address='0xb7f5110' value='0x" DATA.LONG(A:0xb7f5110) "' name='RPMH_ARC_RM4_ADDITIONAL_BACKOFF_TIME'/>"
WRITE #1 "        <register address='0xb7f5150' value='0x" DATA.LONG(A:0xb7f5150) "' name='RPMH_ARC_RM5_ADDITIONAL_BACKOFF_TIME'/>"
WRITE #1 "        <register address='0xb7f5190' value='0x" DATA.LONG(A:0xb7f5190) "' name='RPMH_ARC_RM6_ADDITIONAL_BACKOFF_TIME'/>"
WRITE #1 "        <register address='0xb7f6000' value='0x" DATA.LONG(A:0xb7f6000) "' name='RPMH_ARC_RM0_RAIL_MUX_SEL'/>"
WRITE #1 "        <register address='0xb7f6028' value='0x" DATA.LONG(A:0xb7f6028) "' name='RPMH_ARC_RM1_RAIL_MUX_SEL'/>"
WRITE #1 "        <register address='0xb7f6050' value='0x" DATA.LONG(A:0xb7f6050) "' name='RPMH_ARC_RM2_RAIL_MUX_SEL'/>"
WRITE #1 "        <register address='0xb7f6078' value='0x" DATA.LONG(A:0xb7f6078) "' name='RPMH_ARC_RM3_RAIL_MUX_SEL'/>"
WRITE #1 "        <register address='0xb7f60a0' value='0x" DATA.LONG(A:0xb7f60a0) "' name='RPMH_ARC_RM4_RAIL_MUX_SEL'/>"
WRITE #1 "        <register address='0xb7f60c8' value='0x" DATA.LONG(A:0xb7f60c8) "' name='RPMH_ARC_RM5_RAIL_MUX_SEL'/>"
WRITE #1 "        <register address='0xb7f60f0' value='0x" DATA.LONG(A:0xb7f60f0) "' name='RPMH_ARC_RM6_RAIL_MUX_SEL'/>"
WRITE #1 "        <register address='0xb7fd000' value='0x" DATA.LONG(A:0xb7fd000) "' name='RPMH_ARC_ARC_VERSION'/>"
WRITE #1 "        <register address='0xb7fd004' value='0x" DATA.LONG(A:0xb7fd004) "' name='RPMH_ARC_ARC_EN'/>"
WRITE #1 "        <register address='0xb7fd008' value='0x" DATA.LONG(A:0xb7fd008) "' name='RPMH_ARC_SLV_ID_FOR_RESP'/>"
WRITE #1 "        <register address='0xb7fd00c' value='0x" DATA.LONG(A:0xb7fd00c) "' name='RPMH_ARC_DRV_ID_FOR_VOTING'/>"
WRITE #1 "        <register address='0xb7fd010' value='0x" DATA.LONG(A:0xb7fd010) "' name='RPMH_ARC_ERROR_RESP_CTRL'/>"
WRITE #1 "        <register address='0xb7fd014' value='0x" DATA.LONG(A:0xb7fd014) "' name='RPMH_ARC_CONFIG'/>"
WRITE #1 "        <register address='0xb7fd040' value='0x" DATA.LONG(A:0xb7fd040) "' name='RPMH_ARC_DRV0_RESP_ADDR'/>"
WRITE #1 "        <register address='0xb7fd044' value='0x" DATA.LONG(A:0xb7fd044) "' name='RPMH_ARC_DRV1_RESP_ADDR'/>"
WRITE #1 "        <register address='0xb7fd048' value='0x" DATA.LONG(A:0xb7fd048) "' name='RPMH_ARC_DRV2_RESP_ADDR'/>"
WRITE #1 "        <register address='0xb7fd04c' value='0x" DATA.LONG(A:0xb7fd04c) "' name='RPMH_ARC_DRV3_RESP_ADDR'/>"
WRITE #1 "        <register address='0xb7fd050' value='0x" DATA.LONG(A:0xb7fd050) "' name='RPMH_ARC_DRV4_RESP_ADDR'/>"
WRITE #1 "        <register address='0xb7fd054' value='0x" DATA.LONG(A:0xb7fd054) "' name='RPMH_ARC_DRV5_RESP_ADDR'/>"
WRITE #1 "        <register address='0xb7fd080' value='0x" DATA.LONG(A:0xb7fd080) "' name='RPMH_ARC_BCM_DRV0_RESP_ADDR'/>"
WRITE #1 "        <register address='0xb7fd084' value='0x" DATA.LONG(A:0xb7fd084) "' name='RPMH_ARC_BCM_DRV1_RESP_ADDR'/>"
WRITE #1 "        <register address='0xb7fd088' value='0x" DATA.LONG(A:0xb7fd088) "' name='RPMH_ARC_BCM_DRV2_RESP_ADDR'/>"
WRITE #1 "        <register address='0xb7fd08c' value='0x" DATA.LONG(A:0xb7fd08c) "' name='RPMH_ARC_BCM_DRV3_RESP_ADDR'/>"
WRITE #1 "        <register address='0xb7fd090' value='0x" DATA.LONG(A:0xb7fd090) "' name='RPMH_ARC_BCM_DRV4_RESP_ADDR'/>"
WRITE #1 "        <register address='0xb7fd094' value='0x" DATA.LONG(A:0xb7fd094) "' name='RPMH_ARC_BCM_DRV5_RESP_ADDR'/>"
WRITE #1 "        <register address='0xb7fd098' value='0x" DATA.LONG(A:0xb7fd098) "' name='RPMH_ARC_BCM_DRV6_RESP_ADDR'/>"
WRITE #1 "        <register address='0xb7fd09c' value='0x" DATA.LONG(A:0xb7fd09c) "' name='RPMH_ARC_BCM_DRV7_RESP_ADDR'/>"
WRITE #1 "        <register address='0xb7fd0a0' value='0x" DATA.LONG(A:0xb7fd0a0) "' name='RPMH_ARC_BCM_DRV8_RESP_ADDR'/>"
WRITE #1 "        <register address='0xb7fd0a4' value='0x" DATA.LONG(A:0xb7fd0a4) "' name='RPMH_ARC_BCM_DRV9_RESP_ADDR'/>"
WRITE #1 "        <register address='0xb7fd0a8' value='0x" DATA.LONG(A:0xb7fd0a8) "' name='RPMH_ARC_BCM_DRV10_RESP_ADDR'/>"
WRITE #1 "        <register address='0xb7fd0ac' value='0x" DATA.LONG(A:0xb7fd0ac) "' name='RPMH_ARC_BCM_DRV11_RESP_ADDR'/>"
WRITE #1 "        <register address='0xb7fd0b0' value='0x" DATA.LONG(A:0xb7fd0b0) "' name='RPMH_ARC_BCM_DRV12_RESP_ADDR'/>"
WRITE #1 "        <register address='0xb7fd0b4' value='0x" DATA.LONG(A:0xb7fd0b4) "' name='RPMH_ARC_BCM_DRV13_RESP_ADDR'/>"
WRITE #1 "        <register address='0xb7fd0b8' value='0x" DATA.LONG(A:0xb7fd0b8) "' name='RPMH_ARC_BCM_DRV14_RESP_ADDR'/>"
WRITE #1 "        <register address='0xb7fd0bc' value='0x" DATA.LONG(A:0xb7fd0bc) "' name='RPMH_ARC_BCM_DRV15_RESP_ADDR'/>"
WRITE #1 "        <register address='0xb7fd0f0' value='0x" DATA.LONG(A:0xb7fd0f0) "' name='RPMH_ARC_ARC_DEBUG_BUS_DATA'/>"
WRITE #1 "        <register address='0xb7fd0f4' value='0x" DATA.LONG(A:0xb7fd0f4) "' name='RPMH_ARC_ARC_CLK_GATING_EN_CFG'/>"
WRITE #1 "        <register address='0xb7fd0f8' value='0x" DATA.LONG(A:0xb7fd0f8) "' name='RPMH_ARC_ARC_DEBUG_BUS_EN_CFG'/>"
WRITE #1 "        <register address='0xb7fd0fc' value='0x" DATA.LONG(A:0xb7fd0fc) "' name='RPMH_ARC_DEBUG_BUS_CFG'/>"
WRITE #1 "        <register address='0xb7fd100' value='0x" DATA.LONG(A:0xb7fd100) "' name='RPMH_ARC_DRV0_TIMER_LOW'/>"
WRITE #1 "        <register address='0xb7fd104' value='0x" DATA.LONG(A:0xb7fd104) "' name='RPMH_ARC_DRV1_TIMER_LOW'/>"
WRITE #1 "        <register address='0xb7fd108' value='0x" DATA.LONG(A:0xb7fd108) "' name='RPMH_ARC_DRV2_TIMER_LOW'/>"
WRITE #1 "        <register address='0xb7fd10c' value='0x" DATA.LONG(A:0xb7fd10c) "' name='RPMH_ARC_DRV3_TIMER_LOW'/>"
WRITE #1 "        <register address='0xb7fd110' value='0x" DATA.LONG(A:0xb7fd110) "' name='RPMH_ARC_DRV4_TIMER_LOW'/>"
WRITE #1 "        <register address='0xb7fd114' value='0x" DATA.LONG(A:0xb7fd114) "' name='RPMH_ARC_DRV5_TIMER_LOW'/>"
WRITE #1 "        <register address='0xb7fd180' value='0x" DATA.LONG(A:0xb7fd180) "' name='RPMH_ARC_DRV0_TIMER_HIGH'/>"
WRITE #1 "        <register address='0xb7fd184' value='0x" DATA.LONG(A:0xb7fd184) "' name='RPMH_ARC_DRV1_TIMER_HIGH'/>"
WRITE #1 "        <register address='0xb7fd188' value='0x" DATA.LONG(A:0xb7fd188) "' name='RPMH_ARC_DRV2_TIMER_HIGH'/>"
WRITE #1 "        <register address='0xb7fd18c' value='0x" DATA.LONG(A:0xb7fd18c) "' name='RPMH_ARC_DRV3_TIMER_HIGH'/>"
WRITE #1 "        <register address='0xb7fd190' value='0x" DATA.LONG(A:0xb7fd190) "' name='RPMH_ARC_DRV4_TIMER_HIGH'/>"
WRITE #1 "        <register address='0xb7fd194' value='0x" DATA.LONG(A:0xb7fd194) "' name='RPMH_ARC_DRV5_TIMER_HIGH'/>"
WRITE #1 "        <register address='0xb7fd200' value='0x" DATA.LONG(A:0xb7fd200) "' name='RPMH_ARC_DRVS_TIMER_CONSIDERED_STATUS'/>"
WRITE #1 "        <register address='0xb7fd204' value='0x" DATA.LONG(A:0xb7fd204) "' name='RPMH_ARC_RM_CTRL_STATUS'/>"
WRITE #1 "        <register address='0xb7fd300' value='0x" DATA.LONG(A:0xb7fd300) "' name='RPMH_ARC_RM0_ACC_CTRL'/>"
WRITE #1 "        <register address='0xb7fd304' value='0x" DATA.LONG(A:0xb7fd304) "' name='RPMH_ARC_RM1_ACC_CTRL'/>"
WRITE #1 "        <register address='0xb7fd308' value='0x" DATA.LONG(A:0xb7fd308) "' name='RPMH_ARC_RM2_ACC_CTRL'/>"
WRITE #1 "        <register address='0xb7fd30c' value='0x" DATA.LONG(A:0xb7fd30c) "' name='RPMH_ARC_RM3_ACC_CTRL'/>"
WRITE #1 "        <register address='0xb7fd310' value='0x" DATA.LONG(A:0xb7fd310) "' name='RPMH_ARC_RM4_ACC_CTRL'/>"
WRITE #1 "        <register address='0xb7fd314' value='0x" DATA.LONG(A:0xb7fd314) "' name='RPMH_ARC_RM5_ACC_CTRL'/>"
WRITE #1 "        <register address='0xb7fd318' value='0x" DATA.LONG(A:0xb7fd318) "' name='RPMH_ARC_RM6_ACC_CTRL'/>"
WRITE #1 "        <register address='0xb7fd80c' value='0x" DATA.LONG(A:0xb7fd80c) "' name='RPMH_ARC_RM0_IRQ_EN'/>"
WRITE #1 "        <register address='0xb7fd810' value='0x" DATA.LONG(A:0xb7fd810) "' name='RPMH_ARC_RM1_IRQ_EN'/>"
WRITE #1 "        <register address='0xb7fd814' value='0x" DATA.LONG(A:0xb7fd814) "' name='RPMH_ARC_RM2_IRQ_EN'/>"
WRITE #1 "        <register address='0xb7fd818' value='0x" DATA.LONG(A:0xb7fd818) "' name='RPMH_ARC_RM3_IRQ_EN'/>"
WRITE #1 "        <register address='0xb7fd81c' value='0x" DATA.LONG(A:0xb7fd81c) "' name='RPMH_ARC_RM4_IRQ_EN'/>"
WRITE #1 "        <register address='0xb7fd820' value='0x" DATA.LONG(A:0xb7fd820) "' name='RPMH_ARC_RM5_IRQ_EN'/>"
WRITE #1 "        <register address='0xb7fd824' value='0x" DATA.LONG(A:0xb7fd824) "' name='RPMH_ARC_RM6_IRQ_EN'/>"
WRITE #1 "        <register address='0xb7fd900' value='0x" DATA.LONG(A:0xb7fd900) "' name='RPMH_ARC_RM0_IRQ_STATUS'/>"
WRITE #1 "        <register address='0xb7fd904' value='0x" DATA.LONG(A:0xb7fd904) "' name='RPMH_ARC_RM1_IRQ_STATUS'/>"
WRITE #1 "        <register address='0xb7fd908' value='0x" DATA.LONG(A:0xb7fd908) "' name='RPMH_ARC_RM2_IRQ_STATUS'/>"
WRITE #1 "        <register address='0xb7fd90c' value='0x" DATA.LONG(A:0xb7fd90c) "' name='RPMH_ARC_RM3_IRQ_STATUS'/>"
WRITE #1 "        <register address='0xb7fd910' value='0x" DATA.LONG(A:0xb7fd910) "' name='RPMH_ARC_RM4_IRQ_STATUS'/>"
WRITE #1 "        <register address='0xb7fd914' value='0x" DATA.LONG(A:0xb7fd914) "' name='RPMH_ARC_RM5_IRQ_STATUS'/>"
WRITE #1 "        <register address='0xb7fd918' value='0x" DATA.LONG(A:0xb7fd918) "' name='RPMH_ARC_RM6_IRQ_STATUS'/>"
WRITE #1 "        <register address='0xb7fe000' value='0x" DATA.LONG(A:0xb7fe000) "' name='RPMH_ARC_PV_ADDR_FOR_COMP'/>"
WRITE #1 "        <register address='0xb7fe040' value='0x" DATA.LONG(A:0xb7fe040) "' name='RPMH_ARC_RM0_PV_TCS_CMD0_STATUS'/>"
WRITE #1 "        <register address='0xb7fe044' value='0x" DATA.LONG(A:0xb7fe044) "' name='RPMH_ARC_RM0_PV_TCS_CMD1_STATUS'/>"
WRITE #1 "        <register address='0xb7fe048' value='0x" DATA.LONG(A:0xb7fe048) "' name='RPMH_ARC_RM0_PV_TCS_CMD2_STATUS'/>"
WRITE #1 "        <register address='0xb7fe04c' value='0x" DATA.LONG(A:0xb7fe04c) "' name='RPMH_ARC_RM0_PV_TCS_CMD3_STATUS'/>"
WRITE #1 "        <register address='0xb7fe050' value='0x" DATA.LONG(A:0xb7fe050) "' name='RPMH_ARC_RM1_PV_TCS_CMD0_STATUS'/>"
WRITE #1 "        <register address='0xb7fe054' value='0x" DATA.LONG(A:0xb7fe054) "' name='RPMH_ARC_RM1_PV_TCS_CMD1_STATUS'/>"
WRITE #1 "        <register address='0xb7fe058' value='0x" DATA.LONG(A:0xb7fe058) "' name='RPMH_ARC_RM1_PV_TCS_CMD2_STATUS'/>"
WRITE #1 "        <register address='0xb7fe05c' value='0x" DATA.LONG(A:0xb7fe05c) "' name='RPMH_ARC_RM1_PV_TCS_CMD3_STATUS'/>"
WRITE #1 "        <register address='0xb7fe060' value='0x" DATA.LONG(A:0xb7fe060) "' name='RPMH_ARC_RM2_PV_TCS_CMD0_STATUS'/>"
WRITE #1 "        <register address='0xb7fe064' value='0x" DATA.LONG(A:0xb7fe064) "' name='RPMH_ARC_RM2_PV_TCS_CMD1_STATUS'/>"
WRITE #1 "        <register address='0xb7fe068' value='0x" DATA.LONG(A:0xb7fe068) "' name='RPMH_ARC_RM2_PV_TCS_CMD2_STATUS'/>"
WRITE #1 "        <register address='0xb7fe06c' value='0x" DATA.LONG(A:0xb7fe06c) "' name='RPMH_ARC_RM2_PV_TCS_CMD3_STATUS'/>"
WRITE #1 "        <register address='0xb7fe070' value='0x" DATA.LONG(A:0xb7fe070) "' name='RPMH_ARC_RM3_PV_TCS_CMD0_STATUS'/>"
WRITE #1 "        <register address='0xb7fe074' value='0x" DATA.LONG(A:0xb7fe074) "' name='RPMH_ARC_RM3_PV_TCS_CMD1_STATUS'/>"
WRITE #1 "        <register address='0xb7fe078' value='0x" DATA.LONG(A:0xb7fe078) "' name='RPMH_ARC_RM3_PV_TCS_CMD2_STATUS'/>"
WRITE #1 "        <register address='0xb7fe07c' value='0x" DATA.LONG(A:0xb7fe07c) "' name='RPMH_ARC_RM3_PV_TCS_CMD3_STATUS'/>"
WRITE #1 "        <register address='0xb7fe080' value='0x" DATA.LONG(A:0xb7fe080) "' name='RPMH_ARC_RM4_PV_TCS_CMD0_STATUS'/>"
WRITE #1 "        <register address='0xb7fe084' value='0x" DATA.LONG(A:0xb7fe084) "' name='RPMH_ARC_RM4_PV_TCS_CMD1_STATUS'/>"
WRITE #1 "        <register address='0xb7fe088' value='0x" DATA.LONG(A:0xb7fe088) "' name='RPMH_ARC_RM4_PV_TCS_CMD2_STATUS'/>"
WRITE #1 "        <register address='0xb7fe08c' value='0x" DATA.LONG(A:0xb7fe08c) "' name='RPMH_ARC_RM4_PV_TCS_CMD3_STATUS'/>"
WRITE #1 "        <register address='0xb7fe090' value='0x" DATA.LONG(A:0xb7fe090) "' name='RPMH_ARC_RM5_PV_TCS_CMD0_STATUS'/>"
WRITE #1 "        <register address='0xb7fe094' value='0x" DATA.LONG(A:0xb7fe094) "' name='RPMH_ARC_RM5_PV_TCS_CMD1_STATUS'/>"
WRITE #1 "        <register address='0xb7fe098' value='0x" DATA.LONG(A:0xb7fe098) "' name='RPMH_ARC_RM5_PV_TCS_CMD2_STATUS'/>"
WRITE #1 "        <register address='0xb7fe09c' value='0x" DATA.LONG(A:0xb7fe09c) "' name='RPMH_ARC_RM5_PV_TCS_CMD3_STATUS'/>"
WRITE #1 "        <register address='0xb7fe0a0' value='0x" DATA.LONG(A:0xb7fe0a0) "' name='RPMH_ARC_RM6_PV_TCS_CMD0_STATUS'/>"
WRITE #1 "        <register address='0xb7fe0a4' value='0x" DATA.LONG(A:0xb7fe0a4) "' name='RPMH_ARC_RM6_PV_TCS_CMD1_STATUS'/>"
WRITE #1 "        <register address='0xb7fe0a8' value='0x" DATA.LONG(A:0xb7fe0a8) "' name='RPMH_ARC_RM6_PV_TCS_CMD2_STATUS'/>"
WRITE #1 "        <register address='0xb7fe0ac' value='0x" DATA.LONG(A:0xb7fe0ac) "' name='RPMH_ARC_RM6_PV_TCS_CMD3_STATUS'/>"
WRITE #1 "        <register address='0xb7fe150' value='0x" DATA.LONG(A:0xb7fe150) "' name='RPMH_ARC_RM0_PV_TCS_CMD0_VOTE'/>"
WRITE #1 "        <register address='0xb7fe154' value='0x" DATA.LONG(A:0xb7fe154) "' name='RPMH_ARC_RM0_PV_TCS_CMD1_VOTE'/>"
WRITE #1 "        <register address='0xb7fe158' value='0x" DATA.LONG(A:0xb7fe158) "' name='RPMH_ARC_RM0_PV_TCS_CMD2_VOTE'/>"
WRITE #1 "        <register address='0xb7fe15c' value='0x" DATA.LONG(A:0xb7fe15c) "' name='RPMH_ARC_RM0_PV_TCS_CMD3_VOTE'/>"
WRITE #1 "        <register address='0xb7fe160' value='0x" DATA.LONG(A:0xb7fe160) "' name='RPMH_ARC_RM1_PV_TCS_CMD0_VOTE'/>"
WRITE #1 "        <register address='0xb7fe164' value='0x" DATA.LONG(A:0xb7fe164) "' name='RPMH_ARC_RM1_PV_TCS_CMD1_VOTE'/>"
WRITE #1 "        <register address='0xb7fe168' value='0x" DATA.LONG(A:0xb7fe168) "' name='RPMH_ARC_RM1_PV_TCS_CMD2_VOTE'/>"
WRITE #1 "        <register address='0xb7fe16c' value='0x" DATA.LONG(A:0xb7fe16c) "' name='RPMH_ARC_RM1_PV_TCS_CMD3_VOTE'/>"
WRITE #1 "        <register address='0xb7fe170' value='0x" DATA.LONG(A:0xb7fe170) "' name='RPMH_ARC_RM2_PV_TCS_CMD0_VOTE'/>"
WRITE #1 "        <register address='0xb7fe174' value='0x" DATA.LONG(A:0xb7fe174) "' name='RPMH_ARC_RM2_PV_TCS_CMD1_VOTE'/>"
WRITE #1 "        <register address='0xb7fe178' value='0x" DATA.LONG(A:0xb7fe178) "' name='RPMH_ARC_RM2_PV_TCS_CMD2_VOTE'/>"
WRITE #1 "        <register address='0xb7fe17c' value='0x" DATA.LONG(A:0xb7fe17c) "' name='RPMH_ARC_RM2_PV_TCS_CMD3_VOTE'/>"
WRITE #1 "        <register address='0xb7fe180' value='0x" DATA.LONG(A:0xb7fe180) "' name='RPMH_ARC_RM3_PV_TCS_CMD0_VOTE'/>"
WRITE #1 "        <register address='0xb7fe184' value='0x" DATA.LONG(A:0xb7fe184) "' name='RPMH_ARC_RM3_PV_TCS_CMD1_VOTE'/>"
WRITE #1 "        <register address='0xb7fe188' value='0x" DATA.LONG(A:0xb7fe188) "' name='RPMH_ARC_RM3_PV_TCS_CMD2_VOTE'/>"
WRITE #1 "        <register address='0xb7fe18c' value='0x" DATA.LONG(A:0xb7fe18c) "' name='RPMH_ARC_RM3_PV_TCS_CMD3_VOTE'/>"
WRITE #1 "        <register address='0xb7fe190' value='0x" DATA.LONG(A:0xb7fe190) "' name='RPMH_ARC_RM4_PV_TCS_CMD0_VOTE'/>"
WRITE #1 "        <register address='0xb7fe194' value='0x" DATA.LONG(A:0xb7fe194) "' name='RPMH_ARC_RM4_PV_TCS_CMD1_VOTE'/>"
WRITE #1 "        <register address='0xb7fe198' value='0x" DATA.LONG(A:0xb7fe198) "' name='RPMH_ARC_RM4_PV_TCS_CMD2_VOTE'/>"
WRITE #1 "        <register address='0xb7fe19c' value='0x" DATA.LONG(A:0xb7fe19c) "' name='RPMH_ARC_RM4_PV_TCS_CMD3_VOTE'/>"
WRITE #1 "        <register address='0xb7fe1a0' value='0x" DATA.LONG(A:0xb7fe1a0) "' name='RPMH_ARC_RM5_PV_TCS_CMD0_VOTE'/>"
WRITE #1 "        <register address='0xb7fe1a4' value='0x" DATA.LONG(A:0xb7fe1a4) "' name='RPMH_ARC_RM5_PV_TCS_CMD1_VOTE'/>"
WRITE #1 "        <register address='0xb7fe1a8' value='0x" DATA.LONG(A:0xb7fe1a8) "' name='RPMH_ARC_RM5_PV_TCS_CMD2_VOTE'/>"
WRITE #1 "        <register address='0xb7fe1ac' value='0x" DATA.LONG(A:0xb7fe1ac) "' name='RPMH_ARC_RM5_PV_TCS_CMD3_VOTE'/>"
WRITE #1 "        <register address='0xb7fe1b0' value='0x" DATA.LONG(A:0xb7fe1b0) "' name='RPMH_ARC_RM6_PV_TCS_CMD0_VOTE'/>"
WRITE #1 "        <register address='0xb7fe1b4' value='0x" DATA.LONG(A:0xb7fe1b4) "' name='RPMH_ARC_RM6_PV_TCS_CMD1_VOTE'/>"
WRITE #1 "        <register address='0xb7fe1b8' value='0x" DATA.LONG(A:0xb7fe1b8) "' name='RPMH_ARC_RM6_PV_TCS_CMD2_VOTE'/>"
WRITE #1 "        <register address='0xb7fe1bc' value='0x" DATA.LONG(A:0xb7fe1bc) "' name='RPMH_ARC_RM6_PV_TCS_CMD3_VOTE'/>"
WRITE #1 "        <register address='0xb7fe300' value='0x" DATA.LONG(A:0xb7fe300) "' name='RPMH_ARC_RM0_PV_TCS_CMD0_VOTE_ADDR'/>"
WRITE #1 "        <register address='0xb7fe304' value='0x" DATA.LONG(A:0xb7fe304) "' name='RPMH_ARC_RM0_PV_TCS_CMD1_VOTE_ADDR'/>"
WRITE #1 "        <register address='0xb7fe308' value='0x" DATA.LONG(A:0xb7fe308) "' name='RPMH_ARC_RM0_PV_TCS_CMD2_VOTE_ADDR'/>"
WRITE #1 "        <register address='0xb7fe30c' value='0x" DATA.LONG(A:0xb7fe30c) "' name='RPMH_ARC_RM0_PV_TCS_CMD3_VOTE_ADDR'/>"
WRITE #1 "        <register address='0xb7fe310' value='0x" DATA.LONG(A:0xb7fe310) "' name='RPMH_ARC_RM1_PV_TCS_CMD0_VOTE_ADDR'/>"
WRITE #1 "        <register address='0xb7fe314' value='0x" DATA.LONG(A:0xb7fe314) "' name='RPMH_ARC_RM1_PV_TCS_CMD1_VOTE_ADDR'/>"
WRITE #1 "        <register address='0xb7fe318' value='0x" DATA.LONG(A:0xb7fe318) "' name='RPMH_ARC_RM1_PV_TCS_CMD2_VOTE_ADDR'/>"
WRITE #1 "        <register address='0xb7fe31c' value='0x" DATA.LONG(A:0xb7fe31c) "' name='RPMH_ARC_RM1_PV_TCS_CMD3_VOTE_ADDR'/>"
WRITE #1 "        <register address='0xb7fe320' value='0x" DATA.LONG(A:0xb7fe320) "' name='RPMH_ARC_RM2_PV_TCS_CMD0_VOTE_ADDR'/>"
WRITE #1 "        <register address='0xb7fe324' value='0x" DATA.LONG(A:0xb7fe324) "' name='RPMH_ARC_RM2_PV_TCS_CMD1_VOTE_ADDR'/>"
WRITE #1 "        <register address='0xb7fe328' value='0x" DATA.LONG(A:0xb7fe328) "' name='RPMH_ARC_RM2_PV_TCS_CMD2_VOTE_ADDR'/>"
WRITE #1 "        <register address='0xb7fe32c' value='0x" DATA.LONG(A:0xb7fe32c) "' name='RPMH_ARC_RM2_PV_TCS_CMD3_VOTE_ADDR'/>"
WRITE #1 "        <register address='0xb7fe330' value='0x" DATA.LONG(A:0xb7fe330) "' name='RPMH_ARC_RM3_PV_TCS_CMD0_VOTE_ADDR'/>"
WRITE #1 "        <register address='0xb7fe334' value='0x" DATA.LONG(A:0xb7fe334) "' name='RPMH_ARC_RM3_PV_TCS_CMD1_VOTE_ADDR'/>"
WRITE #1 "        <register address='0xb7fe338' value='0x" DATA.LONG(A:0xb7fe338) "' name='RPMH_ARC_RM3_PV_TCS_CMD2_VOTE_ADDR'/>"
WRITE #1 "        <register address='0xb7fe33c' value='0x" DATA.LONG(A:0xb7fe33c) "' name='RPMH_ARC_RM3_PV_TCS_CMD3_VOTE_ADDR'/>"
WRITE #1 "        <register address='0xb7fe340' value='0x" DATA.LONG(A:0xb7fe340) "' name='RPMH_ARC_RM4_PV_TCS_CMD0_VOTE_ADDR'/>"
WRITE #1 "        <register address='0xb7fe344' value='0x" DATA.LONG(A:0xb7fe344) "' name='RPMH_ARC_RM4_PV_TCS_CMD1_VOTE_ADDR'/>"
WRITE #1 "        <register address='0xb7fe348' value='0x" DATA.LONG(A:0xb7fe348) "' name='RPMH_ARC_RM4_PV_TCS_CMD2_VOTE_ADDR'/>"
WRITE #1 "        <register address='0xb7fe34c' value='0x" DATA.LONG(A:0xb7fe34c) "' name='RPMH_ARC_RM4_PV_TCS_CMD3_VOTE_ADDR'/>"
WRITE #1 "        <register address='0xb7fe350' value='0x" DATA.LONG(A:0xb7fe350) "' name='RPMH_ARC_RM5_PV_TCS_CMD0_VOTE_ADDR'/>"
WRITE #1 "        <register address='0xb7fe354' value='0x" DATA.LONG(A:0xb7fe354) "' name='RPMH_ARC_RM5_PV_TCS_CMD1_VOTE_ADDR'/>"
WRITE #1 "        <register address='0xb7fe358' value='0x" DATA.LONG(A:0xb7fe358) "' name='RPMH_ARC_RM5_PV_TCS_CMD2_VOTE_ADDR'/>"
WRITE #1 "        <register address='0xb7fe35c' value='0x" DATA.LONG(A:0xb7fe35c) "' name='RPMH_ARC_RM5_PV_TCS_CMD3_VOTE_ADDR'/>"
WRITE #1 "        <register address='0xb7fe360' value='0x" DATA.LONG(A:0xb7fe360) "' name='RPMH_ARC_RM6_PV_TCS_CMD0_VOTE_ADDR'/>"
WRITE #1 "        <register address='0xb7fe364' value='0x" DATA.LONG(A:0xb7fe364) "' name='RPMH_ARC_RM6_PV_TCS_CMD1_VOTE_ADDR'/>"
WRITE #1 "        <register address='0xb7fe368' value='0x" DATA.LONG(A:0xb7fe368) "' name='RPMH_ARC_RM6_PV_TCS_CMD2_VOTE_ADDR'/>"
WRITE #1 "        <register address='0xb7fe36c' value='0x" DATA.LONG(A:0xb7fe36c) "' name='RPMH_ARC_RM6_PV_TCS_CMD3_VOTE_ADDR'/>"
WRITE #1 "        <register address='0xb7fe5c0' value='0x" DATA.LONG(A:0xb7fe5c0) "' name='RPMH_ARC_RM0_PV_TCS_CMD0_VOTE_DATA'/>"
WRITE #1 "        <register address='0xb7fe5c4' value='0x" DATA.LONG(A:0xb7fe5c4) "' name='RPMH_ARC_RM0_PV_TCS_CMD1_VOTE_DATA'/>"
WRITE #1 "        <register address='0xb7fe5c8' value='0x" DATA.LONG(A:0xb7fe5c8) "' name='RPMH_ARC_RM0_PV_TCS_CMD2_VOTE_DATA'/>"
WRITE #1 "        <register address='0xb7fe5cc' value='0x" DATA.LONG(A:0xb7fe5cc) "' name='RPMH_ARC_RM0_PV_TCS_CMD3_VOTE_DATA'/>"
WRITE #1 "        <register address='0xb7fe5d0' value='0x" DATA.LONG(A:0xb7fe5d0) "' name='RPMH_ARC_RM1_PV_TCS_CMD0_VOTE_DATA'/>"
WRITE #1 "        <register address='0xb7fe5d4' value='0x" DATA.LONG(A:0xb7fe5d4) "' name='RPMH_ARC_RM1_PV_TCS_CMD1_VOTE_DATA'/>"
WRITE #1 "        <register address='0xb7fe5d8' value='0x" DATA.LONG(A:0xb7fe5d8) "' name='RPMH_ARC_RM1_PV_TCS_CMD2_VOTE_DATA'/>"
WRITE #1 "        <register address='0xb7fe5dc' value='0x" DATA.LONG(A:0xb7fe5dc) "' name='RPMH_ARC_RM1_PV_TCS_CMD3_VOTE_DATA'/>"
WRITE #1 "        <register address='0xb7fe5e0' value='0x" DATA.LONG(A:0xb7fe5e0) "' name='RPMH_ARC_RM2_PV_TCS_CMD0_VOTE_DATA'/>"
WRITE #1 "        <register address='0xb7fe5e4' value='0x" DATA.LONG(A:0xb7fe5e4) "' name='RPMH_ARC_RM2_PV_TCS_CMD1_VOTE_DATA'/>"
WRITE #1 "        <register address='0xb7fe5e8' value='0x" DATA.LONG(A:0xb7fe5e8) "' name='RPMH_ARC_RM2_PV_TCS_CMD2_VOTE_DATA'/>"
WRITE #1 "        <register address='0xb7fe5ec' value='0x" DATA.LONG(A:0xb7fe5ec) "' name='RPMH_ARC_RM2_PV_TCS_CMD3_VOTE_DATA'/>"
WRITE #1 "        <register address='0xb7fe5f0' value='0x" DATA.LONG(A:0xb7fe5f0) "' name='RPMH_ARC_RM3_PV_TCS_CMD0_VOTE_DATA'/>"
WRITE #1 "        <register address='0xb7fe5f4' value='0x" DATA.LONG(A:0xb7fe5f4) "' name='RPMH_ARC_RM3_PV_TCS_CMD1_VOTE_DATA'/>"
WRITE #1 "        <register address='0xb7fe5f8' value='0x" DATA.LONG(A:0xb7fe5f8) "' name='RPMH_ARC_RM3_PV_TCS_CMD2_VOTE_DATA'/>"
WRITE #1 "        <register address='0xb7fe5fc' value='0x" DATA.LONG(A:0xb7fe5fc) "' name='RPMH_ARC_RM3_PV_TCS_CMD3_VOTE_DATA'/>"
WRITE #1 "        <register address='0xb7fe600' value='0x" DATA.LONG(A:0xb7fe600) "' name='RPMH_ARC_RM4_PV_TCS_CMD0_VOTE_DATA'/>"
WRITE #1 "        <register address='0xb7fe604' value='0x" DATA.LONG(A:0xb7fe604) "' name='RPMH_ARC_RM4_PV_TCS_CMD1_VOTE_DATA'/>"
WRITE #1 "        <register address='0xb7fe608' value='0x" DATA.LONG(A:0xb7fe608) "' name='RPMH_ARC_RM4_PV_TCS_CMD2_VOTE_DATA'/>"
WRITE #1 "        <register address='0xb7fe60c' value='0x" DATA.LONG(A:0xb7fe60c) "' name='RPMH_ARC_RM4_PV_TCS_CMD3_VOTE_DATA'/>"
WRITE #1 "        <register address='0xb7fe610' value='0x" DATA.LONG(A:0xb7fe610) "' name='RPMH_ARC_RM5_PV_TCS_CMD0_VOTE_DATA'/>"
WRITE #1 "        <register address='0xb7fe614' value='0x" DATA.LONG(A:0xb7fe614) "' name='RPMH_ARC_RM5_PV_TCS_CMD1_VOTE_DATA'/>"
WRITE #1 "        <register address='0xb7fe618' value='0x" DATA.LONG(A:0xb7fe618) "' name='RPMH_ARC_RM5_PV_TCS_CMD2_VOTE_DATA'/>"
WRITE #1 "        <register address='0xb7fe61c' value='0x" DATA.LONG(A:0xb7fe61c) "' name='RPMH_ARC_RM5_PV_TCS_CMD3_VOTE_DATA'/>"
WRITE #1 "        <register address='0xb7fe620' value='0x" DATA.LONG(A:0xb7fe620) "' name='RPMH_ARC_RM6_PV_TCS_CMD0_VOTE_DATA'/>"
WRITE #1 "        <register address='0xb7fe624' value='0x" DATA.LONG(A:0xb7fe624) "' name='RPMH_ARC_RM6_PV_TCS_CMD1_VOTE_DATA'/>"
WRITE #1 "        <register address='0xb7fe628' value='0x" DATA.LONG(A:0xb7fe628) "' name='RPMH_ARC_RM6_PV_TCS_CMD2_VOTE_DATA'/>"
WRITE #1 "        <register address='0xb7fe62c' value='0x" DATA.LONG(A:0xb7fe62c) "' name='RPMH_ARC_RM6_PV_TCS_CMD3_VOTE_DATA'/>"
WRITE #1 "        <register address='0xb7fea40' value='0x" DATA.LONG(A:0xb7fea40) "' name='RPMH_ARC_SW_OVERRIDE_PWR_CTRL_VAL_RM0'/>"
WRITE #1 "        <register address='0xb7fea44' value='0x" DATA.LONG(A:0xb7fea44) "' name='RPMH_ARC_SW_OVERRIDE_PWR_CTRL_VAL_RM1'/>"
WRITE #1 "        <register address='0xb7fea48' value='0x" DATA.LONG(A:0xb7fea48) "' name='RPMH_ARC_SW_OVERRIDE_PWR_CTRL_VAL_RM2'/>"
WRITE #1 "        <register address='0xb7fea4c' value='0x" DATA.LONG(A:0xb7fea4c) "' name='RPMH_ARC_SW_OVERRIDE_PWR_CTRL_VAL_RM3'/>"
WRITE #1 "        <register address='0xb7fea50' value='0x" DATA.LONG(A:0xb7fea50) "' name='RPMH_ARC_SW_OVERRIDE_PWR_CTRL_VAL_RM4'/>"
WRITE #1 "        <register address='0xb7fea54' value='0x" DATA.LONG(A:0xb7fea54) "' name='RPMH_ARC_SW_OVERRIDE_PWR_CTRL_VAL_RM5'/>"
WRITE #1 "        <register address='0xb7fea58' value='0x" DATA.LONG(A:0xb7fea58) "' name='RPMH_ARC_SW_OVERRIDE_PWR_CTRL_VAL_RM6'/>"
WRITE #1 "        <register address='0xb7fea80' value='0x" DATA.LONG(A:0xb7fea80) "' name='RPMH_ARC_SW_OVERRIDE_PWR_CTRL2_VAL_RM0'/>"
WRITE #1 "        <register address='0xb7fea84' value='0x" DATA.LONG(A:0xb7fea84) "' name='RPMH_ARC_SW_OVERRIDE_PWR_CTRL2_VAL_RM1'/>"
WRITE #1 "        <register address='0xb7fea88' value='0x" DATA.LONG(A:0xb7fea88) "' name='RPMH_ARC_SW_OVERRIDE_PWR_CTRL2_VAL_RM2'/>"
WRITE #1 "        <register address='0xb7fea8c' value='0x" DATA.LONG(A:0xb7fea8c) "' name='RPMH_ARC_SW_OVERRIDE_PWR_CTRL2_VAL_RM3'/>"
WRITE #1 "        <register address='0xb7fea90' value='0x" DATA.LONG(A:0xb7fea90) "' name='RPMH_ARC_SW_OVERRIDE_PWR_CTRL2_VAL_RM4'/>"
WRITE #1 "        <register address='0xb7fea94' value='0x" DATA.LONG(A:0xb7fea94) "' name='RPMH_ARC_SW_OVERRIDE_PWR_CTRL2_VAL_RM5'/>"
WRITE #1 "        <register address='0xb7fea98' value='0x" DATA.LONG(A:0xb7fea98) "' name='RPMH_ARC_SW_OVERRIDE_PWR_CTRL2_VAL_RM6'/>"
WRITE #1 "        <register address='0xb7feac0' value='0x" DATA.LONG(A:0xb7feac0) "' name='RPMH_ARC_SW_OVERRIDE_PWR_CTRL_MASK_RM0'/>"
WRITE #1 "        <register address='0xb7feac4' value='0x" DATA.LONG(A:0xb7feac4) "' name='RPMH_ARC_SW_OVERRIDE_PWR_CTRL_MASK_RM1'/>"
WRITE #1 "        <register address='0xb7feac8' value='0x" DATA.LONG(A:0xb7feac8) "' name='RPMH_ARC_SW_OVERRIDE_PWR_CTRL_MASK_RM2'/>"
WRITE #1 "        <register address='0xb7feacc' value='0x" DATA.LONG(A:0xb7feacc) "' name='RPMH_ARC_SW_OVERRIDE_PWR_CTRL_MASK_RM3'/>"
WRITE #1 "        <register address='0xb7fead0' value='0x" DATA.LONG(A:0xb7fead0) "' name='RPMH_ARC_SW_OVERRIDE_PWR_CTRL_MASK_RM4'/>"
WRITE #1 "        <register address='0xb7fead4' value='0x" DATA.LONG(A:0xb7fead4) "' name='RPMH_ARC_SW_OVERRIDE_PWR_CTRL_MASK_RM5'/>"
WRITE #1 "        <register address='0xb7fead8' value='0x" DATA.LONG(A:0xb7fead8) "' name='RPMH_ARC_SW_OVERRIDE_PWR_CTRL_MASK_RM6'/>"
WRITE #1 "        <register address='0xb7feb00' value='0x" DATA.LONG(A:0xb7feb00) "' name='RPMH_ARC_SW_OVERRIDE_PWR_CTRL2_MASK_RM0'/>"
WRITE #1 "        <register address='0xb7feb04' value='0x" DATA.LONG(A:0xb7feb04) "' name='RPMH_ARC_SW_OVERRIDE_PWR_CTRL2_MASK_RM1'/>"
WRITE #1 "        <register address='0xb7feb08' value='0x" DATA.LONG(A:0xb7feb08) "' name='RPMH_ARC_SW_OVERRIDE_PWR_CTRL2_MASK_RM2'/>"
WRITE #1 "        <register address='0xb7feb0c' value='0x" DATA.LONG(A:0xb7feb0c) "' name='RPMH_ARC_SW_OVERRIDE_PWR_CTRL2_MASK_RM3'/>"
WRITE #1 "        <register address='0xb7feb10' value='0x" DATA.LONG(A:0xb7feb10) "' name='RPMH_ARC_SW_OVERRIDE_PWR_CTRL2_MASK_RM4'/>"
WRITE #1 "        <register address='0xb7feb14' value='0x" DATA.LONG(A:0xb7feb14) "' name='RPMH_ARC_SW_OVERRIDE_PWR_CTRL2_MASK_RM5'/>"
WRITE #1 "        <register address='0xb7feb18' value='0x" DATA.LONG(A:0xb7feb18) "' name='RPMH_ARC_SW_OVERRIDE_PWR_CTRL2_MASK_RM6'/>"
WRITE #1 "        <register address='0xb7feb40' value='0x" DATA.LONG(A:0xb7feb40) "' name='RPMH_ARC_SW_OVERRIDE_WAIT_EVENT_VAL_RM0'/>"
WRITE #1 "        <register address='0xb7feb44' value='0x" DATA.LONG(A:0xb7feb44) "' name='RPMH_ARC_SW_OVERRIDE_WAIT_EVENT_VAL_RM1'/>"
WRITE #1 "        <register address='0xb7feb48' value='0x" DATA.LONG(A:0xb7feb48) "' name='RPMH_ARC_SW_OVERRIDE_WAIT_EVENT_VAL_RM2'/>"
WRITE #1 "        <register address='0xb7feb4c' value='0x" DATA.LONG(A:0xb7feb4c) "' name='RPMH_ARC_SW_OVERRIDE_WAIT_EVENT_VAL_RM3'/>"
WRITE #1 "        <register address='0xb7feb50' value='0x" DATA.LONG(A:0xb7feb50) "' name='RPMH_ARC_SW_OVERRIDE_WAIT_EVENT_VAL_RM4'/>"
WRITE #1 "        <register address='0xb7feb54' value='0x" DATA.LONG(A:0xb7feb54) "' name='RPMH_ARC_SW_OVERRIDE_WAIT_EVENT_VAL_RM5'/>"
WRITE #1 "        <register address='0xb7feb58' value='0x" DATA.LONG(A:0xb7feb58) "' name='RPMH_ARC_SW_OVERRIDE_WAIT_EVENT_VAL_RM6'/>"
WRITE #1 "        <register address='0xb7feb80' value='0x" DATA.LONG(A:0xb7feb80) "' name='RPMH_ARC_SW_OVERRIDE_WAIT_EVENT_MASK_RM0'/>"
WRITE #1 "        <register address='0xb7feb84' value='0x" DATA.LONG(A:0xb7feb84) "' name='RPMH_ARC_SW_OVERRIDE_WAIT_EVENT_MASK_RM1'/>"
WRITE #1 "        <register address='0xb7feb88' value='0x" DATA.LONG(A:0xb7feb88) "' name='RPMH_ARC_SW_OVERRIDE_WAIT_EVENT_MASK_RM2'/>"
WRITE #1 "        <register address='0xb7feb8c' value='0x" DATA.LONG(A:0xb7feb8c) "' name='RPMH_ARC_SW_OVERRIDE_WAIT_EVENT_MASK_RM3'/>"
WRITE #1 "        <register address='0xb7feb90' value='0x" DATA.LONG(A:0xb7feb90) "' name='RPMH_ARC_SW_OVERRIDE_WAIT_EVENT_MASK_RM4'/>"
WRITE #1 "        <register address='0xb7feb94' value='0x" DATA.LONG(A:0xb7feb94) "' name='RPMH_ARC_SW_OVERRIDE_WAIT_EVENT_MASK_RM5'/>"
WRITE #1 "        <register address='0xb7feb98' value='0x" DATA.LONG(A:0xb7feb98) "' name='RPMH_ARC_SW_OVERRIDE_WAIT_EVENT_MASK_RM6'/>"
WRITE #1 "        <register address='0xb7febc0' value='0x" DATA.LONG(A:0xb7febc0) "' name='RPMH_ARC_SW_OVERRIDE_BR_EVENT_VAL_RM0'/>"
WRITE #1 "        <register address='0xb7febc4' value='0x" DATA.LONG(A:0xb7febc4) "' name='RPMH_ARC_SW_OVERRIDE_BR_EVENT_VAL_RM1'/>"
WRITE #1 "        <register address='0xb7febc8' value='0x" DATA.LONG(A:0xb7febc8) "' name='RPMH_ARC_SW_OVERRIDE_BR_EVENT_VAL_RM2'/>"
WRITE #1 "        <register address='0xb7febcc' value='0x" DATA.LONG(A:0xb7febcc) "' name='RPMH_ARC_SW_OVERRIDE_BR_EVENT_VAL_RM3'/>"
WRITE #1 "        <register address='0xb7febd0' value='0x" DATA.LONG(A:0xb7febd0) "' name='RPMH_ARC_SW_OVERRIDE_BR_EVENT_VAL_RM4'/>"
WRITE #1 "        <register address='0xb7febd4' value='0x" DATA.LONG(A:0xb7febd4) "' name='RPMH_ARC_SW_OVERRIDE_BR_EVENT_VAL_RM5'/>"
WRITE #1 "        <register address='0xb7febd8' value='0x" DATA.LONG(A:0xb7febd8) "' name='RPMH_ARC_SW_OVERRIDE_BR_EVENT_VAL_RM6'/>"
WRITE #1 "        <register address='0xb7fec00' value='0x" DATA.LONG(A:0xb7fec00) "' name='RPMH_ARC_SW_OVERRIDE_BR_EVENT_MASK_RM0'/>"
WRITE #1 "        <register address='0xb7fec04' value='0x" DATA.LONG(A:0xb7fec04) "' name='RPMH_ARC_SW_OVERRIDE_BR_EVENT_MASK_RM1'/>"
WRITE #1 "        <register address='0xb7fec08' value='0x" DATA.LONG(A:0xb7fec08) "' name='RPMH_ARC_SW_OVERRIDE_BR_EVENT_MASK_RM2'/>"
WRITE #1 "        <register address='0xb7fec0c' value='0x" DATA.LONG(A:0xb7fec0c) "' name='RPMH_ARC_SW_OVERRIDE_BR_EVENT_MASK_RM3'/>"
WRITE #1 "        <register address='0xb7fec10' value='0x" DATA.LONG(A:0xb7fec10) "' name='RPMH_ARC_SW_OVERRIDE_BR_EVENT_MASK_RM4'/>"
WRITE #1 "        <register address='0xb7fec14' value='0x" DATA.LONG(A:0xb7fec14) "' name='RPMH_ARC_SW_OVERRIDE_BR_EVENT_MASK_RM5'/>"
WRITE #1 "        <register address='0xb7fec18' value='0x" DATA.LONG(A:0xb7fec18) "' name='RPMH_ARC_SW_OVERRIDE_BR_EVENT_MASK_RM6'/>"
WRITE #1 "        <register address='0xb7fec40' value='0x" DATA.LONG(A:0xb7fec40) "' name='RPMH_ARC_SW_OVERRIDE_MEM_ACC_VAL_RM0'/>"
WRITE #1 "        <register address='0xb7fec44' value='0x" DATA.LONG(A:0xb7fec44) "' name='RPMH_ARC_SW_OVERRIDE_MEM_ACC_VAL_RM1'/>"
WRITE #1 "        <register address='0xb7fec48' value='0x" DATA.LONG(A:0xb7fec48) "' name='RPMH_ARC_SW_OVERRIDE_MEM_ACC_VAL_RM2'/>"
WRITE #1 "        <register address='0xb7fec4c' value='0x" DATA.LONG(A:0xb7fec4c) "' name='RPMH_ARC_SW_OVERRIDE_MEM_ACC_VAL_RM3'/>"
WRITE #1 "        <register address='0xb7fec50' value='0x" DATA.LONG(A:0xb7fec50) "' name='RPMH_ARC_SW_OVERRIDE_MEM_ACC_VAL_RM4'/>"
WRITE #1 "        <register address='0xb7fec54' value='0x" DATA.LONG(A:0xb7fec54) "' name='RPMH_ARC_SW_OVERRIDE_MEM_ACC_VAL_RM5'/>"
WRITE #1 "        <register address='0xb7fec58' value='0x" DATA.LONG(A:0xb7fec58) "' name='RPMH_ARC_SW_OVERRIDE_MEM_ACC_VAL_RM6'/>"
WRITE #1 "        <register address='0xb7fec80' value='0x" DATA.LONG(A:0xb7fec80) "' name='RPMH_ARC_SW_OVERRIDE_MEM_ACC_MASK_RM0'/>"
WRITE #1 "        <register address='0xb7fec84' value='0x" DATA.LONG(A:0xb7fec84) "' name='RPMH_ARC_SW_OVERRIDE_MEM_ACC_MASK_RM1'/>"
WRITE #1 "        <register address='0xb7fec88' value='0x" DATA.LONG(A:0xb7fec88) "' name='RPMH_ARC_SW_OVERRIDE_MEM_ACC_MASK_RM2'/>"
WRITE #1 "        <register address='0xb7fec8c' value='0x" DATA.LONG(A:0xb7fec8c) "' name='RPMH_ARC_SW_OVERRIDE_MEM_ACC_MASK_RM3'/>"
WRITE #1 "        <register address='0xb7fec90' value='0x" DATA.LONG(A:0xb7fec90) "' name='RPMH_ARC_SW_OVERRIDE_MEM_ACC_MASK_RM4'/>"
WRITE #1 "        <register address='0xb7fec94' value='0x" DATA.LONG(A:0xb7fec94) "' name='RPMH_ARC_SW_OVERRIDE_MEM_ACC_MASK_RM5'/>"
WRITE #1 "        <register address='0xb7fec98' value='0x" DATA.LONG(A:0xb7fec98) "' name='RPMH_ARC_SW_OVERRIDE_MEM_ACC_MASK_RM6'/>"
WRITE #1 "        <register address='0xb7fed00' value='0x" DATA.LONG(A:0xb7fed00) "' name='RPMH_ARC_SW_UNBLOCK_SEQ_PRE_RM0'/>"
WRITE #1 "        <register address='0xb7fed04' value='0x" DATA.LONG(A:0xb7fed04) "' name='RPMH_ARC_SW_UNBLOCK_SEQ_PRE_RM1'/>"
WRITE #1 "        <register address='0xb7fed08' value='0x" DATA.LONG(A:0xb7fed08) "' name='RPMH_ARC_SW_UNBLOCK_SEQ_PRE_RM2'/>"
WRITE #1 "        <register address='0xb7fed0c' value='0x" DATA.LONG(A:0xb7fed0c) "' name='RPMH_ARC_SW_UNBLOCK_SEQ_PRE_RM3'/>"
WRITE #1 "        <register address='0xb7fed10' value='0x" DATA.LONG(A:0xb7fed10) "' name='RPMH_ARC_SW_UNBLOCK_SEQ_PRE_RM4'/>"
WRITE #1 "        <register address='0xb7fed14' value='0x" DATA.LONG(A:0xb7fed14) "' name='RPMH_ARC_SW_UNBLOCK_SEQ_PRE_RM5'/>"
WRITE #1 "        <register address='0xb7fed18' value='0x" DATA.LONG(A:0xb7fed18) "' name='RPMH_ARC_SW_UNBLOCK_SEQ_PRE_RM6'/>"
WRITE #1 "        <register address='0xb7fed40' value='0x" DATA.LONG(A:0xb7fed40) "' name='RPMH_ARC_SW_UNBLOCK_SEQ_POST_RM0'/>"
WRITE #1 "        <register address='0xb7fed44' value='0x" DATA.LONG(A:0xb7fed44) "' name='RPMH_ARC_SW_UNBLOCK_SEQ_POST_RM1'/>"
WRITE #1 "        <register address='0xb7fed48' value='0x" DATA.LONG(A:0xb7fed48) "' name='RPMH_ARC_SW_UNBLOCK_SEQ_POST_RM2'/>"
WRITE #1 "        <register address='0xb7fed4c' value='0x" DATA.LONG(A:0xb7fed4c) "' name='RPMH_ARC_SW_UNBLOCK_SEQ_POST_RM3'/>"
WRITE #1 "        <register address='0xb7fed50' value='0x" DATA.LONG(A:0xb7fed50) "' name='RPMH_ARC_SW_UNBLOCK_SEQ_POST_RM4'/>"
WRITE #1 "        <register address='0xb7fed54' value='0x" DATA.LONG(A:0xb7fed54) "' name='RPMH_ARC_SW_UNBLOCK_SEQ_POST_RM5'/>"
WRITE #1 "        <register address='0xb7fed58' value='0x" DATA.LONG(A:0xb7fed58) "' name='RPMH_ARC_SW_UNBLOCK_SEQ_POST_RM6'/>"
WRITE #1 "        <register address='0xb7ff000' value='0x" DATA.LONG(A:0xb7ff000) "' name='RPMH_ARC_SEQ_MEM_0'/>"
WRITE #1 "        <register address='0xb7ff004' value='0x" DATA.LONG(A:0xb7ff004) "' name='RPMH_ARC_SEQ_MEM_1'/>"
WRITE #1 "        <register address='0xb7ff008' value='0x" DATA.LONG(A:0xb7ff008) "' name='RPMH_ARC_SEQ_MEM_2'/>"
WRITE #1 "        <register address='0xb7ff00c' value='0x" DATA.LONG(A:0xb7ff00c) "' name='RPMH_ARC_SEQ_MEM_3'/>"
WRITE #1 "        <register address='0xb7ff010' value='0x" DATA.LONG(A:0xb7ff010) "' name='RPMH_ARC_SEQ_MEM_4'/>"
WRITE #1 "        <register address='0xb7ff014' value='0x" DATA.LONG(A:0xb7ff014) "' name='RPMH_ARC_SEQ_MEM_5'/>"
WRITE #1 "        <register address='0xb7ff018' value='0x" DATA.LONG(A:0xb7ff018) "' name='RPMH_ARC_SEQ_MEM_6'/>"
WRITE #1 "        <register address='0xb7ff01c' value='0x" DATA.LONG(A:0xb7ff01c) "' name='RPMH_ARC_SEQ_MEM_7'/>"
WRITE #1 "        <register address='0xb7ff020' value='0x" DATA.LONG(A:0xb7ff020) "' name='RPMH_ARC_SEQ_MEM_8'/>"
WRITE #1 "        <register address='0xb7ff024' value='0x" DATA.LONG(A:0xb7ff024) "' name='RPMH_ARC_SEQ_MEM_9'/>"
WRITE #1 "        <register address='0xb7ff028' value='0x" DATA.LONG(A:0xb7ff028) "' name='RPMH_ARC_SEQ_MEM_10'/>"
WRITE #1 "        <register address='0xb7ff02c' value='0x" DATA.LONG(A:0xb7ff02c) "' name='RPMH_ARC_SEQ_MEM_11'/>"
WRITE #1 "        <register address='0xb7ff030' value='0x" DATA.LONG(A:0xb7ff030) "' name='RPMH_ARC_SEQ_MEM_12'/>"
WRITE #1 "        <register address='0xb7ff034' value='0x" DATA.LONG(A:0xb7ff034) "' name='RPMH_ARC_SEQ_MEM_13'/>"
WRITE #1 "        <register address='0xb7ff038' value='0x" DATA.LONG(A:0xb7ff038) "' name='RPMH_ARC_SEQ_MEM_14'/>"
WRITE #1 "        <register address='0xb7ff03c' value='0x" DATA.LONG(A:0xb7ff03c) "' name='RPMH_ARC_SEQ_MEM_15'/>"
WRITE #1 "        <register address='0xb7ff040' value='0x" DATA.LONG(A:0xb7ff040) "' name='RPMH_ARC_SEQ_MEM_16'/>"
WRITE #1 "        <register address='0xb7ff044' value='0x" DATA.LONG(A:0xb7ff044) "' name='RPMH_ARC_SEQ_MEM_17'/>"
WRITE #1 "        <register address='0xb7ff048' value='0x" DATA.LONG(A:0xb7ff048) "' name='RPMH_ARC_SEQ_MEM_18'/>"
WRITE #1 "        <register address='0xb7ff04c' value='0x" DATA.LONG(A:0xb7ff04c) "' name='RPMH_ARC_SEQ_MEM_19'/>"
WRITE #1 "        <register address='0xb7ff050' value='0x" DATA.LONG(A:0xb7ff050) "' name='RPMH_ARC_SEQ_MEM_20'/>"
WRITE #1 "        <register address='0xb7ff054' value='0x" DATA.LONG(A:0xb7ff054) "' name='RPMH_ARC_SEQ_MEM_21'/>"
WRITE #1 "        <register address='0xb7ff058' value='0x" DATA.LONG(A:0xb7ff058) "' name='RPMH_ARC_SEQ_MEM_22'/>"
WRITE #1 "        <register address='0xb7ff05c' value='0x" DATA.LONG(A:0xb7ff05c) "' name='RPMH_ARC_SEQ_MEM_23'/>"
WRITE #1 "        <register address='0xb7ff060' value='0x" DATA.LONG(A:0xb7ff060) "' name='RPMH_ARC_SEQ_MEM_24'/>"
WRITE #1 "        <register address='0xb7ff064' value='0x" DATA.LONG(A:0xb7ff064) "' name='RPMH_ARC_SEQ_MEM_25'/>"
WRITE #1 "        <register address='0xb7ff068' value='0x" DATA.LONG(A:0xb7ff068) "' name='RPMH_ARC_SEQ_MEM_26'/>"
WRITE #1 "        <register address='0xb7ff06c' value='0x" DATA.LONG(A:0xb7ff06c) "' name='RPMH_ARC_SEQ_MEM_27'/>"
WRITE #1 "        <register address='0xb7ff070' value='0x" DATA.LONG(A:0xb7ff070) "' name='RPMH_ARC_SEQ_MEM_28'/>"
WRITE #1 "        <register address='0xb7ff074' value='0x" DATA.LONG(A:0xb7ff074) "' name='RPMH_ARC_SEQ_MEM_29'/>"
WRITE #1 "        <register address='0xb7ff078' value='0x" DATA.LONG(A:0xb7ff078) "' name='RPMH_ARC_SEQ_MEM_30'/>"
WRITE #1 "        <register address='0xb7ff07c' value='0x" DATA.LONG(A:0xb7ff07c) "' name='RPMH_ARC_SEQ_MEM_31'/>"
WRITE #1 "        <register address='0xb7ff080' value='0x" DATA.LONG(A:0xb7ff080) "' name='RPMH_ARC_SEQ_MEM_32'/>"
WRITE #1 "        <register address='0xb7ff084' value='0x" DATA.LONG(A:0xb7ff084) "' name='RPMH_ARC_SEQ_MEM_33'/>"
WRITE #1 "        <register address='0xb7ff088' value='0x" DATA.LONG(A:0xb7ff088) "' name='RPMH_ARC_SEQ_MEM_34'/>"
WRITE #1 "        <register address='0xb7ff08c' value='0x" DATA.LONG(A:0xb7ff08c) "' name='RPMH_ARC_SEQ_MEM_35'/>"
WRITE #1 "        <register address='0xb7ff090' value='0x" DATA.LONG(A:0xb7ff090) "' name='RPMH_ARC_SEQ_MEM_36'/>"
WRITE #1 "        <register address='0xb7ff094' value='0x" DATA.LONG(A:0xb7ff094) "' name='RPMH_ARC_SEQ_MEM_37'/>"
WRITE #1 "        <register address='0xb7ff098' value='0x" DATA.LONG(A:0xb7ff098) "' name='RPMH_ARC_SEQ_MEM_38'/>"
WRITE #1 "        <register address='0xb7ff09c' value='0x" DATA.LONG(A:0xb7ff09c) "' name='RPMH_ARC_SEQ_MEM_39'/>"
WRITE #1 "        <register address='0xb7ff0a0' value='0x" DATA.LONG(A:0xb7ff0a0) "' name='RPMH_ARC_SEQ_MEM_40'/>"
WRITE #1 "        <register address='0xb7ff0a4' value='0x" DATA.LONG(A:0xb7ff0a4) "' name='RPMH_ARC_SEQ_MEM_41'/>"
WRITE #1 "        <register address='0xb7ff0a8' value='0x" DATA.LONG(A:0xb7ff0a8) "' name='RPMH_ARC_SEQ_MEM_42'/>"
WRITE #1 "        <register address='0xb7ff0ac' value='0x" DATA.LONG(A:0xb7ff0ac) "' name='RPMH_ARC_SEQ_MEM_43'/>"
WRITE #1 "        <register address='0xb7ff0b0' value='0x" DATA.LONG(A:0xb7ff0b0) "' name='RPMH_ARC_SEQ_MEM_44'/>"
WRITE #1 "        <register address='0xb7ff0b4' value='0x" DATA.LONG(A:0xb7ff0b4) "' name='RPMH_ARC_SEQ_MEM_45'/>"
WRITE #1 "        <register address='0xb7ff0b8' value='0x" DATA.LONG(A:0xb7ff0b8) "' name='RPMH_ARC_SEQ_MEM_46'/>"
WRITE #1 "        <register address='0xb7ff0bc' value='0x" DATA.LONG(A:0xb7ff0bc) "' name='RPMH_ARC_SEQ_MEM_47'/>"
WRITE #1 "        <register address='0xb7ff0c0' value='0x" DATA.LONG(A:0xb7ff0c0) "' name='RPMH_ARC_SEQ_MEM_48'/>"
WRITE #1 "        <register address='0xb7ff0c4' value='0x" DATA.LONG(A:0xb7ff0c4) "' name='RPMH_ARC_SEQ_MEM_49'/>"
WRITE #1 "        <register address='0xb7ff0c8' value='0x" DATA.LONG(A:0xb7ff0c8) "' name='RPMH_ARC_SEQ_MEM_50'/>"
WRITE #1 "        <register address='0xb7ff0cc' value='0x" DATA.LONG(A:0xb7ff0cc) "' name='RPMH_ARC_SEQ_MEM_51'/>"
WRITE #1 "        <register address='0xb7ff0d0' value='0x" DATA.LONG(A:0xb7ff0d0) "' name='RPMH_ARC_SEQ_MEM_52'/>"
WRITE #1 "        <register address='0xb7ff0d4' value='0x" DATA.LONG(A:0xb7ff0d4) "' name='RPMH_ARC_SEQ_MEM_53'/>"
WRITE #1 "        <register address='0xb7ff0d8' value='0x" DATA.LONG(A:0xb7ff0d8) "' name='RPMH_ARC_SEQ_MEM_54'/>"
WRITE #1 "        <register address='0xb7ff0dc' value='0x" DATA.LONG(A:0xb7ff0dc) "' name='RPMH_ARC_SEQ_MEM_55'/>"
WRITE #1 "        <register address='0xb7ff0e0' value='0x" DATA.LONG(A:0xb7ff0e0) "' name='RPMH_ARC_SEQ_MEM_56'/>"
WRITE #1 "        <register address='0xb7ff0e4' value='0x" DATA.LONG(A:0xb7ff0e4) "' name='RPMH_ARC_SEQ_MEM_57'/>"
WRITE #1 "        <register address='0xb7ff0e8' value='0x" DATA.LONG(A:0xb7ff0e8) "' name='RPMH_ARC_SEQ_MEM_58'/>"
WRITE #1 "        <register address='0xb7ff0ec' value='0x" DATA.LONG(A:0xb7ff0ec) "' name='RPMH_ARC_SEQ_MEM_59'/>"
WRITE #1 "        <register address='0xb7ff0f0' value='0x" DATA.LONG(A:0xb7ff0f0) "' name='RPMH_ARC_SEQ_MEM_60'/>"
WRITE #1 "        <register address='0xb7ff0f4' value='0x" DATA.LONG(A:0xb7ff0f4) "' name='RPMH_ARC_SEQ_MEM_61'/>"
WRITE #1 "        <register address='0xb7ff0f8' value='0x" DATA.LONG(A:0xb7ff0f8) "' name='RPMH_ARC_SEQ_MEM_62'/>"
WRITE #1 "        <register address='0xb7ff0fc' value='0x" DATA.LONG(A:0xb7ff0fc) "' name='RPMH_ARC_SEQ_MEM_63'/>"
WRITE #1 "        <register address='0xb7ff100' value='0x" DATA.LONG(A:0xb7ff100) "' name='RPMH_ARC_SEQ_MEM_64'/>"
WRITE #1 "        <register address='0xb7ff104' value='0x" DATA.LONG(A:0xb7ff104) "' name='RPMH_ARC_SEQ_MEM_65'/>"
WRITE #1 "        <register address='0xb7ff108' value='0x" DATA.LONG(A:0xb7ff108) "' name='RPMH_ARC_SEQ_MEM_66'/>"
WRITE #1 "        <register address='0xb7ff10c' value='0x" DATA.LONG(A:0xb7ff10c) "' name='RPMH_ARC_SEQ_MEM_67'/>"
WRITE #1 "        <register address='0xb7ff110' value='0x" DATA.LONG(A:0xb7ff110) "' name='RPMH_ARC_SEQ_MEM_68'/>"
WRITE #1 "        <register address='0xb7ff114' value='0x" DATA.LONG(A:0xb7ff114) "' name='RPMH_ARC_SEQ_MEM_69'/>"
WRITE #1 "        <register address='0xb7ff118' value='0x" DATA.LONG(A:0xb7ff118) "' name='RPMH_ARC_SEQ_MEM_70'/>"
WRITE #1 "        <register address='0xb7ff11c' value='0x" DATA.LONG(A:0xb7ff11c) "' name='RPMH_ARC_SEQ_MEM_71'/>"
WRITE #1 "        <register address='0xb7ff120' value='0x" DATA.LONG(A:0xb7ff120) "' name='RPMH_ARC_SEQ_MEM_72'/>"
WRITE #1 "        <register address='0xb7ff124' value='0x" DATA.LONG(A:0xb7ff124) "' name='RPMH_ARC_SEQ_MEM_73'/>"
WRITE #1 "        <register address='0xb7ff128' value='0x" DATA.LONG(A:0xb7ff128) "' name='RPMH_ARC_SEQ_MEM_74'/>"
WRITE #1 "        <register address='0xb7ff12c' value='0x" DATA.LONG(A:0xb7ff12c) "' name='RPMH_ARC_SEQ_MEM_75'/>"
WRITE #1 "        <register address='0xb7ff130' value='0x" DATA.LONG(A:0xb7ff130) "' name='RPMH_ARC_SEQ_MEM_76'/>"
WRITE #1 "        <register address='0xb7ff134' value='0x" DATA.LONG(A:0xb7ff134) "' name='RPMH_ARC_SEQ_MEM_77'/>"
WRITE #1 "        <register address='0xb7ff138' value='0x" DATA.LONG(A:0xb7ff138) "' name='RPMH_ARC_SEQ_MEM_78'/>"
WRITE #1 "        <register address='0xb7ff13c' value='0x" DATA.LONG(A:0xb7ff13c) "' name='RPMH_ARC_SEQ_MEM_79'/>"
WRITE #1 "        <register address='0xb7ff140' value='0x" DATA.LONG(A:0xb7ff140) "' name='RPMH_ARC_SEQ_MEM_80'/>"
WRITE #1 "        <register address='0xb7ff144' value='0x" DATA.LONG(A:0xb7ff144) "' name='RPMH_ARC_SEQ_MEM_81'/>"
WRITE #1 "        <register address='0xb7ff148' value='0x" DATA.LONG(A:0xb7ff148) "' name='RPMH_ARC_SEQ_MEM_82'/>"
WRITE #1 "        <register address='0xb7ff14c' value='0x" DATA.LONG(A:0xb7ff14c) "' name='RPMH_ARC_SEQ_MEM_83'/>"
WRITE #1 "        <register address='0xb7ff150' value='0x" DATA.LONG(A:0xb7ff150) "' name='RPMH_ARC_SEQ_MEM_84'/>"
WRITE #1 "        <register address='0xb7ff154' value='0x" DATA.LONG(A:0xb7ff154) "' name='RPMH_ARC_SEQ_MEM_85'/>"
WRITE #1 "        <register address='0xb7ff158' value='0x" DATA.LONG(A:0xb7ff158) "' name='RPMH_ARC_SEQ_MEM_86'/>"
WRITE #1 "        <register address='0xb7ff15c' value='0x" DATA.LONG(A:0xb7ff15c) "' name='RPMH_ARC_SEQ_MEM_87'/>"
WRITE #1 "        <register address='0xb7ff160' value='0x" DATA.LONG(A:0xb7ff160) "' name='RPMH_ARC_SEQ_MEM_88'/>"
WRITE #1 "        <register address='0xb7ff164' value='0x" DATA.LONG(A:0xb7ff164) "' name='RPMH_ARC_SEQ_MEM_89'/>"
WRITE #1 "        <register address='0xb7ff168' value='0x" DATA.LONG(A:0xb7ff168) "' name='RPMH_ARC_SEQ_MEM_90'/>"
WRITE #1 "        <register address='0xb7ff16c' value='0x" DATA.LONG(A:0xb7ff16c) "' name='RPMH_ARC_SEQ_MEM_91'/>"
WRITE #1 "        <register address='0xb7ff170' value='0x" DATA.LONG(A:0xb7ff170) "' name='RPMH_ARC_SEQ_MEM_92'/>"
WRITE #1 "        <register address='0xb7ff174' value='0x" DATA.LONG(A:0xb7ff174) "' name='RPMH_ARC_SEQ_MEM_93'/>"
WRITE #1 "        <register address='0xb7ff178' value='0x" DATA.LONG(A:0xb7ff178) "' name='RPMH_ARC_SEQ_MEM_94'/>"
WRITE #1 "        <register address='0xb7ff17c' value='0x" DATA.LONG(A:0xb7ff17c) "' name='RPMH_ARC_SEQ_MEM_95'/>"
WRITE #1 "        <register address='0xb7ff200' value='0x" DATA.LONG(A:0xb7ff200) "' name='RPMH_ARC_SEQ_UP_BR_ADDR0'/>"
WRITE #1 "        <register address='0xb7ff204' value='0x" DATA.LONG(A:0xb7ff204) "' name='RPMH_ARC_SEQ_UP_BR_ADDR1'/>"
WRITE #1 "        <register address='0xb7ff208' value='0x" DATA.LONG(A:0xb7ff208) "' name='RPMH_ARC_SEQ_UP_BR_ADDR2'/>"
WRITE #1 "        <register address='0xb7ff20c' value='0x" DATA.LONG(A:0xb7ff20c) "' name='RPMH_ARC_SEQ_UP_BR_ADDR3'/>"
WRITE #1 "        <register address='0xb7ff210' value='0x" DATA.LONG(A:0xb7ff210) "' name='RPMH_ARC_SEQ_UP_BR_ADDR4'/>"
WRITE #1 "        <register address='0xb7ff214' value='0x" DATA.LONG(A:0xb7ff214) "' name='RPMH_ARC_SEQ_UP_BR_ADDR5'/>"
WRITE #1 "        <register address='0xb7ff218' value='0x" DATA.LONG(A:0xb7ff218) "' name='RPMH_ARC_SEQ_UP_BR_ADDR6'/>"
WRITE #1 "        <register address='0xb7ff21c' value='0x" DATA.LONG(A:0xb7ff21c) "' name='RPMH_ARC_SEQ_UP_BR_ADDR7'/>"
WRITE #1 "        <register address='0xb7ff220' value='0x" DATA.LONG(A:0xb7ff220) "' name='RPMH_ARC_SEQ_UP_BR_ADDR8'/>"
WRITE #1 "        <register address='0xb7ff224' value='0x" DATA.LONG(A:0xb7ff224) "' name='RPMH_ARC_SEQ_UP_BR_ADDR9'/>"
WRITE #1 "        <register address='0xb7ff228' value='0x" DATA.LONG(A:0xb7ff228) "' name='RPMH_ARC_SEQ_UP_BR_ADDR10'/>"
WRITE #1 "        <register address='0xb7ff22c' value='0x" DATA.LONG(A:0xb7ff22c) "' name='RPMH_ARC_SEQ_UP_BR_ADDR11'/>"
WRITE #1 "        <register address='0xb7ff230' value='0x" DATA.LONG(A:0xb7ff230) "' name='RPMH_ARC_SEQ_UP_BR_ADDR12'/>"
WRITE #1 "        <register address='0xb7ff234' value='0x" DATA.LONG(A:0xb7ff234) "' name='RPMH_ARC_SEQ_UP_BR_ADDR13'/>"
WRITE #1 "        <register address='0xb7ff238' value='0x" DATA.LONG(A:0xb7ff238) "' name='RPMH_ARC_SEQ_UP_BR_ADDR14'/>"
WRITE #1 "        <register address='0xb7ff23c' value='0x" DATA.LONG(A:0xb7ff23c) "' name='RPMH_ARC_SEQ_UP_BR_ADDR15'/>"
WRITE #1 "        <register address='0xb7ff300' value='0x" DATA.LONG(A:0xb7ff300) "' name='RPMH_ARC_SEQ_DOWN_BR_ADDR0'/>"
WRITE #1 "        <register address='0xb7ff304' value='0x" DATA.LONG(A:0xb7ff304) "' name='RPMH_ARC_SEQ_DOWN_BR_ADDR1'/>"
WRITE #1 "        <register address='0xb7ff308' value='0x" DATA.LONG(A:0xb7ff308) "' name='RPMH_ARC_SEQ_DOWN_BR_ADDR2'/>"
WRITE #1 "        <register address='0xb7ff30c' value='0x" DATA.LONG(A:0xb7ff30c) "' name='RPMH_ARC_SEQ_DOWN_BR_ADDR3'/>"
WRITE #1 "        <register address='0xb7ff310' value='0x" DATA.LONG(A:0xb7ff310) "' name='RPMH_ARC_SEQ_DOWN_BR_ADDR4'/>"
WRITE #1 "        <register address='0xb7ff314' value='0x" DATA.LONG(A:0xb7ff314) "' name='RPMH_ARC_SEQ_DOWN_BR_ADDR5'/>"
WRITE #1 "        <register address='0xb7ff318' value='0x" DATA.LONG(A:0xb7ff318) "' name='RPMH_ARC_SEQ_DOWN_BR_ADDR6'/>"
WRITE #1 "        <register address='0xb7ff31c' value='0x" DATA.LONG(A:0xb7ff31c) "' name='RPMH_ARC_SEQ_DOWN_BR_ADDR7'/>"
WRITE #1 "        <register address='0xb7ff320' value='0x" DATA.LONG(A:0xb7ff320) "' name='RPMH_ARC_SEQ_DOWN_BR_ADDR8'/>"
WRITE #1 "        <register address='0xb7ff324' value='0x" DATA.LONG(A:0xb7ff324) "' name='RPMH_ARC_SEQ_DOWN_BR_ADDR9'/>"
WRITE #1 "        <register address='0xb7ff328' value='0x" DATA.LONG(A:0xb7ff328) "' name='RPMH_ARC_SEQ_DOWN_BR_ADDR10'/>"
WRITE #1 "        <register address='0xb7ff32c' value='0x" DATA.LONG(A:0xb7ff32c) "' name='RPMH_ARC_SEQ_DOWN_BR_ADDR11'/>"
WRITE #1 "        <register address='0xb7ff330' value='0x" DATA.LONG(A:0xb7ff330) "' name='RPMH_ARC_SEQ_DOWN_BR_ADDR12'/>"
WRITE #1 "        <register address='0xb7ff334' value='0x" DATA.LONG(A:0xb7ff334) "' name='RPMH_ARC_SEQ_DOWN_BR_ADDR13'/>"
WRITE #1 "        <register address='0xb7ff338' value='0x" DATA.LONG(A:0xb7ff338) "' name='RPMH_ARC_SEQ_DOWN_BR_ADDR14'/>"
WRITE #1 "        <register address='0xb7ff33c' value='0x" DATA.LONG(A:0xb7ff33c) "' name='RPMH_ARC_SEQ_DOWN_BR_ADDR15'/>"
WRITE #1 "        <register address='0xb7ff400' value='0x" DATA.LONG(A:0xb7ff400) "' name='RPMH_ARC_SEQ_SW_CONF_ADDR0'/>"
WRITE #1 "        <register address='0xb7ff404' value='0x" DATA.LONG(A:0xb7ff404) "' name='RPMH_ARC_SEQ_SW_CONF_ADDR1'/>"
WRITE #1 "        <register address='0xb7ff408' value='0x" DATA.LONG(A:0xb7ff408) "' name='RPMH_ARC_SEQ_SW_CONF_ADDR2'/>"
WRITE #1 "        <register address='0xb7ff40c' value='0x" DATA.LONG(A:0xb7ff40c) "' name='RPMH_ARC_SEQ_SW_CONF_ADDR3'/>"
WRITE #1 "        <register address='0xb7ff410' value='0x" DATA.LONG(A:0xb7ff410) "' name='RPMH_ARC_SEQ_SW_CONF_ADDR4'/>"
WRITE #1 "        <register address='0xb7ff414' value='0x" DATA.LONG(A:0xb7ff414) "' name='RPMH_ARC_SEQ_SW_CONF_ADDR5'/>"
WRITE #1 "        <register address='0xb7ff418' value='0x" DATA.LONG(A:0xb7ff418) "' name='RPMH_ARC_SEQ_SW_CONF_ADDR6'/>"
WRITE #1 "        <register address='0xb7ff41c' value='0x" DATA.LONG(A:0xb7ff41c) "' name='RPMH_ARC_SEQ_SW_CONF_ADDR7'/>"
WRITE #1 "        <register address='0xb7ff420' value='0x" DATA.LONG(A:0xb7ff420) "' name='RPMH_ARC_SEQ_SW_CONF_ADDR8'/>"
WRITE #1 "        <register address='0xb7ff424' value='0x" DATA.LONG(A:0xb7ff424) "' name='RPMH_ARC_SEQ_SW_CONF_ADDR9'/>"
WRITE #1 "        <register address='0xb7ff428' value='0x" DATA.LONG(A:0xb7ff428) "' name='RPMH_ARC_SEQ_SW_CONF_ADDR10'/>"
WRITE #1 "        <register address='0xb7ff42c' value='0x" DATA.LONG(A:0xb7ff42c) "' name='RPMH_ARC_SEQ_SW_CONF_ADDR11'/>"
WRITE #1 "        <register address='0xb7ff430' value='0x" DATA.LONG(A:0xb7ff430) "' name='RPMH_ARC_SEQ_SW_CONF_ADDR12'/>"
WRITE #1 "        <register address='0xb7ff434' value='0x" DATA.LONG(A:0xb7ff434) "' name='RPMH_ARC_SEQ_SW_CONF_ADDR13'/>"
WRITE #1 "        <register address='0xb7ff438' value='0x" DATA.LONG(A:0xb7ff438) "' name='RPMH_ARC_SEQ_SW_CONF_ADDR14'/>"
WRITE #1 "        <register address='0xb7ff43c' value='0x" DATA.LONG(A:0xb7ff43c) "' name='RPMH_ARC_SEQ_SW_CONF_ADDR15'/>"
WRITE #1 "        <register address='0xb800000' value='0x" DATA.LONG(A:0xb800000) "' name='RPMH_VRM_VOLTAGE_VOTE_DRV0_REG0'/>"
WRITE #1 "        <register address='0xb800100' value='0x" DATA.LONG(A:0xb800100) "' name='RPMH_VRM_VOLTAGE_VOTE_DRV0_REG1'/>"
WRITE #1 "        <register address='0xb800200' value='0x" DATA.LONG(A:0xb800200) "' name='RPMH_VRM_VOLTAGE_VOTE_DRV0_REG2'/>"
WRITE #1 "        <register address='0xb800300' value='0x" DATA.LONG(A:0xb800300) "' name='RPMH_VRM_VOLTAGE_VOTE_DRV0_REG3'/>"
WRITE #1 "        <register address='0xb800400' value='0x" DATA.LONG(A:0xb800400) "' name='RPMH_VRM_VOLTAGE_VOTE_DRV0_REG4'/>"
WRITE #1 "        <register address='0xb800500' value='0x" DATA.LONG(A:0xb800500) "' name='RPMH_VRM_VOLTAGE_VOTE_DRV0_REG5'/>"
WRITE #1 "        <register address='0xb800600' value='0x" DATA.LONG(A:0xb800600) "' name='RPMH_VRM_VOLTAGE_VOTE_DRV0_REG6'/>"
WRITE #1 "        <register address='0xb800700' value='0x" DATA.LONG(A:0xb800700) "' name='RPMH_VRM_VOLTAGE_VOTE_DRV0_REG7'/>"
WRITE #1 "        <register address='0xb800800' value='0x" DATA.LONG(A:0xb800800) "' name='RPMH_VRM_VOLTAGE_VOTE_DRV0_REG8'/>"
WRITE #1 "        <register address='0xb800900' value='0x" DATA.LONG(A:0xb800900) "' name='RPMH_VRM_VOLTAGE_VOTE_DRV0_REG9'/>"
WRITE #1 "        <register address='0xb800a00' value='0x" DATA.LONG(A:0xb800a00) "' name='RPMH_VRM_VOLTAGE_VOTE_DRV0_REG10'/>"
WRITE #1 "        <register address='0xb800b00' value='0x" DATA.LONG(A:0xb800b00) "' name='RPMH_VRM_VOLTAGE_VOTE_DRV0_REG11'/>"
WRITE #1 "        <register address='0xb800c00' value='0x" DATA.LONG(A:0xb800c00) "' name='RPMH_VRM_VOLTAGE_VOTE_DRV0_REG12'/>"
WRITE #1 "        <register address='0xb800d00' value='0x" DATA.LONG(A:0xb800d00) "' name='RPMH_VRM_VOLTAGE_VOTE_DRV0_REG13'/>"
WRITE #1 "        <register address='0xb800e00' value='0x" DATA.LONG(A:0xb800e00) "' name='RPMH_VRM_VOLTAGE_VOTE_DRV0_REG14'/>"
WRITE #1 "        <register address='0xb800f00' value='0x" DATA.LONG(A:0xb800f00) "' name='RPMH_VRM_VOLTAGE_VOTE_DRV0_REG15'/>"
WRITE #1 "        <register address='0xb801000' value='0x" DATA.LONG(A:0xb801000) "' name='RPMH_VRM_VOLTAGE_VOTE_DRV0_REG16'/>"
WRITE #1 "        <register address='0xb801100' value='0x" DATA.LONG(A:0xb801100) "' name='RPMH_VRM_VOLTAGE_VOTE_DRV0_REG17'/>"
WRITE #1 "        <register address='0xb801200' value='0x" DATA.LONG(A:0xb801200) "' name='RPMH_VRM_VOLTAGE_VOTE_DRV0_REG18'/>"
WRITE #1 "        <register address='0xb801300' value='0x" DATA.LONG(A:0xb801300) "' name='RPMH_VRM_VOLTAGE_VOTE_DRV0_REG19'/>"
WRITE #1 "        <register address='0xb801400' value='0x" DATA.LONG(A:0xb801400) "' name='RPMH_VRM_VOLTAGE_VOTE_DRV0_REG20'/>"
WRITE #1 "        <register address='0xb801500' value='0x" DATA.LONG(A:0xb801500) "' name='RPMH_VRM_VOLTAGE_VOTE_DRV0_REG21'/>"
WRITE #1 "        <register address='0xb801600' value='0x" DATA.LONG(A:0xb801600) "' name='RPMH_VRM_VOLTAGE_VOTE_DRV0_REG22'/>"
WRITE #1 "        <register address='0xb801700' value='0x" DATA.LONG(A:0xb801700) "' name='RPMH_VRM_VOLTAGE_VOTE_DRV0_REG23'/>"
WRITE #1 "        <register address='0xb801800' value='0x" DATA.LONG(A:0xb801800) "' name='RPMH_VRM_VOLTAGE_VOTE_DRV0_REG24'/>"
WRITE #1 "        <register address='0xb810000' value='0x" DATA.LONG(A:0xb810000) "' name='RPMH_VRM_VOLTAGE_VOTE_DRV1_REG0'/>"
WRITE #1 "        <register address='0xb810100' value='0x" DATA.LONG(A:0xb810100) "' name='RPMH_VRM_VOLTAGE_VOTE_DRV1_REG1'/>"
WRITE #1 "        <register address='0xb810200' value='0x" DATA.LONG(A:0xb810200) "' name='RPMH_VRM_VOLTAGE_VOTE_DRV1_REG2'/>"
WRITE #1 "        <register address='0xb810300' value='0x" DATA.LONG(A:0xb810300) "' name='RPMH_VRM_VOLTAGE_VOTE_DRV1_REG3'/>"
WRITE #1 "        <register address='0xb810400' value='0x" DATA.LONG(A:0xb810400) "' name='RPMH_VRM_VOLTAGE_VOTE_DRV1_REG4'/>"
WRITE #1 "        <register address='0xb810500' value='0x" DATA.LONG(A:0xb810500) "' name='RPMH_VRM_VOLTAGE_VOTE_DRV1_REG5'/>"
WRITE #1 "        <register address='0xb810600' value='0x" DATA.LONG(A:0xb810600) "' name='RPMH_VRM_VOLTAGE_VOTE_DRV1_REG6'/>"
WRITE #1 "        <register address='0xb810700' value='0x" DATA.LONG(A:0xb810700) "' name='RPMH_VRM_VOLTAGE_VOTE_DRV1_REG7'/>"
WRITE #1 "        <register address='0xb810800' value='0x" DATA.LONG(A:0xb810800) "' name='RPMH_VRM_VOLTAGE_VOTE_DRV1_REG8'/>"
WRITE #1 "        <register address='0xb810900' value='0x" DATA.LONG(A:0xb810900) "' name='RPMH_VRM_VOLTAGE_VOTE_DRV1_REG9'/>"
WRITE #1 "        <register address='0xb810a00' value='0x" DATA.LONG(A:0xb810a00) "' name='RPMH_VRM_VOLTAGE_VOTE_DRV1_REG10'/>"
WRITE #1 "        <register address='0xb810b00' value='0x" DATA.LONG(A:0xb810b00) "' name='RPMH_VRM_VOLTAGE_VOTE_DRV1_REG11'/>"
WRITE #1 "        <register address='0xb810c00' value='0x" DATA.LONG(A:0xb810c00) "' name='RPMH_VRM_VOLTAGE_VOTE_DRV1_REG12'/>"
WRITE #1 "        <register address='0xb810d00' value='0x" DATA.LONG(A:0xb810d00) "' name='RPMH_VRM_VOLTAGE_VOTE_DRV1_REG13'/>"
WRITE #1 "        <register address='0xb810e00' value='0x" DATA.LONG(A:0xb810e00) "' name='RPMH_VRM_VOLTAGE_VOTE_DRV1_REG14'/>"
WRITE #1 "        <register address='0xb810f00' value='0x" DATA.LONG(A:0xb810f00) "' name='RPMH_VRM_VOLTAGE_VOTE_DRV1_REG15'/>"
WRITE #1 "        <register address='0xb811000' value='0x" DATA.LONG(A:0xb811000) "' name='RPMH_VRM_VOLTAGE_VOTE_DRV1_REG16'/>"
WRITE #1 "        <register address='0xb811100' value='0x" DATA.LONG(A:0xb811100) "' name='RPMH_VRM_VOLTAGE_VOTE_DRV1_REG17'/>"
WRITE #1 "        <register address='0xb811200' value='0x" DATA.LONG(A:0xb811200) "' name='RPMH_VRM_VOLTAGE_VOTE_DRV1_REG18'/>"
WRITE #1 "        <register address='0xb811300' value='0x" DATA.LONG(A:0xb811300) "' name='RPMH_VRM_VOLTAGE_VOTE_DRV1_REG19'/>"
WRITE #1 "        <register address='0xb811400' value='0x" DATA.LONG(A:0xb811400) "' name='RPMH_VRM_VOLTAGE_VOTE_DRV1_REG20'/>"
WRITE #1 "        <register address='0xb811500' value='0x" DATA.LONG(A:0xb811500) "' name='RPMH_VRM_VOLTAGE_VOTE_DRV1_REG21'/>"
WRITE #1 "        <register address='0xb811600' value='0x" DATA.LONG(A:0xb811600) "' name='RPMH_VRM_VOLTAGE_VOTE_DRV1_REG22'/>"
WRITE #1 "        <register address='0xb811700' value='0x" DATA.LONG(A:0xb811700) "' name='RPMH_VRM_VOLTAGE_VOTE_DRV1_REG23'/>"
WRITE #1 "        <register address='0xb811800' value='0x" DATA.LONG(A:0xb811800) "' name='RPMH_VRM_VOLTAGE_VOTE_DRV1_REG24'/>"
WRITE #1 "        <register address='0xb820000' value='0x" DATA.LONG(A:0xb820000) "' name='RPMH_VRM_VOLTAGE_VOTE_DRV2_REG0'/>"
WRITE #1 "        <register address='0xb820100' value='0x" DATA.LONG(A:0xb820100) "' name='RPMH_VRM_VOLTAGE_VOTE_DRV2_REG1'/>"
WRITE #1 "        <register address='0xb820200' value='0x" DATA.LONG(A:0xb820200) "' name='RPMH_VRM_VOLTAGE_VOTE_DRV2_REG2'/>"
WRITE #1 "        <register address='0xb820300' value='0x" DATA.LONG(A:0xb820300) "' name='RPMH_VRM_VOLTAGE_VOTE_DRV2_REG3'/>"
WRITE #1 "        <register address='0xb820400' value='0x" DATA.LONG(A:0xb820400) "' name='RPMH_VRM_VOLTAGE_VOTE_DRV2_REG4'/>"
WRITE #1 "        <register address='0xb820500' value='0x" DATA.LONG(A:0xb820500) "' name='RPMH_VRM_VOLTAGE_VOTE_DRV2_REG5'/>"
WRITE #1 "        <register address='0xb820600' value='0x" DATA.LONG(A:0xb820600) "' name='RPMH_VRM_VOLTAGE_VOTE_DRV2_REG6'/>"
WRITE #1 "        <register address='0xb820700' value='0x" DATA.LONG(A:0xb820700) "' name='RPMH_VRM_VOLTAGE_VOTE_DRV2_REG7'/>"
WRITE #1 "        <register address='0xb820800' value='0x" DATA.LONG(A:0xb820800) "' name='RPMH_VRM_VOLTAGE_VOTE_DRV2_REG8'/>"
WRITE #1 "        <register address='0xb820900' value='0x" DATA.LONG(A:0xb820900) "' name='RPMH_VRM_VOLTAGE_VOTE_DRV2_REG9'/>"
WRITE #1 "        <register address='0xb820a00' value='0x" DATA.LONG(A:0xb820a00) "' name='RPMH_VRM_VOLTAGE_VOTE_DRV2_REG10'/>"
WRITE #1 "        <register address='0xb820b00' value='0x" DATA.LONG(A:0xb820b00) "' name='RPMH_VRM_VOLTAGE_VOTE_DRV2_REG11'/>"
WRITE #1 "        <register address='0xb820c00' value='0x" DATA.LONG(A:0xb820c00) "' name='RPMH_VRM_VOLTAGE_VOTE_DRV2_REG12'/>"
WRITE #1 "        <register address='0xb820d00' value='0x" DATA.LONG(A:0xb820d00) "' name='RPMH_VRM_VOLTAGE_VOTE_DRV2_REG13'/>"
WRITE #1 "        <register address='0xb820e00' value='0x" DATA.LONG(A:0xb820e00) "' name='RPMH_VRM_VOLTAGE_VOTE_DRV2_REG14'/>"
WRITE #1 "        <register address='0xb820f00' value='0x" DATA.LONG(A:0xb820f00) "' name='RPMH_VRM_VOLTAGE_VOTE_DRV2_REG15'/>"
WRITE #1 "        <register address='0xb821000' value='0x" DATA.LONG(A:0xb821000) "' name='RPMH_VRM_VOLTAGE_VOTE_DRV2_REG16'/>"
WRITE #1 "        <register address='0xb821100' value='0x" DATA.LONG(A:0xb821100) "' name='RPMH_VRM_VOLTAGE_VOTE_DRV2_REG17'/>"
WRITE #1 "        <register address='0xb821200' value='0x" DATA.LONG(A:0xb821200) "' name='RPMH_VRM_VOLTAGE_VOTE_DRV2_REG18'/>"
WRITE #1 "        <register address='0xb821300' value='0x" DATA.LONG(A:0xb821300) "' name='RPMH_VRM_VOLTAGE_VOTE_DRV2_REG19'/>"
WRITE #1 "        <register address='0xb821400' value='0x" DATA.LONG(A:0xb821400) "' name='RPMH_VRM_VOLTAGE_VOTE_DRV2_REG20'/>"
WRITE #1 "        <register address='0xb821500' value='0x" DATA.LONG(A:0xb821500) "' name='RPMH_VRM_VOLTAGE_VOTE_DRV2_REG21'/>"
WRITE #1 "        <register address='0xb821600' value='0x" DATA.LONG(A:0xb821600) "' name='RPMH_VRM_VOLTAGE_VOTE_DRV2_REG22'/>"
WRITE #1 "        <register address='0xb821700' value='0x" DATA.LONG(A:0xb821700) "' name='RPMH_VRM_VOLTAGE_VOTE_DRV2_REG23'/>"
WRITE #1 "        <register address='0xb821800' value='0x" DATA.LONG(A:0xb821800) "' name='RPMH_VRM_VOLTAGE_VOTE_DRV2_REG24'/>"
WRITE #1 "        <register address='0xb830000' value='0x" DATA.LONG(A:0xb830000) "' name='RPMH_VRM_VOLTAGE_VOTE_DRV3_REG0'/>"
WRITE #1 "        <register address='0xb830100' value='0x" DATA.LONG(A:0xb830100) "' name='RPMH_VRM_VOLTAGE_VOTE_DRV3_REG1'/>"
WRITE #1 "        <register address='0xb830200' value='0x" DATA.LONG(A:0xb830200) "' name='RPMH_VRM_VOLTAGE_VOTE_DRV3_REG2'/>"
WRITE #1 "        <register address='0xb830300' value='0x" DATA.LONG(A:0xb830300) "' name='RPMH_VRM_VOLTAGE_VOTE_DRV3_REG3'/>"
WRITE #1 "        <register address='0xb830400' value='0x" DATA.LONG(A:0xb830400) "' name='RPMH_VRM_VOLTAGE_VOTE_DRV3_REG4'/>"
WRITE #1 "        <register address='0xb830500' value='0x" DATA.LONG(A:0xb830500) "' name='RPMH_VRM_VOLTAGE_VOTE_DRV3_REG5'/>"
WRITE #1 "        <register address='0xb830600' value='0x" DATA.LONG(A:0xb830600) "' name='RPMH_VRM_VOLTAGE_VOTE_DRV3_REG6'/>"
WRITE #1 "        <register address='0xb830700' value='0x" DATA.LONG(A:0xb830700) "' name='RPMH_VRM_VOLTAGE_VOTE_DRV3_REG7'/>"
WRITE #1 "        <register address='0xb830800' value='0x" DATA.LONG(A:0xb830800) "' name='RPMH_VRM_VOLTAGE_VOTE_DRV3_REG8'/>"
WRITE #1 "        <register address='0xb830900' value='0x" DATA.LONG(A:0xb830900) "' name='RPMH_VRM_VOLTAGE_VOTE_DRV3_REG9'/>"
WRITE #1 "        <register address='0xb830a00' value='0x" DATA.LONG(A:0xb830a00) "' name='RPMH_VRM_VOLTAGE_VOTE_DRV3_REG10'/>"
WRITE #1 "        <register address='0xb830b00' value='0x" DATA.LONG(A:0xb830b00) "' name='RPMH_VRM_VOLTAGE_VOTE_DRV3_REG11'/>"
WRITE #1 "        <register address='0xb830c00' value='0x" DATA.LONG(A:0xb830c00) "' name='RPMH_VRM_VOLTAGE_VOTE_DRV3_REG12'/>"
WRITE #1 "        <register address='0xb830d00' value='0x" DATA.LONG(A:0xb830d00) "' name='RPMH_VRM_VOLTAGE_VOTE_DRV3_REG13'/>"
WRITE #1 "        <register address='0xb830e00' value='0x" DATA.LONG(A:0xb830e00) "' name='RPMH_VRM_VOLTAGE_VOTE_DRV3_REG14'/>"
WRITE #1 "        <register address='0xb830f00' value='0x" DATA.LONG(A:0xb830f00) "' name='RPMH_VRM_VOLTAGE_VOTE_DRV3_REG15'/>"
WRITE #1 "        <register address='0xb831000' value='0x" DATA.LONG(A:0xb831000) "' name='RPMH_VRM_VOLTAGE_VOTE_DRV3_REG16'/>"
WRITE #1 "        <register address='0xb831100' value='0x" DATA.LONG(A:0xb831100) "' name='RPMH_VRM_VOLTAGE_VOTE_DRV3_REG17'/>"
WRITE #1 "        <register address='0xb831200' value='0x" DATA.LONG(A:0xb831200) "' name='RPMH_VRM_VOLTAGE_VOTE_DRV3_REG18'/>"
WRITE #1 "        <register address='0xb831300' value='0x" DATA.LONG(A:0xb831300) "' name='RPMH_VRM_VOLTAGE_VOTE_DRV3_REG19'/>"
WRITE #1 "        <register address='0xb831400' value='0x" DATA.LONG(A:0xb831400) "' name='RPMH_VRM_VOLTAGE_VOTE_DRV3_REG20'/>"
WRITE #1 "        <register address='0xb831500' value='0x" DATA.LONG(A:0xb831500) "' name='RPMH_VRM_VOLTAGE_VOTE_DRV3_REG21'/>"
WRITE #1 "        <register address='0xb831600' value='0x" DATA.LONG(A:0xb831600) "' name='RPMH_VRM_VOLTAGE_VOTE_DRV3_REG22'/>"
WRITE #1 "        <register address='0xb831700' value='0x" DATA.LONG(A:0xb831700) "' name='RPMH_VRM_VOLTAGE_VOTE_DRV3_REG23'/>"
WRITE #1 "        <register address='0xb831800' value='0x" DATA.LONG(A:0xb831800) "' name='RPMH_VRM_VOLTAGE_VOTE_DRV3_REG24'/>"
WRITE #1 "        <register address='0xb840000' value='0x" DATA.LONG(A:0xb840000) "' name='RPMH_VRM_VOLTAGE_VOTE_DRV4_REG0'/>"
WRITE #1 "        <register address='0xb840100' value='0x" DATA.LONG(A:0xb840100) "' name='RPMH_VRM_VOLTAGE_VOTE_DRV4_REG1'/>"
WRITE #1 "        <register address='0xb840200' value='0x" DATA.LONG(A:0xb840200) "' name='RPMH_VRM_VOLTAGE_VOTE_DRV4_REG2'/>"
WRITE #1 "        <register address='0xb840300' value='0x" DATA.LONG(A:0xb840300) "' name='RPMH_VRM_VOLTAGE_VOTE_DRV4_REG3'/>"
WRITE #1 "        <register address='0xb840400' value='0x" DATA.LONG(A:0xb840400) "' name='RPMH_VRM_VOLTAGE_VOTE_DRV4_REG4'/>"
WRITE #1 "        <register address='0xb840500' value='0x" DATA.LONG(A:0xb840500) "' name='RPMH_VRM_VOLTAGE_VOTE_DRV4_REG5'/>"
WRITE #1 "        <register address='0xb840600' value='0x" DATA.LONG(A:0xb840600) "' name='RPMH_VRM_VOLTAGE_VOTE_DRV4_REG6'/>"
WRITE #1 "        <register address='0xb840700' value='0x" DATA.LONG(A:0xb840700) "' name='RPMH_VRM_VOLTAGE_VOTE_DRV4_REG7'/>"
WRITE #1 "        <register address='0xb840800' value='0x" DATA.LONG(A:0xb840800) "' name='RPMH_VRM_VOLTAGE_VOTE_DRV4_REG8'/>"
WRITE #1 "        <register address='0xb840900' value='0x" DATA.LONG(A:0xb840900) "' name='RPMH_VRM_VOLTAGE_VOTE_DRV4_REG9'/>"
WRITE #1 "        <register address='0xb840a00' value='0x" DATA.LONG(A:0xb840a00) "' name='RPMH_VRM_VOLTAGE_VOTE_DRV4_REG10'/>"
WRITE #1 "        <register address='0xb840b00' value='0x" DATA.LONG(A:0xb840b00) "' name='RPMH_VRM_VOLTAGE_VOTE_DRV4_REG11'/>"
WRITE #1 "        <register address='0xb840c00' value='0x" DATA.LONG(A:0xb840c00) "' name='RPMH_VRM_VOLTAGE_VOTE_DRV4_REG12'/>"
WRITE #1 "        <register address='0xb840d00' value='0x" DATA.LONG(A:0xb840d00) "' name='RPMH_VRM_VOLTAGE_VOTE_DRV4_REG13'/>"
WRITE #1 "        <register address='0xb840e00' value='0x" DATA.LONG(A:0xb840e00) "' name='RPMH_VRM_VOLTAGE_VOTE_DRV4_REG14'/>"
WRITE #1 "        <register address='0xb840f00' value='0x" DATA.LONG(A:0xb840f00) "' name='RPMH_VRM_VOLTAGE_VOTE_DRV4_REG15'/>"
WRITE #1 "        <register address='0xb841000' value='0x" DATA.LONG(A:0xb841000) "' name='RPMH_VRM_VOLTAGE_VOTE_DRV4_REG16'/>"
WRITE #1 "        <register address='0xb841100' value='0x" DATA.LONG(A:0xb841100) "' name='RPMH_VRM_VOLTAGE_VOTE_DRV4_REG17'/>"
WRITE #1 "        <register address='0xb841200' value='0x" DATA.LONG(A:0xb841200) "' name='RPMH_VRM_VOLTAGE_VOTE_DRV4_REG18'/>"
WRITE #1 "        <register address='0xb841300' value='0x" DATA.LONG(A:0xb841300) "' name='RPMH_VRM_VOLTAGE_VOTE_DRV4_REG19'/>"
WRITE #1 "        <register address='0xb841400' value='0x" DATA.LONG(A:0xb841400) "' name='RPMH_VRM_VOLTAGE_VOTE_DRV4_REG20'/>"
WRITE #1 "        <register address='0xb841500' value='0x" DATA.LONG(A:0xb841500) "' name='RPMH_VRM_VOLTAGE_VOTE_DRV4_REG21'/>"
WRITE #1 "        <register address='0xb841600' value='0x" DATA.LONG(A:0xb841600) "' name='RPMH_VRM_VOLTAGE_VOTE_DRV4_REG22'/>"
WRITE #1 "        <register address='0xb841700' value='0x" DATA.LONG(A:0xb841700) "' name='RPMH_VRM_VOLTAGE_VOTE_DRV4_REG23'/>"
WRITE #1 "        <register address='0xb841800' value='0x" DATA.LONG(A:0xb841800) "' name='RPMH_VRM_VOLTAGE_VOTE_DRV4_REG24'/>"
WRITE #1 "        <register address='0xb850000' value='0x" DATA.LONG(A:0xb850000) "' name='RPMH_VRM_VOLTAGE_VOTE_DRV5_REG0'/>"
WRITE #1 "        <register address='0xb850100' value='0x" DATA.LONG(A:0xb850100) "' name='RPMH_VRM_VOLTAGE_VOTE_DRV5_REG1'/>"
WRITE #1 "        <register address='0xb850200' value='0x" DATA.LONG(A:0xb850200) "' name='RPMH_VRM_VOLTAGE_VOTE_DRV5_REG2'/>"
WRITE #1 "        <register address='0xb850300' value='0x" DATA.LONG(A:0xb850300) "' name='RPMH_VRM_VOLTAGE_VOTE_DRV5_REG3'/>"
WRITE #1 "        <register address='0xb850400' value='0x" DATA.LONG(A:0xb850400) "' name='RPMH_VRM_VOLTAGE_VOTE_DRV5_REG4'/>"
WRITE #1 "        <register address='0xb850500' value='0x" DATA.LONG(A:0xb850500) "' name='RPMH_VRM_VOLTAGE_VOTE_DRV5_REG5'/>"
WRITE #1 "        <register address='0xb850600' value='0x" DATA.LONG(A:0xb850600) "' name='RPMH_VRM_VOLTAGE_VOTE_DRV5_REG6'/>"
WRITE #1 "        <register address='0xb850700' value='0x" DATA.LONG(A:0xb850700) "' name='RPMH_VRM_VOLTAGE_VOTE_DRV5_REG7'/>"
WRITE #1 "        <register address='0xb850800' value='0x" DATA.LONG(A:0xb850800) "' name='RPMH_VRM_VOLTAGE_VOTE_DRV5_REG8'/>"
WRITE #1 "        <register address='0xb850900' value='0x" DATA.LONG(A:0xb850900) "' name='RPMH_VRM_VOLTAGE_VOTE_DRV5_REG9'/>"
WRITE #1 "        <register address='0xb850a00' value='0x" DATA.LONG(A:0xb850a00) "' name='RPMH_VRM_VOLTAGE_VOTE_DRV5_REG10'/>"
WRITE #1 "        <register address='0xb850b00' value='0x" DATA.LONG(A:0xb850b00) "' name='RPMH_VRM_VOLTAGE_VOTE_DRV5_REG11'/>"
WRITE #1 "        <register address='0xb850c00' value='0x" DATA.LONG(A:0xb850c00) "' name='RPMH_VRM_VOLTAGE_VOTE_DRV5_REG12'/>"
WRITE #1 "        <register address='0xb850d00' value='0x" DATA.LONG(A:0xb850d00) "' name='RPMH_VRM_VOLTAGE_VOTE_DRV5_REG13'/>"
WRITE #1 "        <register address='0xb850e00' value='0x" DATA.LONG(A:0xb850e00) "' name='RPMH_VRM_VOLTAGE_VOTE_DRV5_REG14'/>"
WRITE #1 "        <register address='0xb850f00' value='0x" DATA.LONG(A:0xb850f00) "' name='RPMH_VRM_VOLTAGE_VOTE_DRV5_REG15'/>"
WRITE #1 "        <register address='0xb851000' value='0x" DATA.LONG(A:0xb851000) "' name='RPMH_VRM_VOLTAGE_VOTE_DRV5_REG16'/>"
WRITE #1 "        <register address='0xb851100' value='0x" DATA.LONG(A:0xb851100) "' name='RPMH_VRM_VOLTAGE_VOTE_DRV5_REG17'/>"
WRITE #1 "        <register address='0xb851200' value='0x" DATA.LONG(A:0xb851200) "' name='RPMH_VRM_VOLTAGE_VOTE_DRV5_REG18'/>"
WRITE #1 "        <register address='0xb851300' value='0x" DATA.LONG(A:0xb851300) "' name='RPMH_VRM_VOLTAGE_VOTE_DRV5_REG19'/>"
WRITE #1 "        <register address='0xb851400' value='0x" DATA.LONG(A:0xb851400) "' name='RPMH_VRM_VOLTAGE_VOTE_DRV5_REG20'/>"
WRITE #1 "        <register address='0xb851500' value='0x" DATA.LONG(A:0xb851500) "' name='RPMH_VRM_VOLTAGE_VOTE_DRV5_REG21'/>"
WRITE #1 "        <register address='0xb851600' value='0x" DATA.LONG(A:0xb851600) "' name='RPMH_VRM_VOLTAGE_VOTE_DRV5_REG22'/>"
WRITE #1 "        <register address='0xb851700' value='0x" DATA.LONG(A:0xb851700) "' name='RPMH_VRM_VOLTAGE_VOTE_DRV5_REG23'/>"
WRITE #1 "        <register address='0xb851800' value='0x" DATA.LONG(A:0xb851800) "' name='RPMH_VRM_VOLTAGE_VOTE_DRV5_REG24'/>"
WRITE #1 "        <register address='0xb860000' value='0x" DATA.LONG(A:0xb860000) "' name='RPMH_VRM_VOLTAGE_VOTE_DRV6_REG0'/>"
WRITE #1 "        <register address='0xb860100' value='0x" DATA.LONG(A:0xb860100) "' name='RPMH_VRM_VOLTAGE_VOTE_DRV6_REG1'/>"
WRITE #1 "        <register address='0xb860200' value='0x" DATA.LONG(A:0xb860200) "' name='RPMH_VRM_VOLTAGE_VOTE_DRV6_REG2'/>"
WRITE #1 "        <register address='0xb860300' value='0x" DATA.LONG(A:0xb860300) "' name='RPMH_VRM_VOLTAGE_VOTE_DRV6_REG3'/>"
WRITE #1 "        <register address='0xb860400' value='0x" DATA.LONG(A:0xb860400) "' name='RPMH_VRM_VOLTAGE_VOTE_DRV6_REG4'/>"
WRITE #1 "        <register address='0xb860500' value='0x" DATA.LONG(A:0xb860500) "' name='RPMH_VRM_VOLTAGE_VOTE_DRV6_REG5'/>"
WRITE #1 "        <register address='0xb860600' value='0x" DATA.LONG(A:0xb860600) "' name='RPMH_VRM_VOLTAGE_VOTE_DRV6_REG6'/>"
WRITE #1 "        <register address='0xb860700' value='0x" DATA.LONG(A:0xb860700) "' name='RPMH_VRM_VOLTAGE_VOTE_DRV6_REG7'/>"
WRITE #1 "        <register address='0xb860800' value='0x" DATA.LONG(A:0xb860800) "' name='RPMH_VRM_VOLTAGE_VOTE_DRV6_REG8'/>"
WRITE #1 "        <register address='0xb860900' value='0x" DATA.LONG(A:0xb860900) "' name='RPMH_VRM_VOLTAGE_VOTE_DRV6_REG9'/>"
WRITE #1 "        <register address='0xb860a00' value='0x" DATA.LONG(A:0xb860a00) "' name='RPMH_VRM_VOLTAGE_VOTE_DRV6_REG10'/>"
WRITE #1 "        <register address='0xb860b00' value='0x" DATA.LONG(A:0xb860b00) "' name='RPMH_VRM_VOLTAGE_VOTE_DRV6_REG11'/>"
WRITE #1 "        <register address='0xb860c00' value='0x" DATA.LONG(A:0xb860c00) "' name='RPMH_VRM_VOLTAGE_VOTE_DRV6_REG12'/>"
WRITE #1 "        <register address='0xb860d00' value='0x" DATA.LONG(A:0xb860d00) "' name='RPMH_VRM_VOLTAGE_VOTE_DRV6_REG13'/>"
WRITE #1 "        <register address='0xb860e00' value='0x" DATA.LONG(A:0xb860e00) "' name='RPMH_VRM_VOLTAGE_VOTE_DRV6_REG14'/>"
WRITE #1 "        <register address='0xb860f00' value='0x" DATA.LONG(A:0xb860f00) "' name='RPMH_VRM_VOLTAGE_VOTE_DRV6_REG15'/>"
WRITE #1 "        <register address='0xb861000' value='0x" DATA.LONG(A:0xb861000) "' name='RPMH_VRM_VOLTAGE_VOTE_DRV6_REG16'/>"
WRITE #1 "        <register address='0xb861100' value='0x" DATA.LONG(A:0xb861100) "' name='RPMH_VRM_VOLTAGE_VOTE_DRV6_REG17'/>"
WRITE #1 "        <register address='0xb861200' value='0x" DATA.LONG(A:0xb861200) "' name='RPMH_VRM_VOLTAGE_VOTE_DRV6_REG18'/>"
WRITE #1 "        <register address='0xb861300' value='0x" DATA.LONG(A:0xb861300) "' name='RPMH_VRM_VOLTAGE_VOTE_DRV6_REG19'/>"
WRITE #1 "        <register address='0xb861400' value='0x" DATA.LONG(A:0xb861400) "' name='RPMH_VRM_VOLTAGE_VOTE_DRV6_REG20'/>"
WRITE #1 "        <register address='0xb861500' value='0x" DATA.LONG(A:0xb861500) "' name='RPMH_VRM_VOLTAGE_VOTE_DRV6_REG21'/>"
WRITE #1 "        <register address='0xb861600' value='0x" DATA.LONG(A:0xb861600) "' name='RPMH_VRM_VOLTAGE_VOTE_DRV6_REG22'/>"
WRITE #1 "        <register address='0xb861700' value='0x" DATA.LONG(A:0xb861700) "' name='RPMH_VRM_VOLTAGE_VOTE_DRV6_REG23'/>"
WRITE #1 "        <register address='0xb861800' value='0x" DATA.LONG(A:0xb861800) "' name='RPMH_VRM_VOLTAGE_VOTE_DRV6_REG24'/>"
WRITE #1 "        <register address='0xb800004' value='0x" DATA.LONG(A:0xb800004) "' name='RPMH_VRM_ENABLE_VOTE_DRV0_REG0'/>"
WRITE #1 "        <register address='0xb800104' value='0x" DATA.LONG(A:0xb800104) "' name='RPMH_VRM_ENABLE_VOTE_DRV0_REG1'/>"
WRITE #1 "        <register address='0xb800204' value='0x" DATA.LONG(A:0xb800204) "' name='RPMH_VRM_ENABLE_VOTE_DRV0_REG2'/>"
WRITE #1 "        <register address='0xb800304' value='0x" DATA.LONG(A:0xb800304) "' name='RPMH_VRM_ENABLE_VOTE_DRV0_REG3'/>"
WRITE #1 "        <register address='0xb800404' value='0x" DATA.LONG(A:0xb800404) "' name='RPMH_VRM_ENABLE_VOTE_DRV0_REG4'/>"
WRITE #1 "        <register address='0xb800504' value='0x" DATA.LONG(A:0xb800504) "' name='RPMH_VRM_ENABLE_VOTE_DRV0_REG5'/>"
WRITE #1 "        <register address='0xb800604' value='0x" DATA.LONG(A:0xb800604) "' name='RPMH_VRM_ENABLE_VOTE_DRV0_REG6'/>"
WRITE #1 "        <register address='0xb800704' value='0x" DATA.LONG(A:0xb800704) "' name='RPMH_VRM_ENABLE_VOTE_DRV0_REG7'/>"
WRITE #1 "        <register address='0xb800804' value='0x" DATA.LONG(A:0xb800804) "' name='RPMH_VRM_ENABLE_VOTE_DRV0_REG8'/>"
WRITE #1 "        <register address='0xb800904' value='0x" DATA.LONG(A:0xb800904) "' name='RPMH_VRM_ENABLE_VOTE_DRV0_REG9'/>"
WRITE #1 "        <register address='0xb800a04' value='0x" DATA.LONG(A:0xb800a04) "' name='RPMH_VRM_ENABLE_VOTE_DRV0_REG10'/>"
WRITE #1 "        <register address='0xb800b04' value='0x" DATA.LONG(A:0xb800b04) "' name='RPMH_VRM_ENABLE_VOTE_DRV0_REG11'/>"
WRITE #1 "        <register address='0xb800c04' value='0x" DATA.LONG(A:0xb800c04) "' name='RPMH_VRM_ENABLE_VOTE_DRV0_REG12'/>"
WRITE #1 "        <register address='0xb800d04' value='0x" DATA.LONG(A:0xb800d04) "' name='RPMH_VRM_ENABLE_VOTE_DRV0_REG13'/>"
WRITE #1 "        <register address='0xb800e04' value='0x" DATA.LONG(A:0xb800e04) "' name='RPMH_VRM_ENABLE_VOTE_DRV0_REG14'/>"
WRITE #1 "        <register address='0xb800f04' value='0x" DATA.LONG(A:0xb800f04) "' name='RPMH_VRM_ENABLE_VOTE_DRV0_REG15'/>"
WRITE #1 "        <register address='0xb801004' value='0x" DATA.LONG(A:0xb801004) "' name='RPMH_VRM_ENABLE_VOTE_DRV0_REG16'/>"
WRITE #1 "        <register address='0xb801104' value='0x" DATA.LONG(A:0xb801104) "' name='RPMH_VRM_ENABLE_VOTE_DRV0_REG17'/>"
WRITE #1 "        <register address='0xb801204' value='0x" DATA.LONG(A:0xb801204) "' name='RPMH_VRM_ENABLE_VOTE_DRV0_REG18'/>"
WRITE #1 "        <register address='0xb801304' value='0x" DATA.LONG(A:0xb801304) "' name='RPMH_VRM_ENABLE_VOTE_DRV0_REG19'/>"
WRITE #1 "        <register address='0xb801404' value='0x" DATA.LONG(A:0xb801404) "' name='RPMH_VRM_ENABLE_VOTE_DRV0_REG20'/>"
WRITE #1 "        <register address='0xb801504' value='0x" DATA.LONG(A:0xb801504) "' name='RPMH_VRM_ENABLE_VOTE_DRV0_REG21'/>"
WRITE #1 "        <register address='0xb801604' value='0x" DATA.LONG(A:0xb801604) "' name='RPMH_VRM_ENABLE_VOTE_DRV0_REG22'/>"
WRITE #1 "        <register address='0xb801704' value='0x" DATA.LONG(A:0xb801704) "' name='RPMH_VRM_ENABLE_VOTE_DRV0_REG23'/>"
WRITE #1 "        <register address='0xb801804' value='0x" DATA.LONG(A:0xb801804) "' name='RPMH_VRM_ENABLE_VOTE_DRV0_REG24'/>"
WRITE #1 "        <register address='0xb810004' value='0x" DATA.LONG(A:0xb810004) "' name='RPMH_VRM_ENABLE_VOTE_DRV1_REG0'/>"
WRITE #1 "        <register address='0xb810104' value='0x" DATA.LONG(A:0xb810104) "' name='RPMH_VRM_ENABLE_VOTE_DRV1_REG1'/>"
WRITE #1 "        <register address='0xb810204' value='0x" DATA.LONG(A:0xb810204) "' name='RPMH_VRM_ENABLE_VOTE_DRV1_REG2'/>"
WRITE #1 "        <register address='0xb810304' value='0x" DATA.LONG(A:0xb810304) "' name='RPMH_VRM_ENABLE_VOTE_DRV1_REG3'/>"
WRITE #1 "        <register address='0xb810404' value='0x" DATA.LONG(A:0xb810404) "' name='RPMH_VRM_ENABLE_VOTE_DRV1_REG4'/>"
WRITE #1 "        <register address='0xb810504' value='0x" DATA.LONG(A:0xb810504) "' name='RPMH_VRM_ENABLE_VOTE_DRV1_REG5'/>"
WRITE #1 "        <register address='0xb810604' value='0x" DATA.LONG(A:0xb810604) "' name='RPMH_VRM_ENABLE_VOTE_DRV1_REG6'/>"
WRITE #1 "        <register address='0xb810704' value='0x" DATA.LONG(A:0xb810704) "' name='RPMH_VRM_ENABLE_VOTE_DRV1_REG7'/>"
WRITE #1 "        <register address='0xb810804' value='0x" DATA.LONG(A:0xb810804) "' name='RPMH_VRM_ENABLE_VOTE_DRV1_REG8'/>"
WRITE #1 "        <register address='0xb810904' value='0x" DATA.LONG(A:0xb810904) "' name='RPMH_VRM_ENABLE_VOTE_DRV1_REG9'/>"
WRITE #1 "        <register address='0xb810a04' value='0x" DATA.LONG(A:0xb810a04) "' name='RPMH_VRM_ENABLE_VOTE_DRV1_REG10'/>"
WRITE #1 "        <register address='0xb810b04' value='0x" DATA.LONG(A:0xb810b04) "' name='RPMH_VRM_ENABLE_VOTE_DRV1_REG11'/>"
WRITE #1 "        <register address='0xb810c04' value='0x" DATA.LONG(A:0xb810c04) "' name='RPMH_VRM_ENABLE_VOTE_DRV1_REG12'/>"
WRITE #1 "        <register address='0xb810d04' value='0x" DATA.LONG(A:0xb810d04) "' name='RPMH_VRM_ENABLE_VOTE_DRV1_REG13'/>"
WRITE #1 "        <register address='0xb810e04' value='0x" DATA.LONG(A:0xb810e04) "' name='RPMH_VRM_ENABLE_VOTE_DRV1_REG14'/>"
WRITE #1 "        <register address='0xb810f04' value='0x" DATA.LONG(A:0xb810f04) "' name='RPMH_VRM_ENABLE_VOTE_DRV1_REG15'/>"
WRITE #1 "        <register address='0xb811004' value='0x" DATA.LONG(A:0xb811004) "' name='RPMH_VRM_ENABLE_VOTE_DRV1_REG16'/>"
WRITE #1 "        <register address='0xb811104' value='0x" DATA.LONG(A:0xb811104) "' name='RPMH_VRM_ENABLE_VOTE_DRV1_REG17'/>"
WRITE #1 "        <register address='0xb811204' value='0x" DATA.LONG(A:0xb811204) "' name='RPMH_VRM_ENABLE_VOTE_DRV1_REG18'/>"
WRITE #1 "        <register address='0xb811304' value='0x" DATA.LONG(A:0xb811304) "' name='RPMH_VRM_ENABLE_VOTE_DRV1_REG19'/>"
WRITE #1 "        <register address='0xb811404' value='0x" DATA.LONG(A:0xb811404) "' name='RPMH_VRM_ENABLE_VOTE_DRV1_REG20'/>"
WRITE #1 "        <register address='0xb811504' value='0x" DATA.LONG(A:0xb811504) "' name='RPMH_VRM_ENABLE_VOTE_DRV1_REG21'/>"
WRITE #1 "        <register address='0xb811604' value='0x" DATA.LONG(A:0xb811604) "' name='RPMH_VRM_ENABLE_VOTE_DRV1_REG22'/>"
WRITE #1 "        <register address='0xb811704' value='0x" DATA.LONG(A:0xb811704) "' name='RPMH_VRM_ENABLE_VOTE_DRV1_REG23'/>"
WRITE #1 "        <register address='0xb811804' value='0x" DATA.LONG(A:0xb811804) "' name='RPMH_VRM_ENABLE_VOTE_DRV1_REG24'/>"
WRITE #1 "        <register address='0xb820004' value='0x" DATA.LONG(A:0xb820004) "' name='RPMH_VRM_ENABLE_VOTE_DRV2_REG0'/>"
WRITE #1 "        <register address='0xb820104' value='0x" DATA.LONG(A:0xb820104) "' name='RPMH_VRM_ENABLE_VOTE_DRV2_REG1'/>"
WRITE #1 "        <register address='0xb820204' value='0x" DATA.LONG(A:0xb820204) "' name='RPMH_VRM_ENABLE_VOTE_DRV2_REG2'/>"
WRITE #1 "        <register address='0xb820304' value='0x" DATA.LONG(A:0xb820304) "' name='RPMH_VRM_ENABLE_VOTE_DRV2_REG3'/>"
WRITE #1 "        <register address='0xb820404' value='0x" DATA.LONG(A:0xb820404) "' name='RPMH_VRM_ENABLE_VOTE_DRV2_REG4'/>"
WRITE #1 "        <register address='0xb820504' value='0x" DATA.LONG(A:0xb820504) "' name='RPMH_VRM_ENABLE_VOTE_DRV2_REG5'/>"
WRITE #1 "        <register address='0xb820604' value='0x" DATA.LONG(A:0xb820604) "' name='RPMH_VRM_ENABLE_VOTE_DRV2_REG6'/>"
WRITE #1 "        <register address='0xb820704' value='0x" DATA.LONG(A:0xb820704) "' name='RPMH_VRM_ENABLE_VOTE_DRV2_REG7'/>"
WRITE #1 "        <register address='0xb820804' value='0x" DATA.LONG(A:0xb820804) "' name='RPMH_VRM_ENABLE_VOTE_DRV2_REG8'/>"
WRITE #1 "        <register address='0xb820904' value='0x" DATA.LONG(A:0xb820904) "' name='RPMH_VRM_ENABLE_VOTE_DRV2_REG9'/>"
WRITE #1 "        <register address='0xb820a04' value='0x" DATA.LONG(A:0xb820a04) "' name='RPMH_VRM_ENABLE_VOTE_DRV2_REG10'/>"
WRITE #1 "        <register address='0xb820b04' value='0x" DATA.LONG(A:0xb820b04) "' name='RPMH_VRM_ENABLE_VOTE_DRV2_REG11'/>"
WRITE #1 "        <register address='0xb820c04' value='0x" DATA.LONG(A:0xb820c04) "' name='RPMH_VRM_ENABLE_VOTE_DRV2_REG12'/>"
WRITE #1 "        <register address='0xb820d04' value='0x" DATA.LONG(A:0xb820d04) "' name='RPMH_VRM_ENABLE_VOTE_DRV2_REG13'/>"
WRITE #1 "        <register address='0xb820e04' value='0x" DATA.LONG(A:0xb820e04) "' name='RPMH_VRM_ENABLE_VOTE_DRV2_REG14'/>"
WRITE #1 "        <register address='0xb820f04' value='0x" DATA.LONG(A:0xb820f04) "' name='RPMH_VRM_ENABLE_VOTE_DRV2_REG15'/>"
WRITE #1 "        <register address='0xb821004' value='0x" DATA.LONG(A:0xb821004) "' name='RPMH_VRM_ENABLE_VOTE_DRV2_REG16'/>"
WRITE #1 "        <register address='0xb821104' value='0x" DATA.LONG(A:0xb821104) "' name='RPMH_VRM_ENABLE_VOTE_DRV2_REG17'/>"
WRITE #1 "        <register address='0xb821204' value='0x" DATA.LONG(A:0xb821204) "' name='RPMH_VRM_ENABLE_VOTE_DRV2_REG18'/>"
WRITE #1 "        <register address='0xb821304' value='0x" DATA.LONG(A:0xb821304) "' name='RPMH_VRM_ENABLE_VOTE_DRV2_REG19'/>"
WRITE #1 "        <register address='0xb821404' value='0x" DATA.LONG(A:0xb821404) "' name='RPMH_VRM_ENABLE_VOTE_DRV2_REG20'/>"
WRITE #1 "        <register address='0xb821504' value='0x" DATA.LONG(A:0xb821504) "' name='RPMH_VRM_ENABLE_VOTE_DRV2_REG21'/>"
WRITE #1 "        <register address='0xb821604' value='0x" DATA.LONG(A:0xb821604) "' name='RPMH_VRM_ENABLE_VOTE_DRV2_REG22'/>"
WRITE #1 "        <register address='0xb821704' value='0x" DATA.LONG(A:0xb821704) "' name='RPMH_VRM_ENABLE_VOTE_DRV2_REG23'/>"
WRITE #1 "        <register address='0xb821804' value='0x" DATA.LONG(A:0xb821804) "' name='RPMH_VRM_ENABLE_VOTE_DRV2_REG24'/>"
WRITE #1 "        <register address='0xb830004' value='0x" DATA.LONG(A:0xb830004) "' name='RPMH_VRM_ENABLE_VOTE_DRV3_REG0'/>"
WRITE #1 "        <register address='0xb830104' value='0x" DATA.LONG(A:0xb830104) "' name='RPMH_VRM_ENABLE_VOTE_DRV3_REG1'/>"
WRITE #1 "        <register address='0xb830204' value='0x" DATA.LONG(A:0xb830204) "' name='RPMH_VRM_ENABLE_VOTE_DRV3_REG2'/>"
WRITE #1 "        <register address='0xb830304' value='0x" DATA.LONG(A:0xb830304) "' name='RPMH_VRM_ENABLE_VOTE_DRV3_REG3'/>"
WRITE #1 "        <register address='0xb830404' value='0x" DATA.LONG(A:0xb830404) "' name='RPMH_VRM_ENABLE_VOTE_DRV3_REG4'/>"
WRITE #1 "        <register address='0xb830504' value='0x" DATA.LONG(A:0xb830504) "' name='RPMH_VRM_ENABLE_VOTE_DRV3_REG5'/>"
WRITE #1 "        <register address='0xb830604' value='0x" DATA.LONG(A:0xb830604) "' name='RPMH_VRM_ENABLE_VOTE_DRV3_REG6'/>"
WRITE #1 "        <register address='0xb830704' value='0x" DATA.LONG(A:0xb830704) "' name='RPMH_VRM_ENABLE_VOTE_DRV3_REG7'/>"
WRITE #1 "        <register address='0xb830804' value='0x" DATA.LONG(A:0xb830804) "' name='RPMH_VRM_ENABLE_VOTE_DRV3_REG8'/>"
WRITE #1 "        <register address='0xb830904' value='0x" DATA.LONG(A:0xb830904) "' name='RPMH_VRM_ENABLE_VOTE_DRV3_REG9'/>"
WRITE #1 "        <register address='0xb830a04' value='0x" DATA.LONG(A:0xb830a04) "' name='RPMH_VRM_ENABLE_VOTE_DRV3_REG10'/>"
WRITE #1 "        <register address='0xb830b04' value='0x" DATA.LONG(A:0xb830b04) "' name='RPMH_VRM_ENABLE_VOTE_DRV3_REG11'/>"
WRITE #1 "        <register address='0xb830c04' value='0x" DATA.LONG(A:0xb830c04) "' name='RPMH_VRM_ENABLE_VOTE_DRV3_REG12'/>"
WRITE #1 "        <register address='0xb830d04' value='0x" DATA.LONG(A:0xb830d04) "' name='RPMH_VRM_ENABLE_VOTE_DRV3_REG13'/>"
WRITE #1 "        <register address='0xb830e04' value='0x" DATA.LONG(A:0xb830e04) "' name='RPMH_VRM_ENABLE_VOTE_DRV3_REG14'/>"
WRITE #1 "        <register address='0xb830f04' value='0x" DATA.LONG(A:0xb830f04) "' name='RPMH_VRM_ENABLE_VOTE_DRV3_REG15'/>"
WRITE #1 "        <register address='0xb831004' value='0x" DATA.LONG(A:0xb831004) "' name='RPMH_VRM_ENABLE_VOTE_DRV3_REG16'/>"
WRITE #1 "        <register address='0xb831104' value='0x" DATA.LONG(A:0xb831104) "' name='RPMH_VRM_ENABLE_VOTE_DRV3_REG17'/>"
WRITE #1 "        <register address='0xb831204' value='0x" DATA.LONG(A:0xb831204) "' name='RPMH_VRM_ENABLE_VOTE_DRV3_REG18'/>"
WRITE #1 "        <register address='0xb831304' value='0x" DATA.LONG(A:0xb831304) "' name='RPMH_VRM_ENABLE_VOTE_DRV3_REG19'/>"
WRITE #1 "        <register address='0xb831404' value='0x" DATA.LONG(A:0xb831404) "' name='RPMH_VRM_ENABLE_VOTE_DRV3_REG20'/>"
WRITE #1 "        <register address='0xb831504' value='0x" DATA.LONG(A:0xb831504) "' name='RPMH_VRM_ENABLE_VOTE_DRV3_REG21'/>"
WRITE #1 "        <register address='0xb831604' value='0x" DATA.LONG(A:0xb831604) "' name='RPMH_VRM_ENABLE_VOTE_DRV3_REG22'/>"
WRITE #1 "        <register address='0xb831704' value='0x" DATA.LONG(A:0xb831704) "' name='RPMH_VRM_ENABLE_VOTE_DRV3_REG23'/>"
WRITE #1 "        <register address='0xb831804' value='0x" DATA.LONG(A:0xb831804) "' name='RPMH_VRM_ENABLE_VOTE_DRV3_REG24'/>"
WRITE #1 "        <register address='0xb840004' value='0x" DATA.LONG(A:0xb840004) "' name='RPMH_VRM_ENABLE_VOTE_DRV4_REG0'/>"
WRITE #1 "        <register address='0xb840104' value='0x" DATA.LONG(A:0xb840104) "' name='RPMH_VRM_ENABLE_VOTE_DRV4_REG1'/>"
WRITE #1 "        <register address='0xb840204' value='0x" DATA.LONG(A:0xb840204) "' name='RPMH_VRM_ENABLE_VOTE_DRV4_REG2'/>"
WRITE #1 "        <register address='0xb840304' value='0x" DATA.LONG(A:0xb840304) "' name='RPMH_VRM_ENABLE_VOTE_DRV4_REG3'/>"
WRITE #1 "        <register address='0xb840404' value='0x" DATA.LONG(A:0xb840404) "' name='RPMH_VRM_ENABLE_VOTE_DRV4_REG4'/>"
WRITE #1 "        <register address='0xb840504' value='0x" DATA.LONG(A:0xb840504) "' name='RPMH_VRM_ENABLE_VOTE_DRV4_REG5'/>"
WRITE #1 "        <register address='0xb840604' value='0x" DATA.LONG(A:0xb840604) "' name='RPMH_VRM_ENABLE_VOTE_DRV4_REG6'/>"
WRITE #1 "        <register address='0xb840704' value='0x" DATA.LONG(A:0xb840704) "' name='RPMH_VRM_ENABLE_VOTE_DRV4_REG7'/>"
WRITE #1 "        <register address='0xb840804' value='0x" DATA.LONG(A:0xb840804) "' name='RPMH_VRM_ENABLE_VOTE_DRV4_REG8'/>"
WRITE #1 "        <register address='0xb840904' value='0x" DATA.LONG(A:0xb840904) "' name='RPMH_VRM_ENABLE_VOTE_DRV4_REG9'/>"
WRITE #1 "        <register address='0xb840a04' value='0x" DATA.LONG(A:0xb840a04) "' name='RPMH_VRM_ENABLE_VOTE_DRV4_REG10'/>"
WRITE #1 "        <register address='0xb840b04' value='0x" DATA.LONG(A:0xb840b04) "' name='RPMH_VRM_ENABLE_VOTE_DRV4_REG11'/>"
WRITE #1 "        <register address='0xb840c04' value='0x" DATA.LONG(A:0xb840c04) "' name='RPMH_VRM_ENABLE_VOTE_DRV4_REG12'/>"
WRITE #1 "        <register address='0xb840d04' value='0x" DATA.LONG(A:0xb840d04) "' name='RPMH_VRM_ENABLE_VOTE_DRV4_REG13'/>"
WRITE #1 "        <register address='0xb840e04' value='0x" DATA.LONG(A:0xb840e04) "' name='RPMH_VRM_ENABLE_VOTE_DRV4_REG14'/>"
WRITE #1 "        <register address='0xb840f04' value='0x" DATA.LONG(A:0xb840f04) "' name='RPMH_VRM_ENABLE_VOTE_DRV4_REG15'/>"
WRITE #1 "        <register address='0xb841004' value='0x" DATA.LONG(A:0xb841004) "' name='RPMH_VRM_ENABLE_VOTE_DRV4_REG16'/>"
WRITE #1 "        <register address='0xb841104' value='0x" DATA.LONG(A:0xb841104) "' name='RPMH_VRM_ENABLE_VOTE_DRV4_REG17'/>"
WRITE #1 "        <register address='0xb841204' value='0x" DATA.LONG(A:0xb841204) "' name='RPMH_VRM_ENABLE_VOTE_DRV4_REG18'/>"
WRITE #1 "        <register address='0xb841304' value='0x" DATA.LONG(A:0xb841304) "' name='RPMH_VRM_ENABLE_VOTE_DRV4_REG19'/>"
WRITE #1 "        <register address='0xb841404' value='0x" DATA.LONG(A:0xb841404) "' name='RPMH_VRM_ENABLE_VOTE_DRV4_REG20'/>"
WRITE #1 "        <register address='0xb841504' value='0x" DATA.LONG(A:0xb841504) "' name='RPMH_VRM_ENABLE_VOTE_DRV4_REG21'/>"
WRITE #1 "        <register address='0xb841604' value='0x" DATA.LONG(A:0xb841604) "' name='RPMH_VRM_ENABLE_VOTE_DRV4_REG22'/>"
WRITE #1 "        <register address='0xb841704' value='0x" DATA.LONG(A:0xb841704) "' name='RPMH_VRM_ENABLE_VOTE_DRV4_REG23'/>"
WRITE #1 "        <register address='0xb841804' value='0x" DATA.LONG(A:0xb841804) "' name='RPMH_VRM_ENABLE_VOTE_DRV4_REG24'/>"
WRITE #1 "        <register address='0xb850004' value='0x" DATA.LONG(A:0xb850004) "' name='RPMH_VRM_ENABLE_VOTE_DRV5_REG0'/>"
WRITE #1 "        <register address='0xb850104' value='0x" DATA.LONG(A:0xb850104) "' name='RPMH_VRM_ENABLE_VOTE_DRV5_REG1'/>"
WRITE #1 "        <register address='0xb850204' value='0x" DATA.LONG(A:0xb850204) "' name='RPMH_VRM_ENABLE_VOTE_DRV5_REG2'/>"
WRITE #1 "        <register address='0xb850304' value='0x" DATA.LONG(A:0xb850304) "' name='RPMH_VRM_ENABLE_VOTE_DRV5_REG3'/>"
WRITE #1 "        <register address='0xb850404' value='0x" DATA.LONG(A:0xb850404) "' name='RPMH_VRM_ENABLE_VOTE_DRV5_REG4'/>"
WRITE #1 "        <register address='0xb850504' value='0x" DATA.LONG(A:0xb850504) "' name='RPMH_VRM_ENABLE_VOTE_DRV5_REG5'/>"
WRITE #1 "        <register address='0xb850604' value='0x" DATA.LONG(A:0xb850604) "' name='RPMH_VRM_ENABLE_VOTE_DRV5_REG6'/>"
WRITE #1 "        <register address='0xb850704' value='0x" DATA.LONG(A:0xb850704) "' name='RPMH_VRM_ENABLE_VOTE_DRV5_REG7'/>"
WRITE #1 "        <register address='0xb850804' value='0x" DATA.LONG(A:0xb850804) "' name='RPMH_VRM_ENABLE_VOTE_DRV5_REG8'/>"
WRITE #1 "        <register address='0xb850904' value='0x" DATA.LONG(A:0xb850904) "' name='RPMH_VRM_ENABLE_VOTE_DRV5_REG9'/>"
WRITE #1 "        <register address='0xb850a04' value='0x" DATA.LONG(A:0xb850a04) "' name='RPMH_VRM_ENABLE_VOTE_DRV5_REG10'/>"
WRITE #1 "        <register address='0xb850b04' value='0x" DATA.LONG(A:0xb850b04) "' name='RPMH_VRM_ENABLE_VOTE_DRV5_REG11'/>"
WRITE #1 "        <register address='0xb850c04' value='0x" DATA.LONG(A:0xb850c04) "' name='RPMH_VRM_ENABLE_VOTE_DRV5_REG12'/>"
WRITE #1 "        <register address='0xb850d04' value='0x" DATA.LONG(A:0xb850d04) "' name='RPMH_VRM_ENABLE_VOTE_DRV5_REG13'/>"
WRITE #1 "        <register address='0xb850e04' value='0x" DATA.LONG(A:0xb850e04) "' name='RPMH_VRM_ENABLE_VOTE_DRV5_REG14'/>"
WRITE #1 "        <register address='0xb850f04' value='0x" DATA.LONG(A:0xb850f04) "' name='RPMH_VRM_ENABLE_VOTE_DRV5_REG15'/>"
WRITE #1 "        <register address='0xb851004' value='0x" DATA.LONG(A:0xb851004) "' name='RPMH_VRM_ENABLE_VOTE_DRV5_REG16'/>"
WRITE #1 "        <register address='0xb851104' value='0x" DATA.LONG(A:0xb851104) "' name='RPMH_VRM_ENABLE_VOTE_DRV5_REG17'/>"
WRITE #1 "        <register address='0xb851204' value='0x" DATA.LONG(A:0xb851204) "' name='RPMH_VRM_ENABLE_VOTE_DRV5_REG18'/>"
WRITE #1 "        <register address='0xb851304' value='0x" DATA.LONG(A:0xb851304) "' name='RPMH_VRM_ENABLE_VOTE_DRV5_REG19'/>"
WRITE #1 "        <register address='0xb851404' value='0x" DATA.LONG(A:0xb851404) "' name='RPMH_VRM_ENABLE_VOTE_DRV5_REG20'/>"
WRITE #1 "        <register address='0xb851504' value='0x" DATA.LONG(A:0xb851504) "' name='RPMH_VRM_ENABLE_VOTE_DRV5_REG21'/>"
WRITE #1 "        <register address='0xb851604' value='0x" DATA.LONG(A:0xb851604) "' name='RPMH_VRM_ENABLE_VOTE_DRV5_REG22'/>"
WRITE #1 "        <register address='0xb851704' value='0x" DATA.LONG(A:0xb851704) "' name='RPMH_VRM_ENABLE_VOTE_DRV5_REG23'/>"
WRITE #1 "        <register address='0xb851804' value='0x" DATA.LONG(A:0xb851804) "' name='RPMH_VRM_ENABLE_VOTE_DRV5_REG24'/>"
WRITE #1 "        <register address='0xb860004' value='0x" DATA.LONG(A:0xb860004) "' name='RPMH_VRM_ENABLE_VOTE_DRV6_REG0'/>"
WRITE #1 "        <register address='0xb860104' value='0x" DATA.LONG(A:0xb860104) "' name='RPMH_VRM_ENABLE_VOTE_DRV6_REG1'/>"
WRITE #1 "        <register address='0xb860204' value='0x" DATA.LONG(A:0xb860204) "' name='RPMH_VRM_ENABLE_VOTE_DRV6_REG2'/>"
WRITE #1 "        <register address='0xb860304' value='0x" DATA.LONG(A:0xb860304) "' name='RPMH_VRM_ENABLE_VOTE_DRV6_REG3'/>"
WRITE #1 "        <register address='0xb860404' value='0x" DATA.LONG(A:0xb860404) "' name='RPMH_VRM_ENABLE_VOTE_DRV6_REG4'/>"
WRITE #1 "        <register address='0xb860504' value='0x" DATA.LONG(A:0xb860504) "' name='RPMH_VRM_ENABLE_VOTE_DRV6_REG5'/>"
WRITE #1 "        <register address='0xb860604' value='0x" DATA.LONG(A:0xb860604) "' name='RPMH_VRM_ENABLE_VOTE_DRV6_REG6'/>"
WRITE #1 "        <register address='0xb860704' value='0x" DATA.LONG(A:0xb860704) "' name='RPMH_VRM_ENABLE_VOTE_DRV6_REG7'/>"
WRITE #1 "        <register address='0xb860804' value='0x" DATA.LONG(A:0xb860804) "' name='RPMH_VRM_ENABLE_VOTE_DRV6_REG8'/>"
WRITE #1 "        <register address='0xb860904' value='0x" DATA.LONG(A:0xb860904) "' name='RPMH_VRM_ENABLE_VOTE_DRV6_REG9'/>"
WRITE #1 "        <register address='0xb860a04' value='0x" DATA.LONG(A:0xb860a04) "' name='RPMH_VRM_ENABLE_VOTE_DRV6_REG10'/>"
WRITE #1 "        <register address='0xb860b04' value='0x" DATA.LONG(A:0xb860b04) "' name='RPMH_VRM_ENABLE_VOTE_DRV6_REG11'/>"
WRITE #1 "        <register address='0xb860c04' value='0x" DATA.LONG(A:0xb860c04) "' name='RPMH_VRM_ENABLE_VOTE_DRV6_REG12'/>"
WRITE #1 "        <register address='0xb860d04' value='0x" DATA.LONG(A:0xb860d04) "' name='RPMH_VRM_ENABLE_VOTE_DRV6_REG13'/>"
WRITE #1 "        <register address='0xb860e04' value='0x" DATA.LONG(A:0xb860e04) "' name='RPMH_VRM_ENABLE_VOTE_DRV6_REG14'/>"
WRITE #1 "        <register address='0xb860f04' value='0x" DATA.LONG(A:0xb860f04) "' name='RPMH_VRM_ENABLE_VOTE_DRV6_REG15'/>"
WRITE #1 "        <register address='0xb861004' value='0x" DATA.LONG(A:0xb861004) "' name='RPMH_VRM_ENABLE_VOTE_DRV6_REG16'/>"
WRITE #1 "        <register address='0xb861104' value='0x" DATA.LONG(A:0xb861104) "' name='RPMH_VRM_ENABLE_VOTE_DRV6_REG17'/>"
WRITE #1 "        <register address='0xb861204' value='0x" DATA.LONG(A:0xb861204) "' name='RPMH_VRM_ENABLE_VOTE_DRV6_REG18'/>"
WRITE #1 "        <register address='0xb861304' value='0x" DATA.LONG(A:0xb861304) "' name='RPMH_VRM_ENABLE_VOTE_DRV6_REG19'/>"
WRITE #1 "        <register address='0xb861404' value='0x" DATA.LONG(A:0xb861404) "' name='RPMH_VRM_ENABLE_VOTE_DRV6_REG20'/>"
WRITE #1 "        <register address='0xb861504' value='0x" DATA.LONG(A:0xb861504) "' name='RPMH_VRM_ENABLE_VOTE_DRV6_REG21'/>"
WRITE #1 "        <register address='0xb861604' value='0x" DATA.LONG(A:0xb861604) "' name='RPMH_VRM_ENABLE_VOTE_DRV6_REG22'/>"
WRITE #1 "        <register address='0xb861704' value='0x" DATA.LONG(A:0xb861704) "' name='RPMH_VRM_ENABLE_VOTE_DRV6_REG23'/>"
WRITE #1 "        <register address='0xb861804' value='0x" DATA.LONG(A:0xb861804) "' name='RPMH_VRM_ENABLE_VOTE_DRV6_REG24'/>"
WRITE #1 "        <register address='0xb800008' value='0x" DATA.LONG(A:0xb800008) "' name='RPMH_VRM_MODE_VOTE_DRV0_REG0'/>"
WRITE #1 "        <register address='0xb800108' value='0x" DATA.LONG(A:0xb800108) "' name='RPMH_VRM_MODE_VOTE_DRV0_REG1'/>"
WRITE #1 "        <register address='0xb800208' value='0x" DATA.LONG(A:0xb800208) "' name='RPMH_VRM_MODE_VOTE_DRV0_REG2'/>"
WRITE #1 "        <register address='0xb800308' value='0x" DATA.LONG(A:0xb800308) "' name='RPMH_VRM_MODE_VOTE_DRV0_REG3'/>"
WRITE #1 "        <register address='0xb800408' value='0x" DATA.LONG(A:0xb800408) "' name='RPMH_VRM_MODE_VOTE_DRV0_REG4'/>"
WRITE #1 "        <register address='0xb800508' value='0x" DATA.LONG(A:0xb800508) "' name='RPMH_VRM_MODE_VOTE_DRV0_REG5'/>"
WRITE #1 "        <register address='0xb800608' value='0x" DATA.LONG(A:0xb800608) "' name='RPMH_VRM_MODE_VOTE_DRV0_REG6'/>"
WRITE #1 "        <register address='0xb800708' value='0x" DATA.LONG(A:0xb800708) "' name='RPMH_VRM_MODE_VOTE_DRV0_REG7'/>"
WRITE #1 "        <register address='0xb800808' value='0x" DATA.LONG(A:0xb800808) "' name='RPMH_VRM_MODE_VOTE_DRV0_REG8'/>"
WRITE #1 "        <register address='0xb800908' value='0x" DATA.LONG(A:0xb800908) "' name='RPMH_VRM_MODE_VOTE_DRV0_REG9'/>"
WRITE #1 "        <register address='0xb800a08' value='0x" DATA.LONG(A:0xb800a08) "' name='RPMH_VRM_MODE_VOTE_DRV0_REG10'/>"
WRITE #1 "        <register address='0xb800b08' value='0x" DATA.LONG(A:0xb800b08) "' name='RPMH_VRM_MODE_VOTE_DRV0_REG11'/>"
WRITE #1 "        <register address='0xb800c08' value='0x" DATA.LONG(A:0xb800c08) "' name='RPMH_VRM_MODE_VOTE_DRV0_REG12'/>"
WRITE #1 "        <register address='0xb800d08' value='0x" DATA.LONG(A:0xb800d08) "' name='RPMH_VRM_MODE_VOTE_DRV0_REG13'/>"
WRITE #1 "        <register address='0xb800e08' value='0x" DATA.LONG(A:0xb800e08) "' name='RPMH_VRM_MODE_VOTE_DRV0_REG14'/>"
WRITE #1 "        <register address='0xb800f08' value='0x" DATA.LONG(A:0xb800f08) "' name='RPMH_VRM_MODE_VOTE_DRV0_REG15'/>"
WRITE #1 "        <register address='0xb801008' value='0x" DATA.LONG(A:0xb801008) "' name='RPMH_VRM_MODE_VOTE_DRV0_REG16'/>"
WRITE #1 "        <register address='0xb801108' value='0x" DATA.LONG(A:0xb801108) "' name='RPMH_VRM_MODE_VOTE_DRV0_REG17'/>"
WRITE #1 "        <register address='0xb801208' value='0x" DATA.LONG(A:0xb801208) "' name='RPMH_VRM_MODE_VOTE_DRV0_REG18'/>"
WRITE #1 "        <register address='0xb801308' value='0x" DATA.LONG(A:0xb801308) "' name='RPMH_VRM_MODE_VOTE_DRV0_REG19'/>"
WRITE #1 "        <register address='0xb801408' value='0x" DATA.LONG(A:0xb801408) "' name='RPMH_VRM_MODE_VOTE_DRV0_REG20'/>"
WRITE #1 "        <register address='0xb801508' value='0x" DATA.LONG(A:0xb801508) "' name='RPMH_VRM_MODE_VOTE_DRV0_REG21'/>"
WRITE #1 "        <register address='0xb801608' value='0x" DATA.LONG(A:0xb801608) "' name='RPMH_VRM_MODE_VOTE_DRV0_REG22'/>"
WRITE #1 "        <register address='0xb801708' value='0x" DATA.LONG(A:0xb801708) "' name='RPMH_VRM_MODE_VOTE_DRV0_REG23'/>"
WRITE #1 "        <register address='0xb801808' value='0x" DATA.LONG(A:0xb801808) "' name='RPMH_VRM_MODE_VOTE_DRV0_REG24'/>"
WRITE #1 "        <register address='0xb810008' value='0x" DATA.LONG(A:0xb810008) "' name='RPMH_VRM_MODE_VOTE_DRV1_REG0'/>"
WRITE #1 "        <register address='0xb810108' value='0x" DATA.LONG(A:0xb810108) "' name='RPMH_VRM_MODE_VOTE_DRV1_REG1'/>"
WRITE #1 "        <register address='0xb810208' value='0x" DATA.LONG(A:0xb810208) "' name='RPMH_VRM_MODE_VOTE_DRV1_REG2'/>"
WRITE #1 "        <register address='0xb810308' value='0x" DATA.LONG(A:0xb810308) "' name='RPMH_VRM_MODE_VOTE_DRV1_REG3'/>"
WRITE #1 "        <register address='0xb810408' value='0x" DATA.LONG(A:0xb810408) "' name='RPMH_VRM_MODE_VOTE_DRV1_REG4'/>"
WRITE #1 "        <register address='0xb810508' value='0x" DATA.LONG(A:0xb810508) "' name='RPMH_VRM_MODE_VOTE_DRV1_REG5'/>"
WRITE #1 "        <register address='0xb810608' value='0x" DATA.LONG(A:0xb810608) "' name='RPMH_VRM_MODE_VOTE_DRV1_REG6'/>"
WRITE #1 "        <register address='0xb810708' value='0x" DATA.LONG(A:0xb810708) "' name='RPMH_VRM_MODE_VOTE_DRV1_REG7'/>"
WRITE #1 "        <register address='0xb810808' value='0x" DATA.LONG(A:0xb810808) "' name='RPMH_VRM_MODE_VOTE_DRV1_REG8'/>"
WRITE #1 "        <register address='0xb810908' value='0x" DATA.LONG(A:0xb810908) "' name='RPMH_VRM_MODE_VOTE_DRV1_REG9'/>"
WRITE #1 "        <register address='0xb810a08' value='0x" DATA.LONG(A:0xb810a08) "' name='RPMH_VRM_MODE_VOTE_DRV1_REG10'/>"
WRITE #1 "        <register address='0xb810b08' value='0x" DATA.LONG(A:0xb810b08) "' name='RPMH_VRM_MODE_VOTE_DRV1_REG11'/>"
WRITE #1 "        <register address='0xb810c08' value='0x" DATA.LONG(A:0xb810c08) "' name='RPMH_VRM_MODE_VOTE_DRV1_REG12'/>"
WRITE #1 "        <register address='0xb810d08' value='0x" DATA.LONG(A:0xb810d08) "' name='RPMH_VRM_MODE_VOTE_DRV1_REG13'/>"
WRITE #1 "        <register address='0xb810e08' value='0x" DATA.LONG(A:0xb810e08) "' name='RPMH_VRM_MODE_VOTE_DRV1_REG14'/>"
WRITE #1 "        <register address='0xb810f08' value='0x" DATA.LONG(A:0xb810f08) "' name='RPMH_VRM_MODE_VOTE_DRV1_REG15'/>"
WRITE #1 "        <register address='0xb811008' value='0x" DATA.LONG(A:0xb811008) "' name='RPMH_VRM_MODE_VOTE_DRV1_REG16'/>"
WRITE #1 "        <register address='0xb811108' value='0x" DATA.LONG(A:0xb811108) "' name='RPMH_VRM_MODE_VOTE_DRV1_REG17'/>"
WRITE #1 "        <register address='0xb811208' value='0x" DATA.LONG(A:0xb811208) "' name='RPMH_VRM_MODE_VOTE_DRV1_REG18'/>"
WRITE #1 "        <register address='0xb811308' value='0x" DATA.LONG(A:0xb811308) "' name='RPMH_VRM_MODE_VOTE_DRV1_REG19'/>"
WRITE #1 "        <register address='0xb811408' value='0x" DATA.LONG(A:0xb811408) "' name='RPMH_VRM_MODE_VOTE_DRV1_REG20'/>"
WRITE #1 "        <register address='0xb811508' value='0x" DATA.LONG(A:0xb811508) "' name='RPMH_VRM_MODE_VOTE_DRV1_REG21'/>"
WRITE #1 "        <register address='0xb811608' value='0x" DATA.LONG(A:0xb811608) "' name='RPMH_VRM_MODE_VOTE_DRV1_REG22'/>"
WRITE #1 "        <register address='0xb811708' value='0x" DATA.LONG(A:0xb811708) "' name='RPMH_VRM_MODE_VOTE_DRV1_REG23'/>"
WRITE #1 "        <register address='0xb811808' value='0x" DATA.LONG(A:0xb811808) "' name='RPMH_VRM_MODE_VOTE_DRV1_REG24'/>"
WRITE #1 "        <register address='0xb820008' value='0x" DATA.LONG(A:0xb820008) "' name='RPMH_VRM_MODE_VOTE_DRV2_REG0'/>"
WRITE #1 "        <register address='0xb820108' value='0x" DATA.LONG(A:0xb820108) "' name='RPMH_VRM_MODE_VOTE_DRV2_REG1'/>"
WRITE #1 "        <register address='0xb820208' value='0x" DATA.LONG(A:0xb820208) "' name='RPMH_VRM_MODE_VOTE_DRV2_REG2'/>"
WRITE #1 "        <register address='0xb820308' value='0x" DATA.LONG(A:0xb820308) "' name='RPMH_VRM_MODE_VOTE_DRV2_REG3'/>"
WRITE #1 "        <register address='0xb820408' value='0x" DATA.LONG(A:0xb820408) "' name='RPMH_VRM_MODE_VOTE_DRV2_REG4'/>"
WRITE #1 "        <register address='0xb820508' value='0x" DATA.LONG(A:0xb820508) "' name='RPMH_VRM_MODE_VOTE_DRV2_REG5'/>"
WRITE #1 "        <register address='0xb820608' value='0x" DATA.LONG(A:0xb820608) "' name='RPMH_VRM_MODE_VOTE_DRV2_REG6'/>"
WRITE #1 "        <register address='0xb820708' value='0x" DATA.LONG(A:0xb820708) "' name='RPMH_VRM_MODE_VOTE_DRV2_REG7'/>"
WRITE #1 "        <register address='0xb820808' value='0x" DATA.LONG(A:0xb820808) "' name='RPMH_VRM_MODE_VOTE_DRV2_REG8'/>"
WRITE #1 "        <register address='0xb820908' value='0x" DATA.LONG(A:0xb820908) "' name='RPMH_VRM_MODE_VOTE_DRV2_REG9'/>"
WRITE #1 "        <register address='0xb820a08' value='0x" DATA.LONG(A:0xb820a08) "' name='RPMH_VRM_MODE_VOTE_DRV2_REG10'/>"
WRITE #1 "        <register address='0xb820b08' value='0x" DATA.LONG(A:0xb820b08) "' name='RPMH_VRM_MODE_VOTE_DRV2_REG11'/>"
WRITE #1 "        <register address='0xb820c08' value='0x" DATA.LONG(A:0xb820c08) "' name='RPMH_VRM_MODE_VOTE_DRV2_REG12'/>"
WRITE #1 "        <register address='0xb820d08' value='0x" DATA.LONG(A:0xb820d08) "' name='RPMH_VRM_MODE_VOTE_DRV2_REG13'/>"
WRITE #1 "        <register address='0xb820e08' value='0x" DATA.LONG(A:0xb820e08) "' name='RPMH_VRM_MODE_VOTE_DRV2_REG14'/>"
WRITE #1 "        <register address='0xb820f08' value='0x" DATA.LONG(A:0xb820f08) "' name='RPMH_VRM_MODE_VOTE_DRV2_REG15'/>"
WRITE #1 "        <register address='0xb821008' value='0x" DATA.LONG(A:0xb821008) "' name='RPMH_VRM_MODE_VOTE_DRV2_REG16'/>"
WRITE #1 "        <register address='0xb821108' value='0x" DATA.LONG(A:0xb821108) "' name='RPMH_VRM_MODE_VOTE_DRV2_REG17'/>"
WRITE #1 "        <register address='0xb821208' value='0x" DATA.LONG(A:0xb821208) "' name='RPMH_VRM_MODE_VOTE_DRV2_REG18'/>"
WRITE #1 "        <register address='0xb821308' value='0x" DATA.LONG(A:0xb821308) "' name='RPMH_VRM_MODE_VOTE_DRV2_REG19'/>"
WRITE #1 "        <register address='0xb821408' value='0x" DATA.LONG(A:0xb821408) "' name='RPMH_VRM_MODE_VOTE_DRV2_REG20'/>"
WRITE #1 "        <register address='0xb821508' value='0x" DATA.LONG(A:0xb821508) "' name='RPMH_VRM_MODE_VOTE_DRV2_REG21'/>"
WRITE #1 "        <register address='0xb821608' value='0x" DATA.LONG(A:0xb821608) "' name='RPMH_VRM_MODE_VOTE_DRV2_REG22'/>"
WRITE #1 "        <register address='0xb821708' value='0x" DATA.LONG(A:0xb821708) "' name='RPMH_VRM_MODE_VOTE_DRV2_REG23'/>"
WRITE #1 "        <register address='0xb821808' value='0x" DATA.LONG(A:0xb821808) "' name='RPMH_VRM_MODE_VOTE_DRV2_REG24'/>"
WRITE #1 "        <register address='0xb830008' value='0x" DATA.LONG(A:0xb830008) "' name='RPMH_VRM_MODE_VOTE_DRV3_REG0'/>"
WRITE #1 "        <register address='0xb830108' value='0x" DATA.LONG(A:0xb830108) "' name='RPMH_VRM_MODE_VOTE_DRV3_REG1'/>"
WRITE #1 "        <register address='0xb830208' value='0x" DATA.LONG(A:0xb830208) "' name='RPMH_VRM_MODE_VOTE_DRV3_REG2'/>"
WRITE #1 "        <register address='0xb830308' value='0x" DATA.LONG(A:0xb830308) "' name='RPMH_VRM_MODE_VOTE_DRV3_REG3'/>"
WRITE #1 "        <register address='0xb830408' value='0x" DATA.LONG(A:0xb830408) "' name='RPMH_VRM_MODE_VOTE_DRV3_REG4'/>"
WRITE #1 "        <register address='0xb830508' value='0x" DATA.LONG(A:0xb830508) "' name='RPMH_VRM_MODE_VOTE_DRV3_REG5'/>"
WRITE #1 "        <register address='0xb830608' value='0x" DATA.LONG(A:0xb830608) "' name='RPMH_VRM_MODE_VOTE_DRV3_REG6'/>"
WRITE #1 "        <register address='0xb830708' value='0x" DATA.LONG(A:0xb830708) "' name='RPMH_VRM_MODE_VOTE_DRV3_REG7'/>"
WRITE #1 "        <register address='0xb830808' value='0x" DATA.LONG(A:0xb830808) "' name='RPMH_VRM_MODE_VOTE_DRV3_REG8'/>"
WRITE #1 "        <register address='0xb830908' value='0x" DATA.LONG(A:0xb830908) "' name='RPMH_VRM_MODE_VOTE_DRV3_REG9'/>"
WRITE #1 "        <register address='0xb830a08' value='0x" DATA.LONG(A:0xb830a08) "' name='RPMH_VRM_MODE_VOTE_DRV3_REG10'/>"
WRITE #1 "        <register address='0xb830b08' value='0x" DATA.LONG(A:0xb830b08) "' name='RPMH_VRM_MODE_VOTE_DRV3_REG11'/>"
WRITE #1 "        <register address='0xb830c08' value='0x" DATA.LONG(A:0xb830c08) "' name='RPMH_VRM_MODE_VOTE_DRV3_REG12'/>"
WRITE #1 "        <register address='0xb830d08' value='0x" DATA.LONG(A:0xb830d08) "' name='RPMH_VRM_MODE_VOTE_DRV3_REG13'/>"
WRITE #1 "        <register address='0xb830e08' value='0x" DATA.LONG(A:0xb830e08) "' name='RPMH_VRM_MODE_VOTE_DRV3_REG14'/>"
WRITE #1 "        <register address='0xb830f08' value='0x" DATA.LONG(A:0xb830f08) "' name='RPMH_VRM_MODE_VOTE_DRV3_REG15'/>"
WRITE #1 "        <register address='0xb831008' value='0x" DATA.LONG(A:0xb831008) "' name='RPMH_VRM_MODE_VOTE_DRV3_REG16'/>"
WRITE #1 "        <register address='0xb831108' value='0x" DATA.LONG(A:0xb831108) "' name='RPMH_VRM_MODE_VOTE_DRV3_REG17'/>"
WRITE #1 "        <register address='0xb831208' value='0x" DATA.LONG(A:0xb831208) "' name='RPMH_VRM_MODE_VOTE_DRV3_REG18'/>"
WRITE #1 "        <register address='0xb831308' value='0x" DATA.LONG(A:0xb831308) "' name='RPMH_VRM_MODE_VOTE_DRV3_REG19'/>"
WRITE #1 "        <register address='0xb831408' value='0x" DATA.LONG(A:0xb831408) "' name='RPMH_VRM_MODE_VOTE_DRV3_REG20'/>"
WRITE #1 "        <register address='0xb831508' value='0x" DATA.LONG(A:0xb831508) "' name='RPMH_VRM_MODE_VOTE_DRV3_REG21'/>"
WRITE #1 "        <register address='0xb831608' value='0x" DATA.LONG(A:0xb831608) "' name='RPMH_VRM_MODE_VOTE_DRV3_REG22'/>"
WRITE #1 "        <register address='0xb831708' value='0x" DATA.LONG(A:0xb831708) "' name='RPMH_VRM_MODE_VOTE_DRV3_REG23'/>"
WRITE #1 "        <register address='0xb831808' value='0x" DATA.LONG(A:0xb831808) "' name='RPMH_VRM_MODE_VOTE_DRV3_REG24'/>"
WRITE #1 "        <register address='0xb840008' value='0x" DATA.LONG(A:0xb840008) "' name='RPMH_VRM_MODE_VOTE_DRV4_REG0'/>"
WRITE #1 "        <register address='0xb840108' value='0x" DATA.LONG(A:0xb840108) "' name='RPMH_VRM_MODE_VOTE_DRV4_REG1'/>"
WRITE #1 "        <register address='0xb840208' value='0x" DATA.LONG(A:0xb840208) "' name='RPMH_VRM_MODE_VOTE_DRV4_REG2'/>"
WRITE #1 "        <register address='0xb840308' value='0x" DATA.LONG(A:0xb840308) "' name='RPMH_VRM_MODE_VOTE_DRV4_REG3'/>"
WRITE #1 "        <register address='0xb840408' value='0x" DATA.LONG(A:0xb840408) "' name='RPMH_VRM_MODE_VOTE_DRV4_REG4'/>"
WRITE #1 "        <register address='0xb840508' value='0x" DATA.LONG(A:0xb840508) "' name='RPMH_VRM_MODE_VOTE_DRV4_REG5'/>"
WRITE #1 "        <register address='0xb840608' value='0x" DATA.LONG(A:0xb840608) "' name='RPMH_VRM_MODE_VOTE_DRV4_REG6'/>"
WRITE #1 "        <register address='0xb840708' value='0x" DATA.LONG(A:0xb840708) "' name='RPMH_VRM_MODE_VOTE_DRV4_REG7'/>"
WRITE #1 "        <register address='0xb840808' value='0x" DATA.LONG(A:0xb840808) "' name='RPMH_VRM_MODE_VOTE_DRV4_REG8'/>"
WRITE #1 "        <register address='0xb840908' value='0x" DATA.LONG(A:0xb840908) "' name='RPMH_VRM_MODE_VOTE_DRV4_REG9'/>"
WRITE #1 "        <register address='0xb840a08' value='0x" DATA.LONG(A:0xb840a08) "' name='RPMH_VRM_MODE_VOTE_DRV4_REG10'/>"
WRITE #1 "        <register address='0xb840b08' value='0x" DATA.LONG(A:0xb840b08) "' name='RPMH_VRM_MODE_VOTE_DRV4_REG11'/>"
WRITE #1 "        <register address='0xb840c08' value='0x" DATA.LONG(A:0xb840c08) "' name='RPMH_VRM_MODE_VOTE_DRV4_REG12'/>"
WRITE #1 "        <register address='0xb840d08' value='0x" DATA.LONG(A:0xb840d08) "' name='RPMH_VRM_MODE_VOTE_DRV4_REG13'/>"
WRITE #1 "        <register address='0xb840e08' value='0x" DATA.LONG(A:0xb840e08) "' name='RPMH_VRM_MODE_VOTE_DRV4_REG14'/>"
WRITE #1 "        <register address='0xb840f08' value='0x" DATA.LONG(A:0xb840f08) "' name='RPMH_VRM_MODE_VOTE_DRV4_REG15'/>"
WRITE #1 "        <register address='0xb841008' value='0x" DATA.LONG(A:0xb841008) "' name='RPMH_VRM_MODE_VOTE_DRV4_REG16'/>"
WRITE #1 "        <register address='0xb841108' value='0x" DATA.LONG(A:0xb841108) "' name='RPMH_VRM_MODE_VOTE_DRV4_REG17'/>"
WRITE #1 "        <register address='0xb841208' value='0x" DATA.LONG(A:0xb841208) "' name='RPMH_VRM_MODE_VOTE_DRV4_REG18'/>"
WRITE #1 "        <register address='0xb841308' value='0x" DATA.LONG(A:0xb841308) "' name='RPMH_VRM_MODE_VOTE_DRV4_REG19'/>"
WRITE #1 "        <register address='0xb841408' value='0x" DATA.LONG(A:0xb841408) "' name='RPMH_VRM_MODE_VOTE_DRV4_REG20'/>"
WRITE #1 "        <register address='0xb841508' value='0x" DATA.LONG(A:0xb841508) "' name='RPMH_VRM_MODE_VOTE_DRV4_REG21'/>"
WRITE #1 "        <register address='0xb841608' value='0x" DATA.LONG(A:0xb841608) "' name='RPMH_VRM_MODE_VOTE_DRV4_REG22'/>"
WRITE #1 "        <register address='0xb841708' value='0x" DATA.LONG(A:0xb841708) "' name='RPMH_VRM_MODE_VOTE_DRV4_REG23'/>"
WRITE #1 "        <register address='0xb841808' value='0x" DATA.LONG(A:0xb841808) "' name='RPMH_VRM_MODE_VOTE_DRV4_REG24'/>"
WRITE #1 "        <register address='0xb850008' value='0x" DATA.LONG(A:0xb850008) "' name='RPMH_VRM_MODE_VOTE_DRV5_REG0'/>"
WRITE #1 "        <register address='0xb850108' value='0x" DATA.LONG(A:0xb850108) "' name='RPMH_VRM_MODE_VOTE_DRV5_REG1'/>"
WRITE #1 "        <register address='0xb850208' value='0x" DATA.LONG(A:0xb850208) "' name='RPMH_VRM_MODE_VOTE_DRV5_REG2'/>"
WRITE #1 "        <register address='0xb850308' value='0x" DATA.LONG(A:0xb850308) "' name='RPMH_VRM_MODE_VOTE_DRV5_REG3'/>"
WRITE #1 "        <register address='0xb850408' value='0x" DATA.LONG(A:0xb850408) "' name='RPMH_VRM_MODE_VOTE_DRV5_REG4'/>"
WRITE #1 "        <register address='0xb850508' value='0x" DATA.LONG(A:0xb850508) "' name='RPMH_VRM_MODE_VOTE_DRV5_REG5'/>"
WRITE #1 "        <register address='0xb850608' value='0x" DATA.LONG(A:0xb850608) "' name='RPMH_VRM_MODE_VOTE_DRV5_REG6'/>"
WRITE #1 "        <register address='0xb850708' value='0x" DATA.LONG(A:0xb850708) "' name='RPMH_VRM_MODE_VOTE_DRV5_REG7'/>"
WRITE #1 "        <register address='0xb850808' value='0x" DATA.LONG(A:0xb850808) "' name='RPMH_VRM_MODE_VOTE_DRV5_REG8'/>"
WRITE #1 "        <register address='0xb850908' value='0x" DATA.LONG(A:0xb850908) "' name='RPMH_VRM_MODE_VOTE_DRV5_REG9'/>"
WRITE #1 "        <register address='0xb850a08' value='0x" DATA.LONG(A:0xb850a08) "' name='RPMH_VRM_MODE_VOTE_DRV5_REG10'/>"
WRITE #1 "        <register address='0xb850b08' value='0x" DATA.LONG(A:0xb850b08) "' name='RPMH_VRM_MODE_VOTE_DRV5_REG11'/>"
WRITE #1 "        <register address='0xb850c08' value='0x" DATA.LONG(A:0xb850c08) "' name='RPMH_VRM_MODE_VOTE_DRV5_REG12'/>"
WRITE #1 "        <register address='0xb850d08' value='0x" DATA.LONG(A:0xb850d08) "' name='RPMH_VRM_MODE_VOTE_DRV5_REG13'/>"
WRITE #1 "        <register address='0xb850e08' value='0x" DATA.LONG(A:0xb850e08) "' name='RPMH_VRM_MODE_VOTE_DRV5_REG14'/>"
WRITE #1 "        <register address='0xb850f08' value='0x" DATA.LONG(A:0xb850f08) "' name='RPMH_VRM_MODE_VOTE_DRV5_REG15'/>"
WRITE #1 "        <register address='0xb851008' value='0x" DATA.LONG(A:0xb851008) "' name='RPMH_VRM_MODE_VOTE_DRV5_REG16'/>"
WRITE #1 "        <register address='0xb851108' value='0x" DATA.LONG(A:0xb851108) "' name='RPMH_VRM_MODE_VOTE_DRV5_REG17'/>"
WRITE #1 "        <register address='0xb851208' value='0x" DATA.LONG(A:0xb851208) "' name='RPMH_VRM_MODE_VOTE_DRV5_REG18'/>"
WRITE #1 "        <register address='0xb851308' value='0x" DATA.LONG(A:0xb851308) "' name='RPMH_VRM_MODE_VOTE_DRV5_REG19'/>"
WRITE #1 "        <register address='0xb851408' value='0x" DATA.LONG(A:0xb851408) "' name='RPMH_VRM_MODE_VOTE_DRV5_REG20'/>"
WRITE #1 "        <register address='0xb851508' value='0x" DATA.LONG(A:0xb851508) "' name='RPMH_VRM_MODE_VOTE_DRV5_REG21'/>"
WRITE #1 "        <register address='0xb851608' value='0x" DATA.LONG(A:0xb851608) "' name='RPMH_VRM_MODE_VOTE_DRV5_REG22'/>"
WRITE #1 "        <register address='0xb851708' value='0x" DATA.LONG(A:0xb851708) "' name='RPMH_VRM_MODE_VOTE_DRV5_REG23'/>"
WRITE #1 "        <register address='0xb851808' value='0x" DATA.LONG(A:0xb851808) "' name='RPMH_VRM_MODE_VOTE_DRV5_REG24'/>"
WRITE #1 "        <register address='0xb860008' value='0x" DATA.LONG(A:0xb860008) "' name='RPMH_VRM_MODE_VOTE_DRV6_REG0'/>"
WRITE #1 "        <register address='0xb860108' value='0x" DATA.LONG(A:0xb860108) "' name='RPMH_VRM_MODE_VOTE_DRV6_REG1'/>"
WRITE #1 "        <register address='0xb860208' value='0x" DATA.LONG(A:0xb860208) "' name='RPMH_VRM_MODE_VOTE_DRV6_REG2'/>"
WRITE #1 "        <register address='0xb860308' value='0x" DATA.LONG(A:0xb860308) "' name='RPMH_VRM_MODE_VOTE_DRV6_REG3'/>"
WRITE #1 "        <register address='0xb860408' value='0x" DATA.LONG(A:0xb860408) "' name='RPMH_VRM_MODE_VOTE_DRV6_REG4'/>"
WRITE #1 "        <register address='0xb860508' value='0x" DATA.LONG(A:0xb860508) "' name='RPMH_VRM_MODE_VOTE_DRV6_REG5'/>"
WRITE #1 "        <register address='0xb860608' value='0x" DATA.LONG(A:0xb860608) "' name='RPMH_VRM_MODE_VOTE_DRV6_REG6'/>"
WRITE #1 "        <register address='0xb860708' value='0x" DATA.LONG(A:0xb860708) "' name='RPMH_VRM_MODE_VOTE_DRV6_REG7'/>"
WRITE #1 "        <register address='0xb860808' value='0x" DATA.LONG(A:0xb860808) "' name='RPMH_VRM_MODE_VOTE_DRV6_REG8'/>"
WRITE #1 "        <register address='0xb860908' value='0x" DATA.LONG(A:0xb860908) "' name='RPMH_VRM_MODE_VOTE_DRV6_REG9'/>"
WRITE #1 "        <register address='0xb860a08' value='0x" DATA.LONG(A:0xb860a08) "' name='RPMH_VRM_MODE_VOTE_DRV6_REG10'/>"
WRITE #1 "        <register address='0xb860b08' value='0x" DATA.LONG(A:0xb860b08) "' name='RPMH_VRM_MODE_VOTE_DRV6_REG11'/>"
WRITE #1 "        <register address='0xb860c08' value='0x" DATA.LONG(A:0xb860c08) "' name='RPMH_VRM_MODE_VOTE_DRV6_REG12'/>"
WRITE #1 "        <register address='0xb860d08' value='0x" DATA.LONG(A:0xb860d08) "' name='RPMH_VRM_MODE_VOTE_DRV6_REG13'/>"
WRITE #1 "        <register address='0xb860e08' value='0x" DATA.LONG(A:0xb860e08) "' name='RPMH_VRM_MODE_VOTE_DRV6_REG14'/>"
WRITE #1 "        <register address='0xb860f08' value='0x" DATA.LONG(A:0xb860f08) "' name='RPMH_VRM_MODE_VOTE_DRV6_REG15'/>"
WRITE #1 "        <register address='0xb861008' value='0x" DATA.LONG(A:0xb861008) "' name='RPMH_VRM_MODE_VOTE_DRV6_REG16'/>"
WRITE #1 "        <register address='0xb861108' value='0x" DATA.LONG(A:0xb861108) "' name='RPMH_VRM_MODE_VOTE_DRV6_REG17'/>"
WRITE #1 "        <register address='0xb861208' value='0x" DATA.LONG(A:0xb861208) "' name='RPMH_VRM_MODE_VOTE_DRV6_REG18'/>"
WRITE #1 "        <register address='0xb861308' value='0x" DATA.LONG(A:0xb861308) "' name='RPMH_VRM_MODE_VOTE_DRV6_REG19'/>"
WRITE #1 "        <register address='0xb861408' value='0x" DATA.LONG(A:0xb861408) "' name='RPMH_VRM_MODE_VOTE_DRV6_REG20'/>"
WRITE #1 "        <register address='0xb861508' value='0x" DATA.LONG(A:0xb861508) "' name='RPMH_VRM_MODE_VOTE_DRV6_REG21'/>"
WRITE #1 "        <register address='0xb861608' value='0x" DATA.LONG(A:0xb861608) "' name='RPMH_VRM_MODE_VOTE_DRV6_REG22'/>"
WRITE #1 "        <register address='0xb861708' value='0x" DATA.LONG(A:0xb861708) "' name='RPMH_VRM_MODE_VOTE_DRV6_REG23'/>"
WRITE #1 "        <register address='0xb861808' value='0x" DATA.LONG(A:0xb861808) "' name='RPMH_VRM_MODE_VOTE_DRV6_REG24'/>"
WRITE #1 "        <register address='0xb801904' value='0x" DATA.LONG(A:0xb801904) "' name='RPMH_VRM_ENABLE_VOTE_DRV0_XOB0'/>"
WRITE #1 "        <register address='0xb801a04' value='0x" DATA.LONG(A:0xb801a04) "' name='RPMH_VRM_ENABLE_VOTE_DRV0_XOB1'/>"
WRITE #1 "        <register address='0xb801b04' value='0x" DATA.LONG(A:0xb801b04) "' name='RPMH_VRM_ENABLE_VOTE_DRV0_XOB2'/>"
WRITE #1 "        <register address='0xb801c04' value='0x" DATA.LONG(A:0xb801c04) "' name='RPMH_VRM_ENABLE_VOTE_DRV0_XOB3'/>"
WRITE #1 "        <register address='0xb801d04' value='0x" DATA.LONG(A:0xb801d04) "' name='RPMH_VRM_ENABLE_VOTE_DRV0_XOB4'/>"
WRITE #1 "        <register address='0xb801e04' value='0x" DATA.LONG(A:0xb801e04) "' name='RPMH_VRM_ENABLE_VOTE_DRV0_XOB5'/>"
WRITE #1 "        <register address='0xb801f04' value='0x" DATA.LONG(A:0xb801f04) "' name='RPMH_VRM_ENABLE_VOTE_DRV0_XOB6'/>"
WRITE #1 "        <register address='0xb802004' value='0x" DATA.LONG(A:0xb802004) "' name='RPMH_VRM_ENABLE_VOTE_DRV0_XOB7'/>"
WRITE #1 "        <register address='0xb802104' value='0x" DATA.LONG(A:0xb802104) "' name='RPMH_VRM_ENABLE_VOTE_DRV0_XOB8'/>"
WRITE #1 "        <register address='0xb802204' value='0x" DATA.LONG(A:0xb802204) "' name='RPMH_VRM_ENABLE_VOTE_DRV0_XOB9'/>"
WRITE #1 "        <register address='0xb802304' value='0x" DATA.LONG(A:0xb802304) "' name='RPMH_VRM_ENABLE_VOTE_DRV0_XOB10'/>"
WRITE #1 "        <register address='0xb802404' value='0x" DATA.LONG(A:0xb802404) "' name='RPMH_VRM_ENABLE_VOTE_DRV0_XOB11'/>"
WRITE #1 "        <register address='0xb802504' value='0x" DATA.LONG(A:0xb802504) "' name='RPMH_VRM_ENABLE_VOTE_DRV0_XOB12'/>"
WRITE #1 "        <register address='0xb802604' value='0x" DATA.LONG(A:0xb802604) "' name='RPMH_VRM_ENABLE_VOTE_DRV0_XOB13'/>"
WRITE #1 "        <register address='0xb802704' value='0x" DATA.LONG(A:0xb802704) "' name='RPMH_VRM_ENABLE_VOTE_DRV0_XOB14'/>"
WRITE #1 "        <register address='0xb802804' value='0x" DATA.LONG(A:0xb802804) "' name='RPMH_VRM_ENABLE_VOTE_DRV0_XOB15'/>"
WRITE #1 "        <register address='0xb811904' value='0x" DATA.LONG(A:0xb811904) "' name='RPMH_VRM_ENABLE_VOTE_DRV1_XOB0'/>"
WRITE #1 "        <register address='0xb811a04' value='0x" DATA.LONG(A:0xb811a04) "' name='RPMH_VRM_ENABLE_VOTE_DRV1_XOB1'/>"
WRITE #1 "        <register address='0xb811b04' value='0x" DATA.LONG(A:0xb811b04) "' name='RPMH_VRM_ENABLE_VOTE_DRV1_XOB2'/>"
WRITE #1 "        <register address='0xb811c04' value='0x" DATA.LONG(A:0xb811c04) "' name='RPMH_VRM_ENABLE_VOTE_DRV1_XOB3'/>"
WRITE #1 "        <register address='0xb811d04' value='0x" DATA.LONG(A:0xb811d04) "' name='RPMH_VRM_ENABLE_VOTE_DRV1_XOB4'/>"
WRITE #1 "        <register address='0xb811e04' value='0x" DATA.LONG(A:0xb811e04) "' name='RPMH_VRM_ENABLE_VOTE_DRV1_XOB5'/>"
WRITE #1 "        <register address='0xb811f04' value='0x" DATA.LONG(A:0xb811f04) "' name='RPMH_VRM_ENABLE_VOTE_DRV1_XOB6'/>"
WRITE #1 "        <register address='0xb812004' value='0x" DATA.LONG(A:0xb812004) "' name='RPMH_VRM_ENABLE_VOTE_DRV1_XOB7'/>"
WRITE #1 "        <register address='0xb812104' value='0x" DATA.LONG(A:0xb812104) "' name='RPMH_VRM_ENABLE_VOTE_DRV1_XOB8'/>"
WRITE #1 "        <register address='0xb812204' value='0x" DATA.LONG(A:0xb812204) "' name='RPMH_VRM_ENABLE_VOTE_DRV1_XOB9'/>"
WRITE #1 "        <register address='0xb812304' value='0x" DATA.LONG(A:0xb812304) "' name='RPMH_VRM_ENABLE_VOTE_DRV1_XOB10'/>"
WRITE #1 "        <register address='0xb812404' value='0x" DATA.LONG(A:0xb812404) "' name='RPMH_VRM_ENABLE_VOTE_DRV1_XOB11'/>"
WRITE #1 "        <register address='0xb812504' value='0x" DATA.LONG(A:0xb812504) "' name='RPMH_VRM_ENABLE_VOTE_DRV1_XOB12'/>"
WRITE #1 "        <register address='0xb812604' value='0x" DATA.LONG(A:0xb812604) "' name='RPMH_VRM_ENABLE_VOTE_DRV1_XOB13'/>"
WRITE #1 "        <register address='0xb812704' value='0x" DATA.LONG(A:0xb812704) "' name='RPMH_VRM_ENABLE_VOTE_DRV1_XOB14'/>"
WRITE #1 "        <register address='0xb812804' value='0x" DATA.LONG(A:0xb812804) "' name='RPMH_VRM_ENABLE_VOTE_DRV1_XOB15'/>"
WRITE #1 "        <register address='0xb821904' value='0x" DATA.LONG(A:0xb821904) "' name='RPMH_VRM_ENABLE_VOTE_DRV2_XOB0'/>"
WRITE #1 "        <register address='0xb821a04' value='0x" DATA.LONG(A:0xb821a04) "' name='RPMH_VRM_ENABLE_VOTE_DRV2_XOB1'/>"
WRITE #1 "        <register address='0xb821b04' value='0x" DATA.LONG(A:0xb821b04) "' name='RPMH_VRM_ENABLE_VOTE_DRV2_XOB2'/>"
WRITE #1 "        <register address='0xb821c04' value='0x" DATA.LONG(A:0xb821c04) "' name='RPMH_VRM_ENABLE_VOTE_DRV2_XOB3'/>"
WRITE #1 "        <register address='0xb821d04' value='0x" DATA.LONG(A:0xb821d04) "' name='RPMH_VRM_ENABLE_VOTE_DRV2_XOB4'/>"
WRITE #1 "        <register address='0xb821e04' value='0x" DATA.LONG(A:0xb821e04) "' name='RPMH_VRM_ENABLE_VOTE_DRV2_XOB5'/>"
WRITE #1 "        <register address='0xb821f04' value='0x" DATA.LONG(A:0xb821f04) "' name='RPMH_VRM_ENABLE_VOTE_DRV2_XOB6'/>"
WRITE #1 "        <register address='0xb822004' value='0x" DATA.LONG(A:0xb822004) "' name='RPMH_VRM_ENABLE_VOTE_DRV2_XOB7'/>"
WRITE #1 "        <register address='0xb822104' value='0x" DATA.LONG(A:0xb822104) "' name='RPMH_VRM_ENABLE_VOTE_DRV2_XOB8'/>"
WRITE #1 "        <register address='0xb822204' value='0x" DATA.LONG(A:0xb822204) "' name='RPMH_VRM_ENABLE_VOTE_DRV2_XOB9'/>"
WRITE #1 "        <register address='0xb822304' value='0x" DATA.LONG(A:0xb822304) "' name='RPMH_VRM_ENABLE_VOTE_DRV2_XOB10'/>"
WRITE #1 "        <register address='0xb822404' value='0x" DATA.LONG(A:0xb822404) "' name='RPMH_VRM_ENABLE_VOTE_DRV2_XOB11'/>"
WRITE #1 "        <register address='0xb822504' value='0x" DATA.LONG(A:0xb822504) "' name='RPMH_VRM_ENABLE_VOTE_DRV2_XOB12'/>"
WRITE #1 "        <register address='0xb822604' value='0x" DATA.LONG(A:0xb822604) "' name='RPMH_VRM_ENABLE_VOTE_DRV2_XOB13'/>"
WRITE #1 "        <register address='0xb822704' value='0x" DATA.LONG(A:0xb822704) "' name='RPMH_VRM_ENABLE_VOTE_DRV2_XOB14'/>"
WRITE #1 "        <register address='0xb822804' value='0x" DATA.LONG(A:0xb822804) "' name='RPMH_VRM_ENABLE_VOTE_DRV2_XOB15'/>"
WRITE #1 "        <register address='0xb831904' value='0x" DATA.LONG(A:0xb831904) "' name='RPMH_VRM_ENABLE_VOTE_DRV3_XOB0'/>"
WRITE #1 "        <register address='0xb831a04' value='0x" DATA.LONG(A:0xb831a04) "' name='RPMH_VRM_ENABLE_VOTE_DRV3_XOB1'/>"
WRITE #1 "        <register address='0xb831b04' value='0x" DATA.LONG(A:0xb831b04) "' name='RPMH_VRM_ENABLE_VOTE_DRV3_XOB2'/>"
WRITE #1 "        <register address='0xb831c04' value='0x" DATA.LONG(A:0xb831c04) "' name='RPMH_VRM_ENABLE_VOTE_DRV3_XOB3'/>"
WRITE #1 "        <register address='0xb831d04' value='0x" DATA.LONG(A:0xb831d04) "' name='RPMH_VRM_ENABLE_VOTE_DRV3_XOB4'/>"
WRITE #1 "        <register address='0xb831e04' value='0x" DATA.LONG(A:0xb831e04) "' name='RPMH_VRM_ENABLE_VOTE_DRV3_XOB5'/>"
WRITE #1 "        <register address='0xb831f04' value='0x" DATA.LONG(A:0xb831f04) "' name='RPMH_VRM_ENABLE_VOTE_DRV3_XOB6'/>"
WRITE #1 "        <register address='0xb832004' value='0x" DATA.LONG(A:0xb832004) "' name='RPMH_VRM_ENABLE_VOTE_DRV3_XOB7'/>"
WRITE #1 "        <register address='0xb832104' value='0x" DATA.LONG(A:0xb832104) "' name='RPMH_VRM_ENABLE_VOTE_DRV3_XOB8'/>"
WRITE #1 "        <register address='0xb832204' value='0x" DATA.LONG(A:0xb832204) "' name='RPMH_VRM_ENABLE_VOTE_DRV3_XOB9'/>"
WRITE #1 "        <register address='0xb832304' value='0x" DATA.LONG(A:0xb832304) "' name='RPMH_VRM_ENABLE_VOTE_DRV3_XOB10'/>"
WRITE #1 "        <register address='0xb832404' value='0x" DATA.LONG(A:0xb832404) "' name='RPMH_VRM_ENABLE_VOTE_DRV3_XOB11'/>"
WRITE #1 "        <register address='0xb832504' value='0x" DATA.LONG(A:0xb832504) "' name='RPMH_VRM_ENABLE_VOTE_DRV3_XOB12'/>"
WRITE #1 "        <register address='0xb832604' value='0x" DATA.LONG(A:0xb832604) "' name='RPMH_VRM_ENABLE_VOTE_DRV3_XOB13'/>"
WRITE #1 "        <register address='0xb832704' value='0x" DATA.LONG(A:0xb832704) "' name='RPMH_VRM_ENABLE_VOTE_DRV3_XOB14'/>"
WRITE #1 "        <register address='0xb832804' value='0x" DATA.LONG(A:0xb832804) "' name='RPMH_VRM_ENABLE_VOTE_DRV3_XOB15'/>"
WRITE #1 "        <register address='0xb841904' value='0x" DATA.LONG(A:0xb841904) "' name='RPMH_VRM_ENABLE_VOTE_DRV4_XOB0'/>"
WRITE #1 "        <register address='0xb841a04' value='0x" DATA.LONG(A:0xb841a04) "' name='RPMH_VRM_ENABLE_VOTE_DRV4_XOB1'/>"
WRITE #1 "        <register address='0xb841b04' value='0x" DATA.LONG(A:0xb841b04) "' name='RPMH_VRM_ENABLE_VOTE_DRV4_XOB2'/>"
WRITE #1 "        <register address='0xb841c04' value='0x" DATA.LONG(A:0xb841c04) "' name='RPMH_VRM_ENABLE_VOTE_DRV4_XOB3'/>"
WRITE #1 "        <register address='0xb841d04' value='0x" DATA.LONG(A:0xb841d04) "' name='RPMH_VRM_ENABLE_VOTE_DRV4_XOB4'/>"
WRITE #1 "        <register address='0xb841e04' value='0x" DATA.LONG(A:0xb841e04) "' name='RPMH_VRM_ENABLE_VOTE_DRV4_XOB5'/>"
WRITE #1 "        <register address='0xb841f04' value='0x" DATA.LONG(A:0xb841f04) "' name='RPMH_VRM_ENABLE_VOTE_DRV4_XOB6'/>"
WRITE #1 "        <register address='0xb842004' value='0x" DATA.LONG(A:0xb842004) "' name='RPMH_VRM_ENABLE_VOTE_DRV4_XOB7'/>"
WRITE #1 "        <register address='0xb842104' value='0x" DATA.LONG(A:0xb842104) "' name='RPMH_VRM_ENABLE_VOTE_DRV4_XOB8'/>"
WRITE #1 "        <register address='0xb842204' value='0x" DATA.LONG(A:0xb842204) "' name='RPMH_VRM_ENABLE_VOTE_DRV4_XOB9'/>"
WRITE #1 "        <register address='0xb842304' value='0x" DATA.LONG(A:0xb842304) "' name='RPMH_VRM_ENABLE_VOTE_DRV4_XOB10'/>"
WRITE #1 "        <register address='0xb842404' value='0x" DATA.LONG(A:0xb842404) "' name='RPMH_VRM_ENABLE_VOTE_DRV4_XOB11'/>"
WRITE #1 "        <register address='0xb842504' value='0x" DATA.LONG(A:0xb842504) "' name='RPMH_VRM_ENABLE_VOTE_DRV4_XOB12'/>"
WRITE #1 "        <register address='0xb842604' value='0x" DATA.LONG(A:0xb842604) "' name='RPMH_VRM_ENABLE_VOTE_DRV4_XOB13'/>"
WRITE #1 "        <register address='0xb842704' value='0x" DATA.LONG(A:0xb842704) "' name='RPMH_VRM_ENABLE_VOTE_DRV4_XOB14'/>"
WRITE #1 "        <register address='0xb842804' value='0x" DATA.LONG(A:0xb842804) "' name='RPMH_VRM_ENABLE_VOTE_DRV4_XOB15'/>"
WRITE #1 "        <register address='0xb851904' value='0x" DATA.LONG(A:0xb851904) "' name='RPMH_VRM_ENABLE_VOTE_DRV5_XOB0'/>"
WRITE #1 "        <register address='0xb851a04' value='0x" DATA.LONG(A:0xb851a04) "' name='RPMH_VRM_ENABLE_VOTE_DRV5_XOB1'/>"
WRITE #1 "        <register address='0xb851b04' value='0x" DATA.LONG(A:0xb851b04) "' name='RPMH_VRM_ENABLE_VOTE_DRV5_XOB2'/>"
WRITE #1 "        <register address='0xb851c04' value='0x" DATA.LONG(A:0xb851c04) "' name='RPMH_VRM_ENABLE_VOTE_DRV5_XOB3'/>"
WRITE #1 "        <register address='0xb851d04' value='0x" DATA.LONG(A:0xb851d04) "' name='RPMH_VRM_ENABLE_VOTE_DRV5_XOB4'/>"
WRITE #1 "        <register address='0xb851e04' value='0x" DATA.LONG(A:0xb851e04) "' name='RPMH_VRM_ENABLE_VOTE_DRV5_XOB5'/>"
WRITE #1 "        <register address='0xb851f04' value='0x" DATA.LONG(A:0xb851f04) "' name='RPMH_VRM_ENABLE_VOTE_DRV5_XOB6'/>"
WRITE #1 "        <register address='0xb852004' value='0x" DATA.LONG(A:0xb852004) "' name='RPMH_VRM_ENABLE_VOTE_DRV5_XOB7'/>"
WRITE #1 "        <register address='0xb852104' value='0x" DATA.LONG(A:0xb852104) "' name='RPMH_VRM_ENABLE_VOTE_DRV5_XOB8'/>"
WRITE #1 "        <register address='0xb852204' value='0x" DATA.LONG(A:0xb852204) "' name='RPMH_VRM_ENABLE_VOTE_DRV5_XOB9'/>"
WRITE #1 "        <register address='0xb852304' value='0x" DATA.LONG(A:0xb852304) "' name='RPMH_VRM_ENABLE_VOTE_DRV5_XOB10'/>"
WRITE #1 "        <register address='0xb852404' value='0x" DATA.LONG(A:0xb852404) "' name='RPMH_VRM_ENABLE_VOTE_DRV5_XOB11'/>"
WRITE #1 "        <register address='0xb852504' value='0x" DATA.LONG(A:0xb852504) "' name='RPMH_VRM_ENABLE_VOTE_DRV5_XOB12'/>"
WRITE #1 "        <register address='0xb852604' value='0x" DATA.LONG(A:0xb852604) "' name='RPMH_VRM_ENABLE_VOTE_DRV5_XOB13'/>"
WRITE #1 "        <register address='0xb852704' value='0x" DATA.LONG(A:0xb852704) "' name='RPMH_VRM_ENABLE_VOTE_DRV5_XOB14'/>"
WRITE #1 "        <register address='0xb852804' value='0x" DATA.LONG(A:0xb852804) "' name='RPMH_VRM_ENABLE_VOTE_DRV5_XOB15'/>"
WRITE #1 "        <register address='0xb861904' value='0x" DATA.LONG(A:0xb861904) "' name='RPMH_VRM_ENABLE_VOTE_DRV6_XOB0'/>"
WRITE #1 "        <register address='0xb861a04' value='0x" DATA.LONG(A:0xb861a04) "' name='RPMH_VRM_ENABLE_VOTE_DRV6_XOB1'/>"
WRITE #1 "        <register address='0xb861b04' value='0x" DATA.LONG(A:0xb861b04) "' name='RPMH_VRM_ENABLE_VOTE_DRV6_XOB2'/>"
WRITE #1 "        <register address='0xb861c04' value='0x" DATA.LONG(A:0xb861c04) "' name='RPMH_VRM_ENABLE_VOTE_DRV6_XOB3'/>"
WRITE #1 "        <register address='0xb861d04' value='0x" DATA.LONG(A:0xb861d04) "' name='RPMH_VRM_ENABLE_VOTE_DRV6_XOB4'/>"
WRITE #1 "        <register address='0xb861e04' value='0x" DATA.LONG(A:0xb861e04) "' name='RPMH_VRM_ENABLE_VOTE_DRV6_XOB5'/>"
WRITE #1 "        <register address='0xb861f04' value='0x" DATA.LONG(A:0xb861f04) "' name='RPMH_VRM_ENABLE_VOTE_DRV6_XOB6'/>"
WRITE #1 "        <register address='0xb862004' value='0x" DATA.LONG(A:0xb862004) "' name='RPMH_VRM_ENABLE_VOTE_DRV6_XOB7'/>"
WRITE #1 "        <register address='0xb862104' value='0x" DATA.LONG(A:0xb862104) "' name='RPMH_VRM_ENABLE_VOTE_DRV6_XOB8'/>"
WRITE #1 "        <register address='0xb862204' value='0x" DATA.LONG(A:0xb862204) "' name='RPMH_VRM_ENABLE_VOTE_DRV6_XOB9'/>"
WRITE #1 "        <register address='0xb862304' value='0x" DATA.LONG(A:0xb862304) "' name='RPMH_VRM_ENABLE_VOTE_DRV6_XOB10'/>"
WRITE #1 "        <register address='0xb862404' value='0x" DATA.LONG(A:0xb862404) "' name='RPMH_VRM_ENABLE_VOTE_DRV6_XOB11'/>"
WRITE #1 "        <register address='0xb862504' value='0x" DATA.LONG(A:0xb862504) "' name='RPMH_VRM_ENABLE_VOTE_DRV6_XOB12'/>"
WRITE #1 "        <register address='0xb862604' value='0x" DATA.LONG(A:0xb862604) "' name='RPMH_VRM_ENABLE_VOTE_DRV6_XOB13'/>"
WRITE #1 "        <register address='0xb862704' value='0x" DATA.LONG(A:0xb862704) "' name='RPMH_VRM_ENABLE_VOTE_DRV6_XOB14'/>"
WRITE #1 "        <register address='0xb862804' value='0x" DATA.LONG(A:0xb862804) "' name='RPMH_VRM_ENABLE_VOTE_DRV6_XOB15'/>"
WRITE #1 "        <register address='0xb802904' value='0x" DATA.LONG(A:0xb802904) "' name='RPMH_VRM_ENABLE_VOTE_DRV0_XO0'/>"
WRITE #1 "        <register address='0xb812904' value='0x" DATA.LONG(A:0xb812904) "' name='RPMH_VRM_ENABLE_VOTE_DRV1_XO0'/>"
WRITE #1 "        <register address='0xb822904' value='0x" DATA.LONG(A:0xb822904) "' name='RPMH_VRM_ENABLE_VOTE_DRV2_XO0'/>"
WRITE #1 "        <register address='0xb832904' value='0x" DATA.LONG(A:0xb832904) "' name='RPMH_VRM_ENABLE_VOTE_DRV3_XO0'/>"
WRITE #1 "        <register address='0xb842904' value='0x" DATA.LONG(A:0xb842904) "' name='RPMH_VRM_ENABLE_VOTE_DRV4_XO0'/>"
WRITE #1 "        <register address='0xb852904' value='0x" DATA.LONG(A:0xb852904) "' name='RPMH_VRM_ENABLE_VOTE_DRV5_XO0'/>"
WRITE #1 "        <register address='0xb862904' value='0x" DATA.LONG(A:0xb862904) "' name='RPMH_VRM_ENABLE_VOTE_DRV6_XO0'/>"
WRITE #1 "        <register address='0xb800020' value='0x" DATA.LONG(A:0xb800020) "' name='RPMH_VRM_VOLTAGE_CRS_DRV0_REG0'/>"
WRITE #1 "        <register address='0xb800120' value='0x" DATA.LONG(A:0xb800120) "' name='RPMH_VRM_VOLTAGE_CRS_DRV0_REG1'/>"
WRITE #1 "        <register address='0xb800220' value='0x" DATA.LONG(A:0xb800220) "' name='RPMH_VRM_VOLTAGE_CRS_DRV0_REG2'/>"
WRITE #1 "        <register address='0xb800320' value='0x" DATA.LONG(A:0xb800320) "' name='RPMH_VRM_VOLTAGE_CRS_DRV0_REG3'/>"
WRITE #1 "        <register address='0xb800420' value='0x" DATA.LONG(A:0xb800420) "' name='RPMH_VRM_VOLTAGE_CRS_DRV0_REG4'/>"
WRITE #1 "        <register address='0xb800520' value='0x" DATA.LONG(A:0xb800520) "' name='RPMH_VRM_VOLTAGE_CRS_DRV0_REG5'/>"
WRITE #1 "        <register address='0xb800620' value='0x" DATA.LONG(A:0xb800620) "' name='RPMH_VRM_VOLTAGE_CRS_DRV0_REG6'/>"
WRITE #1 "        <register address='0xb800720' value='0x" DATA.LONG(A:0xb800720) "' name='RPMH_VRM_VOLTAGE_CRS_DRV0_REG7'/>"
WRITE #1 "        <register address='0xb800820' value='0x" DATA.LONG(A:0xb800820) "' name='RPMH_VRM_VOLTAGE_CRS_DRV0_REG8'/>"
WRITE #1 "        <register address='0xb800920' value='0x" DATA.LONG(A:0xb800920) "' name='RPMH_VRM_VOLTAGE_CRS_DRV0_REG9'/>"
WRITE #1 "        <register address='0xb800a20' value='0x" DATA.LONG(A:0xb800a20) "' name='RPMH_VRM_VOLTAGE_CRS_DRV0_REG10'/>"
WRITE #1 "        <register address='0xb800b20' value='0x" DATA.LONG(A:0xb800b20) "' name='RPMH_VRM_VOLTAGE_CRS_DRV0_REG11'/>"
WRITE #1 "        <register address='0xb800c20' value='0x" DATA.LONG(A:0xb800c20) "' name='RPMH_VRM_VOLTAGE_CRS_DRV0_REG12'/>"
WRITE #1 "        <register address='0xb800d20' value='0x" DATA.LONG(A:0xb800d20) "' name='RPMH_VRM_VOLTAGE_CRS_DRV0_REG13'/>"
WRITE #1 "        <register address='0xb800e20' value='0x" DATA.LONG(A:0xb800e20) "' name='RPMH_VRM_VOLTAGE_CRS_DRV0_REG14'/>"
WRITE #1 "        <register address='0xb800f20' value='0x" DATA.LONG(A:0xb800f20) "' name='RPMH_VRM_VOLTAGE_CRS_DRV0_REG15'/>"
WRITE #1 "        <register address='0xb801020' value='0x" DATA.LONG(A:0xb801020) "' name='RPMH_VRM_VOLTAGE_CRS_DRV0_REG16'/>"
WRITE #1 "        <register address='0xb801120' value='0x" DATA.LONG(A:0xb801120) "' name='RPMH_VRM_VOLTAGE_CRS_DRV0_REG17'/>"
WRITE #1 "        <register address='0xb801220' value='0x" DATA.LONG(A:0xb801220) "' name='RPMH_VRM_VOLTAGE_CRS_DRV0_REG18'/>"
WRITE #1 "        <register address='0xb801320' value='0x" DATA.LONG(A:0xb801320) "' name='RPMH_VRM_VOLTAGE_CRS_DRV0_REG19'/>"
WRITE #1 "        <register address='0xb801420' value='0x" DATA.LONG(A:0xb801420) "' name='RPMH_VRM_VOLTAGE_CRS_DRV0_REG20'/>"
WRITE #1 "        <register address='0xb801520' value='0x" DATA.LONG(A:0xb801520) "' name='RPMH_VRM_VOLTAGE_CRS_DRV0_REG21'/>"
WRITE #1 "        <register address='0xb801620' value='0x" DATA.LONG(A:0xb801620) "' name='RPMH_VRM_VOLTAGE_CRS_DRV0_REG22'/>"
WRITE #1 "        <register address='0xb801720' value='0x" DATA.LONG(A:0xb801720) "' name='RPMH_VRM_VOLTAGE_CRS_DRV0_REG23'/>"
WRITE #1 "        <register address='0xb801820' value='0x" DATA.LONG(A:0xb801820) "' name='RPMH_VRM_VOLTAGE_CRS_DRV0_REG24'/>"
WRITE #1 "        <register address='0xb810020' value='0x" DATA.LONG(A:0xb810020) "' name='RPMH_VRM_VOLTAGE_CRS_DRV1_REG0'/>"
WRITE #1 "        <register address='0xb810120' value='0x" DATA.LONG(A:0xb810120) "' name='RPMH_VRM_VOLTAGE_CRS_DRV1_REG1'/>"
WRITE #1 "        <register address='0xb810220' value='0x" DATA.LONG(A:0xb810220) "' name='RPMH_VRM_VOLTAGE_CRS_DRV1_REG2'/>"
WRITE #1 "        <register address='0xb810320' value='0x" DATA.LONG(A:0xb810320) "' name='RPMH_VRM_VOLTAGE_CRS_DRV1_REG3'/>"
WRITE #1 "        <register address='0xb810420' value='0x" DATA.LONG(A:0xb810420) "' name='RPMH_VRM_VOLTAGE_CRS_DRV1_REG4'/>"
WRITE #1 "        <register address='0xb810520' value='0x" DATA.LONG(A:0xb810520) "' name='RPMH_VRM_VOLTAGE_CRS_DRV1_REG5'/>"
WRITE #1 "        <register address='0xb810620' value='0x" DATA.LONG(A:0xb810620) "' name='RPMH_VRM_VOLTAGE_CRS_DRV1_REG6'/>"
WRITE #1 "        <register address='0xb810720' value='0x" DATA.LONG(A:0xb810720) "' name='RPMH_VRM_VOLTAGE_CRS_DRV1_REG7'/>"
WRITE #1 "        <register address='0xb810820' value='0x" DATA.LONG(A:0xb810820) "' name='RPMH_VRM_VOLTAGE_CRS_DRV1_REG8'/>"
WRITE #1 "        <register address='0xb810920' value='0x" DATA.LONG(A:0xb810920) "' name='RPMH_VRM_VOLTAGE_CRS_DRV1_REG9'/>"
WRITE #1 "        <register address='0xb810a20' value='0x" DATA.LONG(A:0xb810a20) "' name='RPMH_VRM_VOLTAGE_CRS_DRV1_REG10'/>"
WRITE #1 "        <register address='0xb810b20' value='0x" DATA.LONG(A:0xb810b20) "' name='RPMH_VRM_VOLTAGE_CRS_DRV1_REG11'/>"
WRITE #1 "        <register address='0xb810c20' value='0x" DATA.LONG(A:0xb810c20) "' name='RPMH_VRM_VOLTAGE_CRS_DRV1_REG12'/>"
WRITE #1 "        <register address='0xb810d20' value='0x" DATA.LONG(A:0xb810d20) "' name='RPMH_VRM_VOLTAGE_CRS_DRV1_REG13'/>"
WRITE #1 "        <register address='0xb810e20' value='0x" DATA.LONG(A:0xb810e20) "' name='RPMH_VRM_VOLTAGE_CRS_DRV1_REG14'/>"
WRITE #1 "        <register address='0xb810f20' value='0x" DATA.LONG(A:0xb810f20) "' name='RPMH_VRM_VOLTAGE_CRS_DRV1_REG15'/>"
WRITE #1 "        <register address='0xb811020' value='0x" DATA.LONG(A:0xb811020) "' name='RPMH_VRM_VOLTAGE_CRS_DRV1_REG16'/>"
WRITE #1 "        <register address='0xb811120' value='0x" DATA.LONG(A:0xb811120) "' name='RPMH_VRM_VOLTAGE_CRS_DRV1_REG17'/>"
WRITE #1 "        <register address='0xb811220' value='0x" DATA.LONG(A:0xb811220) "' name='RPMH_VRM_VOLTAGE_CRS_DRV1_REG18'/>"
WRITE #1 "        <register address='0xb811320' value='0x" DATA.LONG(A:0xb811320) "' name='RPMH_VRM_VOLTAGE_CRS_DRV1_REG19'/>"
WRITE #1 "        <register address='0xb811420' value='0x" DATA.LONG(A:0xb811420) "' name='RPMH_VRM_VOLTAGE_CRS_DRV1_REG20'/>"
WRITE #1 "        <register address='0xb811520' value='0x" DATA.LONG(A:0xb811520) "' name='RPMH_VRM_VOLTAGE_CRS_DRV1_REG21'/>"
WRITE #1 "        <register address='0xb811620' value='0x" DATA.LONG(A:0xb811620) "' name='RPMH_VRM_VOLTAGE_CRS_DRV1_REG22'/>"
WRITE #1 "        <register address='0xb811720' value='0x" DATA.LONG(A:0xb811720) "' name='RPMH_VRM_VOLTAGE_CRS_DRV1_REG23'/>"
WRITE #1 "        <register address='0xb811820' value='0x" DATA.LONG(A:0xb811820) "' name='RPMH_VRM_VOLTAGE_CRS_DRV1_REG24'/>"
WRITE #1 "        <register address='0xb820020' value='0x" DATA.LONG(A:0xb820020) "' name='RPMH_VRM_VOLTAGE_CRS_DRV2_REG0'/>"
WRITE #1 "        <register address='0xb820120' value='0x" DATA.LONG(A:0xb820120) "' name='RPMH_VRM_VOLTAGE_CRS_DRV2_REG1'/>"
WRITE #1 "        <register address='0xb820220' value='0x" DATA.LONG(A:0xb820220) "' name='RPMH_VRM_VOLTAGE_CRS_DRV2_REG2'/>"
WRITE #1 "        <register address='0xb820320' value='0x" DATA.LONG(A:0xb820320) "' name='RPMH_VRM_VOLTAGE_CRS_DRV2_REG3'/>"
WRITE #1 "        <register address='0xb820420' value='0x" DATA.LONG(A:0xb820420) "' name='RPMH_VRM_VOLTAGE_CRS_DRV2_REG4'/>"
WRITE #1 "        <register address='0xb820520' value='0x" DATA.LONG(A:0xb820520) "' name='RPMH_VRM_VOLTAGE_CRS_DRV2_REG5'/>"
WRITE #1 "        <register address='0xb820620' value='0x" DATA.LONG(A:0xb820620) "' name='RPMH_VRM_VOLTAGE_CRS_DRV2_REG6'/>"
WRITE #1 "        <register address='0xb820720' value='0x" DATA.LONG(A:0xb820720) "' name='RPMH_VRM_VOLTAGE_CRS_DRV2_REG7'/>"
WRITE #1 "        <register address='0xb820820' value='0x" DATA.LONG(A:0xb820820) "' name='RPMH_VRM_VOLTAGE_CRS_DRV2_REG8'/>"
WRITE #1 "        <register address='0xb820920' value='0x" DATA.LONG(A:0xb820920) "' name='RPMH_VRM_VOLTAGE_CRS_DRV2_REG9'/>"
WRITE #1 "        <register address='0xb820a20' value='0x" DATA.LONG(A:0xb820a20) "' name='RPMH_VRM_VOLTAGE_CRS_DRV2_REG10'/>"
WRITE #1 "        <register address='0xb820b20' value='0x" DATA.LONG(A:0xb820b20) "' name='RPMH_VRM_VOLTAGE_CRS_DRV2_REG11'/>"
WRITE #1 "        <register address='0xb820c20' value='0x" DATA.LONG(A:0xb820c20) "' name='RPMH_VRM_VOLTAGE_CRS_DRV2_REG12'/>"
WRITE #1 "        <register address='0xb820d20' value='0x" DATA.LONG(A:0xb820d20) "' name='RPMH_VRM_VOLTAGE_CRS_DRV2_REG13'/>"
WRITE #1 "        <register address='0xb820e20' value='0x" DATA.LONG(A:0xb820e20) "' name='RPMH_VRM_VOLTAGE_CRS_DRV2_REG14'/>"
WRITE #1 "        <register address='0xb820f20' value='0x" DATA.LONG(A:0xb820f20) "' name='RPMH_VRM_VOLTAGE_CRS_DRV2_REG15'/>"
WRITE #1 "        <register address='0xb821020' value='0x" DATA.LONG(A:0xb821020) "' name='RPMH_VRM_VOLTAGE_CRS_DRV2_REG16'/>"
WRITE #1 "        <register address='0xb821120' value='0x" DATA.LONG(A:0xb821120) "' name='RPMH_VRM_VOLTAGE_CRS_DRV2_REG17'/>"
WRITE #1 "        <register address='0xb821220' value='0x" DATA.LONG(A:0xb821220) "' name='RPMH_VRM_VOLTAGE_CRS_DRV2_REG18'/>"
WRITE #1 "        <register address='0xb821320' value='0x" DATA.LONG(A:0xb821320) "' name='RPMH_VRM_VOLTAGE_CRS_DRV2_REG19'/>"
WRITE #1 "        <register address='0xb821420' value='0x" DATA.LONG(A:0xb821420) "' name='RPMH_VRM_VOLTAGE_CRS_DRV2_REG20'/>"
WRITE #1 "        <register address='0xb821520' value='0x" DATA.LONG(A:0xb821520) "' name='RPMH_VRM_VOLTAGE_CRS_DRV2_REG21'/>"
WRITE #1 "        <register address='0xb821620' value='0x" DATA.LONG(A:0xb821620) "' name='RPMH_VRM_VOLTAGE_CRS_DRV2_REG22'/>"
WRITE #1 "        <register address='0xb821720' value='0x" DATA.LONG(A:0xb821720) "' name='RPMH_VRM_VOLTAGE_CRS_DRV2_REG23'/>"
WRITE #1 "        <register address='0xb821820' value='0x" DATA.LONG(A:0xb821820) "' name='RPMH_VRM_VOLTAGE_CRS_DRV2_REG24'/>"
WRITE #1 "        <register address='0xb830020' value='0x" DATA.LONG(A:0xb830020) "' name='RPMH_VRM_VOLTAGE_CRS_DRV3_REG0'/>"
WRITE #1 "        <register address='0xb830120' value='0x" DATA.LONG(A:0xb830120) "' name='RPMH_VRM_VOLTAGE_CRS_DRV3_REG1'/>"
WRITE #1 "        <register address='0xb830220' value='0x" DATA.LONG(A:0xb830220) "' name='RPMH_VRM_VOLTAGE_CRS_DRV3_REG2'/>"
WRITE #1 "        <register address='0xb830320' value='0x" DATA.LONG(A:0xb830320) "' name='RPMH_VRM_VOLTAGE_CRS_DRV3_REG3'/>"
WRITE #1 "        <register address='0xb830420' value='0x" DATA.LONG(A:0xb830420) "' name='RPMH_VRM_VOLTAGE_CRS_DRV3_REG4'/>"
WRITE #1 "        <register address='0xb830520' value='0x" DATA.LONG(A:0xb830520) "' name='RPMH_VRM_VOLTAGE_CRS_DRV3_REG5'/>"
WRITE #1 "        <register address='0xb830620' value='0x" DATA.LONG(A:0xb830620) "' name='RPMH_VRM_VOLTAGE_CRS_DRV3_REG6'/>"
WRITE #1 "        <register address='0xb830720' value='0x" DATA.LONG(A:0xb830720) "' name='RPMH_VRM_VOLTAGE_CRS_DRV3_REG7'/>"
WRITE #1 "        <register address='0xb830820' value='0x" DATA.LONG(A:0xb830820) "' name='RPMH_VRM_VOLTAGE_CRS_DRV3_REG8'/>"
WRITE #1 "        <register address='0xb830920' value='0x" DATA.LONG(A:0xb830920) "' name='RPMH_VRM_VOLTAGE_CRS_DRV3_REG9'/>"
WRITE #1 "        <register address='0xb830a20' value='0x" DATA.LONG(A:0xb830a20) "' name='RPMH_VRM_VOLTAGE_CRS_DRV3_REG10'/>"
WRITE #1 "        <register address='0xb830b20' value='0x" DATA.LONG(A:0xb830b20) "' name='RPMH_VRM_VOLTAGE_CRS_DRV3_REG11'/>"
WRITE #1 "        <register address='0xb830c20' value='0x" DATA.LONG(A:0xb830c20) "' name='RPMH_VRM_VOLTAGE_CRS_DRV3_REG12'/>"
WRITE #1 "        <register address='0xb830d20' value='0x" DATA.LONG(A:0xb830d20) "' name='RPMH_VRM_VOLTAGE_CRS_DRV3_REG13'/>"
WRITE #1 "        <register address='0xb830e20' value='0x" DATA.LONG(A:0xb830e20) "' name='RPMH_VRM_VOLTAGE_CRS_DRV3_REG14'/>"
WRITE #1 "        <register address='0xb830f20' value='0x" DATA.LONG(A:0xb830f20) "' name='RPMH_VRM_VOLTAGE_CRS_DRV3_REG15'/>"
WRITE #1 "        <register address='0xb831020' value='0x" DATA.LONG(A:0xb831020) "' name='RPMH_VRM_VOLTAGE_CRS_DRV3_REG16'/>"
WRITE #1 "        <register address='0xb831120' value='0x" DATA.LONG(A:0xb831120) "' name='RPMH_VRM_VOLTAGE_CRS_DRV3_REG17'/>"
WRITE #1 "        <register address='0xb831220' value='0x" DATA.LONG(A:0xb831220) "' name='RPMH_VRM_VOLTAGE_CRS_DRV3_REG18'/>"
WRITE #1 "        <register address='0xb831320' value='0x" DATA.LONG(A:0xb831320) "' name='RPMH_VRM_VOLTAGE_CRS_DRV3_REG19'/>"
WRITE #1 "        <register address='0xb831420' value='0x" DATA.LONG(A:0xb831420) "' name='RPMH_VRM_VOLTAGE_CRS_DRV3_REG20'/>"
WRITE #1 "        <register address='0xb831520' value='0x" DATA.LONG(A:0xb831520) "' name='RPMH_VRM_VOLTAGE_CRS_DRV3_REG21'/>"
WRITE #1 "        <register address='0xb831620' value='0x" DATA.LONG(A:0xb831620) "' name='RPMH_VRM_VOLTAGE_CRS_DRV3_REG22'/>"
WRITE #1 "        <register address='0xb831720' value='0x" DATA.LONG(A:0xb831720) "' name='RPMH_VRM_VOLTAGE_CRS_DRV3_REG23'/>"
WRITE #1 "        <register address='0xb831820' value='0x" DATA.LONG(A:0xb831820) "' name='RPMH_VRM_VOLTAGE_CRS_DRV3_REG24'/>"
WRITE #1 "        <register address='0xb840020' value='0x" DATA.LONG(A:0xb840020) "' name='RPMH_VRM_VOLTAGE_CRS_DRV4_REG0'/>"
WRITE #1 "        <register address='0xb840120' value='0x" DATA.LONG(A:0xb840120) "' name='RPMH_VRM_VOLTAGE_CRS_DRV4_REG1'/>"
WRITE #1 "        <register address='0xb840220' value='0x" DATA.LONG(A:0xb840220) "' name='RPMH_VRM_VOLTAGE_CRS_DRV4_REG2'/>"
WRITE #1 "        <register address='0xb840320' value='0x" DATA.LONG(A:0xb840320) "' name='RPMH_VRM_VOLTAGE_CRS_DRV4_REG3'/>"
WRITE #1 "        <register address='0xb840420' value='0x" DATA.LONG(A:0xb840420) "' name='RPMH_VRM_VOLTAGE_CRS_DRV4_REG4'/>"
WRITE #1 "        <register address='0xb840520' value='0x" DATA.LONG(A:0xb840520) "' name='RPMH_VRM_VOLTAGE_CRS_DRV4_REG5'/>"
WRITE #1 "        <register address='0xb840620' value='0x" DATA.LONG(A:0xb840620) "' name='RPMH_VRM_VOLTAGE_CRS_DRV4_REG6'/>"
WRITE #1 "        <register address='0xb840720' value='0x" DATA.LONG(A:0xb840720) "' name='RPMH_VRM_VOLTAGE_CRS_DRV4_REG7'/>"
WRITE #1 "        <register address='0xb840820' value='0x" DATA.LONG(A:0xb840820) "' name='RPMH_VRM_VOLTAGE_CRS_DRV4_REG8'/>"
WRITE #1 "        <register address='0xb840920' value='0x" DATA.LONG(A:0xb840920) "' name='RPMH_VRM_VOLTAGE_CRS_DRV4_REG9'/>"
WRITE #1 "        <register address='0xb840a20' value='0x" DATA.LONG(A:0xb840a20) "' name='RPMH_VRM_VOLTAGE_CRS_DRV4_REG10'/>"
WRITE #1 "        <register address='0xb840b20' value='0x" DATA.LONG(A:0xb840b20) "' name='RPMH_VRM_VOLTAGE_CRS_DRV4_REG11'/>"
WRITE #1 "        <register address='0xb840c20' value='0x" DATA.LONG(A:0xb840c20) "' name='RPMH_VRM_VOLTAGE_CRS_DRV4_REG12'/>"
WRITE #1 "        <register address='0xb840d20' value='0x" DATA.LONG(A:0xb840d20) "' name='RPMH_VRM_VOLTAGE_CRS_DRV4_REG13'/>"
WRITE #1 "        <register address='0xb840e20' value='0x" DATA.LONG(A:0xb840e20) "' name='RPMH_VRM_VOLTAGE_CRS_DRV4_REG14'/>"
WRITE #1 "        <register address='0xb840f20' value='0x" DATA.LONG(A:0xb840f20) "' name='RPMH_VRM_VOLTAGE_CRS_DRV4_REG15'/>"
WRITE #1 "        <register address='0xb841020' value='0x" DATA.LONG(A:0xb841020) "' name='RPMH_VRM_VOLTAGE_CRS_DRV4_REG16'/>"
WRITE #1 "        <register address='0xb841120' value='0x" DATA.LONG(A:0xb841120) "' name='RPMH_VRM_VOLTAGE_CRS_DRV4_REG17'/>"
WRITE #1 "        <register address='0xb841220' value='0x" DATA.LONG(A:0xb841220) "' name='RPMH_VRM_VOLTAGE_CRS_DRV4_REG18'/>"
WRITE #1 "        <register address='0xb841320' value='0x" DATA.LONG(A:0xb841320) "' name='RPMH_VRM_VOLTAGE_CRS_DRV4_REG19'/>"
WRITE #1 "        <register address='0xb841420' value='0x" DATA.LONG(A:0xb841420) "' name='RPMH_VRM_VOLTAGE_CRS_DRV4_REG20'/>"
WRITE #1 "        <register address='0xb841520' value='0x" DATA.LONG(A:0xb841520) "' name='RPMH_VRM_VOLTAGE_CRS_DRV4_REG21'/>"
WRITE #1 "        <register address='0xb841620' value='0x" DATA.LONG(A:0xb841620) "' name='RPMH_VRM_VOLTAGE_CRS_DRV4_REG22'/>"
WRITE #1 "        <register address='0xb841720' value='0x" DATA.LONG(A:0xb841720) "' name='RPMH_VRM_VOLTAGE_CRS_DRV4_REG23'/>"
WRITE #1 "        <register address='0xb841820' value='0x" DATA.LONG(A:0xb841820) "' name='RPMH_VRM_VOLTAGE_CRS_DRV4_REG24'/>"
WRITE #1 "        <register address='0xb850020' value='0x" DATA.LONG(A:0xb850020) "' name='RPMH_VRM_VOLTAGE_CRS_DRV5_REG0'/>"
WRITE #1 "        <register address='0xb850120' value='0x" DATA.LONG(A:0xb850120) "' name='RPMH_VRM_VOLTAGE_CRS_DRV5_REG1'/>"
WRITE #1 "        <register address='0xb850220' value='0x" DATA.LONG(A:0xb850220) "' name='RPMH_VRM_VOLTAGE_CRS_DRV5_REG2'/>"
WRITE #1 "        <register address='0xb850320' value='0x" DATA.LONG(A:0xb850320) "' name='RPMH_VRM_VOLTAGE_CRS_DRV5_REG3'/>"
WRITE #1 "        <register address='0xb850420' value='0x" DATA.LONG(A:0xb850420) "' name='RPMH_VRM_VOLTAGE_CRS_DRV5_REG4'/>"
WRITE #1 "        <register address='0xb850520' value='0x" DATA.LONG(A:0xb850520) "' name='RPMH_VRM_VOLTAGE_CRS_DRV5_REG5'/>"
WRITE #1 "        <register address='0xb850620' value='0x" DATA.LONG(A:0xb850620) "' name='RPMH_VRM_VOLTAGE_CRS_DRV5_REG6'/>"
WRITE #1 "        <register address='0xb850720' value='0x" DATA.LONG(A:0xb850720) "' name='RPMH_VRM_VOLTAGE_CRS_DRV5_REG7'/>"
WRITE #1 "        <register address='0xb850820' value='0x" DATA.LONG(A:0xb850820) "' name='RPMH_VRM_VOLTAGE_CRS_DRV5_REG8'/>"
WRITE #1 "        <register address='0xb850920' value='0x" DATA.LONG(A:0xb850920) "' name='RPMH_VRM_VOLTAGE_CRS_DRV5_REG9'/>"
WRITE #1 "        <register address='0xb850a20' value='0x" DATA.LONG(A:0xb850a20) "' name='RPMH_VRM_VOLTAGE_CRS_DRV5_REG10'/>"
WRITE #1 "        <register address='0xb850b20' value='0x" DATA.LONG(A:0xb850b20) "' name='RPMH_VRM_VOLTAGE_CRS_DRV5_REG11'/>"
WRITE #1 "        <register address='0xb850c20' value='0x" DATA.LONG(A:0xb850c20) "' name='RPMH_VRM_VOLTAGE_CRS_DRV5_REG12'/>"
WRITE #1 "        <register address='0xb850d20' value='0x" DATA.LONG(A:0xb850d20) "' name='RPMH_VRM_VOLTAGE_CRS_DRV5_REG13'/>"
WRITE #1 "        <register address='0xb850e20' value='0x" DATA.LONG(A:0xb850e20) "' name='RPMH_VRM_VOLTAGE_CRS_DRV5_REG14'/>"
WRITE #1 "        <register address='0xb850f20' value='0x" DATA.LONG(A:0xb850f20) "' name='RPMH_VRM_VOLTAGE_CRS_DRV5_REG15'/>"
WRITE #1 "        <register address='0xb851020' value='0x" DATA.LONG(A:0xb851020) "' name='RPMH_VRM_VOLTAGE_CRS_DRV5_REG16'/>"
WRITE #1 "        <register address='0xb851120' value='0x" DATA.LONG(A:0xb851120) "' name='RPMH_VRM_VOLTAGE_CRS_DRV5_REG17'/>"
WRITE #1 "        <register address='0xb851220' value='0x" DATA.LONG(A:0xb851220) "' name='RPMH_VRM_VOLTAGE_CRS_DRV5_REG18'/>"
WRITE #1 "        <register address='0xb851320' value='0x" DATA.LONG(A:0xb851320) "' name='RPMH_VRM_VOLTAGE_CRS_DRV5_REG19'/>"
WRITE #1 "        <register address='0xb851420' value='0x" DATA.LONG(A:0xb851420) "' name='RPMH_VRM_VOLTAGE_CRS_DRV5_REG20'/>"
WRITE #1 "        <register address='0xb851520' value='0x" DATA.LONG(A:0xb851520) "' name='RPMH_VRM_VOLTAGE_CRS_DRV5_REG21'/>"
WRITE #1 "        <register address='0xb851620' value='0x" DATA.LONG(A:0xb851620) "' name='RPMH_VRM_VOLTAGE_CRS_DRV5_REG22'/>"
WRITE #1 "        <register address='0xb851720' value='0x" DATA.LONG(A:0xb851720) "' name='RPMH_VRM_VOLTAGE_CRS_DRV5_REG23'/>"
WRITE #1 "        <register address='0xb851820' value='0x" DATA.LONG(A:0xb851820) "' name='RPMH_VRM_VOLTAGE_CRS_DRV5_REG24'/>"
WRITE #1 "        <register address='0xb860020' value='0x" DATA.LONG(A:0xb860020) "' name='RPMH_VRM_VOLTAGE_CRS_DRV6_REG0'/>"
WRITE #1 "        <register address='0xb860120' value='0x" DATA.LONG(A:0xb860120) "' name='RPMH_VRM_VOLTAGE_CRS_DRV6_REG1'/>"
WRITE #1 "        <register address='0xb860220' value='0x" DATA.LONG(A:0xb860220) "' name='RPMH_VRM_VOLTAGE_CRS_DRV6_REG2'/>"
WRITE #1 "        <register address='0xb860320' value='0x" DATA.LONG(A:0xb860320) "' name='RPMH_VRM_VOLTAGE_CRS_DRV6_REG3'/>"
WRITE #1 "        <register address='0xb860420' value='0x" DATA.LONG(A:0xb860420) "' name='RPMH_VRM_VOLTAGE_CRS_DRV6_REG4'/>"
WRITE #1 "        <register address='0xb860520' value='0x" DATA.LONG(A:0xb860520) "' name='RPMH_VRM_VOLTAGE_CRS_DRV6_REG5'/>"
WRITE #1 "        <register address='0xb860620' value='0x" DATA.LONG(A:0xb860620) "' name='RPMH_VRM_VOLTAGE_CRS_DRV6_REG6'/>"
WRITE #1 "        <register address='0xb860720' value='0x" DATA.LONG(A:0xb860720) "' name='RPMH_VRM_VOLTAGE_CRS_DRV6_REG7'/>"
WRITE #1 "        <register address='0xb860820' value='0x" DATA.LONG(A:0xb860820) "' name='RPMH_VRM_VOLTAGE_CRS_DRV6_REG8'/>"
WRITE #1 "        <register address='0xb860920' value='0x" DATA.LONG(A:0xb860920) "' name='RPMH_VRM_VOLTAGE_CRS_DRV6_REG9'/>"
WRITE #1 "        <register address='0xb860a20' value='0x" DATA.LONG(A:0xb860a20) "' name='RPMH_VRM_VOLTAGE_CRS_DRV6_REG10'/>"
WRITE #1 "        <register address='0xb860b20' value='0x" DATA.LONG(A:0xb860b20) "' name='RPMH_VRM_VOLTAGE_CRS_DRV6_REG11'/>"
WRITE #1 "        <register address='0xb860c20' value='0x" DATA.LONG(A:0xb860c20) "' name='RPMH_VRM_VOLTAGE_CRS_DRV6_REG12'/>"
WRITE #1 "        <register address='0xb860d20' value='0x" DATA.LONG(A:0xb860d20) "' name='RPMH_VRM_VOLTAGE_CRS_DRV6_REG13'/>"
WRITE #1 "        <register address='0xb860e20' value='0x" DATA.LONG(A:0xb860e20) "' name='RPMH_VRM_VOLTAGE_CRS_DRV6_REG14'/>"
WRITE #1 "        <register address='0xb860f20' value='0x" DATA.LONG(A:0xb860f20) "' name='RPMH_VRM_VOLTAGE_CRS_DRV6_REG15'/>"
WRITE #1 "        <register address='0xb861020' value='0x" DATA.LONG(A:0xb861020) "' name='RPMH_VRM_VOLTAGE_CRS_DRV6_REG16'/>"
WRITE #1 "        <register address='0xb861120' value='0x" DATA.LONG(A:0xb861120) "' name='RPMH_VRM_VOLTAGE_CRS_DRV6_REG17'/>"
WRITE #1 "        <register address='0xb861220' value='0x" DATA.LONG(A:0xb861220) "' name='RPMH_VRM_VOLTAGE_CRS_DRV6_REG18'/>"
WRITE #1 "        <register address='0xb861320' value='0x" DATA.LONG(A:0xb861320) "' name='RPMH_VRM_VOLTAGE_CRS_DRV6_REG19'/>"
WRITE #1 "        <register address='0xb861420' value='0x" DATA.LONG(A:0xb861420) "' name='RPMH_VRM_VOLTAGE_CRS_DRV6_REG20'/>"
WRITE #1 "        <register address='0xb861520' value='0x" DATA.LONG(A:0xb861520) "' name='RPMH_VRM_VOLTAGE_CRS_DRV6_REG21'/>"
WRITE #1 "        <register address='0xb861620' value='0x" DATA.LONG(A:0xb861620) "' name='RPMH_VRM_VOLTAGE_CRS_DRV6_REG22'/>"
WRITE #1 "        <register address='0xb861720' value='0x" DATA.LONG(A:0xb861720) "' name='RPMH_VRM_VOLTAGE_CRS_DRV6_REG23'/>"
WRITE #1 "        <register address='0xb861820' value='0x" DATA.LONG(A:0xb861820) "' name='RPMH_VRM_VOLTAGE_CRS_DRV6_REG24'/>"
WRITE #1 "        <register address='0xb800024' value='0x" DATA.LONG(A:0xb800024) "' name='RPMH_VRM_ENABLE_CRS_DRV0_REG0'/>"
WRITE #1 "        <register address='0xb800124' value='0x" DATA.LONG(A:0xb800124) "' name='RPMH_VRM_ENABLE_CRS_DRV0_REG1'/>"
WRITE #1 "        <register address='0xb800224' value='0x" DATA.LONG(A:0xb800224) "' name='RPMH_VRM_ENABLE_CRS_DRV0_REG2'/>"
WRITE #1 "        <register address='0xb800324' value='0x" DATA.LONG(A:0xb800324) "' name='RPMH_VRM_ENABLE_CRS_DRV0_REG3'/>"
WRITE #1 "        <register address='0xb800424' value='0x" DATA.LONG(A:0xb800424) "' name='RPMH_VRM_ENABLE_CRS_DRV0_REG4'/>"
WRITE #1 "        <register address='0xb800524' value='0x" DATA.LONG(A:0xb800524) "' name='RPMH_VRM_ENABLE_CRS_DRV0_REG5'/>"
WRITE #1 "        <register address='0xb800624' value='0x" DATA.LONG(A:0xb800624) "' name='RPMH_VRM_ENABLE_CRS_DRV0_REG6'/>"
WRITE #1 "        <register address='0xb800724' value='0x" DATA.LONG(A:0xb800724) "' name='RPMH_VRM_ENABLE_CRS_DRV0_REG7'/>"
WRITE #1 "        <register address='0xb800824' value='0x" DATA.LONG(A:0xb800824) "' name='RPMH_VRM_ENABLE_CRS_DRV0_REG8'/>"
WRITE #1 "        <register address='0xb800924' value='0x" DATA.LONG(A:0xb800924) "' name='RPMH_VRM_ENABLE_CRS_DRV0_REG9'/>"
WRITE #1 "        <register address='0xb800a24' value='0x" DATA.LONG(A:0xb800a24) "' name='RPMH_VRM_ENABLE_CRS_DRV0_REG10'/>"
WRITE #1 "        <register address='0xb800b24' value='0x" DATA.LONG(A:0xb800b24) "' name='RPMH_VRM_ENABLE_CRS_DRV0_REG11'/>"
WRITE #1 "        <register address='0xb800c24' value='0x" DATA.LONG(A:0xb800c24) "' name='RPMH_VRM_ENABLE_CRS_DRV0_REG12'/>"
WRITE #1 "        <register address='0xb800d24' value='0x" DATA.LONG(A:0xb800d24) "' name='RPMH_VRM_ENABLE_CRS_DRV0_REG13'/>"
WRITE #1 "        <register address='0xb800e24' value='0x" DATA.LONG(A:0xb800e24) "' name='RPMH_VRM_ENABLE_CRS_DRV0_REG14'/>"
WRITE #1 "        <register address='0xb800f24' value='0x" DATA.LONG(A:0xb800f24) "' name='RPMH_VRM_ENABLE_CRS_DRV0_REG15'/>"
WRITE #1 "        <register address='0xb801024' value='0x" DATA.LONG(A:0xb801024) "' name='RPMH_VRM_ENABLE_CRS_DRV0_REG16'/>"
WRITE #1 "        <register address='0xb801124' value='0x" DATA.LONG(A:0xb801124) "' name='RPMH_VRM_ENABLE_CRS_DRV0_REG17'/>"
WRITE #1 "        <register address='0xb801224' value='0x" DATA.LONG(A:0xb801224) "' name='RPMH_VRM_ENABLE_CRS_DRV0_REG18'/>"
WRITE #1 "        <register address='0xb801324' value='0x" DATA.LONG(A:0xb801324) "' name='RPMH_VRM_ENABLE_CRS_DRV0_REG19'/>"
WRITE #1 "        <register address='0xb801424' value='0x" DATA.LONG(A:0xb801424) "' name='RPMH_VRM_ENABLE_CRS_DRV0_REG20'/>"
WRITE #1 "        <register address='0xb801524' value='0x" DATA.LONG(A:0xb801524) "' name='RPMH_VRM_ENABLE_CRS_DRV0_REG21'/>"
WRITE #1 "        <register address='0xb801624' value='0x" DATA.LONG(A:0xb801624) "' name='RPMH_VRM_ENABLE_CRS_DRV0_REG22'/>"
WRITE #1 "        <register address='0xb801724' value='0x" DATA.LONG(A:0xb801724) "' name='RPMH_VRM_ENABLE_CRS_DRV0_REG23'/>"
WRITE #1 "        <register address='0xb801824' value='0x" DATA.LONG(A:0xb801824) "' name='RPMH_VRM_ENABLE_CRS_DRV0_REG24'/>"
WRITE #1 "        <register address='0xb810024' value='0x" DATA.LONG(A:0xb810024) "' name='RPMH_VRM_ENABLE_CRS_DRV1_REG0'/>"
WRITE #1 "        <register address='0xb810124' value='0x" DATA.LONG(A:0xb810124) "' name='RPMH_VRM_ENABLE_CRS_DRV1_REG1'/>"
WRITE #1 "        <register address='0xb810224' value='0x" DATA.LONG(A:0xb810224) "' name='RPMH_VRM_ENABLE_CRS_DRV1_REG2'/>"
WRITE #1 "        <register address='0xb810324' value='0x" DATA.LONG(A:0xb810324) "' name='RPMH_VRM_ENABLE_CRS_DRV1_REG3'/>"
WRITE #1 "        <register address='0xb810424' value='0x" DATA.LONG(A:0xb810424) "' name='RPMH_VRM_ENABLE_CRS_DRV1_REG4'/>"
WRITE #1 "        <register address='0xb810524' value='0x" DATA.LONG(A:0xb810524) "' name='RPMH_VRM_ENABLE_CRS_DRV1_REG5'/>"
WRITE #1 "        <register address='0xb810624' value='0x" DATA.LONG(A:0xb810624) "' name='RPMH_VRM_ENABLE_CRS_DRV1_REG6'/>"
WRITE #1 "        <register address='0xb810724' value='0x" DATA.LONG(A:0xb810724) "' name='RPMH_VRM_ENABLE_CRS_DRV1_REG7'/>"
WRITE #1 "        <register address='0xb810824' value='0x" DATA.LONG(A:0xb810824) "' name='RPMH_VRM_ENABLE_CRS_DRV1_REG8'/>"
WRITE #1 "        <register address='0xb810924' value='0x" DATA.LONG(A:0xb810924) "' name='RPMH_VRM_ENABLE_CRS_DRV1_REG9'/>"
WRITE #1 "        <register address='0xb810a24' value='0x" DATA.LONG(A:0xb810a24) "' name='RPMH_VRM_ENABLE_CRS_DRV1_REG10'/>"
WRITE #1 "        <register address='0xb810b24' value='0x" DATA.LONG(A:0xb810b24) "' name='RPMH_VRM_ENABLE_CRS_DRV1_REG11'/>"
WRITE #1 "        <register address='0xb810c24' value='0x" DATA.LONG(A:0xb810c24) "' name='RPMH_VRM_ENABLE_CRS_DRV1_REG12'/>"
WRITE #1 "        <register address='0xb810d24' value='0x" DATA.LONG(A:0xb810d24) "' name='RPMH_VRM_ENABLE_CRS_DRV1_REG13'/>"
WRITE #1 "        <register address='0xb810e24' value='0x" DATA.LONG(A:0xb810e24) "' name='RPMH_VRM_ENABLE_CRS_DRV1_REG14'/>"
WRITE #1 "        <register address='0xb810f24' value='0x" DATA.LONG(A:0xb810f24) "' name='RPMH_VRM_ENABLE_CRS_DRV1_REG15'/>"
WRITE #1 "        <register address='0xb811024' value='0x" DATA.LONG(A:0xb811024) "' name='RPMH_VRM_ENABLE_CRS_DRV1_REG16'/>"
WRITE #1 "        <register address='0xb811124' value='0x" DATA.LONG(A:0xb811124) "' name='RPMH_VRM_ENABLE_CRS_DRV1_REG17'/>"
WRITE #1 "        <register address='0xb811224' value='0x" DATA.LONG(A:0xb811224) "' name='RPMH_VRM_ENABLE_CRS_DRV1_REG18'/>"
WRITE #1 "        <register address='0xb811324' value='0x" DATA.LONG(A:0xb811324) "' name='RPMH_VRM_ENABLE_CRS_DRV1_REG19'/>"
WRITE #1 "        <register address='0xb811424' value='0x" DATA.LONG(A:0xb811424) "' name='RPMH_VRM_ENABLE_CRS_DRV1_REG20'/>"
WRITE #1 "        <register address='0xb811524' value='0x" DATA.LONG(A:0xb811524) "' name='RPMH_VRM_ENABLE_CRS_DRV1_REG21'/>"
WRITE #1 "        <register address='0xb811624' value='0x" DATA.LONG(A:0xb811624) "' name='RPMH_VRM_ENABLE_CRS_DRV1_REG22'/>"
WRITE #1 "        <register address='0xb811724' value='0x" DATA.LONG(A:0xb811724) "' name='RPMH_VRM_ENABLE_CRS_DRV1_REG23'/>"
WRITE #1 "        <register address='0xb811824' value='0x" DATA.LONG(A:0xb811824) "' name='RPMH_VRM_ENABLE_CRS_DRV1_REG24'/>"
WRITE #1 "        <register address='0xb820024' value='0x" DATA.LONG(A:0xb820024) "' name='RPMH_VRM_ENABLE_CRS_DRV2_REG0'/>"
WRITE #1 "        <register address='0xb820124' value='0x" DATA.LONG(A:0xb820124) "' name='RPMH_VRM_ENABLE_CRS_DRV2_REG1'/>"
WRITE #1 "        <register address='0xb820224' value='0x" DATA.LONG(A:0xb820224) "' name='RPMH_VRM_ENABLE_CRS_DRV2_REG2'/>"
WRITE #1 "        <register address='0xb820324' value='0x" DATA.LONG(A:0xb820324) "' name='RPMH_VRM_ENABLE_CRS_DRV2_REG3'/>"
WRITE #1 "        <register address='0xb820424' value='0x" DATA.LONG(A:0xb820424) "' name='RPMH_VRM_ENABLE_CRS_DRV2_REG4'/>"
WRITE #1 "        <register address='0xb820524' value='0x" DATA.LONG(A:0xb820524) "' name='RPMH_VRM_ENABLE_CRS_DRV2_REG5'/>"
WRITE #1 "        <register address='0xb820624' value='0x" DATA.LONG(A:0xb820624) "' name='RPMH_VRM_ENABLE_CRS_DRV2_REG6'/>"
WRITE #1 "        <register address='0xb820724' value='0x" DATA.LONG(A:0xb820724) "' name='RPMH_VRM_ENABLE_CRS_DRV2_REG7'/>"
WRITE #1 "        <register address='0xb820824' value='0x" DATA.LONG(A:0xb820824) "' name='RPMH_VRM_ENABLE_CRS_DRV2_REG8'/>"
WRITE #1 "        <register address='0xb820924' value='0x" DATA.LONG(A:0xb820924) "' name='RPMH_VRM_ENABLE_CRS_DRV2_REG9'/>"
WRITE #1 "        <register address='0xb820a24' value='0x" DATA.LONG(A:0xb820a24) "' name='RPMH_VRM_ENABLE_CRS_DRV2_REG10'/>"
WRITE #1 "        <register address='0xb820b24' value='0x" DATA.LONG(A:0xb820b24) "' name='RPMH_VRM_ENABLE_CRS_DRV2_REG11'/>"
WRITE #1 "        <register address='0xb820c24' value='0x" DATA.LONG(A:0xb820c24) "' name='RPMH_VRM_ENABLE_CRS_DRV2_REG12'/>"
WRITE #1 "        <register address='0xb820d24' value='0x" DATA.LONG(A:0xb820d24) "' name='RPMH_VRM_ENABLE_CRS_DRV2_REG13'/>"
WRITE #1 "        <register address='0xb820e24' value='0x" DATA.LONG(A:0xb820e24) "' name='RPMH_VRM_ENABLE_CRS_DRV2_REG14'/>"
WRITE #1 "        <register address='0xb820f24' value='0x" DATA.LONG(A:0xb820f24) "' name='RPMH_VRM_ENABLE_CRS_DRV2_REG15'/>"
WRITE #1 "        <register address='0xb821024' value='0x" DATA.LONG(A:0xb821024) "' name='RPMH_VRM_ENABLE_CRS_DRV2_REG16'/>"
WRITE #1 "        <register address='0xb821124' value='0x" DATA.LONG(A:0xb821124) "' name='RPMH_VRM_ENABLE_CRS_DRV2_REG17'/>"
WRITE #1 "        <register address='0xb821224' value='0x" DATA.LONG(A:0xb821224) "' name='RPMH_VRM_ENABLE_CRS_DRV2_REG18'/>"
WRITE #1 "        <register address='0xb821324' value='0x" DATA.LONG(A:0xb821324) "' name='RPMH_VRM_ENABLE_CRS_DRV2_REG19'/>"
WRITE #1 "        <register address='0xb821424' value='0x" DATA.LONG(A:0xb821424) "' name='RPMH_VRM_ENABLE_CRS_DRV2_REG20'/>"
WRITE #1 "        <register address='0xb821524' value='0x" DATA.LONG(A:0xb821524) "' name='RPMH_VRM_ENABLE_CRS_DRV2_REG21'/>"
WRITE #1 "        <register address='0xb821624' value='0x" DATA.LONG(A:0xb821624) "' name='RPMH_VRM_ENABLE_CRS_DRV2_REG22'/>"
WRITE #1 "        <register address='0xb821724' value='0x" DATA.LONG(A:0xb821724) "' name='RPMH_VRM_ENABLE_CRS_DRV2_REG23'/>"
WRITE #1 "        <register address='0xb821824' value='0x" DATA.LONG(A:0xb821824) "' name='RPMH_VRM_ENABLE_CRS_DRV2_REG24'/>"
WRITE #1 "        <register address='0xb830024' value='0x" DATA.LONG(A:0xb830024) "' name='RPMH_VRM_ENABLE_CRS_DRV3_REG0'/>"
WRITE #1 "        <register address='0xb830124' value='0x" DATA.LONG(A:0xb830124) "' name='RPMH_VRM_ENABLE_CRS_DRV3_REG1'/>"
WRITE #1 "        <register address='0xb830224' value='0x" DATA.LONG(A:0xb830224) "' name='RPMH_VRM_ENABLE_CRS_DRV3_REG2'/>"
WRITE #1 "        <register address='0xb830324' value='0x" DATA.LONG(A:0xb830324) "' name='RPMH_VRM_ENABLE_CRS_DRV3_REG3'/>"
WRITE #1 "        <register address='0xb830424' value='0x" DATA.LONG(A:0xb830424) "' name='RPMH_VRM_ENABLE_CRS_DRV3_REG4'/>"
WRITE #1 "        <register address='0xb830524' value='0x" DATA.LONG(A:0xb830524) "' name='RPMH_VRM_ENABLE_CRS_DRV3_REG5'/>"
WRITE #1 "        <register address='0xb830624' value='0x" DATA.LONG(A:0xb830624) "' name='RPMH_VRM_ENABLE_CRS_DRV3_REG6'/>"
WRITE #1 "        <register address='0xb830724' value='0x" DATA.LONG(A:0xb830724) "' name='RPMH_VRM_ENABLE_CRS_DRV3_REG7'/>"
WRITE #1 "        <register address='0xb830824' value='0x" DATA.LONG(A:0xb830824) "' name='RPMH_VRM_ENABLE_CRS_DRV3_REG8'/>"
WRITE #1 "        <register address='0xb830924' value='0x" DATA.LONG(A:0xb830924) "' name='RPMH_VRM_ENABLE_CRS_DRV3_REG9'/>"
WRITE #1 "        <register address='0xb830a24' value='0x" DATA.LONG(A:0xb830a24) "' name='RPMH_VRM_ENABLE_CRS_DRV3_REG10'/>"
WRITE #1 "        <register address='0xb830b24' value='0x" DATA.LONG(A:0xb830b24) "' name='RPMH_VRM_ENABLE_CRS_DRV3_REG11'/>"
WRITE #1 "        <register address='0xb830c24' value='0x" DATA.LONG(A:0xb830c24) "' name='RPMH_VRM_ENABLE_CRS_DRV3_REG12'/>"
WRITE #1 "        <register address='0xb830d24' value='0x" DATA.LONG(A:0xb830d24) "' name='RPMH_VRM_ENABLE_CRS_DRV3_REG13'/>"
WRITE #1 "        <register address='0xb830e24' value='0x" DATA.LONG(A:0xb830e24) "' name='RPMH_VRM_ENABLE_CRS_DRV3_REG14'/>"
WRITE #1 "        <register address='0xb830f24' value='0x" DATA.LONG(A:0xb830f24) "' name='RPMH_VRM_ENABLE_CRS_DRV3_REG15'/>"
WRITE #1 "        <register address='0xb831024' value='0x" DATA.LONG(A:0xb831024) "' name='RPMH_VRM_ENABLE_CRS_DRV3_REG16'/>"
WRITE #1 "        <register address='0xb831124' value='0x" DATA.LONG(A:0xb831124) "' name='RPMH_VRM_ENABLE_CRS_DRV3_REG17'/>"
WRITE #1 "        <register address='0xb831224' value='0x" DATA.LONG(A:0xb831224) "' name='RPMH_VRM_ENABLE_CRS_DRV3_REG18'/>"
WRITE #1 "        <register address='0xb831324' value='0x" DATA.LONG(A:0xb831324) "' name='RPMH_VRM_ENABLE_CRS_DRV3_REG19'/>"
WRITE #1 "        <register address='0xb831424' value='0x" DATA.LONG(A:0xb831424) "' name='RPMH_VRM_ENABLE_CRS_DRV3_REG20'/>"
WRITE #1 "        <register address='0xb831524' value='0x" DATA.LONG(A:0xb831524) "' name='RPMH_VRM_ENABLE_CRS_DRV3_REG21'/>"
WRITE #1 "        <register address='0xb831624' value='0x" DATA.LONG(A:0xb831624) "' name='RPMH_VRM_ENABLE_CRS_DRV3_REG22'/>"
WRITE #1 "        <register address='0xb831724' value='0x" DATA.LONG(A:0xb831724) "' name='RPMH_VRM_ENABLE_CRS_DRV3_REG23'/>"
WRITE #1 "        <register address='0xb831824' value='0x" DATA.LONG(A:0xb831824) "' name='RPMH_VRM_ENABLE_CRS_DRV3_REG24'/>"
WRITE #1 "        <register address='0xb840024' value='0x" DATA.LONG(A:0xb840024) "' name='RPMH_VRM_ENABLE_CRS_DRV4_REG0'/>"
WRITE #1 "        <register address='0xb840124' value='0x" DATA.LONG(A:0xb840124) "' name='RPMH_VRM_ENABLE_CRS_DRV4_REG1'/>"
WRITE #1 "        <register address='0xb840224' value='0x" DATA.LONG(A:0xb840224) "' name='RPMH_VRM_ENABLE_CRS_DRV4_REG2'/>"
WRITE #1 "        <register address='0xb840324' value='0x" DATA.LONG(A:0xb840324) "' name='RPMH_VRM_ENABLE_CRS_DRV4_REG3'/>"
WRITE #1 "        <register address='0xb840424' value='0x" DATA.LONG(A:0xb840424) "' name='RPMH_VRM_ENABLE_CRS_DRV4_REG4'/>"
WRITE #1 "        <register address='0xb840524' value='0x" DATA.LONG(A:0xb840524) "' name='RPMH_VRM_ENABLE_CRS_DRV4_REG5'/>"
WRITE #1 "        <register address='0xb840624' value='0x" DATA.LONG(A:0xb840624) "' name='RPMH_VRM_ENABLE_CRS_DRV4_REG6'/>"
WRITE #1 "        <register address='0xb840724' value='0x" DATA.LONG(A:0xb840724) "' name='RPMH_VRM_ENABLE_CRS_DRV4_REG7'/>"
WRITE #1 "        <register address='0xb840824' value='0x" DATA.LONG(A:0xb840824) "' name='RPMH_VRM_ENABLE_CRS_DRV4_REG8'/>"
WRITE #1 "        <register address='0xb840924' value='0x" DATA.LONG(A:0xb840924) "' name='RPMH_VRM_ENABLE_CRS_DRV4_REG9'/>"
WRITE #1 "        <register address='0xb840a24' value='0x" DATA.LONG(A:0xb840a24) "' name='RPMH_VRM_ENABLE_CRS_DRV4_REG10'/>"
WRITE #1 "        <register address='0xb840b24' value='0x" DATA.LONG(A:0xb840b24) "' name='RPMH_VRM_ENABLE_CRS_DRV4_REG11'/>"
WRITE #1 "        <register address='0xb840c24' value='0x" DATA.LONG(A:0xb840c24) "' name='RPMH_VRM_ENABLE_CRS_DRV4_REG12'/>"
WRITE #1 "        <register address='0xb840d24' value='0x" DATA.LONG(A:0xb840d24) "' name='RPMH_VRM_ENABLE_CRS_DRV4_REG13'/>"
WRITE #1 "        <register address='0xb840e24' value='0x" DATA.LONG(A:0xb840e24) "' name='RPMH_VRM_ENABLE_CRS_DRV4_REG14'/>"
WRITE #1 "        <register address='0xb840f24' value='0x" DATA.LONG(A:0xb840f24) "' name='RPMH_VRM_ENABLE_CRS_DRV4_REG15'/>"
WRITE #1 "        <register address='0xb841024' value='0x" DATA.LONG(A:0xb841024) "' name='RPMH_VRM_ENABLE_CRS_DRV4_REG16'/>"
WRITE #1 "        <register address='0xb841124' value='0x" DATA.LONG(A:0xb841124) "' name='RPMH_VRM_ENABLE_CRS_DRV4_REG17'/>"
WRITE #1 "        <register address='0xb841224' value='0x" DATA.LONG(A:0xb841224) "' name='RPMH_VRM_ENABLE_CRS_DRV4_REG18'/>"
WRITE #1 "        <register address='0xb841324' value='0x" DATA.LONG(A:0xb841324) "' name='RPMH_VRM_ENABLE_CRS_DRV4_REG19'/>"
WRITE #1 "        <register address='0xb841424' value='0x" DATA.LONG(A:0xb841424) "' name='RPMH_VRM_ENABLE_CRS_DRV4_REG20'/>"
WRITE #1 "        <register address='0xb841524' value='0x" DATA.LONG(A:0xb841524) "' name='RPMH_VRM_ENABLE_CRS_DRV4_REG21'/>"
WRITE #1 "        <register address='0xb841624' value='0x" DATA.LONG(A:0xb841624) "' name='RPMH_VRM_ENABLE_CRS_DRV4_REG22'/>"
WRITE #1 "        <register address='0xb841724' value='0x" DATA.LONG(A:0xb841724) "' name='RPMH_VRM_ENABLE_CRS_DRV4_REG23'/>"
WRITE #1 "        <register address='0xb841824' value='0x" DATA.LONG(A:0xb841824) "' name='RPMH_VRM_ENABLE_CRS_DRV4_REG24'/>"
WRITE #1 "        <register address='0xb850024' value='0x" DATA.LONG(A:0xb850024) "' name='RPMH_VRM_ENABLE_CRS_DRV5_REG0'/>"
WRITE #1 "        <register address='0xb850124' value='0x" DATA.LONG(A:0xb850124) "' name='RPMH_VRM_ENABLE_CRS_DRV5_REG1'/>"
WRITE #1 "        <register address='0xb850224' value='0x" DATA.LONG(A:0xb850224) "' name='RPMH_VRM_ENABLE_CRS_DRV5_REG2'/>"
WRITE #1 "        <register address='0xb850324' value='0x" DATA.LONG(A:0xb850324) "' name='RPMH_VRM_ENABLE_CRS_DRV5_REG3'/>"
WRITE #1 "        <register address='0xb850424' value='0x" DATA.LONG(A:0xb850424) "' name='RPMH_VRM_ENABLE_CRS_DRV5_REG4'/>"
WRITE #1 "        <register address='0xb850524' value='0x" DATA.LONG(A:0xb850524) "' name='RPMH_VRM_ENABLE_CRS_DRV5_REG5'/>"
WRITE #1 "        <register address='0xb850624' value='0x" DATA.LONG(A:0xb850624) "' name='RPMH_VRM_ENABLE_CRS_DRV5_REG6'/>"
WRITE #1 "        <register address='0xb850724' value='0x" DATA.LONG(A:0xb850724) "' name='RPMH_VRM_ENABLE_CRS_DRV5_REG7'/>"
WRITE #1 "        <register address='0xb850824' value='0x" DATA.LONG(A:0xb850824) "' name='RPMH_VRM_ENABLE_CRS_DRV5_REG8'/>"
WRITE #1 "        <register address='0xb850924' value='0x" DATA.LONG(A:0xb850924) "' name='RPMH_VRM_ENABLE_CRS_DRV5_REG9'/>"
WRITE #1 "        <register address='0xb850a24' value='0x" DATA.LONG(A:0xb850a24) "' name='RPMH_VRM_ENABLE_CRS_DRV5_REG10'/>"
WRITE #1 "        <register address='0xb850b24' value='0x" DATA.LONG(A:0xb850b24) "' name='RPMH_VRM_ENABLE_CRS_DRV5_REG11'/>"
WRITE #1 "        <register address='0xb850c24' value='0x" DATA.LONG(A:0xb850c24) "' name='RPMH_VRM_ENABLE_CRS_DRV5_REG12'/>"
WRITE #1 "        <register address='0xb850d24' value='0x" DATA.LONG(A:0xb850d24) "' name='RPMH_VRM_ENABLE_CRS_DRV5_REG13'/>"
WRITE #1 "        <register address='0xb850e24' value='0x" DATA.LONG(A:0xb850e24) "' name='RPMH_VRM_ENABLE_CRS_DRV5_REG14'/>"
WRITE #1 "        <register address='0xb850f24' value='0x" DATA.LONG(A:0xb850f24) "' name='RPMH_VRM_ENABLE_CRS_DRV5_REG15'/>"
WRITE #1 "        <register address='0xb851024' value='0x" DATA.LONG(A:0xb851024) "' name='RPMH_VRM_ENABLE_CRS_DRV5_REG16'/>"
WRITE #1 "        <register address='0xb851124' value='0x" DATA.LONG(A:0xb851124) "' name='RPMH_VRM_ENABLE_CRS_DRV5_REG17'/>"
WRITE #1 "        <register address='0xb851224' value='0x" DATA.LONG(A:0xb851224) "' name='RPMH_VRM_ENABLE_CRS_DRV5_REG18'/>"
WRITE #1 "        <register address='0xb851324' value='0x" DATA.LONG(A:0xb851324) "' name='RPMH_VRM_ENABLE_CRS_DRV5_REG19'/>"
WRITE #1 "        <register address='0xb851424' value='0x" DATA.LONG(A:0xb851424) "' name='RPMH_VRM_ENABLE_CRS_DRV5_REG20'/>"
WRITE #1 "        <register address='0xb851524' value='0x" DATA.LONG(A:0xb851524) "' name='RPMH_VRM_ENABLE_CRS_DRV5_REG21'/>"
WRITE #1 "        <register address='0xb851624' value='0x" DATA.LONG(A:0xb851624) "' name='RPMH_VRM_ENABLE_CRS_DRV5_REG22'/>"
WRITE #1 "        <register address='0xb851724' value='0x" DATA.LONG(A:0xb851724) "' name='RPMH_VRM_ENABLE_CRS_DRV5_REG23'/>"
WRITE #1 "        <register address='0xb851824' value='0x" DATA.LONG(A:0xb851824) "' name='RPMH_VRM_ENABLE_CRS_DRV5_REG24'/>"
WRITE #1 "        <register address='0xb860024' value='0x" DATA.LONG(A:0xb860024) "' name='RPMH_VRM_ENABLE_CRS_DRV6_REG0'/>"
WRITE #1 "        <register address='0xb860124' value='0x" DATA.LONG(A:0xb860124) "' name='RPMH_VRM_ENABLE_CRS_DRV6_REG1'/>"
WRITE #1 "        <register address='0xb860224' value='0x" DATA.LONG(A:0xb860224) "' name='RPMH_VRM_ENABLE_CRS_DRV6_REG2'/>"
WRITE #1 "        <register address='0xb860324' value='0x" DATA.LONG(A:0xb860324) "' name='RPMH_VRM_ENABLE_CRS_DRV6_REG3'/>"
WRITE #1 "        <register address='0xb860424' value='0x" DATA.LONG(A:0xb860424) "' name='RPMH_VRM_ENABLE_CRS_DRV6_REG4'/>"
WRITE #1 "        <register address='0xb860524' value='0x" DATA.LONG(A:0xb860524) "' name='RPMH_VRM_ENABLE_CRS_DRV6_REG5'/>"
WRITE #1 "        <register address='0xb860624' value='0x" DATA.LONG(A:0xb860624) "' name='RPMH_VRM_ENABLE_CRS_DRV6_REG6'/>"
WRITE #1 "        <register address='0xb860724' value='0x" DATA.LONG(A:0xb860724) "' name='RPMH_VRM_ENABLE_CRS_DRV6_REG7'/>"
WRITE #1 "        <register address='0xb860824' value='0x" DATA.LONG(A:0xb860824) "' name='RPMH_VRM_ENABLE_CRS_DRV6_REG8'/>"
WRITE #1 "        <register address='0xb860924' value='0x" DATA.LONG(A:0xb860924) "' name='RPMH_VRM_ENABLE_CRS_DRV6_REG9'/>"
WRITE #1 "        <register address='0xb860a24' value='0x" DATA.LONG(A:0xb860a24) "' name='RPMH_VRM_ENABLE_CRS_DRV6_REG10'/>"
WRITE #1 "        <register address='0xb860b24' value='0x" DATA.LONG(A:0xb860b24) "' name='RPMH_VRM_ENABLE_CRS_DRV6_REG11'/>"
WRITE #1 "        <register address='0xb860c24' value='0x" DATA.LONG(A:0xb860c24) "' name='RPMH_VRM_ENABLE_CRS_DRV6_REG12'/>"
WRITE #1 "        <register address='0xb860d24' value='0x" DATA.LONG(A:0xb860d24) "' name='RPMH_VRM_ENABLE_CRS_DRV6_REG13'/>"
WRITE #1 "        <register address='0xb860e24' value='0x" DATA.LONG(A:0xb860e24) "' name='RPMH_VRM_ENABLE_CRS_DRV6_REG14'/>"
WRITE #1 "        <register address='0xb860f24' value='0x" DATA.LONG(A:0xb860f24) "' name='RPMH_VRM_ENABLE_CRS_DRV6_REG15'/>"
WRITE #1 "        <register address='0xb861024' value='0x" DATA.LONG(A:0xb861024) "' name='RPMH_VRM_ENABLE_CRS_DRV6_REG16'/>"
WRITE #1 "        <register address='0xb861124' value='0x" DATA.LONG(A:0xb861124) "' name='RPMH_VRM_ENABLE_CRS_DRV6_REG17'/>"
WRITE #1 "        <register address='0xb861224' value='0x" DATA.LONG(A:0xb861224) "' name='RPMH_VRM_ENABLE_CRS_DRV6_REG18'/>"
WRITE #1 "        <register address='0xb861324' value='0x" DATA.LONG(A:0xb861324) "' name='RPMH_VRM_ENABLE_CRS_DRV6_REG19'/>"
WRITE #1 "        <register address='0xb861424' value='0x" DATA.LONG(A:0xb861424) "' name='RPMH_VRM_ENABLE_CRS_DRV6_REG20'/>"
WRITE #1 "        <register address='0xb861524' value='0x" DATA.LONG(A:0xb861524) "' name='RPMH_VRM_ENABLE_CRS_DRV6_REG21'/>"
WRITE #1 "        <register address='0xb861624' value='0x" DATA.LONG(A:0xb861624) "' name='RPMH_VRM_ENABLE_CRS_DRV6_REG22'/>"
WRITE #1 "        <register address='0xb861724' value='0x" DATA.LONG(A:0xb861724) "' name='RPMH_VRM_ENABLE_CRS_DRV6_REG23'/>"
WRITE #1 "        <register address='0xb861824' value='0x" DATA.LONG(A:0xb861824) "' name='RPMH_VRM_ENABLE_CRS_DRV6_REG24'/>"
WRITE #1 "        <register address='0xb800028' value='0x" DATA.LONG(A:0xb800028) "' name='RPMH_VRM_MODE_CRS_DRV0_REG0'/>"
WRITE #1 "        <register address='0xb800128' value='0x" DATA.LONG(A:0xb800128) "' name='RPMH_VRM_MODE_CRS_DRV0_REG1'/>"
WRITE #1 "        <register address='0xb800228' value='0x" DATA.LONG(A:0xb800228) "' name='RPMH_VRM_MODE_CRS_DRV0_REG2'/>"
WRITE #1 "        <register address='0xb800328' value='0x" DATA.LONG(A:0xb800328) "' name='RPMH_VRM_MODE_CRS_DRV0_REG3'/>"
WRITE #1 "        <register address='0xb800428' value='0x" DATA.LONG(A:0xb800428) "' name='RPMH_VRM_MODE_CRS_DRV0_REG4'/>"
WRITE #1 "        <register address='0xb800528' value='0x" DATA.LONG(A:0xb800528) "' name='RPMH_VRM_MODE_CRS_DRV0_REG5'/>"
WRITE #1 "        <register address='0xb800628' value='0x" DATA.LONG(A:0xb800628) "' name='RPMH_VRM_MODE_CRS_DRV0_REG6'/>"
WRITE #1 "        <register address='0xb800728' value='0x" DATA.LONG(A:0xb800728) "' name='RPMH_VRM_MODE_CRS_DRV0_REG7'/>"
WRITE #1 "        <register address='0xb800828' value='0x" DATA.LONG(A:0xb800828) "' name='RPMH_VRM_MODE_CRS_DRV0_REG8'/>"
WRITE #1 "        <register address='0xb800928' value='0x" DATA.LONG(A:0xb800928) "' name='RPMH_VRM_MODE_CRS_DRV0_REG9'/>"
WRITE #1 "        <register address='0xb800a28' value='0x" DATA.LONG(A:0xb800a28) "' name='RPMH_VRM_MODE_CRS_DRV0_REG10'/>"
WRITE #1 "        <register address='0xb800b28' value='0x" DATA.LONG(A:0xb800b28) "' name='RPMH_VRM_MODE_CRS_DRV0_REG11'/>"
WRITE #1 "        <register address='0xb800c28' value='0x" DATA.LONG(A:0xb800c28) "' name='RPMH_VRM_MODE_CRS_DRV0_REG12'/>"
WRITE #1 "        <register address='0xb800d28' value='0x" DATA.LONG(A:0xb800d28) "' name='RPMH_VRM_MODE_CRS_DRV0_REG13'/>"
WRITE #1 "        <register address='0xb800e28' value='0x" DATA.LONG(A:0xb800e28) "' name='RPMH_VRM_MODE_CRS_DRV0_REG14'/>"
WRITE #1 "        <register address='0xb800f28' value='0x" DATA.LONG(A:0xb800f28) "' name='RPMH_VRM_MODE_CRS_DRV0_REG15'/>"
WRITE #1 "        <register address='0xb801028' value='0x" DATA.LONG(A:0xb801028) "' name='RPMH_VRM_MODE_CRS_DRV0_REG16'/>"
WRITE #1 "        <register address='0xb801128' value='0x" DATA.LONG(A:0xb801128) "' name='RPMH_VRM_MODE_CRS_DRV0_REG17'/>"
WRITE #1 "        <register address='0xb801228' value='0x" DATA.LONG(A:0xb801228) "' name='RPMH_VRM_MODE_CRS_DRV0_REG18'/>"
WRITE #1 "        <register address='0xb801328' value='0x" DATA.LONG(A:0xb801328) "' name='RPMH_VRM_MODE_CRS_DRV0_REG19'/>"
WRITE #1 "        <register address='0xb801428' value='0x" DATA.LONG(A:0xb801428) "' name='RPMH_VRM_MODE_CRS_DRV0_REG20'/>"
WRITE #1 "        <register address='0xb801528' value='0x" DATA.LONG(A:0xb801528) "' name='RPMH_VRM_MODE_CRS_DRV0_REG21'/>"
WRITE #1 "        <register address='0xb801628' value='0x" DATA.LONG(A:0xb801628) "' name='RPMH_VRM_MODE_CRS_DRV0_REG22'/>"
WRITE #1 "        <register address='0xb801728' value='0x" DATA.LONG(A:0xb801728) "' name='RPMH_VRM_MODE_CRS_DRV0_REG23'/>"
WRITE #1 "        <register address='0xb801828' value='0x" DATA.LONG(A:0xb801828) "' name='RPMH_VRM_MODE_CRS_DRV0_REG24'/>"
WRITE #1 "        <register address='0xb810028' value='0x" DATA.LONG(A:0xb810028) "' name='RPMH_VRM_MODE_CRS_DRV1_REG0'/>"
WRITE #1 "        <register address='0xb810128' value='0x" DATA.LONG(A:0xb810128) "' name='RPMH_VRM_MODE_CRS_DRV1_REG1'/>"
WRITE #1 "        <register address='0xb810228' value='0x" DATA.LONG(A:0xb810228) "' name='RPMH_VRM_MODE_CRS_DRV1_REG2'/>"
WRITE #1 "        <register address='0xb810328' value='0x" DATA.LONG(A:0xb810328) "' name='RPMH_VRM_MODE_CRS_DRV1_REG3'/>"
WRITE #1 "        <register address='0xb810428' value='0x" DATA.LONG(A:0xb810428) "' name='RPMH_VRM_MODE_CRS_DRV1_REG4'/>"
WRITE #1 "        <register address='0xb810528' value='0x" DATA.LONG(A:0xb810528) "' name='RPMH_VRM_MODE_CRS_DRV1_REG5'/>"
WRITE #1 "        <register address='0xb810628' value='0x" DATA.LONG(A:0xb810628) "' name='RPMH_VRM_MODE_CRS_DRV1_REG6'/>"
WRITE #1 "        <register address='0xb810728' value='0x" DATA.LONG(A:0xb810728) "' name='RPMH_VRM_MODE_CRS_DRV1_REG7'/>"
WRITE #1 "        <register address='0xb810828' value='0x" DATA.LONG(A:0xb810828) "' name='RPMH_VRM_MODE_CRS_DRV1_REG8'/>"
WRITE #1 "        <register address='0xb810928' value='0x" DATA.LONG(A:0xb810928) "' name='RPMH_VRM_MODE_CRS_DRV1_REG9'/>"
WRITE #1 "        <register address='0xb810a28' value='0x" DATA.LONG(A:0xb810a28) "' name='RPMH_VRM_MODE_CRS_DRV1_REG10'/>"
WRITE #1 "        <register address='0xb810b28' value='0x" DATA.LONG(A:0xb810b28) "' name='RPMH_VRM_MODE_CRS_DRV1_REG11'/>"
WRITE #1 "        <register address='0xb810c28' value='0x" DATA.LONG(A:0xb810c28) "' name='RPMH_VRM_MODE_CRS_DRV1_REG12'/>"
WRITE #1 "        <register address='0xb810d28' value='0x" DATA.LONG(A:0xb810d28) "' name='RPMH_VRM_MODE_CRS_DRV1_REG13'/>"
WRITE #1 "        <register address='0xb810e28' value='0x" DATA.LONG(A:0xb810e28) "' name='RPMH_VRM_MODE_CRS_DRV1_REG14'/>"
WRITE #1 "        <register address='0xb810f28' value='0x" DATA.LONG(A:0xb810f28) "' name='RPMH_VRM_MODE_CRS_DRV1_REG15'/>"
WRITE #1 "        <register address='0xb811028' value='0x" DATA.LONG(A:0xb811028) "' name='RPMH_VRM_MODE_CRS_DRV1_REG16'/>"
WRITE #1 "        <register address='0xb811128' value='0x" DATA.LONG(A:0xb811128) "' name='RPMH_VRM_MODE_CRS_DRV1_REG17'/>"
WRITE #1 "        <register address='0xb811228' value='0x" DATA.LONG(A:0xb811228) "' name='RPMH_VRM_MODE_CRS_DRV1_REG18'/>"
WRITE #1 "        <register address='0xb811328' value='0x" DATA.LONG(A:0xb811328) "' name='RPMH_VRM_MODE_CRS_DRV1_REG19'/>"
WRITE #1 "        <register address='0xb811428' value='0x" DATA.LONG(A:0xb811428) "' name='RPMH_VRM_MODE_CRS_DRV1_REG20'/>"
WRITE #1 "        <register address='0xb811528' value='0x" DATA.LONG(A:0xb811528) "' name='RPMH_VRM_MODE_CRS_DRV1_REG21'/>"
WRITE #1 "        <register address='0xb811628' value='0x" DATA.LONG(A:0xb811628) "' name='RPMH_VRM_MODE_CRS_DRV1_REG22'/>"
WRITE #1 "        <register address='0xb811728' value='0x" DATA.LONG(A:0xb811728) "' name='RPMH_VRM_MODE_CRS_DRV1_REG23'/>"
WRITE #1 "        <register address='0xb811828' value='0x" DATA.LONG(A:0xb811828) "' name='RPMH_VRM_MODE_CRS_DRV1_REG24'/>"
WRITE #1 "        <register address='0xb820028' value='0x" DATA.LONG(A:0xb820028) "' name='RPMH_VRM_MODE_CRS_DRV2_REG0'/>"
WRITE #1 "        <register address='0xb820128' value='0x" DATA.LONG(A:0xb820128) "' name='RPMH_VRM_MODE_CRS_DRV2_REG1'/>"
WRITE #1 "        <register address='0xb820228' value='0x" DATA.LONG(A:0xb820228) "' name='RPMH_VRM_MODE_CRS_DRV2_REG2'/>"
WRITE #1 "        <register address='0xb820328' value='0x" DATA.LONG(A:0xb820328) "' name='RPMH_VRM_MODE_CRS_DRV2_REG3'/>"
WRITE #1 "        <register address='0xb820428' value='0x" DATA.LONG(A:0xb820428) "' name='RPMH_VRM_MODE_CRS_DRV2_REG4'/>"
WRITE #1 "        <register address='0xb820528' value='0x" DATA.LONG(A:0xb820528) "' name='RPMH_VRM_MODE_CRS_DRV2_REG5'/>"
WRITE #1 "        <register address='0xb820628' value='0x" DATA.LONG(A:0xb820628) "' name='RPMH_VRM_MODE_CRS_DRV2_REG6'/>"
WRITE #1 "        <register address='0xb820728' value='0x" DATA.LONG(A:0xb820728) "' name='RPMH_VRM_MODE_CRS_DRV2_REG7'/>"
WRITE #1 "        <register address='0xb820828' value='0x" DATA.LONG(A:0xb820828) "' name='RPMH_VRM_MODE_CRS_DRV2_REG8'/>"
WRITE #1 "        <register address='0xb820928' value='0x" DATA.LONG(A:0xb820928) "' name='RPMH_VRM_MODE_CRS_DRV2_REG9'/>"
WRITE #1 "        <register address='0xb820a28' value='0x" DATA.LONG(A:0xb820a28) "' name='RPMH_VRM_MODE_CRS_DRV2_REG10'/>"
WRITE #1 "        <register address='0xb820b28' value='0x" DATA.LONG(A:0xb820b28) "' name='RPMH_VRM_MODE_CRS_DRV2_REG11'/>"
WRITE #1 "        <register address='0xb820c28' value='0x" DATA.LONG(A:0xb820c28) "' name='RPMH_VRM_MODE_CRS_DRV2_REG12'/>"
WRITE #1 "        <register address='0xb820d28' value='0x" DATA.LONG(A:0xb820d28) "' name='RPMH_VRM_MODE_CRS_DRV2_REG13'/>"
WRITE #1 "        <register address='0xb820e28' value='0x" DATA.LONG(A:0xb820e28) "' name='RPMH_VRM_MODE_CRS_DRV2_REG14'/>"
WRITE #1 "        <register address='0xb820f28' value='0x" DATA.LONG(A:0xb820f28) "' name='RPMH_VRM_MODE_CRS_DRV2_REG15'/>"
WRITE #1 "        <register address='0xb821028' value='0x" DATA.LONG(A:0xb821028) "' name='RPMH_VRM_MODE_CRS_DRV2_REG16'/>"
WRITE #1 "        <register address='0xb821128' value='0x" DATA.LONG(A:0xb821128) "' name='RPMH_VRM_MODE_CRS_DRV2_REG17'/>"
WRITE #1 "        <register address='0xb821228' value='0x" DATA.LONG(A:0xb821228) "' name='RPMH_VRM_MODE_CRS_DRV2_REG18'/>"
WRITE #1 "        <register address='0xb821328' value='0x" DATA.LONG(A:0xb821328) "' name='RPMH_VRM_MODE_CRS_DRV2_REG19'/>"
WRITE #1 "        <register address='0xb821428' value='0x" DATA.LONG(A:0xb821428) "' name='RPMH_VRM_MODE_CRS_DRV2_REG20'/>"
WRITE #1 "        <register address='0xb821528' value='0x" DATA.LONG(A:0xb821528) "' name='RPMH_VRM_MODE_CRS_DRV2_REG21'/>"
WRITE #1 "        <register address='0xb821628' value='0x" DATA.LONG(A:0xb821628) "' name='RPMH_VRM_MODE_CRS_DRV2_REG22'/>"
WRITE #1 "        <register address='0xb821728' value='0x" DATA.LONG(A:0xb821728) "' name='RPMH_VRM_MODE_CRS_DRV2_REG23'/>"
WRITE #1 "        <register address='0xb821828' value='0x" DATA.LONG(A:0xb821828) "' name='RPMH_VRM_MODE_CRS_DRV2_REG24'/>"
WRITE #1 "        <register address='0xb830028' value='0x" DATA.LONG(A:0xb830028) "' name='RPMH_VRM_MODE_CRS_DRV3_REG0'/>"
WRITE #1 "        <register address='0xb830128' value='0x" DATA.LONG(A:0xb830128) "' name='RPMH_VRM_MODE_CRS_DRV3_REG1'/>"
WRITE #1 "        <register address='0xb830228' value='0x" DATA.LONG(A:0xb830228) "' name='RPMH_VRM_MODE_CRS_DRV3_REG2'/>"
WRITE #1 "        <register address='0xb830328' value='0x" DATA.LONG(A:0xb830328) "' name='RPMH_VRM_MODE_CRS_DRV3_REG3'/>"
WRITE #1 "        <register address='0xb830428' value='0x" DATA.LONG(A:0xb830428) "' name='RPMH_VRM_MODE_CRS_DRV3_REG4'/>"
WRITE #1 "        <register address='0xb830528' value='0x" DATA.LONG(A:0xb830528) "' name='RPMH_VRM_MODE_CRS_DRV3_REG5'/>"
WRITE #1 "        <register address='0xb830628' value='0x" DATA.LONG(A:0xb830628) "' name='RPMH_VRM_MODE_CRS_DRV3_REG6'/>"
WRITE #1 "        <register address='0xb830728' value='0x" DATA.LONG(A:0xb830728) "' name='RPMH_VRM_MODE_CRS_DRV3_REG7'/>"
WRITE #1 "        <register address='0xb830828' value='0x" DATA.LONG(A:0xb830828) "' name='RPMH_VRM_MODE_CRS_DRV3_REG8'/>"
WRITE #1 "        <register address='0xb830928' value='0x" DATA.LONG(A:0xb830928) "' name='RPMH_VRM_MODE_CRS_DRV3_REG9'/>"
WRITE #1 "        <register address='0xb830a28' value='0x" DATA.LONG(A:0xb830a28) "' name='RPMH_VRM_MODE_CRS_DRV3_REG10'/>"
WRITE #1 "        <register address='0xb830b28' value='0x" DATA.LONG(A:0xb830b28) "' name='RPMH_VRM_MODE_CRS_DRV3_REG11'/>"
WRITE #1 "        <register address='0xb830c28' value='0x" DATA.LONG(A:0xb830c28) "' name='RPMH_VRM_MODE_CRS_DRV3_REG12'/>"
WRITE #1 "        <register address='0xb830d28' value='0x" DATA.LONG(A:0xb830d28) "' name='RPMH_VRM_MODE_CRS_DRV3_REG13'/>"
WRITE #1 "        <register address='0xb830e28' value='0x" DATA.LONG(A:0xb830e28) "' name='RPMH_VRM_MODE_CRS_DRV3_REG14'/>"
WRITE #1 "        <register address='0xb830f28' value='0x" DATA.LONG(A:0xb830f28) "' name='RPMH_VRM_MODE_CRS_DRV3_REG15'/>"
WRITE #1 "        <register address='0xb831028' value='0x" DATA.LONG(A:0xb831028) "' name='RPMH_VRM_MODE_CRS_DRV3_REG16'/>"
WRITE #1 "        <register address='0xb831128' value='0x" DATA.LONG(A:0xb831128) "' name='RPMH_VRM_MODE_CRS_DRV3_REG17'/>"
WRITE #1 "        <register address='0xb831228' value='0x" DATA.LONG(A:0xb831228) "' name='RPMH_VRM_MODE_CRS_DRV3_REG18'/>"
WRITE #1 "        <register address='0xb831328' value='0x" DATA.LONG(A:0xb831328) "' name='RPMH_VRM_MODE_CRS_DRV3_REG19'/>"
WRITE #1 "        <register address='0xb831428' value='0x" DATA.LONG(A:0xb831428) "' name='RPMH_VRM_MODE_CRS_DRV3_REG20'/>"
WRITE #1 "        <register address='0xb831528' value='0x" DATA.LONG(A:0xb831528) "' name='RPMH_VRM_MODE_CRS_DRV3_REG21'/>"
WRITE #1 "        <register address='0xb831628' value='0x" DATA.LONG(A:0xb831628) "' name='RPMH_VRM_MODE_CRS_DRV3_REG22'/>"
WRITE #1 "        <register address='0xb831728' value='0x" DATA.LONG(A:0xb831728) "' name='RPMH_VRM_MODE_CRS_DRV3_REG23'/>"
WRITE #1 "        <register address='0xb831828' value='0x" DATA.LONG(A:0xb831828) "' name='RPMH_VRM_MODE_CRS_DRV3_REG24'/>"
WRITE #1 "        <register address='0xb840028' value='0x" DATA.LONG(A:0xb840028) "' name='RPMH_VRM_MODE_CRS_DRV4_REG0'/>"
WRITE #1 "        <register address='0xb840128' value='0x" DATA.LONG(A:0xb840128) "' name='RPMH_VRM_MODE_CRS_DRV4_REG1'/>"
WRITE #1 "        <register address='0xb840228' value='0x" DATA.LONG(A:0xb840228) "' name='RPMH_VRM_MODE_CRS_DRV4_REG2'/>"
WRITE #1 "        <register address='0xb840328' value='0x" DATA.LONG(A:0xb840328) "' name='RPMH_VRM_MODE_CRS_DRV4_REG3'/>"
WRITE #1 "        <register address='0xb840428' value='0x" DATA.LONG(A:0xb840428) "' name='RPMH_VRM_MODE_CRS_DRV4_REG4'/>"
WRITE #1 "        <register address='0xb840528' value='0x" DATA.LONG(A:0xb840528) "' name='RPMH_VRM_MODE_CRS_DRV4_REG5'/>"
WRITE #1 "        <register address='0xb840628' value='0x" DATA.LONG(A:0xb840628) "' name='RPMH_VRM_MODE_CRS_DRV4_REG6'/>"
WRITE #1 "        <register address='0xb840728' value='0x" DATA.LONG(A:0xb840728) "' name='RPMH_VRM_MODE_CRS_DRV4_REG7'/>"
WRITE #1 "        <register address='0xb840828' value='0x" DATA.LONG(A:0xb840828) "' name='RPMH_VRM_MODE_CRS_DRV4_REG8'/>"
WRITE #1 "        <register address='0xb840928' value='0x" DATA.LONG(A:0xb840928) "' name='RPMH_VRM_MODE_CRS_DRV4_REG9'/>"
WRITE #1 "        <register address='0xb840a28' value='0x" DATA.LONG(A:0xb840a28) "' name='RPMH_VRM_MODE_CRS_DRV4_REG10'/>"
WRITE #1 "        <register address='0xb840b28' value='0x" DATA.LONG(A:0xb840b28) "' name='RPMH_VRM_MODE_CRS_DRV4_REG11'/>"
WRITE #1 "        <register address='0xb840c28' value='0x" DATA.LONG(A:0xb840c28) "' name='RPMH_VRM_MODE_CRS_DRV4_REG12'/>"
WRITE #1 "        <register address='0xb840d28' value='0x" DATA.LONG(A:0xb840d28) "' name='RPMH_VRM_MODE_CRS_DRV4_REG13'/>"
WRITE #1 "        <register address='0xb840e28' value='0x" DATA.LONG(A:0xb840e28) "' name='RPMH_VRM_MODE_CRS_DRV4_REG14'/>"
WRITE #1 "        <register address='0xb840f28' value='0x" DATA.LONG(A:0xb840f28) "' name='RPMH_VRM_MODE_CRS_DRV4_REG15'/>"
WRITE #1 "        <register address='0xb841028' value='0x" DATA.LONG(A:0xb841028) "' name='RPMH_VRM_MODE_CRS_DRV4_REG16'/>"
WRITE #1 "        <register address='0xb841128' value='0x" DATA.LONG(A:0xb841128) "' name='RPMH_VRM_MODE_CRS_DRV4_REG17'/>"
WRITE #1 "        <register address='0xb841228' value='0x" DATA.LONG(A:0xb841228) "' name='RPMH_VRM_MODE_CRS_DRV4_REG18'/>"
WRITE #1 "        <register address='0xb841328' value='0x" DATA.LONG(A:0xb841328) "' name='RPMH_VRM_MODE_CRS_DRV4_REG19'/>"
WRITE #1 "        <register address='0xb841428' value='0x" DATA.LONG(A:0xb841428) "' name='RPMH_VRM_MODE_CRS_DRV4_REG20'/>"
WRITE #1 "        <register address='0xb841528' value='0x" DATA.LONG(A:0xb841528) "' name='RPMH_VRM_MODE_CRS_DRV4_REG21'/>"
WRITE #1 "        <register address='0xb841628' value='0x" DATA.LONG(A:0xb841628) "' name='RPMH_VRM_MODE_CRS_DRV4_REG22'/>"
WRITE #1 "        <register address='0xb841728' value='0x" DATA.LONG(A:0xb841728) "' name='RPMH_VRM_MODE_CRS_DRV4_REG23'/>"
WRITE #1 "        <register address='0xb841828' value='0x" DATA.LONG(A:0xb841828) "' name='RPMH_VRM_MODE_CRS_DRV4_REG24'/>"
WRITE #1 "        <register address='0xb850028' value='0x" DATA.LONG(A:0xb850028) "' name='RPMH_VRM_MODE_CRS_DRV5_REG0'/>"
WRITE #1 "        <register address='0xb850128' value='0x" DATA.LONG(A:0xb850128) "' name='RPMH_VRM_MODE_CRS_DRV5_REG1'/>"
WRITE #1 "        <register address='0xb850228' value='0x" DATA.LONG(A:0xb850228) "' name='RPMH_VRM_MODE_CRS_DRV5_REG2'/>"
WRITE #1 "        <register address='0xb850328' value='0x" DATA.LONG(A:0xb850328) "' name='RPMH_VRM_MODE_CRS_DRV5_REG3'/>"
WRITE #1 "        <register address='0xb850428' value='0x" DATA.LONG(A:0xb850428) "' name='RPMH_VRM_MODE_CRS_DRV5_REG4'/>"
WRITE #1 "        <register address='0xb850528' value='0x" DATA.LONG(A:0xb850528) "' name='RPMH_VRM_MODE_CRS_DRV5_REG5'/>"
WRITE #1 "        <register address='0xb850628' value='0x" DATA.LONG(A:0xb850628) "' name='RPMH_VRM_MODE_CRS_DRV5_REG6'/>"
WRITE #1 "        <register address='0xb850728' value='0x" DATA.LONG(A:0xb850728) "' name='RPMH_VRM_MODE_CRS_DRV5_REG7'/>"
WRITE #1 "        <register address='0xb850828' value='0x" DATA.LONG(A:0xb850828) "' name='RPMH_VRM_MODE_CRS_DRV5_REG8'/>"
WRITE #1 "        <register address='0xb850928' value='0x" DATA.LONG(A:0xb850928) "' name='RPMH_VRM_MODE_CRS_DRV5_REG9'/>"
WRITE #1 "        <register address='0xb850a28' value='0x" DATA.LONG(A:0xb850a28) "' name='RPMH_VRM_MODE_CRS_DRV5_REG10'/>"
WRITE #1 "        <register address='0xb850b28' value='0x" DATA.LONG(A:0xb850b28) "' name='RPMH_VRM_MODE_CRS_DRV5_REG11'/>"
WRITE #1 "        <register address='0xb850c28' value='0x" DATA.LONG(A:0xb850c28) "' name='RPMH_VRM_MODE_CRS_DRV5_REG12'/>"
WRITE #1 "        <register address='0xb850d28' value='0x" DATA.LONG(A:0xb850d28) "' name='RPMH_VRM_MODE_CRS_DRV5_REG13'/>"
WRITE #1 "        <register address='0xb850e28' value='0x" DATA.LONG(A:0xb850e28) "' name='RPMH_VRM_MODE_CRS_DRV5_REG14'/>"
WRITE #1 "        <register address='0xb850f28' value='0x" DATA.LONG(A:0xb850f28) "' name='RPMH_VRM_MODE_CRS_DRV5_REG15'/>"
WRITE #1 "        <register address='0xb851028' value='0x" DATA.LONG(A:0xb851028) "' name='RPMH_VRM_MODE_CRS_DRV5_REG16'/>"
WRITE #1 "        <register address='0xb851128' value='0x" DATA.LONG(A:0xb851128) "' name='RPMH_VRM_MODE_CRS_DRV5_REG17'/>"
WRITE #1 "        <register address='0xb851228' value='0x" DATA.LONG(A:0xb851228) "' name='RPMH_VRM_MODE_CRS_DRV5_REG18'/>"
WRITE #1 "        <register address='0xb851328' value='0x" DATA.LONG(A:0xb851328) "' name='RPMH_VRM_MODE_CRS_DRV5_REG19'/>"
WRITE #1 "        <register address='0xb851428' value='0x" DATA.LONG(A:0xb851428) "' name='RPMH_VRM_MODE_CRS_DRV5_REG20'/>"
WRITE #1 "        <register address='0xb851528' value='0x" DATA.LONG(A:0xb851528) "' name='RPMH_VRM_MODE_CRS_DRV5_REG21'/>"
WRITE #1 "        <register address='0xb851628' value='0x" DATA.LONG(A:0xb851628) "' name='RPMH_VRM_MODE_CRS_DRV5_REG22'/>"
WRITE #1 "        <register address='0xb851728' value='0x" DATA.LONG(A:0xb851728) "' name='RPMH_VRM_MODE_CRS_DRV5_REG23'/>"
WRITE #1 "        <register address='0xb851828' value='0x" DATA.LONG(A:0xb851828) "' name='RPMH_VRM_MODE_CRS_DRV5_REG24'/>"
WRITE #1 "        <register address='0xb860028' value='0x" DATA.LONG(A:0xb860028) "' name='RPMH_VRM_MODE_CRS_DRV6_REG0'/>"
WRITE #1 "        <register address='0xb860128' value='0x" DATA.LONG(A:0xb860128) "' name='RPMH_VRM_MODE_CRS_DRV6_REG1'/>"
WRITE #1 "        <register address='0xb860228' value='0x" DATA.LONG(A:0xb860228) "' name='RPMH_VRM_MODE_CRS_DRV6_REG2'/>"
WRITE #1 "        <register address='0xb860328' value='0x" DATA.LONG(A:0xb860328) "' name='RPMH_VRM_MODE_CRS_DRV6_REG3'/>"
WRITE #1 "        <register address='0xb860428' value='0x" DATA.LONG(A:0xb860428) "' name='RPMH_VRM_MODE_CRS_DRV6_REG4'/>"
WRITE #1 "        <register address='0xb860528' value='0x" DATA.LONG(A:0xb860528) "' name='RPMH_VRM_MODE_CRS_DRV6_REG5'/>"
WRITE #1 "        <register address='0xb860628' value='0x" DATA.LONG(A:0xb860628) "' name='RPMH_VRM_MODE_CRS_DRV6_REG6'/>"
WRITE #1 "        <register address='0xb860728' value='0x" DATA.LONG(A:0xb860728) "' name='RPMH_VRM_MODE_CRS_DRV6_REG7'/>"
WRITE #1 "        <register address='0xb860828' value='0x" DATA.LONG(A:0xb860828) "' name='RPMH_VRM_MODE_CRS_DRV6_REG8'/>"
WRITE #1 "        <register address='0xb860928' value='0x" DATA.LONG(A:0xb860928) "' name='RPMH_VRM_MODE_CRS_DRV6_REG9'/>"
WRITE #1 "        <register address='0xb860a28' value='0x" DATA.LONG(A:0xb860a28) "' name='RPMH_VRM_MODE_CRS_DRV6_REG10'/>"
WRITE #1 "        <register address='0xb860b28' value='0x" DATA.LONG(A:0xb860b28) "' name='RPMH_VRM_MODE_CRS_DRV6_REG11'/>"
WRITE #1 "        <register address='0xb860c28' value='0x" DATA.LONG(A:0xb860c28) "' name='RPMH_VRM_MODE_CRS_DRV6_REG12'/>"
WRITE #1 "        <register address='0xb860d28' value='0x" DATA.LONG(A:0xb860d28) "' name='RPMH_VRM_MODE_CRS_DRV6_REG13'/>"
WRITE #1 "        <register address='0xb860e28' value='0x" DATA.LONG(A:0xb860e28) "' name='RPMH_VRM_MODE_CRS_DRV6_REG14'/>"
WRITE #1 "        <register address='0xb860f28' value='0x" DATA.LONG(A:0xb860f28) "' name='RPMH_VRM_MODE_CRS_DRV6_REG15'/>"
WRITE #1 "        <register address='0xb861028' value='0x" DATA.LONG(A:0xb861028) "' name='RPMH_VRM_MODE_CRS_DRV6_REG16'/>"
WRITE #1 "        <register address='0xb861128' value='0x" DATA.LONG(A:0xb861128) "' name='RPMH_VRM_MODE_CRS_DRV6_REG17'/>"
WRITE #1 "        <register address='0xb861228' value='0x" DATA.LONG(A:0xb861228) "' name='RPMH_VRM_MODE_CRS_DRV6_REG18'/>"
WRITE #1 "        <register address='0xb861328' value='0x" DATA.LONG(A:0xb861328) "' name='RPMH_VRM_MODE_CRS_DRV6_REG19'/>"
WRITE #1 "        <register address='0xb861428' value='0x" DATA.LONG(A:0xb861428) "' name='RPMH_VRM_MODE_CRS_DRV6_REG20'/>"
WRITE #1 "        <register address='0xb861528' value='0x" DATA.LONG(A:0xb861528) "' name='RPMH_VRM_MODE_CRS_DRV6_REG21'/>"
WRITE #1 "        <register address='0xb861628' value='0x" DATA.LONG(A:0xb861628) "' name='RPMH_VRM_MODE_CRS_DRV6_REG22'/>"
WRITE #1 "        <register address='0xb861728' value='0x" DATA.LONG(A:0xb861728) "' name='RPMH_VRM_MODE_CRS_DRV6_REG23'/>"
WRITE #1 "        <register address='0xb861828' value='0x" DATA.LONG(A:0xb861828) "' name='RPMH_VRM_MODE_CRS_DRV6_REG24'/>"
WRITE #1 "        <register address='0xb801924' value='0x" DATA.LONG(A:0xb801924) "' name='RPMH_VRM_ENABLE_CRS_DRV0_XOB0'/>"
WRITE #1 "        <register address='0xb801a24' value='0x" DATA.LONG(A:0xb801a24) "' name='RPMH_VRM_ENABLE_CRS_DRV0_XOB1'/>"
WRITE #1 "        <register address='0xb801b24' value='0x" DATA.LONG(A:0xb801b24) "' name='RPMH_VRM_ENABLE_CRS_DRV0_XOB2'/>"
WRITE #1 "        <register address='0xb801c24' value='0x" DATA.LONG(A:0xb801c24) "' name='RPMH_VRM_ENABLE_CRS_DRV0_XOB3'/>"
WRITE #1 "        <register address='0xb801d24' value='0x" DATA.LONG(A:0xb801d24) "' name='RPMH_VRM_ENABLE_CRS_DRV0_XOB4'/>"
WRITE #1 "        <register address='0xb801e24' value='0x" DATA.LONG(A:0xb801e24) "' name='RPMH_VRM_ENABLE_CRS_DRV0_XOB5'/>"
WRITE #1 "        <register address='0xb801f24' value='0x" DATA.LONG(A:0xb801f24) "' name='RPMH_VRM_ENABLE_CRS_DRV0_XOB6'/>"
WRITE #1 "        <register address='0xb802024' value='0x" DATA.LONG(A:0xb802024) "' name='RPMH_VRM_ENABLE_CRS_DRV0_XOB7'/>"
WRITE #1 "        <register address='0xb802124' value='0x" DATA.LONG(A:0xb802124) "' name='RPMH_VRM_ENABLE_CRS_DRV0_XOB8'/>"
WRITE #1 "        <register address='0xb802224' value='0x" DATA.LONG(A:0xb802224) "' name='RPMH_VRM_ENABLE_CRS_DRV0_XOB9'/>"
WRITE #1 "        <register address='0xb802324' value='0x" DATA.LONG(A:0xb802324) "' name='RPMH_VRM_ENABLE_CRS_DRV0_XOB10'/>"
WRITE #1 "        <register address='0xb802424' value='0x" DATA.LONG(A:0xb802424) "' name='RPMH_VRM_ENABLE_CRS_DRV0_XOB11'/>"
WRITE #1 "        <register address='0xb802524' value='0x" DATA.LONG(A:0xb802524) "' name='RPMH_VRM_ENABLE_CRS_DRV0_XOB12'/>"
WRITE #1 "        <register address='0xb802624' value='0x" DATA.LONG(A:0xb802624) "' name='RPMH_VRM_ENABLE_CRS_DRV0_XOB13'/>"
WRITE #1 "        <register address='0xb802724' value='0x" DATA.LONG(A:0xb802724) "' name='RPMH_VRM_ENABLE_CRS_DRV0_XOB14'/>"
WRITE #1 "        <register address='0xb802824' value='0x" DATA.LONG(A:0xb802824) "' name='RPMH_VRM_ENABLE_CRS_DRV0_XOB15'/>"
WRITE #1 "        <register address='0xb811924' value='0x" DATA.LONG(A:0xb811924) "' name='RPMH_VRM_ENABLE_CRS_DRV1_XOB0'/>"
WRITE #1 "        <register address='0xb811a24' value='0x" DATA.LONG(A:0xb811a24) "' name='RPMH_VRM_ENABLE_CRS_DRV1_XOB1'/>"
WRITE #1 "        <register address='0xb811b24' value='0x" DATA.LONG(A:0xb811b24) "' name='RPMH_VRM_ENABLE_CRS_DRV1_XOB2'/>"
WRITE #1 "        <register address='0xb811c24' value='0x" DATA.LONG(A:0xb811c24) "' name='RPMH_VRM_ENABLE_CRS_DRV1_XOB3'/>"
WRITE #1 "        <register address='0xb811d24' value='0x" DATA.LONG(A:0xb811d24) "' name='RPMH_VRM_ENABLE_CRS_DRV1_XOB4'/>"
WRITE #1 "        <register address='0xb811e24' value='0x" DATA.LONG(A:0xb811e24) "' name='RPMH_VRM_ENABLE_CRS_DRV1_XOB5'/>"
WRITE #1 "        <register address='0xb811f24' value='0x" DATA.LONG(A:0xb811f24) "' name='RPMH_VRM_ENABLE_CRS_DRV1_XOB6'/>"
WRITE #1 "        <register address='0xb812024' value='0x" DATA.LONG(A:0xb812024) "' name='RPMH_VRM_ENABLE_CRS_DRV1_XOB7'/>"
WRITE #1 "        <register address='0xb812124' value='0x" DATA.LONG(A:0xb812124) "' name='RPMH_VRM_ENABLE_CRS_DRV1_XOB8'/>"
WRITE #1 "        <register address='0xb812224' value='0x" DATA.LONG(A:0xb812224) "' name='RPMH_VRM_ENABLE_CRS_DRV1_XOB9'/>"
WRITE #1 "        <register address='0xb812324' value='0x" DATA.LONG(A:0xb812324) "' name='RPMH_VRM_ENABLE_CRS_DRV1_XOB10'/>"
WRITE #1 "        <register address='0xb812424' value='0x" DATA.LONG(A:0xb812424) "' name='RPMH_VRM_ENABLE_CRS_DRV1_XOB11'/>"
WRITE #1 "        <register address='0xb812524' value='0x" DATA.LONG(A:0xb812524) "' name='RPMH_VRM_ENABLE_CRS_DRV1_XOB12'/>"
WRITE #1 "        <register address='0xb812624' value='0x" DATA.LONG(A:0xb812624) "' name='RPMH_VRM_ENABLE_CRS_DRV1_XOB13'/>"
WRITE #1 "        <register address='0xb812724' value='0x" DATA.LONG(A:0xb812724) "' name='RPMH_VRM_ENABLE_CRS_DRV1_XOB14'/>"
WRITE #1 "        <register address='0xb812824' value='0x" DATA.LONG(A:0xb812824) "' name='RPMH_VRM_ENABLE_CRS_DRV1_XOB15'/>"
WRITE #1 "        <register address='0xb821924' value='0x" DATA.LONG(A:0xb821924) "' name='RPMH_VRM_ENABLE_CRS_DRV2_XOB0'/>"
WRITE #1 "        <register address='0xb821a24' value='0x" DATA.LONG(A:0xb821a24) "' name='RPMH_VRM_ENABLE_CRS_DRV2_XOB1'/>"
WRITE #1 "        <register address='0xb821b24' value='0x" DATA.LONG(A:0xb821b24) "' name='RPMH_VRM_ENABLE_CRS_DRV2_XOB2'/>"
WRITE #1 "        <register address='0xb821c24' value='0x" DATA.LONG(A:0xb821c24) "' name='RPMH_VRM_ENABLE_CRS_DRV2_XOB3'/>"
WRITE #1 "        <register address='0xb821d24' value='0x" DATA.LONG(A:0xb821d24) "' name='RPMH_VRM_ENABLE_CRS_DRV2_XOB4'/>"
WRITE #1 "        <register address='0xb821e24' value='0x" DATA.LONG(A:0xb821e24) "' name='RPMH_VRM_ENABLE_CRS_DRV2_XOB5'/>"
WRITE #1 "        <register address='0xb821f24' value='0x" DATA.LONG(A:0xb821f24) "' name='RPMH_VRM_ENABLE_CRS_DRV2_XOB6'/>"
WRITE #1 "        <register address='0xb822024' value='0x" DATA.LONG(A:0xb822024) "' name='RPMH_VRM_ENABLE_CRS_DRV2_XOB7'/>"
WRITE #1 "        <register address='0xb822124' value='0x" DATA.LONG(A:0xb822124) "' name='RPMH_VRM_ENABLE_CRS_DRV2_XOB8'/>"
WRITE #1 "        <register address='0xb822224' value='0x" DATA.LONG(A:0xb822224) "' name='RPMH_VRM_ENABLE_CRS_DRV2_XOB9'/>"
WRITE #1 "        <register address='0xb822324' value='0x" DATA.LONG(A:0xb822324) "' name='RPMH_VRM_ENABLE_CRS_DRV2_XOB10'/>"
WRITE #1 "        <register address='0xb822424' value='0x" DATA.LONG(A:0xb822424) "' name='RPMH_VRM_ENABLE_CRS_DRV2_XOB11'/>"
WRITE #1 "        <register address='0xb822524' value='0x" DATA.LONG(A:0xb822524) "' name='RPMH_VRM_ENABLE_CRS_DRV2_XOB12'/>"
WRITE #1 "        <register address='0xb822624' value='0x" DATA.LONG(A:0xb822624) "' name='RPMH_VRM_ENABLE_CRS_DRV2_XOB13'/>"
WRITE #1 "        <register address='0xb822724' value='0x" DATA.LONG(A:0xb822724) "' name='RPMH_VRM_ENABLE_CRS_DRV2_XOB14'/>"
WRITE #1 "        <register address='0xb822824' value='0x" DATA.LONG(A:0xb822824) "' name='RPMH_VRM_ENABLE_CRS_DRV2_XOB15'/>"
WRITE #1 "        <register address='0xb831924' value='0x" DATA.LONG(A:0xb831924) "' name='RPMH_VRM_ENABLE_CRS_DRV3_XOB0'/>"
WRITE #1 "        <register address='0xb831a24' value='0x" DATA.LONG(A:0xb831a24) "' name='RPMH_VRM_ENABLE_CRS_DRV3_XOB1'/>"
WRITE #1 "        <register address='0xb831b24' value='0x" DATA.LONG(A:0xb831b24) "' name='RPMH_VRM_ENABLE_CRS_DRV3_XOB2'/>"
WRITE #1 "        <register address='0xb831c24' value='0x" DATA.LONG(A:0xb831c24) "' name='RPMH_VRM_ENABLE_CRS_DRV3_XOB3'/>"
WRITE #1 "        <register address='0xb831d24' value='0x" DATA.LONG(A:0xb831d24) "' name='RPMH_VRM_ENABLE_CRS_DRV3_XOB4'/>"
WRITE #1 "        <register address='0xb831e24' value='0x" DATA.LONG(A:0xb831e24) "' name='RPMH_VRM_ENABLE_CRS_DRV3_XOB5'/>"
WRITE #1 "        <register address='0xb831f24' value='0x" DATA.LONG(A:0xb831f24) "' name='RPMH_VRM_ENABLE_CRS_DRV3_XOB6'/>"
WRITE #1 "        <register address='0xb832024' value='0x" DATA.LONG(A:0xb832024) "' name='RPMH_VRM_ENABLE_CRS_DRV3_XOB7'/>"
WRITE #1 "        <register address='0xb832124' value='0x" DATA.LONG(A:0xb832124) "' name='RPMH_VRM_ENABLE_CRS_DRV3_XOB8'/>"
WRITE #1 "        <register address='0xb832224' value='0x" DATA.LONG(A:0xb832224) "' name='RPMH_VRM_ENABLE_CRS_DRV3_XOB9'/>"
WRITE #1 "        <register address='0xb832324' value='0x" DATA.LONG(A:0xb832324) "' name='RPMH_VRM_ENABLE_CRS_DRV3_XOB10'/>"
WRITE #1 "        <register address='0xb832424' value='0x" DATA.LONG(A:0xb832424) "' name='RPMH_VRM_ENABLE_CRS_DRV3_XOB11'/>"
WRITE #1 "        <register address='0xb832524' value='0x" DATA.LONG(A:0xb832524) "' name='RPMH_VRM_ENABLE_CRS_DRV3_XOB12'/>"
WRITE #1 "        <register address='0xb832624' value='0x" DATA.LONG(A:0xb832624) "' name='RPMH_VRM_ENABLE_CRS_DRV3_XOB13'/>"
WRITE #1 "        <register address='0xb832724' value='0x" DATA.LONG(A:0xb832724) "' name='RPMH_VRM_ENABLE_CRS_DRV3_XOB14'/>"
WRITE #1 "        <register address='0xb832824' value='0x" DATA.LONG(A:0xb832824) "' name='RPMH_VRM_ENABLE_CRS_DRV3_XOB15'/>"
WRITE #1 "        <register address='0xb841924' value='0x" DATA.LONG(A:0xb841924) "' name='RPMH_VRM_ENABLE_CRS_DRV4_XOB0'/>"
WRITE #1 "        <register address='0xb841a24' value='0x" DATA.LONG(A:0xb841a24) "' name='RPMH_VRM_ENABLE_CRS_DRV4_XOB1'/>"
WRITE #1 "        <register address='0xb841b24' value='0x" DATA.LONG(A:0xb841b24) "' name='RPMH_VRM_ENABLE_CRS_DRV4_XOB2'/>"
WRITE #1 "        <register address='0xb841c24' value='0x" DATA.LONG(A:0xb841c24) "' name='RPMH_VRM_ENABLE_CRS_DRV4_XOB3'/>"
WRITE #1 "        <register address='0xb841d24' value='0x" DATA.LONG(A:0xb841d24) "' name='RPMH_VRM_ENABLE_CRS_DRV4_XOB4'/>"
WRITE #1 "        <register address='0xb841e24' value='0x" DATA.LONG(A:0xb841e24) "' name='RPMH_VRM_ENABLE_CRS_DRV4_XOB5'/>"
WRITE #1 "        <register address='0xb841f24' value='0x" DATA.LONG(A:0xb841f24) "' name='RPMH_VRM_ENABLE_CRS_DRV4_XOB6'/>"
WRITE #1 "        <register address='0xb842024' value='0x" DATA.LONG(A:0xb842024) "' name='RPMH_VRM_ENABLE_CRS_DRV4_XOB7'/>"
WRITE #1 "        <register address='0xb842124' value='0x" DATA.LONG(A:0xb842124) "' name='RPMH_VRM_ENABLE_CRS_DRV4_XOB8'/>"
WRITE #1 "        <register address='0xb842224' value='0x" DATA.LONG(A:0xb842224) "' name='RPMH_VRM_ENABLE_CRS_DRV4_XOB9'/>"
WRITE #1 "        <register address='0xb842324' value='0x" DATA.LONG(A:0xb842324) "' name='RPMH_VRM_ENABLE_CRS_DRV4_XOB10'/>"
WRITE #1 "        <register address='0xb842424' value='0x" DATA.LONG(A:0xb842424) "' name='RPMH_VRM_ENABLE_CRS_DRV4_XOB11'/>"
WRITE #1 "        <register address='0xb842524' value='0x" DATA.LONG(A:0xb842524) "' name='RPMH_VRM_ENABLE_CRS_DRV4_XOB12'/>"
WRITE #1 "        <register address='0xb842624' value='0x" DATA.LONG(A:0xb842624) "' name='RPMH_VRM_ENABLE_CRS_DRV4_XOB13'/>"
WRITE #1 "        <register address='0xb842724' value='0x" DATA.LONG(A:0xb842724) "' name='RPMH_VRM_ENABLE_CRS_DRV4_XOB14'/>"
WRITE #1 "        <register address='0xb842824' value='0x" DATA.LONG(A:0xb842824) "' name='RPMH_VRM_ENABLE_CRS_DRV4_XOB15'/>"
WRITE #1 "        <register address='0xb851924' value='0x" DATA.LONG(A:0xb851924) "' name='RPMH_VRM_ENABLE_CRS_DRV5_XOB0'/>"
WRITE #1 "        <register address='0xb851a24' value='0x" DATA.LONG(A:0xb851a24) "' name='RPMH_VRM_ENABLE_CRS_DRV5_XOB1'/>"
WRITE #1 "        <register address='0xb851b24' value='0x" DATA.LONG(A:0xb851b24) "' name='RPMH_VRM_ENABLE_CRS_DRV5_XOB2'/>"
WRITE #1 "        <register address='0xb851c24' value='0x" DATA.LONG(A:0xb851c24) "' name='RPMH_VRM_ENABLE_CRS_DRV5_XOB3'/>"
WRITE #1 "        <register address='0xb851d24' value='0x" DATA.LONG(A:0xb851d24) "' name='RPMH_VRM_ENABLE_CRS_DRV5_XOB4'/>"
WRITE #1 "        <register address='0xb851e24' value='0x" DATA.LONG(A:0xb851e24) "' name='RPMH_VRM_ENABLE_CRS_DRV5_XOB5'/>"
WRITE #1 "        <register address='0xb851f24' value='0x" DATA.LONG(A:0xb851f24) "' name='RPMH_VRM_ENABLE_CRS_DRV5_XOB6'/>"
WRITE #1 "        <register address='0xb852024' value='0x" DATA.LONG(A:0xb852024) "' name='RPMH_VRM_ENABLE_CRS_DRV5_XOB7'/>"
WRITE #1 "        <register address='0xb852124' value='0x" DATA.LONG(A:0xb852124) "' name='RPMH_VRM_ENABLE_CRS_DRV5_XOB8'/>"
WRITE #1 "        <register address='0xb852224' value='0x" DATA.LONG(A:0xb852224) "' name='RPMH_VRM_ENABLE_CRS_DRV5_XOB9'/>"
WRITE #1 "        <register address='0xb852324' value='0x" DATA.LONG(A:0xb852324) "' name='RPMH_VRM_ENABLE_CRS_DRV5_XOB10'/>"
WRITE #1 "        <register address='0xb852424' value='0x" DATA.LONG(A:0xb852424) "' name='RPMH_VRM_ENABLE_CRS_DRV5_XOB11'/>"
WRITE #1 "        <register address='0xb852524' value='0x" DATA.LONG(A:0xb852524) "' name='RPMH_VRM_ENABLE_CRS_DRV5_XOB12'/>"
WRITE #1 "        <register address='0xb852624' value='0x" DATA.LONG(A:0xb852624) "' name='RPMH_VRM_ENABLE_CRS_DRV5_XOB13'/>"
WRITE #1 "        <register address='0xb852724' value='0x" DATA.LONG(A:0xb852724) "' name='RPMH_VRM_ENABLE_CRS_DRV5_XOB14'/>"
WRITE #1 "        <register address='0xb852824' value='0x" DATA.LONG(A:0xb852824) "' name='RPMH_VRM_ENABLE_CRS_DRV5_XOB15'/>"
WRITE #1 "        <register address='0xb861924' value='0x" DATA.LONG(A:0xb861924) "' name='RPMH_VRM_ENABLE_CRS_DRV6_XOB0'/>"
WRITE #1 "        <register address='0xb861a24' value='0x" DATA.LONG(A:0xb861a24) "' name='RPMH_VRM_ENABLE_CRS_DRV6_XOB1'/>"
WRITE #1 "        <register address='0xb861b24' value='0x" DATA.LONG(A:0xb861b24) "' name='RPMH_VRM_ENABLE_CRS_DRV6_XOB2'/>"
WRITE #1 "        <register address='0xb861c24' value='0x" DATA.LONG(A:0xb861c24) "' name='RPMH_VRM_ENABLE_CRS_DRV6_XOB3'/>"
WRITE #1 "        <register address='0xb861d24' value='0x" DATA.LONG(A:0xb861d24) "' name='RPMH_VRM_ENABLE_CRS_DRV6_XOB4'/>"
WRITE #1 "        <register address='0xb861e24' value='0x" DATA.LONG(A:0xb861e24) "' name='RPMH_VRM_ENABLE_CRS_DRV6_XOB5'/>"
WRITE #1 "        <register address='0xb861f24' value='0x" DATA.LONG(A:0xb861f24) "' name='RPMH_VRM_ENABLE_CRS_DRV6_XOB6'/>"
WRITE #1 "        <register address='0xb862024' value='0x" DATA.LONG(A:0xb862024) "' name='RPMH_VRM_ENABLE_CRS_DRV6_XOB7'/>"
WRITE #1 "        <register address='0xb862124' value='0x" DATA.LONG(A:0xb862124) "' name='RPMH_VRM_ENABLE_CRS_DRV6_XOB8'/>"
WRITE #1 "        <register address='0xb862224' value='0x" DATA.LONG(A:0xb862224) "' name='RPMH_VRM_ENABLE_CRS_DRV6_XOB9'/>"
WRITE #1 "        <register address='0xb862324' value='0x" DATA.LONG(A:0xb862324) "' name='RPMH_VRM_ENABLE_CRS_DRV6_XOB10'/>"
WRITE #1 "        <register address='0xb862424' value='0x" DATA.LONG(A:0xb862424) "' name='RPMH_VRM_ENABLE_CRS_DRV6_XOB11'/>"
WRITE #1 "        <register address='0xb862524' value='0x" DATA.LONG(A:0xb862524) "' name='RPMH_VRM_ENABLE_CRS_DRV6_XOB12'/>"
WRITE #1 "        <register address='0xb862624' value='0x" DATA.LONG(A:0xb862624) "' name='RPMH_VRM_ENABLE_CRS_DRV6_XOB13'/>"
WRITE #1 "        <register address='0xb862724' value='0x" DATA.LONG(A:0xb862724) "' name='RPMH_VRM_ENABLE_CRS_DRV6_XOB14'/>"
WRITE #1 "        <register address='0xb862824' value='0x" DATA.LONG(A:0xb862824) "' name='RPMH_VRM_ENABLE_CRS_DRV6_XOB15'/>"
WRITE #1 "        <register address='0xb802924' value='0x" DATA.LONG(A:0xb802924) "' name='RPMH_VRM_ENABLE_CRS_DRV0_XO0'/>"
WRITE #1 "        <register address='0xb812924' value='0x" DATA.LONG(A:0xb812924) "' name='RPMH_VRM_ENABLE_CRS_DRV1_XO0'/>"
WRITE #1 "        <register address='0xb822924' value='0x" DATA.LONG(A:0xb822924) "' name='RPMH_VRM_ENABLE_CRS_DRV2_XO0'/>"
WRITE #1 "        <register address='0xb832924' value='0x" DATA.LONG(A:0xb832924) "' name='RPMH_VRM_ENABLE_CRS_DRV3_XO0'/>"
WRITE #1 "        <register address='0xb842924' value='0x" DATA.LONG(A:0xb842924) "' name='RPMH_VRM_ENABLE_CRS_DRV4_XO0'/>"
WRITE #1 "        <register address='0xb852924' value='0x" DATA.LONG(A:0xb852924) "' name='RPMH_VRM_ENABLE_CRS_DRV5_XO0'/>"
WRITE #1 "        <register address='0xb862924' value='0x" DATA.LONG(A:0xb862924) "' name='RPMH_VRM_ENABLE_CRS_DRV6_XO0'/>"
WRITE #1 "        <register address='0xb9e0000' value='0x" DATA.LONG(A:0xb9e0000) "' name='RPMH_VRM_VOLTAGE_CRS_CSR_REG0'/>"
WRITE #1 "        <register address='0xb9e0100' value='0x" DATA.LONG(A:0xb9e0100) "' name='RPMH_VRM_VOLTAGE_CRS_CSR_REG1'/>"
WRITE #1 "        <register address='0xb9e0200' value='0x" DATA.LONG(A:0xb9e0200) "' name='RPMH_VRM_VOLTAGE_CRS_CSR_REG2'/>"
WRITE #1 "        <register address='0xb9e0300' value='0x" DATA.LONG(A:0xb9e0300) "' name='RPMH_VRM_VOLTAGE_CRS_CSR_REG3'/>"
WRITE #1 "        <register address='0xb9e0400' value='0x" DATA.LONG(A:0xb9e0400) "' name='RPMH_VRM_VOLTAGE_CRS_CSR_REG4'/>"
WRITE #1 "        <register address='0xb9e0500' value='0x" DATA.LONG(A:0xb9e0500) "' name='RPMH_VRM_VOLTAGE_CRS_CSR_REG5'/>"
WRITE #1 "        <register address='0xb9e0600' value='0x" DATA.LONG(A:0xb9e0600) "' name='RPMH_VRM_VOLTAGE_CRS_CSR_REG6'/>"
WRITE #1 "        <register address='0xb9e0700' value='0x" DATA.LONG(A:0xb9e0700) "' name='RPMH_VRM_VOLTAGE_CRS_CSR_REG7'/>"
WRITE #1 "        <register address='0xb9e0800' value='0x" DATA.LONG(A:0xb9e0800) "' name='RPMH_VRM_VOLTAGE_CRS_CSR_REG8'/>"
WRITE #1 "        <register address='0xb9e0900' value='0x" DATA.LONG(A:0xb9e0900) "' name='RPMH_VRM_VOLTAGE_CRS_CSR_REG9'/>"
WRITE #1 "        <register address='0xb9e0a00' value='0x" DATA.LONG(A:0xb9e0a00) "' name='RPMH_VRM_VOLTAGE_CRS_CSR_REG10'/>"
WRITE #1 "        <register address='0xb9e0b00' value='0x" DATA.LONG(A:0xb9e0b00) "' name='RPMH_VRM_VOLTAGE_CRS_CSR_REG11'/>"
WRITE #1 "        <register address='0xb9e0c00' value='0x" DATA.LONG(A:0xb9e0c00) "' name='RPMH_VRM_VOLTAGE_CRS_CSR_REG12'/>"
WRITE #1 "        <register address='0xb9e0d00' value='0x" DATA.LONG(A:0xb9e0d00) "' name='RPMH_VRM_VOLTAGE_CRS_CSR_REG13'/>"
WRITE #1 "        <register address='0xb9e0e00' value='0x" DATA.LONG(A:0xb9e0e00) "' name='RPMH_VRM_VOLTAGE_CRS_CSR_REG14'/>"
WRITE #1 "        <register address='0xb9e0f00' value='0x" DATA.LONG(A:0xb9e0f00) "' name='RPMH_VRM_VOLTAGE_CRS_CSR_REG15'/>"
WRITE #1 "        <register address='0xb9e1000' value='0x" DATA.LONG(A:0xb9e1000) "' name='RPMH_VRM_VOLTAGE_CRS_CSR_REG16'/>"
WRITE #1 "        <register address='0xb9e1100' value='0x" DATA.LONG(A:0xb9e1100) "' name='RPMH_VRM_VOLTAGE_CRS_CSR_REG17'/>"
WRITE #1 "        <register address='0xb9e1200' value='0x" DATA.LONG(A:0xb9e1200) "' name='RPMH_VRM_VOLTAGE_CRS_CSR_REG18'/>"
WRITE #1 "        <register address='0xb9e1300' value='0x" DATA.LONG(A:0xb9e1300) "' name='RPMH_VRM_VOLTAGE_CRS_CSR_REG19'/>"
WRITE #1 "        <register address='0xb9e1400' value='0x" DATA.LONG(A:0xb9e1400) "' name='RPMH_VRM_VOLTAGE_CRS_CSR_REG20'/>"
WRITE #1 "        <register address='0xb9e1500' value='0x" DATA.LONG(A:0xb9e1500) "' name='RPMH_VRM_VOLTAGE_CRS_CSR_REG21'/>"
WRITE #1 "        <register address='0xb9e1600' value='0x" DATA.LONG(A:0xb9e1600) "' name='RPMH_VRM_VOLTAGE_CRS_CSR_REG22'/>"
WRITE #1 "        <register address='0xb9e1700' value='0x" DATA.LONG(A:0xb9e1700) "' name='RPMH_VRM_VOLTAGE_CRS_CSR_REG23'/>"
WRITE #1 "        <register address='0xb9e1800' value='0x" DATA.LONG(A:0xb9e1800) "' name='RPMH_VRM_VOLTAGE_CRS_CSR_REG24'/>"
WRITE #1 "        <register address='0xb9e0004' value='0x" DATA.LONG(A:0xb9e0004) "' name='RPMH_VRM_ENABLE_CRS_CSR_REG0'/>"
WRITE #1 "        <register address='0xb9e0104' value='0x" DATA.LONG(A:0xb9e0104) "' name='RPMH_VRM_ENABLE_CRS_CSR_REG1'/>"
WRITE #1 "        <register address='0xb9e0204' value='0x" DATA.LONG(A:0xb9e0204) "' name='RPMH_VRM_ENABLE_CRS_CSR_REG2'/>"
WRITE #1 "        <register address='0xb9e0304' value='0x" DATA.LONG(A:0xb9e0304) "' name='RPMH_VRM_ENABLE_CRS_CSR_REG3'/>"
WRITE #1 "        <register address='0xb9e0404' value='0x" DATA.LONG(A:0xb9e0404) "' name='RPMH_VRM_ENABLE_CRS_CSR_REG4'/>"
WRITE #1 "        <register address='0xb9e0504' value='0x" DATA.LONG(A:0xb9e0504) "' name='RPMH_VRM_ENABLE_CRS_CSR_REG5'/>"
WRITE #1 "        <register address='0xb9e0604' value='0x" DATA.LONG(A:0xb9e0604) "' name='RPMH_VRM_ENABLE_CRS_CSR_REG6'/>"
WRITE #1 "        <register address='0xb9e0704' value='0x" DATA.LONG(A:0xb9e0704) "' name='RPMH_VRM_ENABLE_CRS_CSR_REG7'/>"
WRITE #1 "        <register address='0xb9e0804' value='0x" DATA.LONG(A:0xb9e0804) "' name='RPMH_VRM_ENABLE_CRS_CSR_REG8'/>"
WRITE #1 "        <register address='0xb9e0904' value='0x" DATA.LONG(A:0xb9e0904) "' name='RPMH_VRM_ENABLE_CRS_CSR_REG9'/>"
WRITE #1 "        <register address='0xb9e0a04' value='0x" DATA.LONG(A:0xb9e0a04) "' name='RPMH_VRM_ENABLE_CRS_CSR_REG10'/>"
WRITE #1 "        <register address='0xb9e0b04' value='0x" DATA.LONG(A:0xb9e0b04) "' name='RPMH_VRM_ENABLE_CRS_CSR_REG11'/>"
WRITE #1 "        <register address='0xb9e0c04' value='0x" DATA.LONG(A:0xb9e0c04) "' name='RPMH_VRM_ENABLE_CRS_CSR_REG12'/>"
WRITE #1 "        <register address='0xb9e0d04' value='0x" DATA.LONG(A:0xb9e0d04) "' name='RPMH_VRM_ENABLE_CRS_CSR_REG13'/>"
WRITE #1 "        <register address='0xb9e0e04' value='0x" DATA.LONG(A:0xb9e0e04) "' name='RPMH_VRM_ENABLE_CRS_CSR_REG14'/>"
WRITE #1 "        <register address='0xb9e0f04' value='0x" DATA.LONG(A:0xb9e0f04) "' name='RPMH_VRM_ENABLE_CRS_CSR_REG15'/>"
WRITE #1 "        <register address='0xb9e1004' value='0x" DATA.LONG(A:0xb9e1004) "' name='RPMH_VRM_ENABLE_CRS_CSR_REG16'/>"
WRITE #1 "        <register address='0xb9e1104' value='0x" DATA.LONG(A:0xb9e1104) "' name='RPMH_VRM_ENABLE_CRS_CSR_REG17'/>"
WRITE #1 "        <register address='0xb9e1204' value='0x" DATA.LONG(A:0xb9e1204) "' name='RPMH_VRM_ENABLE_CRS_CSR_REG18'/>"
WRITE #1 "        <register address='0xb9e1304' value='0x" DATA.LONG(A:0xb9e1304) "' name='RPMH_VRM_ENABLE_CRS_CSR_REG19'/>"
WRITE #1 "        <register address='0xb9e1404' value='0x" DATA.LONG(A:0xb9e1404) "' name='RPMH_VRM_ENABLE_CRS_CSR_REG20'/>"
WRITE #1 "        <register address='0xb9e1504' value='0x" DATA.LONG(A:0xb9e1504) "' name='RPMH_VRM_ENABLE_CRS_CSR_REG21'/>"
WRITE #1 "        <register address='0xb9e1604' value='0x" DATA.LONG(A:0xb9e1604) "' name='RPMH_VRM_ENABLE_CRS_CSR_REG22'/>"
WRITE #1 "        <register address='0xb9e1704' value='0x" DATA.LONG(A:0xb9e1704) "' name='RPMH_VRM_ENABLE_CRS_CSR_REG23'/>"
WRITE #1 "        <register address='0xb9e1804' value='0x" DATA.LONG(A:0xb9e1804) "' name='RPMH_VRM_ENABLE_CRS_CSR_REG24'/>"
WRITE #1 "        <register address='0xb9e0008' value='0x" DATA.LONG(A:0xb9e0008) "' name='RPMH_VRM_MODE_CRS_CSR_REG0'/>"
WRITE #1 "        <register address='0xb9e0108' value='0x" DATA.LONG(A:0xb9e0108) "' name='RPMH_VRM_MODE_CRS_CSR_REG1'/>"
WRITE #1 "        <register address='0xb9e0208' value='0x" DATA.LONG(A:0xb9e0208) "' name='RPMH_VRM_MODE_CRS_CSR_REG2'/>"
WRITE #1 "        <register address='0xb9e0308' value='0x" DATA.LONG(A:0xb9e0308) "' name='RPMH_VRM_MODE_CRS_CSR_REG3'/>"
WRITE #1 "        <register address='0xb9e0408' value='0x" DATA.LONG(A:0xb9e0408) "' name='RPMH_VRM_MODE_CRS_CSR_REG4'/>"
WRITE #1 "        <register address='0xb9e0508' value='0x" DATA.LONG(A:0xb9e0508) "' name='RPMH_VRM_MODE_CRS_CSR_REG5'/>"
WRITE #1 "        <register address='0xb9e0608' value='0x" DATA.LONG(A:0xb9e0608) "' name='RPMH_VRM_MODE_CRS_CSR_REG6'/>"
WRITE #1 "        <register address='0xb9e0708' value='0x" DATA.LONG(A:0xb9e0708) "' name='RPMH_VRM_MODE_CRS_CSR_REG7'/>"
WRITE #1 "        <register address='0xb9e0808' value='0x" DATA.LONG(A:0xb9e0808) "' name='RPMH_VRM_MODE_CRS_CSR_REG8'/>"
WRITE #1 "        <register address='0xb9e0908' value='0x" DATA.LONG(A:0xb9e0908) "' name='RPMH_VRM_MODE_CRS_CSR_REG9'/>"
WRITE #1 "        <register address='0xb9e0a08' value='0x" DATA.LONG(A:0xb9e0a08) "' name='RPMH_VRM_MODE_CRS_CSR_REG10'/>"
WRITE #1 "        <register address='0xb9e0b08' value='0x" DATA.LONG(A:0xb9e0b08) "' name='RPMH_VRM_MODE_CRS_CSR_REG11'/>"
WRITE #1 "        <register address='0xb9e0c08' value='0x" DATA.LONG(A:0xb9e0c08) "' name='RPMH_VRM_MODE_CRS_CSR_REG12'/>"
WRITE #1 "        <register address='0xb9e0d08' value='0x" DATA.LONG(A:0xb9e0d08) "' name='RPMH_VRM_MODE_CRS_CSR_REG13'/>"
WRITE #1 "        <register address='0xb9e0e08' value='0x" DATA.LONG(A:0xb9e0e08) "' name='RPMH_VRM_MODE_CRS_CSR_REG14'/>"
WRITE #1 "        <register address='0xb9e0f08' value='0x" DATA.LONG(A:0xb9e0f08) "' name='RPMH_VRM_MODE_CRS_CSR_REG15'/>"
WRITE #1 "        <register address='0xb9e1008' value='0x" DATA.LONG(A:0xb9e1008) "' name='RPMH_VRM_MODE_CRS_CSR_REG16'/>"
WRITE #1 "        <register address='0xb9e1108' value='0x" DATA.LONG(A:0xb9e1108) "' name='RPMH_VRM_MODE_CRS_CSR_REG17'/>"
WRITE #1 "        <register address='0xb9e1208' value='0x" DATA.LONG(A:0xb9e1208) "' name='RPMH_VRM_MODE_CRS_CSR_REG18'/>"
WRITE #1 "        <register address='0xb9e1308' value='0x" DATA.LONG(A:0xb9e1308) "' name='RPMH_VRM_MODE_CRS_CSR_REG19'/>"
WRITE #1 "        <register address='0xb9e1408' value='0x" DATA.LONG(A:0xb9e1408) "' name='RPMH_VRM_MODE_CRS_CSR_REG20'/>"
WRITE #1 "        <register address='0xb9e1508' value='0x" DATA.LONG(A:0xb9e1508) "' name='RPMH_VRM_MODE_CRS_CSR_REG21'/>"
WRITE #1 "        <register address='0xb9e1608' value='0x" DATA.LONG(A:0xb9e1608) "' name='RPMH_VRM_MODE_CRS_CSR_REG22'/>"
WRITE #1 "        <register address='0xb9e1708' value='0x" DATA.LONG(A:0xb9e1708) "' name='RPMH_VRM_MODE_CRS_CSR_REG23'/>"
WRITE #1 "        <register address='0xb9e1808' value='0x" DATA.LONG(A:0xb9e1808) "' name='RPMH_VRM_MODE_CRS_CSR_REG24'/>"
WRITE #1 "        <register address='0xb9e1904' value='0x" DATA.LONG(A:0xb9e1904) "' name='RPMH_VRM_ENABLE_CRS_CSR_XOB0'/>"
WRITE #1 "        <register address='0xb9e1a04' value='0x" DATA.LONG(A:0xb9e1a04) "' name='RPMH_VRM_ENABLE_CRS_CSR_XOB1'/>"
WRITE #1 "        <register address='0xb9e1b04' value='0x" DATA.LONG(A:0xb9e1b04) "' name='RPMH_VRM_ENABLE_CRS_CSR_XOB2'/>"
WRITE #1 "        <register address='0xb9e1c04' value='0x" DATA.LONG(A:0xb9e1c04) "' name='RPMH_VRM_ENABLE_CRS_CSR_XOB3'/>"
WRITE #1 "        <register address='0xb9e1d04' value='0x" DATA.LONG(A:0xb9e1d04) "' name='RPMH_VRM_ENABLE_CRS_CSR_XOB4'/>"
WRITE #1 "        <register address='0xb9e1e04' value='0x" DATA.LONG(A:0xb9e1e04) "' name='RPMH_VRM_ENABLE_CRS_CSR_XOB5'/>"
WRITE #1 "        <register address='0xb9e1f04' value='0x" DATA.LONG(A:0xb9e1f04) "' name='RPMH_VRM_ENABLE_CRS_CSR_XOB6'/>"
WRITE #1 "        <register address='0xb9e2004' value='0x" DATA.LONG(A:0xb9e2004) "' name='RPMH_VRM_ENABLE_CRS_CSR_XOB7'/>"
WRITE #1 "        <register address='0xb9e2104' value='0x" DATA.LONG(A:0xb9e2104) "' name='RPMH_VRM_ENABLE_CRS_CSR_XOB8'/>"
WRITE #1 "        <register address='0xb9e2204' value='0x" DATA.LONG(A:0xb9e2204) "' name='RPMH_VRM_ENABLE_CRS_CSR_XOB9'/>"
WRITE #1 "        <register address='0xb9e2304' value='0x" DATA.LONG(A:0xb9e2304) "' name='RPMH_VRM_ENABLE_CRS_CSR_XOB10'/>"
WRITE #1 "        <register address='0xb9e2404' value='0x" DATA.LONG(A:0xb9e2404) "' name='RPMH_VRM_ENABLE_CRS_CSR_XOB11'/>"
WRITE #1 "        <register address='0xb9e2504' value='0x" DATA.LONG(A:0xb9e2504) "' name='RPMH_VRM_ENABLE_CRS_CSR_XOB12'/>"
WRITE #1 "        <register address='0xb9e2604' value='0x" DATA.LONG(A:0xb9e2604) "' name='RPMH_VRM_ENABLE_CRS_CSR_XOB13'/>"
WRITE #1 "        <register address='0xb9e2704' value='0x" DATA.LONG(A:0xb9e2704) "' name='RPMH_VRM_ENABLE_CRS_CSR_XOB14'/>"
WRITE #1 "        <register address='0xb9e2804' value='0x" DATA.LONG(A:0xb9e2804) "' name='RPMH_VRM_ENABLE_CRS_CSR_XOB15'/>"
WRITE #1 "        <register address='0xb9e2904' value='0x" DATA.LONG(A:0xb9e2904) "' name='RPMH_VRM_ENABLE_CRS_CSR_XO0'/>"
WRITE #1 "        <register address='0xb9e0020' value='0x" DATA.LONG(A:0xb9e0020) "' name='RPMH_VRM_VOLTAGE_WRS_CSR_REG0'/>"
WRITE #1 "        <register address='0xb9e0120' value='0x" DATA.LONG(A:0xb9e0120) "' name='RPMH_VRM_VOLTAGE_WRS_CSR_REG1'/>"
WRITE #1 "        <register address='0xb9e0220' value='0x" DATA.LONG(A:0xb9e0220) "' name='RPMH_VRM_VOLTAGE_WRS_CSR_REG2'/>"
WRITE #1 "        <register address='0xb9e0320' value='0x" DATA.LONG(A:0xb9e0320) "' name='RPMH_VRM_VOLTAGE_WRS_CSR_REG3'/>"
WRITE #1 "        <register address='0xb9e0420' value='0x" DATA.LONG(A:0xb9e0420) "' name='RPMH_VRM_VOLTAGE_WRS_CSR_REG4'/>"
WRITE #1 "        <register address='0xb9e0520' value='0x" DATA.LONG(A:0xb9e0520) "' name='RPMH_VRM_VOLTAGE_WRS_CSR_REG5'/>"
WRITE #1 "        <register address='0xb9e0620' value='0x" DATA.LONG(A:0xb9e0620) "' name='RPMH_VRM_VOLTAGE_WRS_CSR_REG6'/>"
WRITE #1 "        <register address='0xb9e0720' value='0x" DATA.LONG(A:0xb9e0720) "' name='RPMH_VRM_VOLTAGE_WRS_CSR_REG7'/>"
WRITE #1 "        <register address='0xb9e0820' value='0x" DATA.LONG(A:0xb9e0820) "' name='RPMH_VRM_VOLTAGE_WRS_CSR_REG8'/>"
WRITE #1 "        <register address='0xb9e0920' value='0x" DATA.LONG(A:0xb9e0920) "' name='RPMH_VRM_VOLTAGE_WRS_CSR_REG9'/>"
WRITE #1 "        <register address='0xb9e0a20' value='0x" DATA.LONG(A:0xb9e0a20) "' name='RPMH_VRM_VOLTAGE_WRS_CSR_REG10'/>"
WRITE #1 "        <register address='0xb9e0b20' value='0x" DATA.LONG(A:0xb9e0b20) "' name='RPMH_VRM_VOLTAGE_WRS_CSR_REG11'/>"
WRITE #1 "        <register address='0xb9e0c20' value='0x" DATA.LONG(A:0xb9e0c20) "' name='RPMH_VRM_VOLTAGE_WRS_CSR_REG12'/>"
WRITE #1 "        <register address='0xb9e0d20' value='0x" DATA.LONG(A:0xb9e0d20) "' name='RPMH_VRM_VOLTAGE_WRS_CSR_REG13'/>"
WRITE #1 "        <register address='0xb9e0e20' value='0x" DATA.LONG(A:0xb9e0e20) "' name='RPMH_VRM_VOLTAGE_WRS_CSR_REG14'/>"
WRITE #1 "        <register address='0xb9e0f20' value='0x" DATA.LONG(A:0xb9e0f20) "' name='RPMH_VRM_VOLTAGE_WRS_CSR_REG15'/>"
WRITE #1 "        <register address='0xb9e1020' value='0x" DATA.LONG(A:0xb9e1020) "' name='RPMH_VRM_VOLTAGE_WRS_CSR_REG16'/>"
WRITE #1 "        <register address='0xb9e1120' value='0x" DATA.LONG(A:0xb9e1120) "' name='RPMH_VRM_VOLTAGE_WRS_CSR_REG17'/>"
WRITE #1 "        <register address='0xb9e1220' value='0x" DATA.LONG(A:0xb9e1220) "' name='RPMH_VRM_VOLTAGE_WRS_CSR_REG18'/>"
WRITE #1 "        <register address='0xb9e1320' value='0x" DATA.LONG(A:0xb9e1320) "' name='RPMH_VRM_VOLTAGE_WRS_CSR_REG19'/>"
WRITE #1 "        <register address='0xb9e1420' value='0x" DATA.LONG(A:0xb9e1420) "' name='RPMH_VRM_VOLTAGE_WRS_CSR_REG20'/>"
WRITE #1 "        <register address='0xb9e1520' value='0x" DATA.LONG(A:0xb9e1520) "' name='RPMH_VRM_VOLTAGE_WRS_CSR_REG21'/>"
WRITE #1 "        <register address='0xb9e1620' value='0x" DATA.LONG(A:0xb9e1620) "' name='RPMH_VRM_VOLTAGE_WRS_CSR_REG22'/>"
WRITE #1 "        <register address='0xb9e1720' value='0x" DATA.LONG(A:0xb9e1720) "' name='RPMH_VRM_VOLTAGE_WRS_CSR_REG23'/>"
WRITE #1 "        <register address='0xb9e1820' value='0x" DATA.LONG(A:0xb9e1820) "' name='RPMH_VRM_VOLTAGE_WRS_CSR_REG24'/>"
WRITE #1 "        <register address='0xb9e0024' value='0x" DATA.LONG(A:0xb9e0024) "' name='RPMH_VRM_ENABLE_WRS_CSR_REG0'/>"
WRITE #1 "        <register address='0xb9e0124' value='0x" DATA.LONG(A:0xb9e0124) "' name='RPMH_VRM_ENABLE_WRS_CSR_REG1'/>"
WRITE #1 "        <register address='0xb9e0224' value='0x" DATA.LONG(A:0xb9e0224) "' name='RPMH_VRM_ENABLE_WRS_CSR_REG2'/>"
WRITE #1 "        <register address='0xb9e0324' value='0x" DATA.LONG(A:0xb9e0324) "' name='RPMH_VRM_ENABLE_WRS_CSR_REG3'/>"
WRITE #1 "        <register address='0xb9e0424' value='0x" DATA.LONG(A:0xb9e0424) "' name='RPMH_VRM_ENABLE_WRS_CSR_REG4'/>"
WRITE #1 "        <register address='0xb9e0524' value='0x" DATA.LONG(A:0xb9e0524) "' name='RPMH_VRM_ENABLE_WRS_CSR_REG5'/>"
WRITE #1 "        <register address='0xb9e0624' value='0x" DATA.LONG(A:0xb9e0624) "' name='RPMH_VRM_ENABLE_WRS_CSR_REG6'/>"
WRITE #1 "        <register address='0xb9e0724' value='0x" DATA.LONG(A:0xb9e0724) "' name='RPMH_VRM_ENABLE_WRS_CSR_REG7'/>"
WRITE #1 "        <register address='0xb9e0824' value='0x" DATA.LONG(A:0xb9e0824) "' name='RPMH_VRM_ENABLE_WRS_CSR_REG8'/>"
WRITE #1 "        <register address='0xb9e0924' value='0x" DATA.LONG(A:0xb9e0924) "' name='RPMH_VRM_ENABLE_WRS_CSR_REG9'/>"
WRITE #1 "        <register address='0xb9e0a24' value='0x" DATA.LONG(A:0xb9e0a24) "' name='RPMH_VRM_ENABLE_WRS_CSR_REG10'/>"
WRITE #1 "        <register address='0xb9e0b24' value='0x" DATA.LONG(A:0xb9e0b24) "' name='RPMH_VRM_ENABLE_WRS_CSR_REG11'/>"
WRITE #1 "        <register address='0xb9e0c24' value='0x" DATA.LONG(A:0xb9e0c24) "' name='RPMH_VRM_ENABLE_WRS_CSR_REG12'/>"
WRITE #1 "        <register address='0xb9e0d24' value='0x" DATA.LONG(A:0xb9e0d24) "' name='RPMH_VRM_ENABLE_WRS_CSR_REG13'/>"
WRITE #1 "        <register address='0xb9e0e24' value='0x" DATA.LONG(A:0xb9e0e24) "' name='RPMH_VRM_ENABLE_WRS_CSR_REG14'/>"
WRITE #1 "        <register address='0xb9e0f24' value='0x" DATA.LONG(A:0xb9e0f24) "' name='RPMH_VRM_ENABLE_WRS_CSR_REG15'/>"
WRITE #1 "        <register address='0xb9e1024' value='0x" DATA.LONG(A:0xb9e1024) "' name='RPMH_VRM_ENABLE_WRS_CSR_REG16'/>"
WRITE #1 "        <register address='0xb9e1124' value='0x" DATA.LONG(A:0xb9e1124) "' name='RPMH_VRM_ENABLE_WRS_CSR_REG17'/>"
WRITE #1 "        <register address='0xb9e1224' value='0x" DATA.LONG(A:0xb9e1224) "' name='RPMH_VRM_ENABLE_WRS_CSR_REG18'/>"
WRITE #1 "        <register address='0xb9e1324' value='0x" DATA.LONG(A:0xb9e1324) "' name='RPMH_VRM_ENABLE_WRS_CSR_REG19'/>"
WRITE #1 "        <register address='0xb9e1424' value='0x" DATA.LONG(A:0xb9e1424) "' name='RPMH_VRM_ENABLE_WRS_CSR_REG20'/>"
WRITE #1 "        <register address='0xb9e1524' value='0x" DATA.LONG(A:0xb9e1524) "' name='RPMH_VRM_ENABLE_WRS_CSR_REG21'/>"
WRITE #1 "        <register address='0xb9e1624' value='0x" DATA.LONG(A:0xb9e1624) "' name='RPMH_VRM_ENABLE_WRS_CSR_REG22'/>"
WRITE #1 "        <register address='0xb9e1724' value='0x" DATA.LONG(A:0xb9e1724) "' name='RPMH_VRM_ENABLE_WRS_CSR_REG23'/>"
WRITE #1 "        <register address='0xb9e1824' value='0x" DATA.LONG(A:0xb9e1824) "' name='RPMH_VRM_ENABLE_WRS_CSR_REG24'/>"
WRITE #1 "        <register address='0xb9e0028' value='0x" DATA.LONG(A:0xb9e0028) "' name='RPMH_VRM_MODE_WRS_CSR_REG0'/>"
WRITE #1 "        <register address='0xb9e0128' value='0x" DATA.LONG(A:0xb9e0128) "' name='RPMH_VRM_MODE_WRS_CSR_REG1'/>"
WRITE #1 "        <register address='0xb9e0228' value='0x" DATA.LONG(A:0xb9e0228) "' name='RPMH_VRM_MODE_WRS_CSR_REG2'/>"
WRITE #1 "        <register address='0xb9e0328' value='0x" DATA.LONG(A:0xb9e0328) "' name='RPMH_VRM_MODE_WRS_CSR_REG3'/>"
WRITE #1 "        <register address='0xb9e0428' value='0x" DATA.LONG(A:0xb9e0428) "' name='RPMH_VRM_MODE_WRS_CSR_REG4'/>"
WRITE #1 "        <register address='0xb9e0528' value='0x" DATA.LONG(A:0xb9e0528) "' name='RPMH_VRM_MODE_WRS_CSR_REG5'/>"
WRITE #1 "        <register address='0xb9e0628' value='0x" DATA.LONG(A:0xb9e0628) "' name='RPMH_VRM_MODE_WRS_CSR_REG6'/>"
WRITE #1 "        <register address='0xb9e0728' value='0x" DATA.LONG(A:0xb9e0728) "' name='RPMH_VRM_MODE_WRS_CSR_REG7'/>"
WRITE #1 "        <register address='0xb9e0828' value='0x" DATA.LONG(A:0xb9e0828) "' name='RPMH_VRM_MODE_WRS_CSR_REG8'/>"
WRITE #1 "        <register address='0xb9e0928' value='0x" DATA.LONG(A:0xb9e0928) "' name='RPMH_VRM_MODE_WRS_CSR_REG9'/>"
WRITE #1 "        <register address='0xb9e0a28' value='0x" DATA.LONG(A:0xb9e0a28) "' name='RPMH_VRM_MODE_WRS_CSR_REG10'/>"
WRITE #1 "        <register address='0xb9e0b28' value='0x" DATA.LONG(A:0xb9e0b28) "' name='RPMH_VRM_MODE_WRS_CSR_REG11'/>"
WRITE #1 "        <register address='0xb9e0c28' value='0x" DATA.LONG(A:0xb9e0c28) "' name='RPMH_VRM_MODE_WRS_CSR_REG12'/>"
WRITE #1 "        <register address='0xb9e0d28' value='0x" DATA.LONG(A:0xb9e0d28) "' name='RPMH_VRM_MODE_WRS_CSR_REG13'/>"
WRITE #1 "        <register address='0xb9e0e28' value='0x" DATA.LONG(A:0xb9e0e28) "' name='RPMH_VRM_MODE_WRS_CSR_REG14'/>"
WRITE #1 "        <register address='0xb9e0f28' value='0x" DATA.LONG(A:0xb9e0f28) "' name='RPMH_VRM_MODE_WRS_CSR_REG15'/>"
WRITE #1 "        <register address='0xb9e1028' value='0x" DATA.LONG(A:0xb9e1028) "' name='RPMH_VRM_MODE_WRS_CSR_REG16'/>"
WRITE #1 "        <register address='0xb9e1128' value='0x" DATA.LONG(A:0xb9e1128) "' name='RPMH_VRM_MODE_WRS_CSR_REG17'/>"
WRITE #1 "        <register address='0xb9e1228' value='0x" DATA.LONG(A:0xb9e1228) "' name='RPMH_VRM_MODE_WRS_CSR_REG18'/>"
WRITE #1 "        <register address='0xb9e1328' value='0x" DATA.LONG(A:0xb9e1328) "' name='RPMH_VRM_MODE_WRS_CSR_REG19'/>"
WRITE #1 "        <register address='0xb9e1428' value='0x" DATA.LONG(A:0xb9e1428) "' name='RPMH_VRM_MODE_WRS_CSR_REG20'/>"
WRITE #1 "        <register address='0xb9e1528' value='0x" DATA.LONG(A:0xb9e1528) "' name='RPMH_VRM_MODE_WRS_CSR_REG21'/>"
WRITE #1 "        <register address='0xb9e1628' value='0x" DATA.LONG(A:0xb9e1628) "' name='RPMH_VRM_MODE_WRS_CSR_REG22'/>"
WRITE #1 "        <register address='0xb9e1728' value='0x" DATA.LONG(A:0xb9e1728) "' name='RPMH_VRM_MODE_WRS_CSR_REG23'/>"
WRITE #1 "        <register address='0xb9e1828' value='0x" DATA.LONG(A:0xb9e1828) "' name='RPMH_VRM_MODE_WRS_CSR_REG24'/>"
WRITE #1 "        <register address='0xb9e1924' value='0x" DATA.LONG(A:0xb9e1924) "' name='RPMH_VRM_ENABLE_WRS_CSR_XOB0'/>"
WRITE #1 "        <register address='0xb9e1a24' value='0x" DATA.LONG(A:0xb9e1a24) "' name='RPMH_VRM_ENABLE_WRS_CSR_XOB1'/>"
WRITE #1 "        <register address='0xb9e1b24' value='0x" DATA.LONG(A:0xb9e1b24) "' name='RPMH_VRM_ENABLE_WRS_CSR_XOB2'/>"
WRITE #1 "        <register address='0xb9e1c24' value='0x" DATA.LONG(A:0xb9e1c24) "' name='RPMH_VRM_ENABLE_WRS_CSR_XOB3'/>"
WRITE #1 "        <register address='0xb9e1d24' value='0x" DATA.LONG(A:0xb9e1d24) "' name='RPMH_VRM_ENABLE_WRS_CSR_XOB4'/>"
WRITE #1 "        <register address='0xb9e1e24' value='0x" DATA.LONG(A:0xb9e1e24) "' name='RPMH_VRM_ENABLE_WRS_CSR_XOB5'/>"
WRITE #1 "        <register address='0xb9e1f24' value='0x" DATA.LONG(A:0xb9e1f24) "' name='RPMH_VRM_ENABLE_WRS_CSR_XOB6'/>"
WRITE #1 "        <register address='0xb9e2024' value='0x" DATA.LONG(A:0xb9e2024) "' name='RPMH_VRM_ENABLE_WRS_CSR_XOB7'/>"
WRITE #1 "        <register address='0xb9e2124' value='0x" DATA.LONG(A:0xb9e2124) "' name='RPMH_VRM_ENABLE_WRS_CSR_XOB8'/>"
WRITE #1 "        <register address='0xb9e2224' value='0x" DATA.LONG(A:0xb9e2224) "' name='RPMH_VRM_ENABLE_WRS_CSR_XOB9'/>"
WRITE #1 "        <register address='0xb9e2324' value='0x" DATA.LONG(A:0xb9e2324) "' name='RPMH_VRM_ENABLE_WRS_CSR_XOB10'/>"
WRITE #1 "        <register address='0xb9e2424' value='0x" DATA.LONG(A:0xb9e2424) "' name='RPMH_VRM_ENABLE_WRS_CSR_XOB11'/>"
WRITE #1 "        <register address='0xb9e2524' value='0x" DATA.LONG(A:0xb9e2524) "' name='RPMH_VRM_ENABLE_WRS_CSR_XOB12'/>"
WRITE #1 "        <register address='0xb9e2624' value='0x" DATA.LONG(A:0xb9e2624) "' name='RPMH_VRM_ENABLE_WRS_CSR_XOB13'/>"
WRITE #1 "        <register address='0xb9e2724' value='0x" DATA.LONG(A:0xb9e2724) "' name='RPMH_VRM_ENABLE_WRS_CSR_XOB14'/>"
WRITE #1 "        <register address='0xb9e2824' value='0x" DATA.LONG(A:0xb9e2824) "' name='RPMH_VRM_ENABLE_WRS_CSR_XOB15'/>"
WRITE #1 "        <register address='0xb9e2924' value='0x" DATA.LONG(A:0xb9e2924) "' name='RPMH_VRM_ENABLE_WRS_CSR_XO0'/>"
WRITE #1 "        <register address='0xb9e0040' value='0x" DATA.LONG(A:0xb9e0040) "' name='RPMH_VRM_VOLTAGE_DRS_CSR_REG0'/>"
WRITE #1 "        <register address='0xb9e0140' value='0x" DATA.LONG(A:0xb9e0140) "' name='RPMH_VRM_VOLTAGE_DRS_CSR_REG1'/>"
WRITE #1 "        <register address='0xb9e0240' value='0x" DATA.LONG(A:0xb9e0240) "' name='RPMH_VRM_VOLTAGE_DRS_CSR_REG2'/>"
WRITE #1 "        <register address='0xb9e0340' value='0x" DATA.LONG(A:0xb9e0340) "' name='RPMH_VRM_VOLTAGE_DRS_CSR_REG3'/>"
WRITE #1 "        <register address='0xb9e0440' value='0x" DATA.LONG(A:0xb9e0440) "' name='RPMH_VRM_VOLTAGE_DRS_CSR_REG4'/>"
WRITE #1 "        <register address='0xb9e0540' value='0x" DATA.LONG(A:0xb9e0540) "' name='RPMH_VRM_VOLTAGE_DRS_CSR_REG5'/>"
WRITE #1 "        <register address='0xb9e0640' value='0x" DATA.LONG(A:0xb9e0640) "' name='RPMH_VRM_VOLTAGE_DRS_CSR_REG6'/>"
WRITE #1 "        <register address='0xb9e0740' value='0x" DATA.LONG(A:0xb9e0740) "' name='RPMH_VRM_VOLTAGE_DRS_CSR_REG7'/>"
WRITE #1 "        <register address='0xb9e0840' value='0x" DATA.LONG(A:0xb9e0840) "' name='RPMH_VRM_VOLTAGE_DRS_CSR_REG8'/>"
WRITE #1 "        <register address='0xb9e0940' value='0x" DATA.LONG(A:0xb9e0940) "' name='RPMH_VRM_VOLTAGE_DRS_CSR_REG9'/>"
WRITE #1 "        <register address='0xb9e0a40' value='0x" DATA.LONG(A:0xb9e0a40) "' name='RPMH_VRM_VOLTAGE_DRS_CSR_REG10'/>"
WRITE #1 "        <register address='0xb9e0b40' value='0x" DATA.LONG(A:0xb9e0b40) "' name='RPMH_VRM_VOLTAGE_DRS_CSR_REG11'/>"
WRITE #1 "        <register address='0xb9e0c40' value='0x" DATA.LONG(A:0xb9e0c40) "' name='RPMH_VRM_VOLTAGE_DRS_CSR_REG12'/>"
WRITE #1 "        <register address='0xb9e0d40' value='0x" DATA.LONG(A:0xb9e0d40) "' name='RPMH_VRM_VOLTAGE_DRS_CSR_REG13'/>"
WRITE #1 "        <register address='0xb9e0e40' value='0x" DATA.LONG(A:0xb9e0e40) "' name='RPMH_VRM_VOLTAGE_DRS_CSR_REG14'/>"
WRITE #1 "        <register address='0xb9e0f40' value='0x" DATA.LONG(A:0xb9e0f40) "' name='RPMH_VRM_VOLTAGE_DRS_CSR_REG15'/>"
WRITE #1 "        <register address='0xb9e1040' value='0x" DATA.LONG(A:0xb9e1040) "' name='RPMH_VRM_VOLTAGE_DRS_CSR_REG16'/>"
WRITE #1 "        <register address='0xb9e1140' value='0x" DATA.LONG(A:0xb9e1140) "' name='RPMH_VRM_VOLTAGE_DRS_CSR_REG17'/>"
WRITE #1 "        <register address='0xb9e1240' value='0x" DATA.LONG(A:0xb9e1240) "' name='RPMH_VRM_VOLTAGE_DRS_CSR_REG18'/>"
WRITE #1 "        <register address='0xb9e1340' value='0x" DATA.LONG(A:0xb9e1340) "' name='RPMH_VRM_VOLTAGE_DRS_CSR_REG19'/>"
WRITE #1 "        <register address='0xb9e1440' value='0x" DATA.LONG(A:0xb9e1440) "' name='RPMH_VRM_VOLTAGE_DRS_CSR_REG20'/>"
WRITE #1 "        <register address='0xb9e1540' value='0x" DATA.LONG(A:0xb9e1540) "' name='RPMH_VRM_VOLTAGE_DRS_CSR_REG21'/>"
WRITE #1 "        <register address='0xb9e1640' value='0x" DATA.LONG(A:0xb9e1640) "' name='RPMH_VRM_VOLTAGE_DRS_CSR_REG22'/>"
WRITE #1 "        <register address='0xb9e1740' value='0x" DATA.LONG(A:0xb9e1740) "' name='RPMH_VRM_VOLTAGE_DRS_CSR_REG23'/>"
WRITE #1 "        <register address='0xb9e1840' value='0x" DATA.LONG(A:0xb9e1840) "' name='RPMH_VRM_VOLTAGE_DRS_CSR_REG24'/>"
WRITE #1 "        <register address='0xb9e0044' value='0x" DATA.LONG(A:0xb9e0044) "' name='RPMH_VRM_ENABLE_DRS_CSR_REG0'/>"
WRITE #1 "        <register address='0xb9e0144' value='0x" DATA.LONG(A:0xb9e0144) "' name='RPMH_VRM_ENABLE_DRS_CSR_REG1'/>"
WRITE #1 "        <register address='0xb9e0244' value='0x" DATA.LONG(A:0xb9e0244) "' name='RPMH_VRM_ENABLE_DRS_CSR_REG2'/>"
WRITE #1 "        <register address='0xb9e0344' value='0x" DATA.LONG(A:0xb9e0344) "' name='RPMH_VRM_ENABLE_DRS_CSR_REG3'/>"
WRITE #1 "        <register address='0xb9e0444' value='0x" DATA.LONG(A:0xb9e0444) "' name='RPMH_VRM_ENABLE_DRS_CSR_REG4'/>"
WRITE #1 "        <register address='0xb9e0544' value='0x" DATA.LONG(A:0xb9e0544) "' name='RPMH_VRM_ENABLE_DRS_CSR_REG5'/>"
WRITE #1 "        <register address='0xb9e0644' value='0x" DATA.LONG(A:0xb9e0644) "' name='RPMH_VRM_ENABLE_DRS_CSR_REG6'/>"
WRITE #1 "        <register address='0xb9e0744' value='0x" DATA.LONG(A:0xb9e0744) "' name='RPMH_VRM_ENABLE_DRS_CSR_REG7'/>"
WRITE #1 "        <register address='0xb9e0844' value='0x" DATA.LONG(A:0xb9e0844) "' name='RPMH_VRM_ENABLE_DRS_CSR_REG8'/>"
WRITE #1 "        <register address='0xb9e0944' value='0x" DATA.LONG(A:0xb9e0944) "' name='RPMH_VRM_ENABLE_DRS_CSR_REG9'/>"
WRITE #1 "        <register address='0xb9e0a44' value='0x" DATA.LONG(A:0xb9e0a44) "' name='RPMH_VRM_ENABLE_DRS_CSR_REG10'/>"
WRITE #1 "        <register address='0xb9e0b44' value='0x" DATA.LONG(A:0xb9e0b44) "' name='RPMH_VRM_ENABLE_DRS_CSR_REG11'/>"
WRITE #1 "        <register address='0xb9e0c44' value='0x" DATA.LONG(A:0xb9e0c44) "' name='RPMH_VRM_ENABLE_DRS_CSR_REG12'/>"
WRITE #1 "        <register address='0xb9e0d44' value='0x" DATA.LONG(A:0xb9e0d44) "' name='RPMH_VRM_ENABLE_DRS_CSR_REG13'/>"
WRITE #1 "        <register address='0xb9e0e44' value='0x" DATA.LONG(A:0xb9e0e44) "' name='RPMH_VRM_ENABLE_DRS_CSR_REG14'/>"
WRITE #1 "        <register address='0xb9e0f44' value='0x" DATA.LONG(A:0xb9e0f44) "' name='RPMH_VRM_ENABLE_DRS_CSR_REG15'/>"
WRITE #1 "        <register address='0xb9e1044' value='0x" DATA.LONG(A:0xb9e1044) "' name='RPMH_VRM_ENABLE_DRS_CSR_REG16'/>"
WRITE #1 "        <register address='0xb9e1144' value='0x" DATA.LONG(A:0xb9e1144) "' name='RPMH_VRM_ENABLE_DRS_CSR_REG17'/>"
WRITE #1 "        <register address='0xb9e1244' value='0x" DATA.LONG(A:0xb9e1244) "' name='RPMH_VRM_ENABLE_DRS_CSR_REG18'/>"
WRITE #1 "        <register address='0xb9e1344' value='0x" DATA.LONG(A:0xb9e1344) "' name='RPMH_VRM_ENABLE_DRS_CSR_REG19'/>"
WRITE #1 "        <register address='0xb9e1444' value='0x" DATA.LONG(A:0xb9e1444) "' name='RPMH_VRM_ENABLE_DRS_CSR_REG20'/>"
WRITE #1 "        <register address='0xb9e1544' value='0x" DATA.LONG(A:0xb9e1544) "' name='RPMH_VRM_ENABLE_DRS_CSR_REG21'/>"
WRITE #1 "        <register address='0xb9e1644' value='0x" DATA.LONG(A:0xb9e1644) "' name='RPMH_VRM_ENABLE_DRS_CSR_REG22'/>"
WRITE #1 "        <register address='0xb9e1744' value='0x" DATA.LONG(A:0xb9e1744) "' name='RPMH_VRM_ENABLE_DRS_CSR_REG23'/>"
WRITE #1 "        <register address='0xb9e1844' value='0x" DATA.LONG(A:0xb9e1844) "' name='RPMH_VRM_ENABLE_DRS_CSR_REG24'/>"
WRITE #1 "        <register address='0xb9e0048' value='0x" DATA.LONG(A:0xb9e0048) "' name='RPMH_VRM_MODE_DRS_CSR_REG0'/>"
WRITE #1 "        <register address='0xb9e0148' value='0x" DATA.LONG(A:0xb9e0148) "' name='RPMH_VRM_MODE_DRS_CSR_REG1'/>"
WRITE #1 "        <register address='0xb9e0248' value='0x" DATA.LONG(A:0xb9e0248) "' name='RPMH_VRM_MODE_DRS_CSR_REG2'/>"
WRITE #1 "        <register address='0xb9e0348' value='0x" DATA.LONG(A:0xb9e0348) "' name='RPMH_VRM_MODE_DRS_CSR_REG3'/>"
WRITE #1 "        <register address='0xb9e0448' value='0x" DATA.LONG(A:0xb9e0448) "' name='RPMH_VRM_MODE_DRS_CSR_REG4'/>"
WRITE #1 "        <register address='0xb9e0548' value='0x" DATA.LONG(A:0xb9e0548) "' name='RPMH_VRM_MODE_DRS_CSR_REG5'/>"
WRITE #1 "        <register address='0xb9e0648' value='0x" DATA.LONG(A:0xb9e0648) "' name='RPMH_VRM_MODE_DRS_CSR_REG6'/>"
WRITE #1 "        <register address='0xb9e0748' value='0x" DATA.LONG(A:0xb9e0748) "' name='RPMH_VRM_MODE_DRS_CSR_REG7'/>"
WRITE #1 "        <register address='0xb9e0848' value='0x" DATA.LONG(A:0xb9e0848) "' name='RPMH_VRM_MODE_DRS_CSR_REG8'/>"
WRITE #1 "        <register address='0xb9e0948' value='0x" DATA.LONG(A:0xb9e0948) "' name='RPMH_VRM_MODE_DRS_CSR_REG9'/>"
WRITE #1 "        <register address='0xb9e0a48' value='0x" DATA.LONG(A:0xb9e0a48) "' name='RPMH_VRM_MODE_DRS_CSR_REG10'/>"
WRITE #1 "        <register address='0xb9e0b48' value='0x" DATA.LONG(A:0xb9e0b48) "' name='RPMH_VRM_MODE_DRS_CSR_REG11'/>"
WRITE #1 "        <register address='0xb9e0c48' value='0x" DATA.LONG(A:0xb9e0c48) "' name='RPMH_VRM_MODE_DRS_CSR_REG12'/>"
WRITE #1 "        <register address='0xb9e0d48' value='0x" DATA.LONG(A:0xb9e0d48) "' name='RPMH_VRM_MODE_DRS_CSR_REG13'/>"
WRITE #1 "        <register address='0xb9e0e48' value='0x" DATA.LONG(A:0xb9e0e48) "' name='RPMH_VRM_MODE_DRS_CSR_REG14'/>"
WRITE #1 "        <register address='0xb9e0f48' value='0x" DATA.LONG(A:0xb9e0f48) "' name='RPMH_VRM_MODE_DRS_CSR_REG15'/>"
WRITE #1 "        <register address='0xb9e1048' value='0x" DATA.LONG(A:0xb9e1048) "' name='RPMH_VRM_MODE_DRS_CSR_REG16'/>"
WRITE #1 "        <register address='0xb9e1148' value='0x" DATA.LONG(A:0xb9e1148) "' name='RPMH_VRM_MODE_DRS_CSR_REG17'/>"
WRITE #1 "        <register address='0xb9e1248' value='0x" DATA.LONG(A:0xb9e1248) "' name='RPMH_VRM_MODE_DRS_CSR_REG18'/>"
WRITE #1 "        <register address='0xb9e1348' value='0x" DATA.LONG(A:0xb9e1348) "' name='RPMH_VRM_MODE_DRS_CSR_REG19'/>"
WRITE #1 "        <register address='0xb9e1448' value='0x" DATA.LONG(A:0xb9e1448) "' name='RPMH_VRM_MODE_DRS_CSR_REG20'/>"
WRITE #1 "        <register address='0xb9e1548' value='0x" DATA.LONG(A:0xb9e1548) "' name='RPMH_VRM_MODE_DRS_CSR_REG21'/>"
WRITE #1 "        <register address='0xb9e1648' value='0x" DATA.LONG(A:0xb9e1648) "' name='RPMH_VRM_MODE_DRS_CSR_REG22'/>"
WRITE #1 "        <register address='0xb9e1748' value='0x" DATA.LONG(A:0xb9e1748) "' name='RPMH_VRM_MODE_DRS_CSR_REG23'/>"
WRITE #1 "        <register address='0xb9e1848' value='0x" DATA.LONG(A:0xb9e1848) "' name='RPMH_VRM_MODE_DRS_CSR_REG24'/>"
WRITE #1 "        <register address='0xb9e1944' value='0x" DATA.LONG(A:0xb9e1944) "' name='RPMH_VRM_ENABLE_DRS_CSR_XOB0'/>"
WRITE #1 "        <register address='0xb9e1a44' value='0x" DATA.LONG(A:0xb9e1a44) "' name='RPMH_VRM_ENABLE_DRS_CSR_XOB1'/>"
WRITE #1 "        <register address='0xb9e1b44' value='0x" DATA.LONG(A:0xb9e1b44) "' name='RPMH_VRM_ENABLE_DRS_CSR_XOB2'/>"
WRITE #1 "        <register address='0xb9e1c44' value='0x" DATA.LONG(A:0xb9e1c44) "' name='RPMH_VRM_ENABLE_DRS_CSR_XOB3'/>"
WRITE #1 "        <register address='0xb9e1d44' value='0x" DATA.LONG(A:0xb9e1d44) "' name='RPMH_VRM_ENABLE_DRS_CSR_XOB4'/>"
WRITE #1 "        <register address='0xb9e1e44' value='0x" DATA.LONG(A:0xb9e1e44) "' name='RPMH_VRM_ENABLE_DRS_CSR_XOB5'/>"
WRITE #1 "        <register address='0xb9e1f44' value='0x" DATA.LONG(A:0xb9e1f44) "' name='RPMH_VRM_ENABLE_DRS_CSR_XOB6'/>"
WRITE #1 "        <register address='0xb9e2044' value='0x" DATA.LONG(A:0xb9e2044) "' name='RPMH_VRM_ENABLE_DRS_CSR_XOB7'/>"
WRITE #1 "        <register address='0xb9e2144' value='0x" DATA.LONG(A:0xb9e2144) "' name='RPMH_VRM_ENABLE_DRS_CSR_XOB8'/>"
WRITE #1 "        <register address='0xb9e2244' value='0x" DATA.LONG(A:0xb9e2244) "' name='RPMH_VRM_ENABLE_DRS_CSR_XOB9'/>"
WRITE #1 "        <register address='0xb9e2344' value='0x" DATA.LONG(A:0xb9e2344) "' name='RPMH_VRM_ENABLE_DRS_CSR_XOB10'/>"
WRITE #1 "        <register address='0xb9e2444' value='0x" DATA.LONG(A:0xb9e2444) "' name='RPMH_VRM_ENABLE_DRS_CSR_XOB11'/>"
WRITE #1 "        <register address='0xb9e2544' value='0x" DATA.LONG(A:0xb9e2544) "' name='RPMH_VRM_ENABLE_DRS_CSR_XOB12'/>"
WRITE #1 "        <register address='0xb9e2644' value='0x" DATA.LONG(A:0xb9e2644) "' name='RPMH_VRM_ENABLE_DRS_CSR_XOB13'/>"
WRITE #1 "        <register address='0xb9e2744' value='0x" DATA.LONG(A:0xb9e2744) "' name='RPMH_VRM_ENABLE_DRS_CSR_XOB14'/>"
WRITE #1 "        <register address='0xb9e2844' value='0x" DATA.LONG(A:0xb9e2844) "' name='RPMH_VRM_ENABLE_DRS_CSR_XOB15'/>"
WRITE #1 "        <register address='0xb9e2944' value='0x" DATA.LONG(A:0xb9e2944) "' name='RPMH_VRM_ENABLE_DRS_CSR_XO0'/>"
WRITE #1 "        <register address='0xb9e0060' value='0x" DATA.LONG(A:0xb9e0060) "' name='RPMH_VRM_VOLTAGE_ARS_CSR_REG0'/>"
WRITE #1 "        <register address='0xb9e0160' value='0x" DATA.LONG(A:0xb9e0160) "' name='RPMH_VRM_VOLTAGE_ARS_CSR_REG1'/>"
WRITE #1 "        <register address='0xb9e0260' value='0x" DATA.LONG(A:0xb9e0260) "' name='RPMH_VRM_VOLTAGE_ARS_CSR_REG2'/>"
WRITE #1 "        <register address='0xb9e0360' value='0x" DATA.LONG(A:0xb9e0360) "' name='RPMH_VRM_VOLTAGE_ARS_CSR_REG3'/>"
WRITE #1 "        <register address='0xb9e0460' value='0x" DATA.LONG(A:0xb9e0460) "' name='RPMH_VRM_VOLTAGE_ARS_CSR_REG4'/>"
WRITE #1 "        <register address='0xb9e0560' value='0x" DATA.LONG(A:0xb9e0560) "' name='RPMH_VRM_VOLTAGE_ARS_CSR_REG5'/>"
WRITE #1 "        <register address='0xb9e0660' value='0x" DATA.LONG(A:0xb9e0660) "' name='RPMH_VRM_VOLTAGE_ARS_CSR_REG6'/>"
WRITE #1 "        <register address='0xb9e0760' value='0x" DATA.LONG(A:0xb9e0760) "' name='RPMH_VRM_VOLTAGE_ARS_CSR_REG7'/>"
WRITE #1 "        <register address='0xb9e0860' value='0x" DATA.LONG(A:0xb9e0860) "' name='RPMH_VRM_VOLTAGE_ARS_CSR_REG8'/>"
WRITE #1 "        <register address='0xb9e0960' value='0x" DATA.LONG(A:0xb9e0960) "' name='RPMH_VRM_VOLTAGE_ARS_CSR_REG9'/>"
WRITE #1 "        <register address='0xb9e0a60' value='0x" DATA.LONG(A:0xb9e0a60) "' name='RPMH_VRM_VOLTAGE_ARS_CSR_REG10'/>"
WRITE #1 "        <register address='0xb9e0b60' value='0x" DATA.LONG(A:0xb9e0b60) "' name='RPMH_VRM_VOLTAGE_ARS_CSR_REG11'/>"
WRITE #1 "        <register address='0xb9e0c60' value='0x" DATA.LONG(A:0xb9e0c60) "' name='RPMH_VRM_VOLTAGE_ARS_CSR_REG12'/>"
WRITE #1 "        <register address='0xb9e0d60' value='0x" DATA.LONG(A:0xb9e0d60) "' name='RPMH_VRM_VOLTAGE_ARS_CSR_REG13'/>"
WRITE #1 "        <register address='0xb9e0e60' value='0x" DATA.LONG(A:0xb9e0e60) "' name='RPMH_VRM_VOLTAGE_ARS_CSR_REG14'/>"
WRITE #1 "        <register address='0xb9e0f60' value='0x" DATA.LONG(A:0xb9e0f60) "' name='RPMH_VRM_VOLTAGE_ARS_CSR_REG15'/>"
WRITE #1 "        <register address='0xb9e1060' value='0x" DATA.LONG(A:0xb9e1060) "' name='RPMH_VRM_VOLTAGE_ARS_CSR_REG16'/>"
WRITE #1 "        <register address='0xb9e1160' value='0x" DATA.LONG(A:0xb9e1160) "' name='RPMH_VRM_VOLTAGE_ARS_CSR_REG17'/>"
WRITE #1 "        <register address='0xb9e1260' value='0x" DATA.LONG(A:0xb9e1260) "' name='RPMH_VRM_VOLTAGE_ARS_CSR_REG18'/>"
WRITE #1 "        <register address='0xb9e1360' value='0x" DATA.LONG(A:0xb9e1360) "' name='RPMH_VRM_VOLTAGE_ARS_CSR_REG19'/>"
WRITE #1 "        <register address='0xb9e1460' value='0x" DATA.LONG(A:0xb9e1460) "' name='RPMH_VRM_VOLTAGE_ARS_CSR_REG20'/>"
WRITE #1 "        <register address='0xb9e1560' value='0x" DATA.LONG(A:0xb9e1560) "' name='RPMH_VRM_VOLTAGE_ARS_CSR_REG21'/>"
WRITE #1 "        <register address='0xb9e1660' value='0x" DATA.LONG(A:0xb9e1660) "' name='RPMH_VRM_VOLTAGE_ARS_CSR_REG22'/>"
WRITE #1 "        <register address='0xb9e1760' value='0x" DATA.LONG(A:0xb9e1760) "' name='RPMH_VRM_VOLTAGE_ARS_CSR_REG23'/>"
WRITE #1 "        <register address='0xb9e1860' value='0x" DATA.LONG(A:0xb9e1860) "' name='RPMH_VRM_VOLTAGE_ARS_CSR_REG24'/>"
WRITE #1 "        <register address='0xb9e0064' value='0x" DATA.LONG(A:0xb9e0064) "' name='RPMH_VRM_ENABLE_ARS_CSR_REG0'/>"
WRITE #1 "        <register address='0xb9e0164' value='0x" DATA.LONG(A:0xb9e0164) "' name='RPMH_VRM_ENABLE_ARS_CSR_REG1'/>"
WRITE #1 "        <register address='0xb9e0264' value='0x" DATA.LONG(A:0xb9e0264) "' name='RPMH_VRM_ENABLE_ARS_CSR_REG2'/>"
WRITE #1 "        <register address='0xb9e0364' value='0x" DATA.LONG(A:0xb9e0364) "' name='RPMH_VRM_ENABLE_ARS_CSR_REG3'/>"
WRITE #1 "        <register address='0xb9e0464' value='0x" DATA.LONG(A:0xb9e0464) "' name='RPMH_VRM_ENABLE_ARS_CSR_REG4'/>"
WRITE #1 "        <register address='0xb9e0564' value='0x" DATA.LONG(A:0xb9e0564) "' name='RPMH_VRM_ENABLE_ARS_CSR_REG5'/>"
WRITE #1 "        <register address='0xb9e0664' value='0x" DATA.LONG(A:0xb9e0664) "' name='RPMH_VRM_ENABLE_ARS_CSR_REG6'/>"
WRITE #1 "        <register address='0xb9e0764' value='0x" DATA.LONG(A:0xb9e0764) "' name='RPMH_VRM_ENABLE_ARS_CSR_REG7'/>"
WRITE #1 "        <register address='0xb9e0864' value='0x" DATA.LONG(A:0xb9e0864) "' name='RPMH_VRM_ENABLE_ARS_CSR_REG8'/>"
WRITE #1 "        <register address='0xb9e0964' value='0x" DATA.LONG(A:0xb9e0964) "' name='RPMH_VRM_ENABLE_ARS_CSR_REG9'/>"
WRITE #1 "        <register address='0xb9e0a64' value='0x" DATA.LONG(A:0xb9e0a64) "' name='RPMH_VRM_ENABLE_ARS_CSR_REG10'/>"
WRITE #1 "        <register address='0xb9e0b64' value='0x" DATA.LONG(A:0xb9e0b64) "' name='RPMH_VRM_ENABLE_ARS_CSR_REG11'/>"
WRITE #1 "        <register address='0xb9e0c64' value='0x" DATA.LONG(A:0xb9e0c64) "' name='RPMH_VRM_ENABLE_ARS_CSR_REG12'/>"
WRITE #1 "        <register address='0xb9e0d64' value='0x" DATA.LONG(A:0xb9e0d64) "' name='RPMH_VRM_ENABLE_ARS_CSR_REG13'/>"
WRITE #1 "        <register address='0xb9e0e64' value='0x" DATA.LONG(A:0xb9e0e64) "' name='RPMH_VRM_ENABLE_ARS_CSR_REG14'/>"
WRITE #1 "        <register address='0xb9e0f64' value='0x" DATA.LONG(A:0xb9e0f64) "' name='RPMH_VRM_ENABLE_ARS_CSR_REG15'/>"
WRITE #1 "        <register address='0xb9e1064' value='0x" DATA.LONG(A:0xb9e1064) "' name='RPMH_VRM_ENABLE_ARS_CSR_REG16'/>"
WRITE #1 "        <register address='0xb9e1164' value='0x" DATA.LONG(A:0xb9e1164) "' name='RPMH_VRM_ENABLE_ARS_CSR_REG17'/>"
WRITE #1 "        <register address='0xb9e1264' value='0x" DATA.LONG(A:0xb9e1264) "' name='RPMH_VRM_ENABLE_ARS_CSR_REG18'/>"
WRITE #1 "        <register address='0xb9e1364' value='0x" DATA.LONG(A:0xb9e1364) "' name='RPMH_VRM_ENABLE_ARS_CSR_REG19'/>"
WRITE #1 "        <register address='0xb9e1464' value='0x" DATA.LONG(A:0xb9e1464) "' name='RPMH_VRM_ENABLE_ARS_CSR_REG20'/>"
WRITE #1 "        <register address='0xb9e1564' value='0x" DATA.LONG(A:0xb9e1564) "' name='RPMH_VRM_ENABLE_ARS_CSR_REG21'/>"
WRITE #1 "        <register address='0xb9e1664' value='0x" DATA.LONG(A:0xb9e1664) "' name='RPMH_VRM_ENABLE_ARS_CSR_REG22'/>"
WRITE #1 "        <register address='0xb9e1764' value='0x" DATA.LONG(A:0xb9e1764) "' name='RPMH_VRM_ENABLE_ARS_CSR_REG23'/>"
WRITE #1 "        <register address='0xb9e1864' value='0x" DATA.LONG(A:0xb9e1864) "' name='RPMH_VRM_ENABLE_ARS_CSR_REG24'/>"
WRITE #1 "        <register address='0xb9e0068' value='0x" DATA.LONG(A:0xb9e0068) "' name='RPMH_VRM_MODE_ARS_CSR_REG0'/>"
WRITE #1 "        <register address='0xb9e0168' value='0x" DATA.LONG(A:0xb9e0168) "' name='RPMH_VRM_MODE_ARS_CSR_REG1'/>"
WRITE #1 "        <register address='0xb9e0268' value='0x" DATA.LONG(A:0xb9e0268) "' name='RPMH_VRM_MODE_ARS_CSR_REG2'/>"
WRITE #1 "        <register address='0xb9e0368' value='0x" DATA.LONG(A:0xb9e0368) "' name='RPMH_VRM_MODE_ARS_CSR_REG3'/>"
WRITE #1 "        <register address='0xb9e0468' value='0x" DATA.LONG(A:0xb9e0468) "' name='RPMH_VRM_MODE_ARS_CSR_REG4'/>"
WRITE #1 "        <register address='0xb9e0568' value='0x" DATA.LONG(A:0xb9e0568) "' name='RPMH_VRM_MODE_ARS_CSR_REG5'/>"
WRITE #1 "        <register address='0xb9e0668' value='0x" DATA.LONG(A:0xb9e0668) "' name='RPMH_VRM_MODE_ARS_CSR_REG6'/>"
WRITE #1 "        <register address='0xb9e0768' value='0x" DATA.LONG(A:0xb9e0768) "' name='RPMH_VRM_MODE_ARS_CSR_REG7'/>"
WRITE #1 "        <register address='0xb9e0868' value='0x" DATA.LONG(A:0xb9e0868) "' name='RPMH_VRM_MODE_ARS_CSR_REG8'/>"
WRITE #1 "        <register address='0xb9e0968' value='0x" DATA.LONG(A:0xb9e0968) "' name='RPMH_VRM_MODE_ARS_CSR_REG9'/>"
WRITE #1 "        <register address='0xb9e0a68' value='0x" DATA.LONG(A:0xb9e0a68) "' name='RPMH_VRM_MODE_ARS_CSR_REG10'/>"
WRITE #1 "        <register address='0xb9e0b68' value='0x" DATA.LONG(A:0xb9e0b68) "' name='RPMH_VRM_MODE_ARS_CSR_REG11'/>"
WRITE #1 "        <register address='0xb9e0c68' value='0x" DATA.LONG(A:0xb9e0c68) "' name='RPMH_VRM_MODE_ARS_CSR_REG12'/>"
WRITE #1 "        <register address='0xb9e0d68' value='0x" DATA.LONG(A:0xb9e0d68) "' name='RPMH_VRM_MODE_ARS_CSR_REG13'/>"
WRITE #1 "        <register address='0xb9e0e68' value='0x" DATA.LONG(A:0xb9e0e68) "' name='RPMH_VRM_MODE_ARS_CSR_REG14'/>"
WRITE #1 "        <register address='0xb9e0f68' value='0x" DATA.LONG(A:0xb9e0f68) "' name='RPMH_VRM_MODE_ARS_CSR_REG15'/>"
WRITE #1 "        <register address='0xb9e1068' value='0x" DATA.LONG(A:0xb9e1068) "' name='RPMH_VRM_MODE_ARS_CSR_REG16'/>"
WRITE #1 "        <register address='0xb9e1168' value='0x" DATA.LONG(A:0xb9e1168) "' name='RPMH_VRM_MODE_ARS_CSR_REG17'/>"
WRITE #1 "        <register address='0xb9e1268' value='0x" DATA.LONG(A:0xb9e1268) "' name='RPMH_VRM_MODE_ARS_CSR_REG18'/>"
WRITE #1 "        <register address='0xb9e1368' value='0x" DATA.LONG(A:0xb9e1368) "' name='RPMH_VRM_MODE_ARS_CSR_REG19'/>"
WRITE #1 "        <register address='0xb9e1468' value='0x" DATA.LONG(A:0xb9e1468) "' name='RPMH_VRM_MODE_ARS_CSR_REG20'/>"
WRITE #1 "        <register address='0xb9e1568' value='0x" DATA.LONG(A:0xb9e1568) "' name='RPMH_VRM_MODE_ARS_CSR_REG21'/>"
WRITE #1 "        <register address='0xb9e1668' value='0x" DATA.LONG(A:0xb9e1668) "' name='RPMH_VRM_MODE_ARS_CSR_REG22'/>"
WRITE #1 "        <register address='0xb9e1768' value='0x" DATA.LONG(A:0xb9e1768) "' name='RPMH_VRM_MODE_ARS_CSR_REG23'/>"
WRITE #1 "        <register address='0xb9e1868' value='0x" DATA.LONG(A:0xb9e1868) "' name='RPMH_VRM_MODE_ARS_CSR_REG24'/>"
WRITE #1 "        <register address='0xb9e1964' value='0x" DATA.LONG(A:0xb9e1964) "' name='RPMH_VRM_ENABLE_ARS_CSR_XOB0'/>"
WRITE #1 "        <register address='0xb9e1a64' value='0x" DATA.LONG(A:0xb9e1a64) "' name='RPMH_VRM_ENABLE_ARS_CSR_XOB1'/>"
WRITE #1 "        <register address='0xb9e1b64' value='0x" DATA.LONG(A:0xb9e1b64) "' name='RPMH_VRM_ENABLE_ARS_CSR_XOB2'/>"
WRITE #1 "        <register address='0xb9e1c64' value='0x" DATA.LONG(A:0xb9e1c64) "' name='RPMH_VRM_ENABLE_ARS_CSR_XOB3'/>"
WRITE #1 "        <register address='0xb9e1d64' value='0x" DATA.LONG(A:0xb9e1d64) "' name='RPMH_VRM_ENABLE_ARS_CSR_XOB4'/>"
WRITE #1 "        <register address='0xb9e1e64' value='0x" DATA.LONG(A:0xb9e1e64) "' name='RPMH_VRM_ENABLE_ARS_CSR_XOB5'/>"
WRITE #1 "        <register address='0xb9e1f64' value='0x" DATA.LONG(A:0xb9e1f64) "' name='RPMH_VRM_ENABLE_ARS_CSR_XOB6'/>"
WRITE #1 "        <register address='0xb9e2064' value='0x" DATA.LONG(A:0xb9e2064) "' name='RPMH_VRM_ENABLE_ARS_CSR_XOB7'/>"
WRITE #1 "        <register address='0xb9e2164' value='0x" DATA.LONG(A:0xb9e2164) "' name='RPMH_VRM_ENABLE_ARS_CSR_XOB8'/>"
WRITE #1 "        <register address='0xb9e2264' value='0x" DATA.LONG(A:0xb9e2264) "' name='RPMH_VRM_ENABLE_ARS_CSR_XOB9'/>"
WRITE #1 "        <register address='0xb9e2364' value='0x" DATA.LONG(A:0xb9e2364) "' name='RPMH_VRM_ENABLE_ARS_CSR_XOB10'/>"
WRITE #1 "        <register address='0xb9e2464' value='0x" DATA.LONG(A:0xb9e2464) "' name='RPMH_VRM_ENABLE_ARS_CSR_XOB11'/>"
WRITE #1 "        <register address='0xb9e2564' value='0x" DATA.LONG(A:0xb9e2564) "' name='RPMH_VRM_ENABLE_ARS_CSR_XOB12'/>"
WRITE #1 "        <register address='0xb9e2664' value='0x" DATA.LONG(A:0xb9e2664) "' name='RPMH_VRM_ENABLE_ARS_CSR_XOB13'/>"
WRITE #1 "        <register address='0xb9e2764' value='0x" DATA.LONG(A:0xb9e2764) "' name='RPMH_VRM_ENABLE_ARS_CSR_XOB14'/>"
WRITE #1 "        <register address='0xb9e2864' value='0x" DATA.LONG(A:0xb9e2864) "' name='RPMH_VRM_ENABLE_ARS_CSR_XOB15'/>"
WRITE #1 "        <register address='0xb9e2964' value='0x" DATA.LONG(A:0xb9e2964) "' name='RPMH_VRM_ENABLE_ARS_CSR_XO0'/>"
WRITE #1 "        <register address='0xb9e0080' value='0x" DATA.LONG(A:0xb9e0080) "' name='RPMH_VRM_TYPE_CSR_REG0'/>"
WRITE #1 "        <register address='0xb9e0180' value='0x" DATA.LONG(A:0xb9e0180) "' name='RPMH_VRM_TYPE_CSR_REG1'/>"
WRITE #1 "        <register address='0xb9e0280' value='0x" DATA.LONG(A:0xb9e0280) "' name='RPMH_VRM_TYPE_CSR_REG2'/>"
WRITE #1 "        <register address='0xb9e0380' value='0x" DATA.LONG(A:0xb9e0380) "' name='RPMH_VRM_TYPE_CSR_REG3'/>"
WRITE #1 "        <register address='0xb9e0480' value='0x" DATA.LONG(A:0xb9e0480) "' name='RPMH_VRM_TYPE_CSR_REG4'/>"
WRITE #1 "        <register address='0xb9e0580' value='0x" DATA.LONG(A:0xb9e0580) "' name='RPMH_VRM_TYPE_CSR_REG5'/>"
WRITE #1 "        <register address='0xb9e0680' value='0x" DATA.LONG(A:0xb9e0680) "' name='RPMH_VRM_TYPE_CSR_REG6'/>"
WRITE #1 "        <register address='0xb9e0780' value='0x" DATA.LONG(A:0xb9e0780) "' name='RPMH_VRM_TYPE_CSR_REG7'/>"
WRITE #1 "        <register address='0xb9e0880' value='0x" DATA.LONG(A:0xb9e0880) "' name='RPMH_VRM_TYPE_CSR_REG8'/>"
WRITE #1 "        <register address='0xb9e0980' value='0x" DATA.LONG(A:0xb9e0980) "' name='RPMH_VRM_TYPE_CSR_REG9'/>"
WRITE #1 "        <register address='0xb9e0a80' value='0x" DATA.LONG(A:0xb9e0a80) "' name='RPMH_VRM_TYPE_CSR_REG10'/>"
WRITE #1 "        <register address='0xb9e0b80' value='0x" DATA.LONG(A:0xb9e0b80) "' name='RPMH_VRM_TYPE_CSR_REG11'/>"
WRITE #1 "        <register address='0xb9e0c80' value='0x" DATA.LONG(A:0xb9e0c80) "' name='RPMH_VRM_TYPE_CSR_REG12'/>"
WRITE #1 "        <register address='0xb9e0d80' value='0x" DATA.LONG(A:0xb9e0d80) "' name='RPMH_VRM_TYPE_CSR_REG13'/>"
WRITE #1 "        <register address='0xb9e0e80' value='0x" DATA.LONG(A:0xb9e0e80) "' name='RPMH_VRM_TYPE_CSR_REG14'/>"
WRITE #1 "        <register address='0xb9e0f80' value='0x" DATA.LONG(A:0xb9e0f80) "' name='RPMH_VRM_TYPE_CSR_REG15'/>"
WRITE #1 "        <register address='0xb9e1080' value='0x" DATA.LONG(A:0xb9e1080) "' name='RPMH_VRM_TYPE_CSR_REG16'/>"
WRITE #1 "        <register address='0xb9e1180' value='0x" DATA.LONG(A:0xb9e1180) "' name='RPMH_VRM_TYPE_CSR_REG17'/>"
WRITE #1 "        <register address='0xb9e1280' value='0x" DATA.LONG(A:0xb9e1280) "' name='RPMH_VRM_TYPE_CSR_REG18'/>"
WRITE #1 "        <register address='0xb9e1380' value='0x" DATA.LONG(A:0xb9e1380) "' name='RPMH_VRM_TYPE_CSR_REG19'/>"
WRITE #1 "        <register address='0xb9e1480' value='0x" DATA.LONG(A:0xb9e1480) "' name='RPMH_VRM_TYPE_CSR_REG20'/>"
WRITE #1 "        <register address='0xb9e1580' value='0x" DATA.LONG(A:0xb9e1580) "' name='RPMH_VRM_TYPE_CSR_REG21'/>"
WRITE #1 "        <register address='0xb9e1680' value='0x" DATA.LONG(A:0xb9e1680) "' name='RPMH_VRM_TYPE_CSR_REG22'/>"
WRITE #1 "        <register address='0xb9e1780' value='0x" DATA.LONG(A:0xb9e1780) "' name='RPMH_VRM_TYPE_CSR_REG23'/>"
WRITE #1 "        <register address='0xb9e1880' value='0x" DATA.LONG(A:0xb9e1880) "' name='RPMH_VRM_TYPE_CSR_REG24'/>"
WRITE #1 "        <register address='0xb9e0084' value='0x" DATA.LONG(A:0xb9e0084) "' name='RPMH_VRM_BASE_ADDR_CSR_REG0'/>"
WRITE #1 "        <register address='0xb9e0184' value='0x" DATA.LONG(A:0xb9e0184) "' name='RPMH_VRM_BASE_ADDR_CSR_REG1'/>"
WRITE #1 "        <register address='0xb9e0284' value='0x" DATA.LONG(A:0xb9e0284) "' name='RPMH_VRM_BASE_ADDR_CSR_REG2'/>"
WRITE #1 "        <register address='0xb9e0384' value='0x" DATA.LONG(A:0xb9e0384) "' name='RPMH_VRM_BASE_ADDR_CSR_REG3'/>"
WRITE #1 "        <register address='0xb9e0484' value='0x" DATA.LONG(A:0xb9e0484) "' name='RPMH_VRM_BASE_ADDR_CSR_REG4'/>"
WRITE #1 "        <register address='0xb9e0584' value='0x" DATA.LONG(A:0xb9e0584) "' name='RPMH_VRM_BASE_ADDR_CSR_REG5'/>"
WRITE #1 "        <register address='0xb9e0684' value='0x" DATA.LONG(A:0xb9e0684) "' name='RPMH_VRM_BASE_ADDR_CSR_REG6'/>"
WRITE #1 "        <register address='0xb9e0784' value='0x" DATA.LONG(A:0xb9e0784) "' name='RPMH_VRM_BASE_ADDR_CSR_REG7'/>"
WRITE #1 "        <register address='0xb9e0884' value='0x" DATA.LONG(A:0xb9e0884) "' name='RPMH_VRM_BASE_ADDR_CSR_REG8'/>"
WRITE #1 "        <register address='0xb9e0984' value='0x" DATA.LONG(A:0xb9e0984) "' name='RPMH_VRM_BASE_ADDR_CSR_REG9'/>"
WRITE #1 "        <register address='0xb9e0a84' value='0x" DATA.LONG(A:0xb9e0a84) "' name='RPMH_VRM_BASE_ADDR_CSR_REG10'/>"
WRITE #1 "        <register address='0xb9e0b84' value='0x" DATA.LONG(A:0xb9e0b84) "' name='RPMH_VRM_BASE_ADDR_CSR_REG11'/>"
WRITE #1 "        <register address='0xb9e0c84' value='0x" DATA.LONG(A:0xb9e0c84) "' name='RPMH_VRM_BASE_ADDR_CSR_REG12'/>"
WRITE #1 "        <register address='0xb9e0d84' value='0x" DATA.LONG(A:0xb9e0d84) "' name='RPMH_VRM_BASE_ADDR_CSR_REG13'/>"
WRITE #1 "        <register address='0xb9e0e84' value='0x" DATA.LONG(A:0xb9e0e84) "' name='RPMH_VRM_BASE_ADDR_CSR_REG14'/>"
WRITE #1 "        <register address='0xb9e0f84' value='0x" DATA.LONG(A:0xb9e0f84) "' name='RPMH_VRM_BASE_ADDR_CSR_REG15'/>"
WRITE #1 "        <register address='0xb9e1084' value='0x" DATA.LONG(A:0xb9e1084) "' name='RPMH_VRM_BASE_ADDR_CSR_REG16'/>"
WRITE #1 "        <register address='0xb9e1184' value='0x" DATA.LONG(A:0xb9e1184) "' name='RPMH_VRM_BASE_ADDR_CSR_REG17'/>"
WRITE #1 "        <register address='0xb9e1284' value='0x" DATA.LONG(A:0xb9e1284) "' name='RPMH_VRM_BASE_ADDR_CSR_REG18'/>"
WRITE #1 "        <register address='0xb9e1384' value='0x" DATA.LONG(A:0xb9e1384) "' name='RPMH_VRM_BASE_ADDR_CSR_REG19'/>"
WRITE #1 "        <register address='0xb9e1484' value='0x" DATA.LONG(A:0xb9e1484) "' name='RPMH_VRM_BASE_ADDR_CSR_REG20'/>"
WRITE #1 "        <register address='0xb9e1584' value='0x" DATA.LONG(A:0xb9e1584) "' name='RPMH_VRM_BASE_ADDR_CSR_REG21'/>"
WRITE #1 "        <register address='0xb9e1684' value='0x" DATA.LONG(A:0xb9e1684) "' name='RPMH_VRM_BASE_ADDR_CSR_REG22'/>"
WRITE #1 "        <register address='0xb9e1784' value='0x" DATA.LONG(A:0xb9e1784) "' name='RPMH_VRM_BASE_ADDR_CSR_REG23'/>"
WRITE #1 "        <register address='0xb9e1884' value='0x" DATA.LONG(A:0xb9e1884) "' name='RPMH_VRM_BASE_ADDR_CSR_REG24'/>"
WRITE #1 "        <register address='0xb9e0088' value='0x" DATA.LONG(A:0xb9e0088) "' name='RPMH_VRM_MAX_VOLTAGE_CSR_REG0'/>"
WRITE #1 "        <register address='0xb9e0188' value='0x" DATA.LONG(A:0xb9e0188) "' name='RPMH_VRM_MAX_VOLTAGE_CSR_REG1'/>"
WRITE #1 "        <register address='0xb9e0288' value='0x" DATA.LONG(A:0xb9e0288) "' name='RPMH_VRM_MAX_VOLTAGE_CSR_REG2'/>"
WRITE #1 "        <register address='0xb9e0388' value='0x" DATA.LONG(A:0xb9e0388) "' name='RPMH_VRM_MAX_VOLTAGE_CSR_REG3'/>"
WRITE #1 "        <register address='0xb9e0488' value='0x" DATA.LONG(A:0xb9e0488) "' name='RPMH_VRM_MAX_VOLTAGE_CSR_REG4'/>"
WRITE #1 "        <register address='0xb9e0588' value='0x" DATA.LONG(A:0xb9e0588) "' name='RPMH_VRM_MAX_VOLTAGE_CSR_REG5'/>"
WRITE #1 "        <register address='0xb9e0688' value='0x" DATA.LONG(A:0xb9e0688) "' name='RPMH_VRM_MAX_VOLTAGE_CSR_REG6'/>"
WRITE #1 "        <register address='0xb9e0788' value='0x" DATA.LONG(A:0xb9e0788) "' name='RPMH_VRM_MAX_VOLTAGE_CSR_REG7'/>"
WRITE #1 "        <register address='0xb9e0888' value='0x" DATA.LONG(A:0xb9e0888) "' name='RPMH_VRM_MAX_VOLTAGE_CSR_REG8'/>"
WRITE #1 "        <register address='0xb9e0988' value='0x" DATA.LONG(A:0xb9e0988) "' name='RPMH_VRM_MAX_VOLTAGE_CSR_REG9'/>"
WRITE #1 "        <register address='0xb9e0a88' value='0x" DATA.LONG(A:0xb9e0a88) "' name='RPMH_VRM_MAX_VOLTAGE_CSR_REG10'/>"
WRITE #1 "        <register address='0xb9e0b88' value='0x" DATA.LONG(A:0xb9e0b88) "' name='RPMH_VRM_MAX_VOLTAGE_CSR_REG11'/>"
WRITE #1 "        <register address='0xb9e0c88' value='0x" DATA.LONG(A:0xb9e0c88) "' name='RPMH_VRM_MAX_VOLTAGE_CSR_REG12'/>"
WRITE #1 "        <register address='0xb9e0d88' value='0x" DATA.LONG(A:0xb9e0d88) "' name='RPMH_VRM_MAX_VOLTAGE_CSR_REG13'/>"
WRITE #1 "        <register address='0xb9e0e88' value='0x" DATA.LONG(A:0xb9e0e88) "' name='RPMH_VRM_MAX_VOLTAGE_CSR_REG14'/>"
WRITE #1 "        <register address='0xb9e0f88' value='0x" DATA.LONG(A:0xb9e0f88) "' name='RPMH_VRM_MAX_VOLTAGE_CSR_REG15'/>"
WRITE #1 "        <register address='0xb9e1088' value='0x" DATA.LONG(A:0xb9e1088) "' name='RPMH_VRM_MAX_VOLTAGE_CSR_REG16'/>"
WRITE #1 "        <register address='0xb9e1188' value='0x" DATA.LONG(A:0xb9e1188) "' name='RPMH_VRM_MAX_VOLTAGE_CSR_REG17'/>"
WRITE #1 "        <register address='0xb9e1288' value='0x" DATA.LONG(A:0xb9e1288) "' name='RPMH_VRM_MAX_VOLTAGE_CSR_REG18'/>"
WRITE #1 "        <register address='0xb9e1388' value='0x" DATA.LONG(A:0xb9e1388) "' name='RPMH_VRM_MAX_VOLTAGE_CSR_REG19'/>"
WRITE #1 "        <register address='0xb9e1488' value='0x" DATA.LONG(A:0xb9e1488) "' name='RPMH_VRM_MAX_VOLTAGE_CSR_REG20'/>"
WRITE #1 "        <register address='0xb9e1588' value='0x" DATA.LONG(A:0xb9e1588) "' name='RPMH_VRM_MAX_VOLTAGE_CSR_REG21'/>"
WRITE #1 "        <register address='0xb9e1688' value='0x" DATA.LONG(A:0xb9e1688) "' name='RPMH_VRM_MAX_VOLTAGE_CSR_REG22'/>"
WRITE #1 "        <register address='0xb9e1788' value='0x" DATA.LONG(A:0xb9e1788) "' name='RPMH_VRM_MAX_VOLTAGE_CSR_REG23'/>"
WRITE #1 "        <register address='0xb9e1888' value='0x" DATA.LONG(A:0xb9e1888) "' name='RPMH_VRM_MAX_VOLTAGE_CSR_REG24'/>"
WRITE #1 "        <register address='0xb9e008c' value='0x" DATA.LONG(A:0xb9e008c) "' name='RPMH_VRM_VOLTAGE_SEQ_ID_CSR_REG0'/>"
WRITE #1 "        <register address='0xb9e018c' value='0x" DATA.LONG(A:0xb9e018c) "' name='RPMH_VRM_VOLTAGE_SEQ_ID_CSR_REG1'/>"
WRITE #1 "        <register address='0xb9e028c' value='0x" DATA.LONG(A:0xb9e028c) "' name='RPMH_VRM_VOLTAGE_SEQ_ID_CSR_REG2'/>"
WRITE #1 "        <register address='0xb9e038c' value='0x" DATA.LONG(A:0xb9e038c) "' name='RPMH_VRM_VOLTAGE_SEQ_ID_CSR_REG3'/>"
WRITE #1 "        <register address='0xb9e048c' value='0x" DATA.LONG(A:0xb9e048c) "' name='RPMH_VRM_VOLTAGE_SEQ_ID_CSR_REG4'/>"
WRITE #1 "        <register address='0xb9e058c' value='0x" DATA.LONG(A:0xb9e058c) "' name='RPMH_VRM_VOLTAGE_SEQ_ID_CSR_REG5'/>"
WRITE #1 "        <register address='0xb9e068c' value='0x" DATA.LONG(A:0xb9e068c) "' name='RPMH_VRM_VOLTAGE_SEQ_ID_CSR_REG6'/>"
WRITE #1 "        <register address='0xb9e078c' value='0x" DATA.LONG(A:0xb9e078c) "' name='RPMH_VRM_VOLTAGE_SEQ_ID_CSR_REG7'/>"
WRITE #1 "        <register address='0xb9e088c' value='0x" DATA.LONG(A:0xb9e088c) "' name='RPMH_VRM_VOLTAGE_SEQ_ID_CSR_REG8'/>"
WRITE #1 "        <register address='0xb9e098c' value='0x" DATA.LONG(A:0xb9e098c) "' name='RPMH_VRM_VOLTAGE_SEQ_ID_CSR_REG9'/>"
WRITE #1 "        <register address='0xb9e0a8c' value='0x" DATA.LONG(A:0xb9e0a8c) "' name='RPMH_VRM_VOLTAGE_SEQ_ID_CSR_REG10'/>"
WRITE #1 "        <register address='0xb9e0b8c' value='0x" DATA.LONG(A:0xb9e0b8c) "' name='RPMH_VRM_VOLTAGE_SEQ_ID_CSR_REG11'/>"
WRITE #1 "        <register address='0xb9e0c8c' value='0x" DATA.LONG(A:0xb9e0c8c) "' name='RPMH_VRM_VOLTAGE_SEQ_ID_CSR_REG12'/>"
WRITE #1 "        <register address='0xb9e0d8c' value='0x" DATA.LONG(A:0xb9e0d8c) "' name='RPMH_VRM_VOLTAGE_SEQ_ID_CSR_REG13'/>"
WRITE #1 "        <register address='0xb9e0e8c' value='0x" DATA.LONG(A:0xb9e0e8c) "' name='RPMH_VRM_VOLTAGE_SEQ_ID_CSR_REG14'/>"
WRITE #1 "        <register address='0xb9e0f8c' value='0x" DATA.LONG(A:0xb9e0f8c) "' name='RPMH_VRM_VOLTAGE_SEQ_ID_CSR_REG15'/>"
WRITE #1 "        <register address='0xb9e108c' value='0x" DATA.LONG(A:0xb9e108c) "' name='RPMH_VRM_VOLTAGE_SEQ_ID_CSR_REG16'/>"
WRITE #1 "        <register address='0xb9e118c' value='0x" DATA.LONG(A:0xb9e118c) "' name='RPMH_VRM_VOLTAGE_SEQ_ID_CSR_REG17'/>"
WRITE #1 "        <register address='0xb9e128c' value='0x" DATA.LONG(A:0xb9e128c) "' name='RPMH_VRM_VOLTAGE_SEQ_ID_CSR_REG18'/>"
WRITE #1 "        <register address='0xb9e138c' value='0x" DATA.LONG(A:0xb9e138c) "' name='RPMH_VRM_VOLTAGE_SEQ_ID_CSR_REG19'/>"
WRITE #1 "        <register address='0xb9e148c' value='0x" DATA.LONG(A:0xb9e148c) "' name='RPMH_VRM_VOLTAGE_SEQ_ID_CSR_REG20'/>"
WRITE #1 "        <register address='0xb9e158c' value='0x" DATA.LONG(A:0xb9e158c) "' name='RPMH_VRM_VOLTAGE_SEQ_ID_CSR_REG21'/>"
WRITE #1 "        <register address='0xb9e168c' value='0x" DATA.LONG(A:0xb9e168c) "' name='RPMH_VRM_VOLTAGE_SEQ_ID_CSR_REG22'/>"
WRITE #1 "        <register address='0xb9e178c' value='0x" DATA.LONG(A:0xb9e178c) "' name='RPMH_VRM_VOLTAGE_SEQ_ID_CSR_REG23'/>"
WRITE #1 "        <register address='0xb9e188c' value='0x" DATA.LONG(A:0xb9e188c) "' name='RPMH_VRM_VOLTAGE_SEQ_ID_CSR_REG24'/>"
WRITE #1 "        <register address='0xb9e0090' value='0x" DATA.LONG(A:0xb9e0090) "' name='RPMH_VRM_ENABLE_SEQ_ID_CSR_REG0'/>"
WRITE #1 "        <register address='0xb9e0190' value='0x" DATA.LONG(A:0xb9e0190) "' name='RPMH_VRM_ENABLE_SEQ_ID_CSR_REG1'/>"
WRITE #1 "        <register address='0xb9e0290' value='0x" DATA.LONG(A:0xb9e0290) "' name='RPMH_VRM_ENABLE_SEQ_ID_CSR_REG2'/>"
WRITE #1 "        <register address='0xb9e0390' value='0x" DATA.LONG(A:0xb9e0390) "' name='RPMH_VRM_ENABLE_SEQ_ID_CSR_REG3'/>"
WRITE #1 "        <register address='0xb9e0490' value='0x" DATA.LONG(A:0xb9e0490) "' name='RPMH_VRM_ENABLE_SEQ_ID_CSR_REG4'/>"
WRITE #1 "        <register address='0xb9e0590' value='0x" DATA.LONG(A:0xb9e0590) "' name='RPMH_VRM_ENABLE_SEQ_ID_CSR_REG5'/>"
WRITE #1 "        <register address='0xb9e0690' value='0x" DATA.LONG(A:0xb9e0690) "' name='RPMH_VRM_ENABLE_SEQ_ID_CSR_REG6'/>"
WRITE #1 "        <register address='0xb9e0790' value='0x" DATA.LONG(A:0xb9e0790) "' name='RPMH_VRM_ENABLE_SEQ_ID_CSR_REG7'/>"
WRITE #1 "        <register address='0xb9e0890' value='0x" DATA.LONG(A:0xb9e0890) "' name='RPMH_VRM_ENABLE_SEQ_ID_CSR_REG8'/>"
WRITE #1 "        <register address='0xb9e0990' value='0x" DATA.LONG(A:0xb9e0990) "' name='RPMH_VRM_ENABLE_SEQ_ID_CSR_REG9'/>"
WRITE #1 "        <register address='0xb9e0a90' value='0x" DATA.LONG(A:0xb9e0a90) "' name='RPMH_VRM_ENABLE_SEQ_ID_CSR_REG10'/>"
WRITE #1 "        <register address='0xb9e0b90' value='0x" DATA.LONG(A:0xb9e0b90) "' name='RPMH_VRM_ENABLE_SEQ_ID_CSR_REG11'/>"
WRITE #1 "        <register address='0xb9e0c90' value='0x" DATA.LONG(A:0xb9e0c90) "' name='RPMH_VRM_ENABLE_SEQ_ID_CSR_REG12'/>"
WRITE #1 "        <register address='0xb9e0d90' value='0x" DATA.LONG(A:0xb9e0d90) "' name='RPMH_VRM_ENABLE_SEQ_ID_CSR_REG13'/>"
WRITE #1 "        <register address='0xb9e0e90' value='0x" DATA.LONG(A:0xb9e0e90) "' name='RPMH_VRM_ENABLE_SEQ_ID_CSR_REG14'/>"
WRITE #1 "        <register address='0xb9e0f90' value='0x" DATA.LONG(A:0xb9e0f90) "' name='RPMH_VRM_ENABLE_SEQ_ID_CSR_REG15'/>"
WRITE #1 "        <register address='0xb9e1090' value='0x" DATA.LONG(A:0xb9e1090) "' name='RPMH_VRM_ENABLE_SEQ_ID_CSR_REG16'/>"
WRITE #1 "        <register address='0xb9e1190' value='0x" DATA.LONG(A:0xb9e1190) "' name='RPMH_VRM_ENABLE_SEQ_ID_CSR_REG17'/>"
WRITE #1 "        <register address='0xb9e1290' value='0x" DATA.LONG(A:0xb9e1290) "' name='RPMH_VRM_ENABLE_SEQ_ID_CSR_REG18'/>"
WRITE #1 "        <register address='0xb9e1390' value='0x" DATA.LONG(A:0xb9e1390) "' name='RPMH_VRM_ENABLE_SEQ_ID_CSR_REG19'/>"
WRITE #1 "        <register address='0xb9e1490' value='0x" DATA.LONG(A:0xb9e1490) "' name='RPMH_VRM_ENABLE_SEQ_ID_CSR_REG20'/>"
WRITE #1 "        <register address='0xb9e1590' value='0x" DATA.LONG(A:0xb9e1590) "' name='RPMH_VRM_ENABLE_SEQ_ID_CSR_REG21'/>"
WRITE #1 "        <register address='0xb9e1690' value='0x" DATA.LONG(A:0xb9e1690) "' name='RPMH_VRM_ENABLE_SEQ_ID_CSR_REG22'/>"
WRITE #1 "        <register address='0xb9e1790' value='0x" DATA.LONG(A:0xb9e1790) "' name='RPMH_VRM_ENABLE_SEQ_ID_CSR_REG23'/>"
WRITE #1 "        <register address='0xb9e1890' value='0x" DATA.LONG(A:0xb9e1890) "' name='RPMH_VRM_ENABLE_SEQ_ID_CSR_REG24'/>"
WRITE #1 "        <register address='0xb9e0094' value='0x" DATA.LONG(A:0xb9e0094) "' name='RPMH_VRM_MODE_SEQ_ID_CSR_REG0'/>"
WRITE #1 "        <register address='0xb9e0194' value='0x" DATA.LONG(A:0xb9e0194) "' name='RPMH_VRM_MODE_SEQ_ID_CSR_REG1'/>"
WRITE #1 "        <register address='0xb9e0294' value='0x" DATA.LONG(A:0xb9e0294) "' name='RPMH_VRM_MODE_SEQ_ID_CSR_REG2'/>"
WRITE #1 "        <register address='0xb9e0394' value='0x" DATA.LONG(A:0xb9e0394) "' name='RPMH_VRM_MODE_SEQ_ID_CSR_REG3'/>"
WRITE #1 "        <register address='0xb9e0494' value='0x" DATA.LONG(A:0xb9e0494) "' name='RPMH_VRM_MODE_SEQ_ID_CSR_REG4'/>"
WRITE #1 "        <register address='0xb9e0594' value='0x" DATA.LONG(A:0xb9e0594) "' name='RPMH_VRM_MODE_SEQ_ID_CSR_REG5'/>"
WRITE #1 "        <register address='0xb9e0694' value='0x" DATA.LONG(A:0xb9e0694) "' name='RPMH_VRM_MODE_SEQ_ID_CSR_REG6'/>"
WRITE #1 "        <register address='0xb9e0794' value='0x" DATA.LONG(A:0xb9e0794) "' name='RPMH_VRM_MODE_SEQ_ID_CSR_REG7'/>"
WRITE #1 "        <register address='0xb9e0894' value='0x" DATA.LONG(A:0xb9e0894) "' name='RPMH_VRM_MODE_SEQ_ID_CSR_REG8'/>"
WRITE #1 "        <register address='0xb9e0994' value='0x" DATA.LONG(A:0xb9e0994) "' name='RPMH_VRM_MODE_SEQ_ID_CSR_REG9'/>"
WRITE #1 "        <register address='0xb9e0a94' value='0x" DATA.LONG(A:0xb9e0a94) "' name='RPMH_VRM_MODE_SEQ_ID_CSR_REG10'/>"
WRITE #1 "        <register address='0xb9e0b94' value='0x" DATA.LONG(A:0xb9e0b94) "' name='RPMH_VRM_MODE_SEQ_ID_CSR_REG11'/>"
WRITE #1 "        <register address='0xb9e0c94' value='0x" DATA.LONG(A:0xb9e0c94) "' name='RPMH_VRM_MODE_SEQ_ID_CSR_REG12'/>"
WRITE #1 "        <register address='0xb9e0d94' value='0x" DATA.LONG(A:0xb9e0d94) "' name='RPMH_VRM_MODE_SEQ_ID_CSR_REG13'/>"
WRITE #1 "        <register address='0xb9e0e94' value='0x" DATA.LONG(A:0xb9e0e94) "' name='RPMH_VRM_MODE_SEQ_ID_CSR_REG14'/>"
WRITE #1 "        <register address='0xb9e0f94' value='0x" DATA.LONG(A:0xb9e0f94) "' name='RPMH_VRM_MODE_SEQ_ID_CSR_REG15'/>"
WRITE #1 "        <register address='0xb9e1094' value='0x" DATA.LONG(A:0xb9e1094) "' name='RPMH_VRM_MODE_SEQ_ID_CSR_REG16'/>"
WRITE #1 "        <register address='0xb9e1194' value='0x" DATA.LONG(A:0xb9e1194) "' name='RPMH_VRM_MODE_SEQ_ID_CSR_REG17'/>"
WRITE #1 "        <register address='0xb9e1294' value='0x" DATA.LONG(A:0xb9e1294) "' name='RPMH_VRM_MODE_SEQ_ID_CSR_REG18'/>"
WRITE #1 "        <register address='0xb9e1394' value='0x" DATA.LONG(A:0xb9e1394) "' name='RPMH_VRM_MODE_SEQ_ID_CSR_REG19'/>"
WRITE #1 "        <register address='0xb9e1494' value='0x" DATA.LONG(A:0xb9e1494) "' name='RPMH_VRM_MODE_SEQ_ID_CSR_REG20'/>"
WRITE #1 "        <register address='0xb9e1594' value='0x" DATA.LONG(A:0xb9e1594) "' name='RPMH_VRM_MODE_SEQ_ID_CSR_REG21'/>"
WRITE #1 "        <register address='0xb9e1694' value='0x" DATA.LONG(A:0xb9e1694) "' name='RPMH_VRM_MODE_SEQ_ID_CSR_REG22'/>"
WRITE #1 "        <register address='0xb9e1794' value='0x" DATA.LONG(A:0xb9e1794) "' name='RPMH_VRM_MODE_SEQ_ID_CSR_REG23'/>"
WRITE #1 "        <register address='0xb9e1894' value='0x" DATA.LONG(A:0xb9e1894) "' name='RPMH_VRM_MODE_SEQ_ID_CSR_REG24'/>"
WRITE #1 "        <register address='0xb9e00a8' value='0x" DATA.LONG(A:0xb9e00a8) "' name='RPMH_VRM_VOLTAGE_DEP_ENABLE_CSR_REG0'/>"
WRITE #1 "        <register address='0xb9e01a8' value='0x" DATA.LONG(A:0xb9e01a8) "' name='RPMH_VRM_VOLTAGE_DEP_ENABLE_CSR_REG1'/>"
WRITE #1 "        <register address='0xb9e02a8' value='0x" DATA.LONG(A:0xb9e02a8) "' name='RPMH_VRM_VOLTAGE_DEP_ENABLE_CSR_REG2'/>"
WRITE #1 "        <register address='0xb9e03a8' value='0x" DATA.LONG(A:0xb9e03a8) "' name='RPMH_VRM_VOLTAGE_DEP_ENABLE_CSR_REG3'/>"
WRITE #1 "        <register address='0xb9e04a8' value='0x" DATA.LONG(A:0xb9e04a8) "' name='RPMH_VRM_VOLTAGE_DEP_ENABLE_CSR_REG4'/>"
WRITE #1 "        <register address='0xb9e05a8' value='0x" DATA.LONG(A:0xb9e05a8) "' name='RPMH_VRM_VOLTAGE_DEP_ENABLE_CSR_REG5'/>"
WRITE #1 "        <register address='0xb9e06a8' value='0x" DATA.LONG(A:0xb9e06a8) "' name='RPMH_VRM_VOLTAGE_DEP_ENABLE_CSR_REG6'/>"
WRITE #1 "        <register address='0xb9e07a8' value='0x" DATA.LONG(A:0xb9e07a8) "' name='RPMH_VRM_VOLTAGE_DEP_ENABLE_CSR_REG7'/>"
WRITE #1 "        <register address='0xb9e08a8' value='0x" DATA.LONG(A:0xb9e08a8) "' name='RPMH_VRM_VOLTAGE_DEP_ENABLE_CSR_REG8'/>"
WRITE #1 "        <register address='0xb9e09a8' value='0x" DATA.LONG(A:0xb9e09a8) "' name='RPMH_VRM_VOLTAGE_DEP_ENABLE_CSR_REG9'/>"
WRITE #1 "        <register address='0xb9e0aa8' value='0x" DATA.LONG(A:0xb9e0aa8) "' name='RPMH_VRM_VOLTAGE_DEP_ENABLE_CSR_REG10'/>"
WRITE #1 "        <register address='0xb9e0ba8' value='0x" DATA.LONG(A:0xb9e0ba8) "' name='RPMH_VRM_VOLTAGE_DEP_ENABLE_CSR_REG11'/>"
WRITE #1 "        <register address='0xb9e0ca8' value='0x" DATA.LONG(A:0xb9e0ca8) "' name='RPMH_VRM_VOLTAGE_DEP_ENABLE_CSR_REG12'/>"
WRITE #1 "        <register address='0xb9e0da8' value='0x" DATA.LONG(A:0xb9e0da8) "' name='RPMH_VRM_VOLTAGE_DEP_ENABLE_CSR_REG13'/>"
WRITE #1 "        <register address='0xb9e0ea8' value='0x" DATA.LONG(A:0xb9e0ea8) "' name='RPMH_VRM_VOLTAGE_DEP_ENABLE_CSR_REG14'/>"
WRITE #1 "        <register address='0xb9e0fa8' value='0x" DATA.LONG(A:0xb9e0fa8) "' name='RPMH_VRM_VOLTAGE_DEP_ENABLE_CSR_REG15'/>"
WRITE #1 "        <register address='0xb9e10a8' value='0x" DATA.LONG(A:0xb9e10a8) "' name='RPMH_VRM_VOLTAGE_DEP_ENABLE_CSR_REG16'/>"
WRITE #1 "        <register address='0xb9e11a8' value='0x" DATA.LONG(A:0xb9e11a8) "' name='RPMH_VRM_VOLTAGE_DEP_ENABLE_CSR_REG17'/>"
WRITE #1 "        <register address='0xb9e12a8' value='0x" DATA.LONG(A:0xb9e12a8) "' name='RPMH_VRM_VOLTAGE_DEP_ENABLE_CSR_REG18'/>"
WRITE #1 "        <register address='0xb9e13a8' value='0x" DATA.LONG(A:0xb9e13a8) "' name='RPMH_VRM_VOLTAGE_DEP_ENABLE_CSR_REG19'/>"
WRITE #1 "        <register address='0xb9e14a8' value='0x" DATA.LONG(A:0xb9e14a8) "' name='RPMH_VRM_VOLTAGE_DEP_ENABLE_CSR_REG20'/>"
WRITE #1 "        <register address='0xb9e15a8' value='0x" DATA.LONG(A:0xb9e15a8) "' name='RPMH_VRM_VOLTAGE_DEP_ENABLE_CSR_REG21'/>"
WRITE #1 "        <register address='0xb9e16a8' value='0x" DATA.LONG(A:0xb9e16a8) "' name='RPMH_VRM_VOLTAGE_DEP_ENABLE_CSR_REG22'/>"
WRITE #1 "        <register address='0xb9e17a8' value='0x" DATA.LONG(A:0xb9e17a8) "' name='RPMH_VRM_VOLTAGE_DEP_ENABLE_CSR_REG23'/>"
WRITE #1 "        <register address='0xb9e18a8' value='0x" DATA.LONG(A:0xb9e18a8) "' name='RPMH_VRM_VOLTAGE_DEP_ENABLE_CSR_REG24'/>"
WRITE #1 "        <register address='0xb9e00ac' value='0x" DATA.LONG(A:0xb9e00ac) "' name='RPMH_VRM_ENABLE_DEP_ENABLE_CSR_REG0'/>"
WRITE #1 "        <register address='0xb9e01ac' value='0x" DATA.LONG(A:0xb9e01ac) "' name='RPMH_VRM_ENABLE_DEP_ENABLE_CSR_REG1'/>"
WRITE #1 "        <register address='0xb9e02ac' value='0x" DATA.LONG(A:0xb9e02ac) "' name='RPMH_VRM_ENABLE_DEP_ENABLE_CSR_REG2'/>"
WRITE #1 "        <register address='0xb9e03ac' value='0x" DATA.LONG(A:0xb9e03ac) "' name='RPMH_VRM_ENABLE_DEP_ENABLE_CSR_REG3'/>"
WRITE #1 "        <register address='0xb9e04ac' value='0x" DATA.LONG(A:0xb9e04ac) "' name='RPMH_VRM_ENABLE_DEP_ENABLE_CSR_REG4'/>"
WRITE #1 "        <register address='0xb9e05ac' value='0x" DATA.LONG(A:0xb9e05ac) "' name='RPMH_VRM_ENABLE_DEP_ENABLE_CSR_REG5'/>"
WRITE #1 "        <register address='0xb9e06ac' value='0x" DATA.LONG(A:0xb9e06ac) "' name='RPMH_VRM_ENABLE_DEP_ENABLE_CSR_REG6'/>"
WRITE #1 "        <register address='0xb9e07ac' value='0x" DATA.LONG(A:0xb9e07ac) "' name='RPMH_VRM_ENABLE_DEP_ENABLE_CSR_REG7'/>"
WRITE #1 "        <register address='0xb9e08ac' value='0x" DATA.LONG(A:0xb9e08ac) "' name='RPMH_VRM_ENABLE_DEP_ENABLE_CSR_REG8'/>"
WRITE #1 "        <register address='0xb9e09ac' value='0x" DATA.LONG(A:0xb9e09ac) "' name='RPMH_VRM_ENABLE_DEP_ENABLE_CSR_REG9'/>"
WRITE #1 "        <register address='0xb9e0aac' value='0x" DATA.LONG(A:0xb9e0aac) "' name='RPMH_VRM_ENABLE_DEP_ENABLE_CSR_REG10'/>"
WRITE #1 "        <register address='0xb9e0bac' value='0x" DATA.LONG(A:0xb9e0bac) "' name='RPMH_VRM_ENABLE_DEP_ENABLE_CSR_REG11'/>"
WRITE #1 "        <register address='0xb9e0cac' value='0x" DATA.LONG(A:0xb9e0cac) "' name='RPMH_VRM_ENABLE_DEP_ENABLE_CSR_REG12'/>"
WRITE #1 "        <register address='0xb9e0dac' value='0x" DATA.LONG(A:0xb9e0dac) "' name='RPMH_VRM_ENABLE_DEP_ENABLE_CSR_REG13'/>"
WRITE #1 "        <register address='0xb9e0eac' value='0x" DATA.LONG(A:0xb9e0eac) "' name='RPMH_VRM_ENABLE_DEP_ENABLE_CSR_REG14'/>"
WRITE #1 "        <register address='0xb9e0fac' value='0x" DATA.LONG(A:0xb9e0fac) "' name='RPMH_VRM_ENABLE_DEP_ENABLE_CSR_REG15'/>"
WRITE #1 "        <register address='0xb9e10ac' value='0x" DATA.LONG(A:0xb9e10ac) "' name='RPMH_VRM_ENABLE_DEP_ENABLE_CSR_REG16'/>"
WRITE #1 "        <register address='0xb9e11ac' value='0x" DATA.LONG(A:0xb9e11ac) "' name='RPMH_VRM_ENABLE_DEP_ENABLE_CSR_REG17'/>"
WRITE #1 "        <register address='0xb9e12ac' value='0x" DATA.LONG(A:0xb9e12ac) "' name='RPMH_VRM_ENABLE_DEP_ENABLE_CSR_REG18'/>"
WRITE #1 "        <register address='0xb9e13ac' value='0x" DATA.LONG(A:0xb9e13ac) "' name='RPMH_VRM_ENABLE_DEP_ENABLE_CSR_REG19'/>"
WRITE #1 "        <register address='0xb9e14ac' value='0x" DATA.LONG(A:0xb9e14ac) "' name='RPMH_VRM_ENABLE_DEP_ENABLE_CSR_REG20'/>"
WRITE #1 "        <register address='0xb9e15ac' value='0x" DATA.LONG(A:0xb9e15ac) "' name='RPMH_VRM_ENABLE_DEP_ENABLE_CSR_REG21'/>"
WRITE #1 "        <register address='0xb9e16ac' value='0x" DATA.LONG(A:0xb9e16ac) "' name='RPMH_VRM_ENABLE_DEP_ENABLE_CSR_REG22'/>"
WRITE #1 "        <register address='0xb9e17ac' value='0x" DATA.LONG(A:0xb9e17ac) "' name='RPMH_VRM_ENABLE_DEP_ENABLE_CSR_REG23'/>"
WRITE #1 "        <register address='0xb9e18ac' value='0x" DATA.LONG(A:0xb9e18ac) "' name='RPMH_VRM_ENABLE_DEP_ENABLE_CSR_REG24'/>"
WRITE #1 "        <register address='0xb9e00b0' value='0x" DATA.LONG(A:0xb9e00b0) "' name='RPMH_VRM_MODE_DEP_ENABLE_CSR_REG0'/>"
WRITE #1 "        <register address='0xb9e01b0' value='0x" DATA.LONG(A:0xb9e01b0) "' name='RPMH_VRM_MODE_DEP_ENABLE_CSR_REG1'/>"
WRITE #1 "        <register address='0xb9e02b0' value='0x" DATA.LONG(A:0xb9e02b0) "' name='RPMH_VRM_MODE_DEP_ENABLE_CSR_REG2'/>"
WRITE #1 "        <register address='0xb9e03b0' value='0x" DATA.LONG(A:0xb9e03b0) "' name='RPMH_VRM_MODE_DEP_ENABLE_CSR_REG3'/>"
WRITE #1 "        <register address='0xb9e04b0' value='0x" DATA.LONG(A:0xb9e04b0) "' name='RPMH_VRM_MODE_DEP_ENABLE_CSR_REG4'/>"
WRITE #1 "        <register address='0xb9e05b0' value='0x" DATA.LONG(A:0xb9e05b0) "' name='RPMH_VRM_MODE_DEP_ENABLE_CSR_REG5'/>"
WRITE #1 "        <register address='0xb9e06b0' value='0x" DATA.LONG(A:0xb9e06b0) "' name='RPMH_VRM_MODE_DEP_ENABLE_CSR_REG6'/>"
WRITE #1 "        <register address='0xb9e07b0' value='0x" DATA.LONG(A:0xb9e07b0) "' name='RPMH_VRM_MODE_DEP_ENABLE_CSR_REG7'/>"
WRITE #1 "        <register address='0xb9e08b0' value='0x" DATA.LONG(A:0xb9e08b0) "' name='RPMH_VRM_MODE_DEP_ENABLE_CSR_REG8'/>"
WRITE #1 "        <register address='0xb9e09b0' value='0x" DATA.LONG(A:0xb9e09b0) "' name='RPMH_VRM_MODE_DEP_ENABLE_CSR_REG9'/>"
WRITE #1 "        <register address='0xb9e0ab0' value='0x" DATA.LONG(A:0xb9e0ab0) "' name='RPMH_VRM_MODE_DEP_ENABLE_CSR_REG10'/>"
WRITE #1 "        <register address='0xb9e0bb0' value='0x" DATA.LONG(A:0xb9e0bb0) "' name='RPMH_VRM_MODE_DEP_ENABLE_CSR_REG11'/>"
WRITE #1 "        <register address='0xb9e0cb0' value='0x" DATA.LONG(A:0xb9e0cb0) "' name='RPMH_VRM_MODE_DEP_ENABLE_CSR_REG12'/>"
WRITE #1 "        <register address='0xb9e0db0' value='0x" DATA.LONG(A:0xb9e0db0) "' name='RPMH_VRM_MODE_DEP_ENABLE_CSR_REG13'/>"
WRITE #1 "        <register address='0xb9e0eb0' value='0x" DATA.LONG(A:0xb9e0eb0) "' name='RPMH_VRM_MODE_DEP_ENABLE_CSR_REG14'/>"
WRITE #1 "        <register address='0xb9e0fb0' value='0x" DATA.LONG(A:0xb9e0fb0) "' name='RPMH_VRM_MODE_DEP_ENABLE_CSR_REG15'/>"
WRITE #1 "        <register address='0xb9e10b0' value='0x" DATA.LONG(A:0xb9e10b0) "' name='RPMH_VRM_MODE_DEP_ENABLE_CSR_REG16'/>"
WRITE #1 "        <register address='0xb9e11b0' value='0x" DATA.LONG(A:0xb9e11b0) "' name='RPMH_VRM_MODE_DEP_ENABLE_CSR_REG17'/>"
WRITE #1 "        <register address='0xb9e12b0' value='0x" DATA.LONG(A:0xb9e12b0) "' name='RPMH_VRM_MODE_DEP_ENABLE_CSR_REG18'/>"
WRITE #1 "        <register address='0xb9e13b0' value='0x" DATA.LONG(A:0xb9e13b0) "' name='RPMH_VRM_MODE_DEP_ENABLE_CSR_REG19'/>"
WRITE #1 "        <register address='0xb9e14b0' value='0x" DATA.LONG(A:0xb9e14b0) "' name='RPMH_VRM_MODE_DEP_ENABLE_CSR_REG20'/>"
WRITE #1 "        <register address='0xb9e15b0' value='0x" DATA.LONG(A:0xb9e15b0) "' name='RPMH_VRM_MODE_DEP_ENABLE_CSR_REG21'/>"
WRITE #1 "        <register address='0xb9e16b0' value='0x" DATA.LONG(A:0xb9e16b0) "' name='RPMH_VRM_MODE_DEP_ENABLE_CSR_REG22'/>"
WRITE #1 "        <register address='0xb9e17b0' value='0x" DATA.LONG(A:0xb9e17b0) "' name='RPMH_VRM_MODE_DEP_ENABLE_CSR_REG23'/>"
WRITE #1 "        <register address='0xb9e18b0' value='0x" DATA.LONG(A:0xb9e18b0) "' name='RPMH_VRM_MODE_DEP_ENABLE_CSR_REG24'/>"
WRITE #1 "        <register address='0xb9e00c4' value='0x" DATA.LONG(A:0xb9e00c4) "' name='RPMH_VRM_VOLTAGE_SETTLING_BLOCK_ENABLE_CSR_REG0'/>"
WRITE #1 "        <register address='0xb9e01c4' value='0x" DATA.LONG(A:0xb9e01c4) "' name='RPMH_VRM_VOLTAGE_SETTLING_BLOCK_ENABLE_CSR_REG1'/>"
WRITE #1 "        <register address='0xb9e02c4' value='0x" DATA.LONG(A:0xb9e02c4) "' name='RPMH_VRM_VOLTAGE_SETTLING_BLOCK_ENABLE_CSR_REG2'/>"
WRITE #1 "        <register address='0xb9e03c4' value='0x" DATA.LONG(A:0xb9e03c4) "' name='RPMH_VRM_VOLTAGE_SETTLING_BLOCK_ENABLE_CSR_REG3'/>"
WRITE #1 "        <register address='0xb9e04c4' value='0x" DATA.LONG(A:0xb9e04c4) "' name='RPMH_VRM_VOLTAGE_SETTLING_BLOCK_ENABLE_CSR_REG4'/>"
WRITE #1 "        <register address='0xb9e05c4' value='0x" DATA.LONG(A:0xb9e05c4) "' name='RPMH_VRM_VOLTAGE_SETTLING_BLOCK_ENABLE_CSR_REG5'/>"
WRITE #1 "        <register address='0xb9e06c4' value='0x" DATA.LONG(A:0xb9e06c4) "' name='RPMH_VRM_VOLTAGE_SETTLING_BLOCK_ENABLE_CSR_REG6'/>"
WRITE #1 "        <register address='0xb9e07c4' value='0x" DATA.LONG(A:0xb9e07c4) "' name='RPMH_VRM_VOLTAGE_SETTLING_BLOCK_ENABLE_CSR_REG7'/>"
WRITE #1 "        <register address='0xb9e08c4' value='0x" DATA.LONG(A:0xb9e08c4) "' name='RPMH_VRM_VOLTAGE_SETTLING_BLOCK_ENABLE_CSR_REG8'/>"
WRITE #1 "        <register address='0xb9e09c4' value='0x" DATA.LONG(A:0xb9e09c4) "' name='RPMH_VRM_VOLTAGE_SETTLING_BLOCK_ENABLE_CSR_REG9'/>"
WRITE #1 "        <register address='0xb9e0ac4' value='0x" DATA.LONG(A:0xb9e0ac4) "' name='RPMH_VRM_VOLTAGE_SETTLING_BLOCK_ENABLE_CSR_REG10'/>"
WRITE #1 "        <register address='0xb9e0bc4' value='0x" DATA.LONG(A:0xb9e0bc4) "' name='RPMH_VRM_VOLTAGE_SETTLING_BLOCK_ENABLE_CSR_REG11'/>"
WRITE #1 "        <register address='0xb9e0cc4' value='0x" DATA.LONG(A:0xb9e0cc4) "' name='RPMH_VRM_VOLTAGE_SETTLING_BLOCK_ENABLE_CSR_REG12'/>"
WRITE #1 "        <register address='0xb9e0dc4' value='0x" DATA.LONG(A:0xb9e0dc4) "' name='RPMH_VRM_VOLTAGE_SETTLING_BLOCK_ENABLE_CSR_REG13'/>"
WRITE #1 "        <register address='0xb9e0ec4' value='0x" DATA.LONG(A:0xb9e0ec4) "' name='RPMH_VRM_VOLTAGE_SETTLING_BLOCK_ENABLE_CSR_REG14'/>"
WRITE #1 "        <register address='0xb9e0fc4' value='0x" DATA.LONG(A:0xb9e0fc4) "' name='RPMH_VRM_VOLTAGE_SETTLING_BLOCK_ENABLE_CSR_REG15'/>"
WRITE #1 "        <register address='0xb9e10c4' value='0x" DATA.LONG(A:0xb9e10c4) "' name='RPMH_VRM_VOLTAGE_SETTLING_BLOCK_ENABLE_CSR_REG16'/>"
WRITE #1 "        <register address='0xb9e11c4' value='0x" DATA.LONG(A:0xb9e11c4) "' name='RPMH_VRM_VOLTAGE_SETTLING_BLOCK_ENABLE_CSR_REG17'/>"
WRITE #1 "        <register address='0xb9e12c4' value='0x" DATA.LONG(A:0xb9e12c4) "' name='RPMH_VRM_VOLTAGE_SETTLING_BLOCK_ENABLE_CSR_REG18'/>"
WRITE #1 "        <register address='0xb9e13c4' value='0x" DATA.LONG(A:0xb9e13c4) "' name='RPMH_VRM_VOLTAGE_SETTLING_BLOCK_ENABLE_CSR_REG19'/>"
WRITE #1 "        <register address='0xb9e14c4' value='0x" DATA.LONG(A:0xb9e14c4) "' name='RPMH_VRM_VOLTAGE_SETTLING_BLOCK_ENABLE_CSR_REG20'/>"
WRITE #1 "        <register address='0xb9e15c4' value='0x" DATA.LONG(A:0xb9e15c4) "' name='RPMH_VRM_VOLTAGE_SETTLING_BLOCK_ENABLE_CSR_REG21'/>"
WRITE #1 "        <register address='0xb9e16c4' value='0x" DATA.LONG(A:0xb9e16c4) "' name='RPMH_VRM_VOLTAGE_SETTLING_BLOCK_ENABLE_CSR_REG22'/>"
WRITE #1 "        <register address='0xb9e17c4' value='0x" DATA.LONG(A:0xb9e17c4) "' name='RPMH_VRM_VOLTAGE_SETTLING_BLOCK_ENABLE_CSR_REG23'/>"
WRITE #1 "        <register address='0xb9e18c4' value='0x" DATA.LONG(A:0xb9e18c4) "' name='RPMH_VRM_VOLTAGE_SETTLING_BLOCK_ENABLE_CSR_REG24'/>"
WRITE #1 "        <register address='0xb9e00c8' value='0x" DATA.LONG(A:0xb9e00c8) "' name='RPMH_VRM_ENABLE_SETTLING_BLOCK_ENABLE_CSR_REG0'/>"
WRITE #1 "        <register address='0xb9e01c8' value='0x" DATA.LONG(A:0xb9e01c8) "' name='RPMH_VRM_ENABLE_SETTLING_BLOCK_ENABLE_CSR_REG1'/>"
WRITE #1 "        <register address='0xb9e02c8' value='0x" DATA.LONG(A:0xb9e02c8) "' name='RPMH_VRM_ENABLE_SETTLING_BLOCK_ENABLE_CSR_REG2'/>"
WRITE #1 "        <register address='0xb9e03c8' value='0x" DATA.LONG(A:0xb9e03c8) "' name='RPMH_VRM_ENABLE_SETTLING_BLOCK_ENABLE_CSR_REG3'/>"
WRITE #1 "        <register address='0xb9e04c8' value='0x" DATA.LONG(A:0xb9e04c8) "' name='RPMH_VRM_ENABLE_SETTLING_BLOCK_ENABLE_CSR_REG4'/>"
WRITE #1 "        <register address='0xb9e05c8' value='0x" DATA.LONG(A:0xb9e05c8) "' name='RPMH_VRM_ENABLE_SETTLING_BLOCK_ENABLE_CSR_REG5'/>"
WRITE #1 "        <register address='0xb9e06c8' value='0x" DATA.LONG(A:0xb9e06c8) "' name='RPMH_VRM_ENABLE_SETTLING_BLOCK_ENABLE_CSR_REG6'/>"
WRITE #1 "        <register address='0xb9e07c8' value='0x" DATA.LONG(A:0xb9e07c8) "' name='RPMH_VRM_ENABLE_SETTLING_BLOCK_ENABLE_CSR_REG7'/>"
WRITE #1 "        <register address='0xb9e08c8' value='0x" DATA.LONG(A:0xb9e08c8) "' name='RPMH_VRM_ENABLE_SETTLING_BLOCK_ENABLE_CSR_REG8'/>"
WRITE #1 "        <register address='0xb9e09c8' value='0x" DATA.LONG(A:0xb9e09c8) "' name='RPMH_VRM_ENABLE_SETTLING_BLOCK_ENABLE_CSR_REG9'/>"
WRITE #1 "        <register address='0xb9e0ac8' value='0x" DATA.LONG(A:0xb9e0ac8) "' name='RPMH_VRM_ENABLE_SETTLING_BLOCK_ENABLE_CSR_REG10'/>"
WRITE #1 "        <register address='0xb9e0bc8' value='0x" DATA.LONG(A:0xb9e0bc8) "' name='RPMH_VRM_ENABLE_SETTLING_BLOCK_ENABLE_CSR_REG11'/>"
WRITE #1 "        <register address='0xb9e0cc8' value='0x" DATA.LONG(A:0xb9e0cc8) "' name='RPMH_VRM_ENABLE_SETTLING_BLOCK_ENABLE_CSR_REG12'/>"
WRITE #1 "        <register address='0xb9e0dc8' value='0x" DATA.LONG(A:0xb9e0dc8) "' name='RPMH_VRM_ENABLE_SETTLING_BLOCK_ENABLE_CSR_REG13'/>"
WRITE #1 "        <register address='0xb9e0ec8' value='0x" DATA.LONG(A:0xb9e0ec8) "' name='RPMH_VRM_ENABLE_SETTLING_BLOCK_ENABLE_CSR_REG14'/>"
WRITE #1 "        <register address='0xb9e0fc8' value='0x" DATA.LONG(A:0xb9e0fc8) "' name='RPMH_VRM_ENABLE_SETTLING_BLOCK_ENABLE_CSR_REG15'/>"
WRITE #1 "        <register address='0xb9e10c8' value='0x" DATA.LONG(A:0xb9e10c8) "' name='RPMH_VRM_ENABLE_SETTLING_BLOCK_ENABLE_CSR_REG16'/>"
WRITE #1 "        <register address='0xb9e11c8' value='0x" DATA.LONG(A:0xb9e11c8) "' name='RPMH_VRM_ENABLE_SETTLING_BLOCK_ENABLE_CSR_REG17'/>"
WRITE #1 "        <register address='0xb9e12c8' value='0x" DATA.LONG(A:0xb9e12c8) "' name='RPMH_VRM_ENABLE_SETTLING_BLOCK_ENABLE_CSR_REG18'/>"
WRITE #1 "        <register address='0xb9e13c8' value='0x" DATA.LONG(A:0xb9e13c8) "' name='RPMH_VRM_ENABLE_SETTLING_BLOCK_ENABLE_CSR_REG19'/>"
WRITE #1 "        <register address='0xb9e14c8' value='0x" DATA.LONG(A:0xb9e14c8) "' name='RPMH_VRM_ENABLE_SETTLING_BLOCK_ENABLE_CSR_REG20'/>"
WRITE #1 "        <register address='0xb9e15c8' value='0x" DATA.LONG(A:0xb9e15c8) "' name='RPMH_VRM_ENABLE_SETTLING_BLOCK_ENABLE_CSR_REG21'/>"
WRITE #1 "        <register address='0xb9e16c8' value='0x" DATA.LONG(A:0xb9e16c8) "' name='RPMH_VRM_ENABLE_SETTLING_BLOCK_ENABLE_CSR_REG22'/>"
WRITE #1 "        <register address='0xb9e17c8' value='0x" DATA.LONG(A:0xb9e17c8) "' name='RPMH_VRM_ENABLE_SETTLING_BLOCK_ENABLE_CSR_REG23'/>"
WRITE #1 "        <register address='0xb9e18c8' value='0x" DATA.LONG(A:0xb9e18c8) "' name='RPMH_VRM_ENABLE_SETTLING_BLOCK_ENABLE_CSR_REG24'/>"
WRITE #1 "        <register address='0xb9e00cc' value='0x" DATA.LONG(A:0xb9e00cc) "' name='RPMH_VRM_MODE_SETTLING_BLOCK_ENABLE_CSR_REG0'/>"
WRITE #1 "        <register address='0xb9e01cc' value='0x" DATA.LONG(A:0xb9e01cc) "' name='RPMH_VRM_MODE_SETTLING_BLOCK_ENABLE_CSR_REG1'/>"
WRITE #1 "        <register address='0xb9e02cc' value='0x" DATA.LONG(A:0xb9e02cc) "' name='RPMH_VRM_MODE_SETTLING_BLOCK_ENABLE_CSR_REG2'/>"
WRITE #1 "        <register address='0xb9e03cc' value='0x" DATA.LONG(A:0xb9e03cc) "' name='RPMH_VRM_MODE_SETTLING_BLOCK_ENABLE_CSR_REG3'/>"
WRITE #1 "        <register address='0xb9e04cc' value='0x" DATA.LONG(A:0xb9e04cc) "' name='RPMH_VRM_MODE_SETTLING_BLOCK_ENABLE_CSR_REG4'/>"
WRITE #1 "        <register address='0xb9e05cc' value='0x" DATA.LONG(A:0xb9e05cc) "' name='RPMH_VRM_MODE_SETTLING_BLOCK_ENABLE_CSR_REG5'/>"
WRITE #1 "        <register address='0xb9e06cc' value='0x" DATA.LONG(A:0xb9e06cc) "' name='RPMH_VRM_MODE_SETTLING_BLOCK_ENABLE_CSR_REG6'/>"
WRITE #1 "        <register address='0xb9e07cc' value='0x" DATA.LONG(A:0xb9e07cc) "' name='RPMH_VRM_MODE_SETTLING_BLOCK_ENABLE_CSR_REG7'/>"
WRITE #1 "        <register address='0xb9e08cc' value='0x" DATA.LONG(A:0xb9e08cc) "' name='RPMH_VRM_MODE_SETTLING_BLOCK_ENABLE_CSR_REG8'/>"
WRITE #1 "        <register address='0xb9e09cc' value='0x" DATA.LONG(A:0xb9e09cc) "' name='RPMH_VRM_MODE_SETTLING_BLOCK_ENABLE_CSR_REG9'/>"
WRITE #1 "        <register address='0xb9e0acc' value='0x" DATA.LONG(A:0xb9e0acc) "' name='RPMH_VRM_MODE_SETTLING_BLOCK_ENABLE_CSR_REG10'/>"
WRITE #1 "        <register address='0xb9e0bcc' value='0x" DATA.LONG(A:0xb9e0bcc) "' name='RPMH_VRM_MODE_SETTLING_BLOCK_ENABLE_CSR_REG11'/>"
WRITE #1 "        <register address='0xb9e0ccc' value='0x" DATA.LONG(A:0xb9e0ccc) "' name='RPMH_VRM_MODE_SETTLING_BLOCK_ENABLE_CSR_REG12'/>"
WRITE #1 "        <register address='0xb9e0dcc' value='0x" DATA.LONG(A:0xb9e0dcc) "' name='RPMH_VRM_MODE_SETTLING_BLOCK_ENABLE_CSR_REG13'/>"
WRITE #1 "        <register address='0xb9e0ecc' value='0x" DATA.LONG(A:0xb9e0ecc) "' name='RPMH_VRM_MODE_SETTLING_BLOCK_ENABLE_CSR_REG14'/>"
WRITE #1 "        <register address='0xb9e0fcc' value='0x" DATA.LONG(A:0xb9e0fcc) "' name='RPMH_VRM_MODE_SETTLING_BLOCK_ENABLE_CSR_REG15'/>"
WRITE #1 "        <register address='0xb9e10cc' value='0x" DATA.LONG(A:0xb9e10cc) "' name='RPMH_VRM_MODE_SETTLING_BLOCK_ENABLE_CSR_REG16'/>"
WRITE #1 "        <register address='0xb9e11cc' value='0x" DATA.LONG(A:0xb9e11cc) "' name='RPMH_VRM_MODE_SETTLING_BLOCK_ENABLE_CSR_REG17'/>"
WRITE #1 "        <register address='0xb9e12cc' value='0x" DATA.LONG(A:0xb9e12cc) "' name='RPMH_VRM_MODE_SETTLING_BLOCK_ENABLE_CSR_REG18'/>"
WRITE #1 "        <register address='0xb9e13cc' value='0x" DATA.LONG(A:0xb9e13cc) "' name='RPMH_VRM_MODE_SETTLING_BLOCK_ENABLE_CSR_REG19'/>"
WRITE #1 "        <register address='0xb9e14cc' value='0x" DATA.LONG(A:0xb9e14cc) "' name='RPMH_VRM_MODE_SETTLING_BLOCK_ENABLE_CSR_REG20'/>"
WRITE #1 "        <register address='0xb9e15cc' value='0x" DATA.LONG(A:0xb9e15cc) "' name='RPMH_VRM_MODE_SETTLING_BLOCK_ENABLE_CSR_REG21'/>"
WRITE #1 "        <register address='0xb9e16cc' value='0x" DATA.LONG(A:0xb9e16cc) "' name='RPMH_VRM_MODE_SETTLING_BLOCK_ENABLE_CSR_REG22'/>"
WRITE #1 "        <register address='0xb9e17cc' value='0x" DATA.LONG(A:0xb9e17cc) "' name='RPMH_VRM_MODE_SETTLING_BLOCK_ENABLE_CSR_REG23'/>"
WRITE #1 "        <register address='0xb9e18cc' value='0x" DATA.LONG(A:0xb9e18cc) "' name='RPMH_VRM_MODE_SETTLING_BLOCK_ENABLE_CSR_REG24'/>"
WRITE #1 "        <register address='0xb9e00d4' value='0x" DATA.LONG(A:0xb9e00d4) "' name='RPMH_VRM_VREG_READY_ENABLE_CSR_REG0'/>"
WRITE #1 "        <register address='0xb9e01d4' value='0x" DATA.LONG(A:0xb9e01d4) "' name='RPMH_VRM_VREG_READY_ENABLE_CSR_REG1'/>"
WRITE #1 "        <register address='0xb9e02d4' value='0x" DATA.LONG(A:0xb9e02d4) "' name='RPMH_VRM_VREG_READY_ENABLE_CSR_REG2'/>"
WRITE #1 "        <register address='0xb9e03d4' value='0x" DATA.LONG(A:0xb9e03d4) "' name='RPMH_VRM_VREG_READY_ENABLE_CSR_REG3'/>"
WRITE #1 "        <register address='0xb9e04d4' value='0x" DATA.LONG(A:0xb9e04d4) "' name='RPMH_VRM_VREG_READY_ENABLE_CSR_REG4'/>"
WRITE #1 "        <register address='0xb9e05d4' value='0x" DATA.LONG(A:0xb9e05d4) "' name='RPMH_VRM_VREG_READY_ENABLE_CSR_REG5'/>"
WRITE #1 "        <register address='0xb9e06d4' value='0x" DATA.LONG(A:0xb9e06d4) "' name='RPMH_VRM_VREG_READY_ENABLE_CSR_REG6'/>"
WRITE #1 "        <register address='0xb9e07d4' value='0x" DATA.LONG(A:0xb9e07d4) "' name='RPMH_VRM_VREG_READY_ENABLE_CSR_REG7'/>"
WRITE #1 "        <register address='0xb9e08d4' value='0x" DATA.LONG(A:0xb9e08d4) "' name='RPMH_VRM_VREG_READY_ENABLE_CSR_REG8'/>"
WRITE #1 "        <register address='0xb9e09d4' value='0x" DATA.LONG(A:0xb9e09d4) "' name='RPMH_VRM_VREG_READY_ENABLE_CSR_REG9'/>"
WRITE #1 "        <register address='0xb9e0ad4' value='0x" DATA.LONG(A:0xb9e0ad4) "' name='RPMH_VRM_VREG_READY_ENABLE_CSR_REG10'/>"
WRITE #1 "        <register address='0xb9e0bd4' value='0x" DATA.LONG(A:0xb9e0bd4) "' name='RPMH_VRM_VREG_READY_ENABLE_CSR_REG11'/>"
WRITE #1 "        <register address='0xb9e0cd4' value='0x" DATA.LONG(A:0xb9e0cd4) "' name='RPMH_VRM_VREG_READY_ENABLE_CSR_REG12'/>"
WRITE #1 "        <register address='0xb9e0dd4' value='0x" DATA.LONG(A:0xb9e0dd4) "' name='RPMH_VRM_VREG_READY_ENABLE_CSR_REG13'/>"
WRITE #1 "        <register address='0xb9e0ed4' value='0x" DATA.LONG(A:0xb9e0ed4) "' name='RPMH_VRM_VREG_READY_ENABLE_CSR_REG14'/>"
WRITE #1 "        <register address='0xb9e0fd4' value='0x" DATA.LONG(A:0xb9e0fd4) "' name='RPMH_VRM_VREG_READY_ENABLE_CSR_REG15'/>"
WRITE #1 "        <register address='0xb9e10d4' value='0x" DATA.LONG(A:0xb9e10d4) "' name='RPMH_VRM_VREG_READY_ENABLE_CSR_REG16'/>"
WRITE #1 "        <register address='0xb9e11d4' value='0x" DATA.LONG(A:0xb9e11d4) "' name='RPMH_VRM_VREG_READY_ENABLE_CSR_REG17'/>"
WRITE #1 "        <register address='0xb9e12d4' value='0x" DATA.LONG(A:0xb9e12d4) "' name='RPMH_VRM_VREG_READY_ENABLE_CSR_REG18'/>"
WRITE #1 "        <register address='0xb9e13d4' value='0x" DATA.LONG(A:0xb9e13d4) "' name='RPMH_VRM_VREG_READY_ENABLE_CSR_REG19'/>"
WRITE #1 "        <register address='0xb9e14d4' value='0x" DATA.LONG(A:0xb9e14d4) "' name='RPMH_VRM_VREG_READY_ENABLE_CSR_REG20'/>"
WRITE #1 "        <register address='0xb9e15d4' value='0x" DATA.LONG(A:0xb9e15d4) "' name='RPMH_VRM_VREG_READY_ENABLE_CSR_REG21'/>"
WRITE #1 "        <register address='0xb9e16d4' value='0x" DATA.LONG(A:0xb9e16d4) "' name='RPMH_VRM_VREG_READY_ENABLE_CSR_REG22'/>"
WRITE #1 "        <register address='0xb9e17d4' value='0x" DATA.LONG(A:0xb9e17d4) "' name='RPMH_VRM_VREG_READY_ENABLE_CSR_REG23'/>"
WRITE #1 "        <register address='0xb9e18d4' value='0x" DATA.LONG(A:0xb9e18d4) "' name='RPMH_VRM_VREG_READY_ENABLE_CSR_REG24'/>"
WRITE #1 "        <register address='0xb9e00d8' value='0x" DATA.LONG(A:0xb9e00d8) "' name='RPMH_VRM_VREG_READY_WDOG_ERROR_ENABLE_CSR_REG0'/>"
WRITE #1 "        <register address='0xb9e01d8' value='0x" DATA.LONG(A:0xb9e01d8) "' name='RPMH_VRM_VREG_READY_WDOG_ERROR_ENABLE_CSR_REG1'/>"
WRITE #1 "        <register address='0xb9e02d8' value='0x" DATA.LONG(A:0xb9e02d8) "' name='RPMH_VRM_VREG_READY_WDOG_ERROR_ENABLE_CSR_REG2'/>"
WRITE #1 "        <register address='0xb9e03d8' value='0x" DATA.LONG(A:0xb9e03d8) "' name='RPMH_VRM_VREG_READY_WDOG_ERROR_ENABLE_CSR_REG3'/>"
WRITE #1 "        <register address='0xb9e04d8' value='0x" DATA.LONG(A:0xb9e04d8) "' name='RPMH_VRM_VREG_READY_WDOG_ERROR_ENABLE_CSR_REG4'/>"
WRITE #1 "        <register address='0xb9e05d8' value='0x" DATA.LONG(A:0xb9e05d8) "' name='RPMH_VRM_VREG_READY_WDOG_ERROR_ENABLE_CSR_REG5'/>"
WRITE #1 "        <register address='0xb9e06d8' value='0x" DATA.LONG(A:0xb9e06d8) "' name='RPMH_VRM_VREG_READY_WDOG_ERROR_ENABLE_CSR_REG6'/>"
WRITE #1 "        <register address='0xb9e07d8' value='0x" DATA.LONG(A:0xb9e07d8) "' name='RPMH_VRM_VREG_READY_WDOG_ERROR_ENABLE_CSR_REG7'/>"
WRITE #1 "        <register address='0xb9e08d8' value='0x" DATA.LONG(A:0xb9e08d8) "' name='RPMH_VRM_VREG_READY_WDOG_ERROR_ENABLE_CSR_REG8'/>"
WRITE #1 "        <register address='0xb9e09d8' value='0x" DATA.LONG(A:0xb9e09d8) "' name='RPMH_VRM_VREG_READY_WDOG_ERROR_ENABLE_CSR_REG9'/>"
WRITE #1 "        <register address='0xb9e0ad8' value='0x" DATA.LONG(A:0xb9e0ad8) "' name='RPMH_VRM_VREG_READY_WDOG_ERROR_ENABLE_CSR_REG10'/>"
WRITE #1 "        <register address='0xb9e0bd8' value='0x" DATA.LONG(A:0xb9e0bd8) "' name='RPMH_VRM_VREG_READY_WDOG_ERROR_ENABLE_CSR_REG11'/>"
WRITE #1 "        <register address='0xb9e0cd8' value='0x" DATA.LONG(A:0xb9e0cd8) "' name='RPMH_VRM_VREG_READY_WDOG_ERROR_ENABLE_CSR_REG12'/>"
WRITE #1 "        <register address='0xb9e0dd8' value='0x" DATA.LONG(A:0xb9e0dd8) "' name='RPMH_VRM_VREG_READY_WDOG_ERROR_ENABLE_CSR_REG13'/>"
WRITE #1 "        <register address='0xb9e0ed8' value='0x" DATA.LONG(A:0xb9e0ed8) "' name='RPMH_VRM_VREG_READY_WDOG_ERROR_ENABLE_CSR_REG14'/>"
WRITE #1 "        <register address='0xb9e0fd8' value='0x" DATA.LONG(A:0xb9e0fd8) "' name='RPMH_VRM_VREG_READY_WDOG_ERROR_ENABLE_CSR_REG15'/>"
WRITE #1 "        <register address='0xb9e10d8' value='0x" DATA.LONG(A:0xb9e10d8) "' name='RPMH_VRM_VREG_READY_WDOG_ERROR_ENABLE_CSR_REG16'/>"
WRITE #1 "        <register address='0xb9e11d8' value='0x" DATA.LONG(A:0xb9e11d8) "' name='RPMH_VRM_VREG_READY_WDOG_ERROR_ENABLE_CSR_REG17'/>"
WRITE #1 "        <register address='0xb9e12d8' value='0x" DATA.LONG(A:0xb9e12d8) "' name='RPMH_VRM_VREG_READY_WDOG_ERROR_ENABLE_CSR_REG18'/>"
WRITE #1 "        <register address='0xb9e13d8' value='0x" DATA.LONG(A:0xb9e13d8) "' name='RPMH_VRM_VREG_READY_WDOG_ERROR_ENABLE_CSR_REG19'/>"
WRITE #1 "        <register address='0xb9e14d8' value='0x" DATA.LONG(A:0xb9e14d8) "' name='RPMH_VRM_VREG_READY_WDOG_ERROR_ENABLE_CSR_REG20'/>"
WRITE #1 "        <register address='0xb9e15d8' value='0x" DATA.LONG(A:0xb9e15d8) "' name='RPMH_VRM_VREG_READY_WDOG_ERROR_ENABLE_CSR_REG21'/>"
WRITE #1 "        <register address='0xb9e16d8' value='0x" DATA.LONG(A:0xb9e16d8) "' name='RPMH_VRM_VREG_READY_WDOG_ERROR_ENABLE_CSR_REG22'/>"
WRITE #1 "        <register address='0xb9e17d8' value='0x" DATA.LONG(A:0xb9e17d8) "' name='RPMH_VRM_VREG_READY_WDOG_ERROR_ENABLE_CSR_REG23'/>"
WRITE #1 "        <register address='0xb9e18d8' value='0x" DATA.LONG(A:0xb9e18d8) "' name='RPMH_VRM_VREG_READY_WDOG_ERROR_ENABLE_CSR_REG24'/>"
WRITE #1 "        <register address='0xb9e00dc' value='0x" DATA.LONG(A:0xb9e00dc) "' name='RPMH_VRM_VREG_READY_LEGACY_MODE_CSR_REG0'/>"
WRITE #1 "        <register address='0xb9e01dc' value='0x" DATA.LONG(A:0xb9e01dc) "' name='RPMH_VRM_VREG_READY_LEGACY_MODE_CSR_REG1'/>"
WRITE #1 "        <register address='0xb9e02dc' value='0x" DATA.LONG(A:0xb9e02dc) "' name='RPMH_VRM_VREG_READY_LEGACY_MODE_CSR_REG2'/>"
WRITE #1 "        <register address='0xb9e03dc' value='0x" DATA.LONG(A:0xb9e03dc) "' name='RPMH_VRM_VREG_READY_LEGACY_MODE_CSR_REG3'/>"
WRITE #1 "        <register address='0xb9e04dc' value='0x" DATA.LONG(A:0xb9e04dc) "' name='RPMH_VRM_VREG_READY_LEGACY_MODE_CSR_REG4'/>"
WRITE #1 "        <register address='0xb9e05dc' value='0x" DATA.LONG(A:0xb9e05dc) "' name='RPMH_VRM_VREG_READY_LEGACY_MODE_CSR_REG5'/>"
WRITE #1 "        <register address='0xb9e06dc' value='0x" DATA.LONG(A:0xb9e06dc) "' name='RPMH_VRM_VREG_READY_LEGACY_MODE_CSR_REG6'/>"
WRITE #1 "        <register address='0xb9e07dc' value='0x" DATA.LONG(A:0xb9e07dc) "' name='RPMH_VRM_VREG_READY_LEGACY_MODE_CSR_REG7'/>"
WRITE #1 "        <register address='0xb9e08dc' value='0x" DATA.LONG(A:0xb9e08dc) "' name='RPMH_VRM_VREG_READY_LEGACY_MODE_CSR_REG8'/>"
WRITE #1 "        <register address='0xb9e09dc' value='0x" DATA.LONG(A:0xb9e09dc) "' name='RPMH_VRM_VREG_READY_LEGACY_MODE_CSR_REG9'/>"
WRITE #1 "        <register address='0xb9e0adc' value='0x" DATA.LONG(A:0xb9e0adc) "' name='RPMH_VRM_VREG_READY_LEGACY_MODE_CSR_REG10'/>"
WRITE #1 "        <register address='0xb9e0bdc' value='0x" DATA.LONG(A:0xb9e0bdc) "' name='RPMH_VRM_VREG_READY_LEGACY_MODE_CSR_REG11'/>"
WRITE #1 "        <register address='0xb9e0cdc' value='0x" DATA.LONG(A:0xb9e0cdc) "' name='RPMH_VRM_VREG_READY_LEGACY_MODE_CSR_REG12'/>"
WRITE #1 "        <register address='0xb9e0ddc' value='0x" DATA.LONG(A:0xb9e0ddc) "' name='RPMH_VRM_VREG_READY_LEGACY_MODE_CSR_REG13'/>"
WRITE #1 "        <register address='0xb9e0edc' value='0x" DATA.LONG(A:0xb9e0edc) "' name='RPMH_VRM_VREG_READY_LEGACY_MODE_CSR_REG14'/>"
WRITE #1 "        <register address='0xb9e0fdc' value='0x" DATA.LONG(A:0xb9e0fdc) "' name='RPMH_VRM_VREG_READY_LEGACY_MODE_CSR_REG15'/>"
WRITE #1 "        <register address='0xb9e10dc' value='0x" DATA.LONG(A:0xb9e10dc) "' name='RPMH_VRM_VREG_READY_LEGACY_MODE_CSR_REG16'/>"
WRITE #1 "        <register address='0xb9e11dc' value='0x" DATA.LONG(A:0xb9e11dc) "' name='RPMH_VRM_VREG_READY_LEGACY_MODE_CSR_REG17'/>"
WRITE #1 "        <register address='0xb9e12dc' value='0x" DATA.LONG(A:0xb9e12dc) "' name='RPMH_VRM_VREG_READY_LEGACY_MODE_CSR_REG18'/>"
WRITE #1 "        <register address='0xb9e13dc' value='0x" DATA.LONG(A:0xb9e13dc) "' name='RPMH_VRM_VREG_READY_LEGACY_MODE_CSR_REG19'/>"
WRITE #1 "        <register address='0xb9e14dc' value='0x" DATA.LONG(A:0xb9e14dc) "' name='RPMH_VRM_VREG_READY_LEGACY_MODE_CSR_REG20'/>"
WRITE #1 "        <register address='0xb9e15dc' value='0x" DATA.LONG(A:0xb9e15dc) "' name='RPMH_VRM_VREG_READY_LEGACY_MODE_CSR_REG21'/>"
WRITE #1 "        <register address='0xb9e16dc' value='0x" DATA.LONG(A:0xb9e16dc) "' name='RPMH_VRM_VREG_READY_LEGACY_MODE_CSR_REG22'/>"
WRITE #1 "        <register address='0xb9e17dc' value='0x" DATA.LONG(A:0xb9e17dc) "' name='RPMH_VRM_VREG_READY_LEGACY_MODE_CSR_REG23'/>"
WRITE #1 "        <register address='0xb9e18dc' value='0x" DATA.LONG(A:0xb9e18dc) "' name='RPMH_VRM_VREG_READY_LEGACY_MODE_CSR_REG24'/>"
WRITE #1 "        <register address='0xb9e1980' value='0x" DATA.LONG(A:0xb9e1980) "' name='RPMH_VRM_TYPE_CSR_XOB0'/>"
WRITE #1 "        <register address='0xb9e1a80' value='0x" DATA.LONG(A:0xb9e1a80) "' name='RPMH_VRM_TYPE_CSR_XOB1'/>"
WRITE #1 "        <register address='0xb9e1b80' value='0x" DATA.LONG(A:0xb9e1b80) "' name='RPMH_VRM_TYPE_CSR_XOB2'/>"
WRITE #1 "        <register address='0xb9e1c80' value='0x" DATA.LONG(A:0xb9e1c80) "' name='RPMH_VRM_TYPE_CSR_XOB3'/>"
WRITE #1 "        <register address='0xb9e1d80' value='0x" DATA.LONG(A:0xb9e1d80) "' name='RPMH_VRM_TYPE_CSR_XOB4'/>"
WRITE #1 "        <register address='0xb9e1e80' value='0x" DATA.LONG(A:0xb9e1e80) "' name='RPMH_VRM_TYPE_CSR_XOB5'/>"
WRITE #1 "        <register address='0xb9e1f80' value='0x" DATA.LONG(A:0xb9e1f80) "' name='RPMH_VRM_TYPE_CSR_XOB6'/>"
WRITE #1 "        <register address='0xb9e2080' value='0x" DATA.LONG(A:0xb9e2080) "' name='RPMH_VRM_TYPE_CSR_XOB7'/>"
WRITE #1 "        <register address='0xb9e2180' value='0x" DATA.LONG(A:0xb9e2180) "' name='RPMH_VRM_TYPE_CSR_XOB8'/>"
WRITE #1 "        <register address='0xb9e2280' value='0x" DATA.LONG(A:0xb9e2280) "' name='RPMH_VRM_TYPE_CSR_XOB9'/>"
WRITE #1 "        <register address='0xb9e2380' value='0x" DATA.LONG(A:0xb9e2380) "' name='RPMH_VRM_TYPE_CSR_XOB10'/>"
WRITE #1 "        <register address='0xb9e2480' value='0x" DATA.LONG(A:0xb9e2480) "' name='RPMH_VRM_TYPE_CSR_XOB11'/>"
WRITE #1 "        <register address='0xb9e2580' value='0x" DATA.LONG(A:0xb9e2580) "' name='RPMH_VRM_TYPE_CSR_XOB12'/>"
WRITE #1 "        <register address='0xb9e2680' value='0x" DATA.LONG(A:0xb9e2680) "' name='RPMH_VRM_TYPE_CSR_XOB13'/>"
WRITE #1 "        <register address='0xb9e2780' value='0x" DATA.LONG(A:0xb9e2780) "' name='RPMH_VRM_TYPE_CSR_XOB14'/>"
WRITE #1 "        <register address='0xb9e2880' value='0x" DATA.LONG(A:0xb9e2880) "' name='RPMH_VRM_TYPE_CSR_XOB15'/>"
WRITE #1 "        <register address='0xb9e1984' value='0x" DATA.LONG(A:0xb9e1984) "' name='RPMH_VRM_BASE_ADDR_CSR_XOB0'/>"
WRITE #1 "        <register address='0xb9e1a84' value='0x" DATA.LONG(A:0xb9e1a84) "' name='RPMH_VRM_BASE_ADDR_CSR_XOB1'/>"
WRITE #1 "        <register address='0xb9e1b84' value='0x" DATA.LONG(A:0xb9e1b84) "' name='RPMH_VRM_BASE_ADDR_CSR_XOB2'/>"
WRITE #1 "        <register address='0xb9e1c84' value='0x" DATA.LONG(A:0xb9e1c84) "' name='RPMH_VRM_BASE_ADDR_CSR_XOB3'/>"
WRITE #1 "        <register address='0xb9e1d84' value='0x" DATA.LONG(A:0xb9e1d84) "' name='RPMH_VRM_BASE_ADDR_CSR_XOB4'/>"
WRITE #1 "        <register address='0xb9e1e84' value='0x" DATA.LONG(A:0xb9e1e84) "' name='RPMH_VRM_BASE_ADDR_CSR_XOB5'/>"
WRITE #1 "        <register address='0xb9e1f84' value='0x" DATA.LONG(A:0xb9e1f84) "' name='RPMH_VRM_BASE_ADDR_CSR_XOB6'/>"
WRITE #1 "        <register address='0xb9e2084' value='0x" DATA.LONG(A:0xb9e2084) "' name='RPMH_VRM_BASE_ADDR_CSR_XOB7'/>"
WRITE #1 "        <register address='0xb9e2184' value='0x" DATA.LONG(A:0xb9e2184) "' name='RPMH_VRM_BASE_ADDR_CSR_XOB8'/>"
WRITE #1 "        <register address='0xb9e2284' value='0x" DATA.LONG(A:0xb9e2284) "' name='RPMH_VRM_BASE_ADDR_CSR_XOB9'/>"
WRITE #1 "        <register address='0xb9e2384' value='0x" DATA.LONG(A:0xb9e2384) "' name='RPMH_VRM_BASE_ADDR_CSR_XOB10'/>"
WRITE #1 "        <register address='0xb9e2484' value='0x" DATA.LONG(A:0xb9e2484) "' name='RPMH_VRM_BASE_ADDR_CSR_XOB11'/>"
WRITE #1 "        <register address='0xb9e2584' value='0x" DATA.LONG(A:0xb9e2584) "' name='RPMH_VRM_BASE_ADDR_CSR_XOB12'/>"
WRITE #1 "        <register address='0xb9e2684' value='0x" DATA.LONG(A:0xb9e2684) "' name='RPMH_VRM_BASE_ADDR_CSR_XOB13'/>"
WRITE #1 "        <register address='0xb9e2784' value='0x" DATA.LONG(A:0xb9e2784) "' name='RPMH_VRM_BASE_ADDR_CSR_XOB14'/>"
WRITE #1 "        <register address='0xb9e2884' value='0x" DATA.LONG(A:0xb9e2884) "' name='RPMH_VRM_BASE_ADDR_CSR_XOB15'/>"
WRITE #1 "        <register address='0xb9e1990' value='0x" DATA.LONG(A:0xb9e1990) "' name='RPMH_VRM_ENABLE_SEQ_ID_CSR_XOB0'/>"
WRITE #1 "        <register address='0xb9e1a90' value='0x" DATA.LONG(A:0xb9e1a90) "' name='RPMH_VRM_ENABLE_SEQ_ID_CSR_XOB1'/>"
WRITE #1 "        <register address='0xb9e1b90' value='0x" DATA.LONG(A:0xb9e1b90) "' name='RPMH_VRM_ENABLE_SEQ_ID_CSR_XOB2'/>"
WRITE #1 "        <register address='0xb9e1c90' value='0x" DATA.LONG(A:0xb9e1c90) "' name='RPMH_VRM_ENABLE_SEQ_ID_CSR_XOB3'/>"
WRITE #1 "        <register address='0xb9e1d90' value='0x" DATA.LONG(A:0xb9e1d90) "' name='RPMH_VRM_ENABLE_SEQ_ID_CSR_XOB4'/>"
WRITE #1 "        <register address='0xb9e1e90' value='0x" DATA.LONG(A:0xb9e1e90) "' name='RPMH_VRM_ENABLE_SEQ_ID_CSR_XOB5'/>"
WRITE #1 "        <register address='0xb9e1f90' value='0x" DATA.LONG(A:0xb9e1f90) "' name='RPMH_VRM_ENABLE_SEQ_ID_CSR_XOB6'/>"
WRITE #1 "        <register address='0xb9e2090' value='0x" DATA.LONG(A:0xb9e2090) "' name='RPMH_VRM_ENABLE_SEQ_ID_CSR_XOB7'/>"
WRITE #1 "        <register address='0xb9e2190' value='0x" DATA.LONG(A:0xb9e2190) "' name='RPMH_VRM_ENABLE_SEQ_ID_CSR_XOB8'/>"
WRITE #1 "        <register address='0xb9e2290' value='0x" DATA.LONG(A:0xb9e2290) "' name='RPMH_VRM_ENABLE_SEQ_ID_CSR_XOB9'/>"
WRITE #1 "        <register address='0xb9e2390' value='0x" DATA.LONG(A:0xb9e2390) "' name='RPMH_VRM_ENABLE_SEQ_ID_CSR_XOB10'/>"
WRITE #1 "        <register address='0xb9e2490' value='0x" DATA.LONG(A:0xb9e2490) "' name='RPMH_VRM_ENABLE_SEQ_ID_CSR_XOB11'/>"
WRITE #1 "        <register address='0xb9e2590' value='0x" DATA.LONG(A:0xb9e2590) "' name='RPMH_VRM_ENABLE_SEQ_ID_CSR_XOB12'/>"
WRITE #1 "        <register address='0xb9e2690' value='0x" DATA.LONG(A:0xb9e2690) "' name='RPMH_VRM_ENABLE_SEQ_ID_CSR_XOB13'/>"
WRITE #1 "        <register address='0xb9e2790' value='0x" DATA.LONG(A:0xb9e2790) "' name='RPMH_VRM_ENABLE_SEQ_ID_CSR_XOB14'/>"
WRITE #1 "        <register address='0xb9e2890' value='0x" DATA.LONG(A:0xb9e2890) "' name='RPMH_VRM_ENABLE_SEQ_ID_CSR_XOB15'/>"
WRITE #1 "        <register address='0xb9e19ac' value='0x" DATA.LONG(A:0xb9e19ac) "' name='RPMH_VRM_ENABLE_DEP_ENABLE_CSR_XOB0'/>"
WRITE #1 "        <register address='0xb9e1aac' value='0x" DATA.LONG(A:0xb9e1aac) "' name='RPMH_VRM_ENABLE_DEP_ENABLE_CSR_XOB1'/>"
WRITE #1 "        <register address='0xb9e1bac' value='0x" DATA.LONG(A:0xb9e1bac) "' name='RPMH_VRM_ENABLE_DEP_ENABLE_CSR_XOB2'/>"
WRITE #1 "        <register address='0xb9e1cac' value='0x" DATA.LONG(A:0xb9e1cac) "' name='RPMH_VRM_ENABLE_DEP_ENABLE_CSR_XOB3'/>"
WRITE #1 "        <register address='0xb9e1dac' value='0x" DATA.LONG(A:0xb9e1dac) "' name='RPMH_VRM_ENABLE_DEP_ENABLE_CSR_XOB4'/>"
WRITE #1 "        <register address='0xb9e1eac' value='0x" DATA.LONG(A:0xb9e1eac) "' name='RPMH_VRM_ENABLE_DEP_ENABLE_CSR_XOB5'/>"
WRITE #1 "        <register address='0xb9e1fac' value='0x" DATA.LONG(A:0xb9e1fac) "' name='RPMH_VRM_ENABLE_DEP_ENABLE_CSR_XOB6'/>"
WRITE #1 "        <register address='0xb9e20ac' value='0x" DATA.LONG(A:0xb9e20ac) "' name='RPMH_VRM_ENABLE_DEP_ENABLE_CSR_XOB7'/>"
WRITE #1 "        <register address='0xb9e21ac' value='0x" DATA.LONG(A:0xb9e21ac) "' name='RPMH_VRM_ENABLE_DEP_ENABLE_CSR_XOB8'/>"
WRITE #1 "        <register address='0xb9e22ac' value='0x" DATA.LONG(A:0xb9e22ac) "' name='RPMH_VRM_ENABLE_DEP_ENABLE_CSR_XOB9'/>"
WRITE #1 "        <register address='0xb9e23ac' value='0x" DATA.LONG(A:0xb9e23ac) "' name='RPMH_VRM_ENABLE_DEP_ENABLE_CSR_XOB10'/>"
WRITE #1 "        <register address='0xb9e24ac' value='0x" DATA.LONG(A:0xb9e24ac) "' name='RPMH_VRM_ENABLE_DEP_ENABLE_CSR_XOB11'/>"
WRITE #1 "        <register address='0xb9e25ac' value='0x" DATA.LONG(A:0xb9e25ac) "' name='RPMH_VRM_ENABLE_DEP_ENABLE_CSR_XOB12'/>"
WRITE #1 "        <register address='0xb9e26ac' value='0x" DATA.LONG(A:0xb9e26ac) "' name='RPMH_VRM_ENABLE_DEP_ENABLE_CSR_XOB13'/>"
WRITE #1 "        <register address='0xb9e27ac' value='0x" DATA.LONG(A:0xb9e27ac) "' name='RPMH_VRM_ENABLE_DEP_ENABLE_CSR_XOB14'/>"
WRITE #1 "        <register address='0xb9e28ac' value='0x" DATA.LONG(A:0xb9e28ac) "' name='RPMH_VRM_ENABLE_DEP_ENABLE_CSR_XOB15'/>"
WRITE #1 "        <register address='0xb9e19c8' value='0x" DATA.LONG(A:0xb9e19c8) "' name='RPMH_VRM_ENABLE_SETTLING_BLOCK_ENABLE_CSR_XOB0'/>"
WRITE #1 "        <register address='0xb9e1ac8' value='0x" DATA.LONG(A:0xb9e1ac8) "' name='RPMH_VRM_ENABLE_SETTLING_BLOCK_ENABLE_CSR_XOB1'/>"
WRITE #1 "        <register address='0xb9e1bc8' value='0x" DATA.LONG(A:0xb9e1bc8) "' name='RPMH_VRM_ENABLE_SETTLING_BLOCK_ENABLE_CSR_XOB2'/>"
WRITE #1 "        <register address='0xb9e1cc8' value='0x" DATA.LONG(A:0xb9e1cc8) "' name='RPMH_VRM_ENABLE_SETTLING_BLOCK_ENABLE_CSR_XOB3'/>"
WRITE #1 "        <register address='0xb9e1dc8' value='0x" DATA.LONG(A:0xb9e1dc8) "' name='RPMH_VRM_ENABLE_SETTLING_BLOCK_ENABLE_CSR_XOB4'/>"
WRITE #1 "        <register address='0xb9e1ec8' value='0x" DATA.LONG(A:0xb9e1ec8) "' name='RPMH_VRM_ENABLE_SETTLING_BLOCK_ENABLE_CSR_XOB5'/>"
WRITE #1 "        <register address='0xb9e1fc8' value='0x" DATA.LONG(A:0xb9e1fc8) "' name='RPMH_VRM_ENABLE_SETTLING_BLOCK_ENABLE_CSR_XOB6'/>"
WRITE #1 "        <register address='0xb9e20c8' value='0x" DATA.LONG(A:0xb9e20c8) "' name='RPMH_VRM_ENABLE_SETTLING_BLOCK_ENABLE_CSR_XOB7'/>"
WRITE #1 "        <register address='0xb9e21c8' value='0x" DATA.LONG(A:0xb9e21c8) "' name='RPMH_VRM_ENABLE_SETTLING_BLOCK_ENABLE_CSR_XOB8'/>"
WRITE #1 "        <register address='0xb9e22c8' value='0x" DATA.LONG(A:0xb9e22c8) "' name='RPMH_VRM_ENABLE_SETTLING_BLOCK_ENABLE_CSR_XOB9'/>"
WRITE #1 "        <register address='0xb9e23c8' value='0x" DATA.LONG(A:0xb9e23c8) "' name='RPMH_VRM_ENABLE_SETTLING_BLOCK_ENABLE_CSR_XOB10'/>"
WRITE #1 "        <register address='0xb9e24c8' value='0x" DATA.LONG(A:0xb9e24c8) "' name='RPMH_VRM_ENABLE_SETTLING_BLOCK_ENABLE_CSR_XOB11'/>"
WRITE #1 "        <register address='0xb9e25c8' value='0x" DATA.LONG(A:0xb9e25c8) "' name='RPMH_VRM_ENABLE_SETTLING_BLOCK_ENABLE_CSR_XOB12'/>"
WRITE #1 "        <register address='0xb9e26c8' value='0x" DATA.LONG(A:0xb9e26c8) "' name='RPMH_VRM_ENABLE_SETTLING_BLOCK_ENABLE_CSR_XOB13'/>"
WRITE #1 "        <register address='0xb9e27c8' value='0x" DATA.LONG(A:0xb9e27c8) "' name='RPMH_VRM_ENABLE_SETTLING_BLOCK_ENABLE_CSR_XOB14'/>"
WRITE #1 "        <register address='0xb9e28c8' value='0x" DATA.LONG(A:0xb9e28c8) "' name='RPMH_VRM_ENABLE_SETTLING_BLOCK_ENABLE_CSR_XOB15'/>"
WRITE #1 "        <register address='0xb9e19cc' value='0x" DATA.LONG(A:0xb9e19cc) "' name='RPMH_VRM_XOB_READY_ENABLE_CSR_REG0'/>"
WRITE #1 "        <register address='0xb9e1acc' value='0x" DATA.LONG(A:0xb9e1acc) "' name='RPMH_VRM_XOB_READY_ENABLE_CSR_REG1'/>"
WRITE #1 "        <register address='0xb9e1bcc' value='0x" DATA.LONG(A:0xb9e1bcc) "' name='RPMH_VRM_XOB_READY_ENABLE_CSR_REG2'/>"
WRITE #1 "        <register address='0xb9e1ccc' value='0x" DATA.LONG(A:0xb9e1ccc) "' name='RPMH_VRM_XOB_READY_ENABLE_CSR_REG3'/>"
WRITE #1 "        <register address='0xb9e1dcc' value='0x" DATA.LONG(A:0xb9e1dcc) "' name='RPMH_VRM_XOB_READY_ENABLE_CSR_REG4'/>"
WRITE #1 "        <register address='0xb9e1ecc' value='0x" DATA.LONG(A:0xb9e1ecc) "' name='RPMH_VRM_XOB_READY_ENABLE_CSR_REG5'/>"
WRITE #1 "        <register address='0xb9e1fcc' value='0x" DATA.LONG(A:0xb9e1fcc) "' name='RPMH_VRM_XOB_READY_ENABLE_CSR_REG6'/>"
WRITE #1 "        <register address='0xb9e20cc' value='0x" DATA.LONG(A:0xb9e20cc) "' name='RPMH_VRM_XOB_READY_ENABLE_CSR_REG7'/>"
WRITE #1 "        <register address='0xb9e21cc' value='0x" DATA.LONG(A:0xb9e21cc) "' name='RPMH_VRM_XOB_READY_ENABLE_CSR_REG8'/>"
WRITE #1 "        <register address='0xb9e22cc' value='0x" DATA.LONG(A:0xb9e22cc) "' name='RPMH_VRM_XOB_READY_ENABLE_CSR_REG9'/>"
WRITE #1 "        <register address='0xb9e23cc' value='0x" DATA.LONG(A:0xb9e23cc) "' name='RPMH_VRM_XOB_READY_ENABLE_CSR_REG10'/>"
WRITE #1 "        <register address='0xb9e24cc' value='0x" DATA.LONG(A:0xb9e24cc) "' name='RPMH_VRM_XOB_READY_ENABLE_CSR_REG11'/>"
WRITE #1 "        <register address='0xb9e25cc' value='0x" DATA.LONG(A:0xb9e25cc) "' name='RPMH_VRM_XOB_READY_ENABLE_CSR_REG12'/>"
WRITE #1 "        <register address='0xb9e26cc' value='0x" DATA.LONG(A:0xb9e26cc) "' name='RPMH_VRM_XOB_READY_ENABLE_CSR_REG13'/>"
WRITE #1 "        <register address='0xb9e27cc' value='0x" DATA.LONG(A:0xb9e27cc) "' name='RPMH_VRM_XOB_READY_ENABLE_CSR_REG14'/>"
WRITE #1 "        <register address='0xb9e28cc' value='0x" DATA.LONG(A:0xb9e28cc) "' name='RPMH_VRM_XOB_READY_ENABLE_CSR_REG15'/>"
WRITE #1 "        <register address='0xb9e2980' value='0x" DATA.LONG(A:0xb9e2980) "' name='RPMH_VRM_TYPE_CSR_XO0'/>"
WRITE #1 "        <register address='0xb9e2984' value='0x" DATA.LONG(A:0xb9e2984) "' name='RPMH_VRM_BASE_ADDR_CSR_XO0'/>"
WRITE #1 "        <register address='0xb9e2990' value='0x" DATA.LONG(A:0xb9e2990) "' name='RPMH_VRM_ENABLE_SEQ_ID_CSR_XO0'/>"
WRITE #1 "        <register address='0xb9e29ac' value='0x" DATA.LONG(A:0xb9e29ac) "' name='RPMH_VRM_ENABLE_DEP_ENABLE_CSR_XO0'/>"
WRITE #1 "        <register address='0xb9e29c8' value='0x" DATA.LONG(A:0xb9e29c8) "' name='RPMH_VRM_ENABLE_SETTLING_BLOCK_ENABLE_CSR_XO0'/>"
WRITE #1 "        <register address='0xb9e29cc' value='0x" DATA.LONG(A:0xb9e29cc) "' name='RPMH_VRM_XO_READY_ENABLE_CSR_REG0'/>"
WRITE #1 "        <register address='0xb9e24e4' value='0x" DATA.LONG(A:0xb9e24e4) "' name='RPMH_VRM_VOLTAGE_ENABLE_SETTLING_DEP_ENABLE_CSR_REG0'/>"
WRITE #1 "        <register address='0xb9e25e4' value='0x" DATA.LONG(A:0xb9e25e4) "' name='RPMH_VRM_VOLTAGE_ENABLE_SETTLING_DEP_ENABLE_CSR_REG1'/>"
WRITE #1 "        <register address='0xb9e26e4' value='0x" DATA.LONG(A:0xb9e26e4) "' name='RPMH_VRM_VOLTAGE_ENABLE_SETTLING_DEP_ENABLE_CSR_REG2'/>"
WRITE #1 "        <register address='0xb9e27e4' value='0x" DATA.LONG(A:0xb9e27e4) "' name='RPMH_VRM_VOLTAGE_ENABLE_SETTLING_DEP_ENABLE_CSR_REG3'/>"
WRITE #1 "        <register address='0xb9e28e4' value='0x" DATA.LONG(A:0xb9e28e4) "' name='RPMH_VRM_VOLTAGE_ENABLE_SETTLING_DEP_ENABLE_CSR_REG4'/>"
WRITE #1 "        <register address='0xb9e29e4' value='0x" DATA.LONG(A:0xb9e29e4) "' name='RPMH_VRM_VOLTAGE_ENABLE_SETTLING_DEP_ENABLE_CSR_REG5'/>"
WRITE #1 "        <register address='0xb9e2ae4' value='0x" DATA.LONG(A:0xb9e2ae4) "' name='RPMH_VRM_VOLTAGE_ENABLE_SETTLING_DEP_ENABLE_CSR_REG6'/>"
WRITE #1 "        <register address='0xb9e2be4' value='0x" DATA.LONG(A:0xb9e2be4) "' name='RPMH_VRM_VOLTAGE_ENABLE_SETTLING_DEP_ENABLE_CSR_REG7'/>"
WRITE #1 "        <register address='0xb9e2ce4' value='0x" DATA.LONG(A:0xb9e2ce4) "' name='RPMH_VRM_VOLTAGE_ENABLE_SETTLING_DEP_ENABLE_CSR_REG8'/>"
WRITE #1 "        <register address='0xb9e2de4' value='0x" DATA.LONG(A:0xb9e2de4) "' name='RPMH_VRM_VOLTAGE_ENABLE_SETTLING_DEP_ENABLE_CSR_REG9'/>"
WRITE #1 "        <register address='0xb9e2ee4' value='0x" DATA.LONG(A:0xb9e2ee4) "' name='RPMH_VRM_VOLTAGE_ENABLE_SETTLING_DEP_ENABLE_CSR_REG10'/>"
WRITE #1 "        <register address='0xb9e2fe4' value='0x" DATA.LONG(A:0xb9e2fe4) "' name='RPMH_VRM_VOLTAGE_ENABLE_SETTLING_DEP_ENABLE_CSR_REG11'/>"
WRITE #1 "        <register address='0xb9e30e4' value='0x" DATA.LONG(A:0xb9e30e4) "' name='RPMH_VRM_VOLTAGE_ENABLE_SETTLING_DEP_ENABLE_CSR_REG12'/>"
WRITE #1 "        <register address='0xb9e31e4' value='0x" DATA.LONG(A:0xb9e31e4) "' name='RPMH_VRM_VOLTAGE_ENABLE_SETTLING_DEP_ENABLE_CSR_REG13'/>"
WRITE #1 "        <register address='0xb9e32e4' value='0x" DATA.LONG(A:0xb9e32e4) "' name='RPMH_VRM_VOLTAGE_ENABLE_SETTLING_DEP_ENABLE_CSR_REG14'/>"
WRITE #1 "        <register address='0xb9e33e4' value='0x" DATA.LONG(A:0xb9e33e4) "' name='RPMH_VRM_VOLTAGE_ENABLE_SETTLING_DEP_ENABLE_CSR_REG15'/>"
WRITE #1 "        <register address='0xb9e34e4' value='0x" DATA.LONG(A:0xb9e34e4) "' name='RPMH_VRM_VOLTAGE_ENABLE_SETTLING_DEP_ENABLE_CSR_REG16'/>"
WRITE #1 "        <register address='0xb9e35e4' value='0x" DATA.LONG(A:0xb9e35e4) "' name='RPMH_VRM_VOLTAGE_ENABLE_SETTLING_DEP_ENABLE_CSR_REG17'/>"
WRITE #1 "        <register address='0xb9e36e4' value='0x" DATA.LONG(A:0xb9e36e4) "' name='RPMH_VRM_VOLTAGE_ENABLE_SETTLING_DEP_ENABLE_CSR_REG18'/>"
WRITE #1 "        <register address='0xb9e37e4' value='0x" DATA.LONG(A:0xb9e37e4) "' name='RPMH_VRM_VOLTAGE_ENABLE_SETTLING_DEP_ENABLE_CSR_REG19'/>"
WRITE #1 "        <register address='0xb9e38e4' value='0x" DATA.LONG(A:0xb9e38e4) "' name='RPMH_VRM_VOLTAGE_ENABLE_SETTLING_DEP_ENABLE_CSR_REG20'/>"
WRITE #1 "        <register address='0xb9e39e4' value='0x" DATA.LONG(A:0xb9e39e4) "' name='RPMH_VRM_VOLTAGE_ENABLE_SETTLING_DEP_ENABLE_CSR_REG21'/>"
WRITE #1 "        <register address='0xb9e3ae4' value='0x" DATA.LONG(A:0xb9e3ae4) "' name='RPMH_VRM_VOLTAGE_ENABLE_SETTLING_DEP_ENABLE_CSR_REG22'/>"
WRITE #1 "        <register address='0xb9e3be4' value='0x" DATA.LONG(A:0xb9e3be4) "' name='RPMH_VRM_VOLTAGE_ENABLE_SETTLING_DEP_ENABLE_CSR_REG23'/>"
WRITE #1 "        <register address='0xb9e3ce4' value='0x" DATA.LONG(A:0xb9e3ce4) "' name='RPMH_VRM_VOLTAGE_ENABLE_SETTLING_DEP_ENABLE_CSR_REG24'/>"
WRITE #1 "        <register address='0xb9e00fc' value='0x" DATA.LONG(A:0xb9e00fc) "' name='RPMH_VRM_SW_WORKAROUND_CSR_REG0'/>"
WRITE #1 "        <register address='0xb9e01fc' value='0x" DATA.LONG(A:0xb9e01fc) "' name='RPMH_VRM_SW_WORKAROUND_CSR_REG1'/>"
WRITE #1 "        <register address='0xb9e02fc' value='0x" DATA.LONG(A:0xb9e02fc) "' name='RPMH_VRM_SW_WORKAROUND_CSR_REG2'/>"
WRITE #1 "        <register address='0xb9e03fc' value='0x" DATA.LONG(A:0xb9e03fc) "' name='RPMH_VRM_SW_WORKAROUND_CSR_REG3'/>"
WRITE #1 "        <register address='0xb9e04fc' value='0x" DATA.LONG(A:0xb9e04fc) "' name='RPMH_VRM_SW_WORKAROUND_CSR_REG4'/>"
WRITE #1 "        <register address='0xb9e05fc' value='0x" DATA.LONG(A:0xb9e05fc) "' name='RPMH_VRM_SW_WORKAROUND_CSR_REG5'/>"
WRITE #1 "        <register address='0xb9e06fc' value='0x" DATA.LONG(A:0xb9e06fc) "' name='RPMH_VRM_SW_WORKAROUND_CSR_REG6'/>"
WRITE #1 "        <register address='0xb9e07fc' value='0x" DATA.LONG(A:0xb9e07fc) "' name='RPMH_VRM_SW_WORKAROUND_CSR_REG7'/>"
WRITE #1 "        <register address='0xb9e08fc' value='0x" DATA.LONG(A:0xb9e08fc) "' name='RPMH_VRM_SW_WORKAROUND_CSR_REG8'/>"
WRITE #1 "        <register address='0xb9e09fc' value='0x" DATA.LONG(A:0xb9e09fc) "' name='RPMH_VRM_SW_WORKAROUND_CSR_REG9'/>"
WRITE #1 "        <register address='0xb9e0afc' value='0x" DATA.LONG(A:0xb9e0afc) "' name='RPMH_VRM_SW_WORKAROUND_CSR_REG10'/>"
WRITE #1 "        <register address='0xb9e0bfc' value='0x" DATA.LONG(A:0xb9e0bfc) "' name='RPMH_VRM_SW_WORKAROUND_CSR_REG11'/>"
WRITE #1 "        <register address='0xb9e0cfc' value='0x" DATA.LONG(A:0xb9e0cfc) "' name='RPMH_VRM_SW_WORKAROUND_CSR_REG12'/>"
WRITE #1 "        <register address='0xb9e0dfc' value='0x" DATA.LONG(A:0xb9e0dfc) "' name='RPMH_VRM_SW_WORKAROUND_CSR_REG13'/>"
WRITE #1 "        <register address='0xb9e0efc' value='0x" DATA.LONG(A:0xb9e0efc) "' name='RPMH_VRM_SW_WORKAROUND_CSR_REG14'/>"
WRITE #1 "        <register address='0xb9e0ffc' value='0x" DATA.LONG(A:0xb9e0ffc) "' name='RPMH_VRM_SW_WORKAROUND_CSR_REG15'/>"
WRITE #1 "        <register address='0xb9e10fc' value='0x" DATA.LONG(A:0xb9e10fc) "' name='RPMH_VRM_SW_WORKAROUND_CSR_REG16'/>"
WRITE #1 "        <register address='0xb9e11fc' value='0x" DATA.LONG(A:0xb9e11fc) "' name='RPMH_VRM_SW_WORKAROUND_CSR_REG17'/>"
WRITE #1 "        <register address='0xb9e12fc' value='0x" DATA.LONG(A:0xb9e12fc) "' name='RPMH_VRM_SW_WORKAROUND_CSR_REG18'/>"
WRITE #1 "        <register address='0xb9e13fc' value='0x" DATA.LONG(A:0xb9e13fc) "' name='RPMH_VRM_SW_WORKAROUND_CSR_REG19'/>"
WRITE #1 "        <register address='0xb9e14fc' value='0x" DATA.LONG(A:0xb9e14fc) "' name='RPMH_VRM_SW_WORKAROUND_CSR_REG20'/>"
WRITE #1 "        <register address='0xb9e15fc' value='0x" DATA.LONG(A:0xb9e15fc) "' name='RPMH_VRM_SW_WORKAROUND_CSR_REG21'/>"
WRITE #1 "        <register address='0xb9e16fc' value='0x" DATA.LONG(A:0xb9e16fc) "' name='RPMH_VRM_SW_WORKAROUND_CSR_REG22'/>"
WRITE #1 "        <register address='0xb9e17fc' value='0x" DATA.LONG(A:0xb9e17fc) "' name='RPMH_VRM_SW_WORKAROUND_CSR_REG23'/>"
WRITE #1 "        <register address='0xb9e18fc' value='0x" DATA.LONG(A:0xb9e18fc) "' name='RPMH_VRM_SW_WORKAROUND_CSR_REG24'/>"
WRITE #1 "        <register address='0xb9ef000' value='0x" DATA.LONG(A:0xb9ef000) "' name='RPMH_VRM_XO_SETTLING_TIME_CSR_RES0'/>"
WRITE #1 "        <register address='0xb9ef108' value='0x" DATA.LONG(A:0xb9ef108) "' name='RPMH_VRM_XOB_SETTLING_TIME_CSR_RES0'/>"
WRITE #1 "        <register address='0xb9ef10c' value='0x" DATA.LONG(A:0xb9ef10c) "' name='RPMH_VRM_XOB_SETTLING_TIME_CSR_RES1'/>"
WRITE #1 "        <register address='0xb9ef110' value='0x" DATA.LONG(A:0xb9ef110) "' name='RPMH_VRM_XOB_SETTLING_TIME_CSR_RES2'/>"
WRITE #1 "        <register address='0xb9ef114' value='0x" DATA.LONG(A:0xb9ef114) "' name='RPMH_VRM_XOB_SETTLING_TIME_CSR_RES3'/>"
WRITE #1 "        <register address='0xb9ef118' value='0x" DATA.LONG(A:0xb9ef118) "' name='RPMH_VRM_XOB_SETTLING_TIME_CSR_RES4'/>"
WRITE #1 "        <register address='0xb9ef11c' value='0x" DATA.LONG(A:0xb9ef11c) "' name='RPMH_VRM_XOB_SETTLING_TIME_CSR_RES5'/>"
WRITE #1 "        <register address='0xb9ef120' value='0x" DATA.LONG(A:0xb9ef120) "' name='RPMH_VRM_XOB_SETTLING_TIME_CSR_RES6'/>"
WRITE #1 "        <register address='0xb9ef124' value='0x" DATA.LONG(A:0xb9ef124) "' name='RPMH_VRM_XOB_SETTLING_TIME_CSR_RES7'/>"
WRITE #1 "        <register address='0xb9ef128' value='0x" DATA.LONG(A:0xb9ef128) "' name='RPMH_VRM_XOB_SETTLING_TIME_CSR_RES8'/>"
WRITE #1 "        <register address='0xb9ef12c' value='0x" DATA.LONG(A:0xb9ef12c) "' name='RPMH_VRM_XOB_SETTLING_TIME_CSR_RES9'/>"
WRITE #1 "        <register address='0xb9ef130' value='0x" DATA.LONG(A:0xb9ef130) "' name='RPMH_VRM_XOB_SETTLING_TIME_CSR_RES10'/>"
WRITE #1 "        <register address='0xb9ef134' value='0x" DATA.LONG(A:0xb9ef134) "' name='RPMH_VRM_XOB_SETTLING_TIME_CSR_RES11'/>"
WRITE #1 "        <register address='0xb9ef138' value='0x" DATA.LONG(A:0xb9ef138) "' name='RPMH_VRM_XOB_SETTLING_TIME_CSR_RES12'/>"
WRITE #1 "        <register address='0xb9ef13c' value='0x" DATA.LONG(A:0xb9ef13c) "' name='RPMH_VRM_XOB_SETTLING_TIME_CSR_RES13'/>"
WRITE #1 "        <register address='0xb9ef140' value='0x" DATA.LONG(A:0xb9ef140) "' name='RPMH_VRM_XOB_SETTLING_TIME_CSR_RES14'/>"
WRITE #1 "        <register address='0xb9ef144' value='0x" DATA.LONG(A:0xb9ef144) "' name='RPMH_VRM_XOB_SETTLING_TIME_CSR_RES15'/>"
WRITE #1 "        <register address='0xb9ef800' value='0x" DATA.LONG(A:0xb9ef800) "' name='RPMH_VRM_PBS_LO_VAL_CSR_REG0'/>"
WRITE #1 "        <register address='0xb9ef804' value='0x" DATA.LONG(A:0xb9ef804) "' name='RPMH_VRM_PBS_LO_VAL_CSR_REG1'/>"
WRITE #1 "        <register address='0xb9ef900' value='0x" DATA.LONG(A:0xb9ef900) "' name='RPMH_VRM_PBS_HI_VAL_CSR_REG0'/>"
WRITE #1 "        <register address='0xb9ef904' value='0x" DATA.LONG(A:0xb9ef904) "' name='RPMH_VRM_PBS_HI_VAL_CSR_REG1'/>"
WRITE #1 "        <register address='0xb9f0000' value='0x" DATA.LONG(A:0xb9f0000) "' name='RPMH_VRM_VOLTAGE_ADDR_OFFSET_CSR_TYPE0'/>"
WRITE #1 "        <register address='0xb9f0060' value='0x" DATA.LONG(A:0xb9f0060) "' name='RPMH_VRM_VOLTAGE_ADDR_OFFSET_CSR_TYPE1'/>"
WRITE #1 "        <register address='0xb9f00c0' value='0x" DATA.LONG(A:0xb9f00c0) "' name='RPMH_VRM_VOLTAGE_ADDR_OFFSET_CSR_TYPE2'/>"
WRITE #1 "        <register address='0xb9f0120' value='0x" DATA.LONG(A:0xb9f0120) "' name='RPMH_VRM_VOLTAGE_ADDR_OFFSET_CSR_TYPE3'/>"
WRITE #1 "        <register address='0xb9f0180' value='0x" DATA.LONG(A:0xb9f0180) "' name='RPMH_VRM_VOLTAGE_ADDR_OFFSET_CSR_TYPE4'/>"
WRITE #1 "        <register address='0xb9f01e0' value='0x" DATA.LONG(A:0xb9f01e0) "' name='RPMH_VRM_VOLTAGE_ADDR_OFFSET_CSR_TYPE5'/>"
WRITE #1 "        <register address='0xb9f0240' value='0x" DATA.LONG(A:0xb9f0240) "' name='RPMH_VRM_VOLTAGE_ADDR_OFFSET_CSR_TYPE6'/>"
WRITE #1 "        <register address='0xb9f02a0' value='0x" DATA.LONG(A:0xb9f02a0) "' name='RPMH_VRM_VOLTAGE_ADDR_OFFSET_CSR_TYPE7'/>"
WRITE #1 "        <register address='0xb9f0300' value='0x" DATA.LONG(A:0xb9f0300) "' name='RPMH_VRM_VOLTAGE_ADDR_OFFSET_CSR_TYPE8'/>"
WRITE #1 "        <register address='0xb9f0360' value='0x" DATA.LONG(A:0xb9f0360) "' name='RPMH_VRM_VOLTAGE_ADDR_OFFSET_CSR_TYPE9'/>"
WRITE #1 "        <register address='0xb9f03c0' value='0x" DATA.LONG(A:0xb9f03c0) "' name='RPMH_VRM_VOLTAGE_ADDR_OFFSET_CSR_TYPE10'/>"
WRITE #1 "        <register address='0xb9f0420' value='0x" DATA.LONG(A:0xb9f0420) "' name='RPMH_VRM_VOLTAGE_ADDR_OFFSET_CSR_TYPE11'/>"
WRITE #1 "        <register address='0xb9f0480' value='0x" DATA.LONG(A:0xb9f0480) "' name='RPMH_VRM_VOLTAGE_ADDR_OFFSET_CSR_TYPE12'/>"
WRITE #1 "        <register address='0xb9f04e0' value='0x" DATA.LONG(A:0xb9f04e0) "' name='RPMH_VRM_VOLTAGE_ADDR_OFFSET_CSR_TYPE13'/>"
WRITE #1 "        <register address='0xb9f0540' value='0x" DATA.LONG(A:0xb9f0540) "' name='RPMH_VRM_VOLTAGE_ADDR_OFFSET_CSR_TYPE14'/>"
WRITE #1 "        <register address='0xb9f05a0' value='0x" DATA.LONG(A:0xb9f05a0) "' name='RPMH_VRM_VOLTAGE_ADDR_OFFSET_CSR_TYPE15'/>"
WRITE #1 "        <register address='0xb9f0004' value='0x" DATA.LONG(A:0xb9f0004) "' name='RPMH_VRM_ENABLE_ADDR_OFFSET_CSR_TYPE0'/>"
WRITE #1 "        <register address='0xb9f0064' value='0x" DATA.LONG(A:0xb9f0064) "' name='RPMH_VRM_ENABLE_ADDR_OFFSET_CSR_TYPE1'/>"
WRITE #1 "        <register address='0xb9f00c4' value='0x" DATA.LONG(A:0xb9f00c4) "' name='RPMH_VRM_ENABLE_ADDR_OFFSET_CSR_TYPE2'/>"
WRITE #1 "        <register address='0xb9f0124' value='0x" DATA.LONG(A:0xb9f0124) "' name='RPMH_VRM_ENABLE_ADDR_OFFSET_CSR_TYPE3'/>"
WRITE #1 "        <register address='0xb9f0184' value='0x" DATA.LONG(A:0xb9f0184) "' name='RPMH_VRM_ENABLE_ADDR_OFFSET_CSR_TYPE4'/>"
WRITE #1 "        <register address='0xb9f01e4' value='0x" DATA.LONG(A:0xb9f01e4) "' name='RPMH_VRM_ENABLE_ADDR_OFFSET_CSR_TYPE5'/>"
WRITE #1 "        <register address='0xb9f0244' value='0x" DATA.LONG(A:0xb9f0244) "' name='RPMH_VRM_ENABLE_ADDR_OFFSET_CSR_TYPE6'/>"
WRITE #1 "        <register address='0xb9f02a4' value='0x" DATA.LONG(A:0xb9f02a4) "' name='RPMH_VRM_ENABLE_ADDR_OFFSET_CSR_TYPE7'/>"
WRITE #1 "        <register address='0xb9f0304' value='0x" DATA.LONG(A:0xb9f0304) "' name='RPMH_VRM_ENABLE_ADDR_OFFSET_CSR_TYPE8'/>"
WRITE #1 "        <register address='0xb9f0364' value='0x" DATA.LONG(A:0xb9f0364) "' name='RPMH_VRM_ENABLE_ADDR_OFFSET_CSR_TYPE9'/>"
WRITE #1 "        <register address='0xb9f03c4' value='0x" DATA.LONG(A:0xb9f03c4) "' name='RPMH_VRM_ENABLE_ADDR_OFFSET_CSR_TYPE10'/>"
WRITE #1 "        <register address='0xb9f0424' value='0x" DATA.LONG(A:0xb9f0424) "' name='RPMH_VRM_ENABLE_ADDR_OFFSET_CSR_TYPE11'/>"
WRITE #1 "        <register address='0xb9f0484' value='0x" DATA.LONG(A:0xb9f0484) "' name='RPMH_VRM_ENABLE_ADDR_OFFSET_CSR_TYPE12'/>"
WRITE #1 "        <register address='0xb9f04e4' value='0x" DATA.LONG(A:0xb9f04e4) "' name='RPMH_VRM_ENABLE_ADDR_OFFSET_CSR_TYPE13'/>"
WRITE #1 "        <register address='0xb9f0544' value='0x" DATA.LONG(A:0xb9f0544) "' name='RPMH_VRM_ENABLE_ADDR_OFFSET_CSR_TYPE14'/>"
WRITE #1 "        <register address='0xb9f05a4' value='0x" DATA.LONG(A:0xb9f05a4) "' name='RPMH_VRM_ENABLE_ADDR_OFFSET_CSR_TYPE15'/>"
WRITE #1 "        <register address='0xb9f0008' value='0x" DATA.LONG(A:0xb9f0008) "' name='RPMH_VRM_MODE_ADDR_OFFSET_CSR_TYPE0'/>"
WRITE #1 "        <register address='0xb9f0068' value='0x" DATA.LONG(A:0xb9f0068) "' name='RPMH_VRM_MODE_ADDR_OFFSET_CSR_TYPE1'/>"
WRITE #1 "        <register address='0xb9f00c8' value='0x" DATA.LONG(A:0xb9f00c8) "' name='RPMH_VRM_MODE_ADDR_OFFSET_CSR_TYPE2'/>"
WRITE #1 "        <register address='0xb9f0128' value='0x" DATA.LONG(A:0xb9f0128) "' name='RPMH_VRM_MODE_ADDR_OFFSET_CSR_TYPE3'/>"
WRITE #1 "        <register address='0xb9f0188' value='0x" DATA.LONG(A:0xb9f0188) "' name='RPMH_VRM_MODE_ADDR_OFFSET_CSR_TYPE4'/>"
WRITE #1 "        <register address='0xb9f01e8' value='0x" DATA.LONG(A:0xb9f01e8) "' name='RPMH_VRM_MODE_ADDR_OFFSET_CSR_TYPE5'/>"
WRITE #1 "        <register address='0xb9f0248' value='0x" DATA.LONG(A:0xb9f0248) "' name='RPMH_VRM_MODE_ADDR_OFFSET_CSR_TYPE6'/>"
WRITE #1 "        <register address='0xb9f02a8' value='0x" DATA.LONG(A:0xb9f02a8) "' name='RPMH_VRM_MODE_ADDR_OFFSET_CSR_TYPE7'/>"
WRITE #1 "        <register address='0xb9f0308' value='0x" DATA.LONG(A:0xb9f0308) "' name='RPMH_VRM_MODE_ADDR_OFFSET_CSR_TYPE8'/>"
WRITE #1 "        <register address='0xb9f0368' value='0x" DATA.LONG(A:0xb9f0368) "' name='RPMH_VRM_MODE_ADDR_OFFSET_CSR_TYPE9'/>"
WRITE #1 "        <register address='0xb9f03c8' value='0x" DATA.LONG(A:0xb9f03c8) "' name='RPMH_VRM_MODE_ADDR_OFFSET_CSR_TYPE10'/>"
WRITE #1 "        <register address='0xb9f0428' value='0x" DATA.LONG(A:0xb9f0428) "' name='RPMH_VRM_MODE_ADDR_OFFSET_CSR_TYPE11'/>"
WRITE #1 "        <register address='0xb9f0488' value='0x" DATA.LONG(A:0xb9f0488) "' name='RPMH_VRM_MODE_ADDR_OFFSET_CSR_TYPE12'/>"
WRITE #1 "        <register address='0xb9f04e8' value='0x" DATA.LONG(A:0xb9f04e8) "' name='RPMH_VRM_MODE_ADDR_OFFSET_CSR_TYPE13'/>"
WRITE #1 "        <register address='0xb9f0548' value='0x" DATA.LONG(A:0xb9f0548) "' name='RPMH_VRM_MODE_ADDR_OFFSET_CSR_TYPE14'/>"
WRITE #1 "        <register address='0xb9f05a8' value='0x" DATA.LONG(A:0xb9f05a8) "' name='RPMH_VRM_MODE_ADDR_OFFSET_CSR_TYPE15'/>"
WRITE #1 "        <register address='0xb9f001c' value='0x" DATA.LONG(A:0xb9f001c) "' name='RPMH_VRM_VOLTAGE_STEPPER_SETTLING_TIME_CSR_TYPE0'/>"
WRITE #1 "        <register address='0xb9f007c' value='0x" DATA.LONG(A:0xb9f007c) "' name='RPMH_VRM_VOLTAGE_STEPPER_SETTLING_TIME_CSR_TYPE1'/>"
WRITE #1 "        <register address='0xb9f00dc' value='0x" DATA.LONG(A:0xb9f00dc) "' name='RPMH_VRM_VOLTAGE_STEPPER_SETTLING_TIME_CSR_TYPE2'/>"
WRITE #1 "        <register address='0xb9f013c' value='0x" DATA.LONG(A:0xb9f013c) "' name='RPMH_VRM_VOLTAGE_STEPPER_SETTLING_TIME_CSR_TYPE3'/>"
WRITE #1 "        <register address='0xb9f019c' value='0x" DATA.LONG(A:0xb9f019c) "' name='RPMH_VRM_VOLTAGE_STEPPER_SETTLING_TIME_CSR_TYPE4'/>"
WRITE #1 "        <register address='0xb9f01fc' value='0x" DATA.LONG(A:0xb9f01fc) "' name='RPMH_VRM_VOLTAGE_STEPPER_SETTLING_TIME_CSR_TYPE5'/>"
WRITE #1 "        <register address='0xb9f025c' value='0x" DATA.LONG(A:0xb9f025c) "' name='RPMH_VRM_VOLTAGE_STEPPER_SETTLING_TIME_CSR_TYPE6'/>"
WRITE #1 "        <register address='0xb9f02bc' value='0x" DATA.LONG(A:0xb9f02bc) "' name='RPMH_VRM_VOLTAGE_STEPPER_SETTLING_TIME_CSR_TYPE7'/>"
WRITE #1 "        <register address='0xb9f031c' value='0x" DATA.LONG(A:0xb9f031c) "' name='RPMH_VRM_VOLTAGE_STEPPER_SETTLING_TIME_CSR_TYPE8'/>"
WRITE #1 "        <register address='0xb9f037c' value='0x" DATA.LONG(A:0xb9f037c) "' name='RPMH_VRM_VOLTAGE_STEPPER_SETTLING_TIME_CSR_TYPE9'/>"
WRITE #1 "        <register address='0xb9f03dc' value='0x" DATA.LONG(A:0xb9f03dc) "' name='RPMH_VRM_VOLTAGE_STEPPER_SETTLING_TIME_CSR_TYPE10'/>"
WRITE #1 "        <register address='0xb9f043c' value='0x" DATA.LONG(A:0xb9f043c) "' name='RPMH_VRM_VOLTAGE_STEPPER_SETTLING_TIME_CSR_TYPE11'/>"
WRITE #1 "        <register address='0xb9f049c' value='0x" DATA.LONG(A:0xb9f049c) "' name='RPMH_VRM_VOLTAGE_STEPPER_SETTLING_TIME_CSR_TYPE12'/>"
WRITE #1 "        <register address='0xb9f04fc' value='0x" DATA.LONG(A:0xb9f04fc) "' name='RPMH_VRM_VOLTAGE_STEPPER_SETTLING_TIME_CSR_TYPE13'/>"
WRITE #1 "        <register address='0xb9f055c' value='0x" DATA.LONG(A:0xb9f055c) "' name='RPMH_VRM_VOLTAGE_STEPPER_SETTLING_TIME_CSR_TYPE14'/>"
WRITE #1 "        <register address='0xb9f05bc' value='0x" DATA.LONG(A:0xb9f05bc) "' name='RPMH_VRM_VOLTAGE_STEPPER_SETTLING_TIME_CSR_TYPE15'/>"
WRITE #1 "        <register address='0xb9f0020' value='0x" DATA.LONG(A:0xb9f0020) "' name='RPMH_VRM_VOLTAGE_FIXED_UP_SETTLING_TIME_CSR_TYPE0'/>"
WRITE #1 "        <register address='0xb9f0080' value='0x" DATA.LONG(A:0xb9f0080) "' name='RPMH_VRM_VOLTAGE_FIXED_UP_SETTLING_TIME_CSR_TYPE1'/>"
WRITE #1 "        <register address='0xb9f00e0' value='0x" DATA.LONG(A:0xb9f00e0) "' name='RPMH_VRM_VOLTAGE_FIXED_UP_SETTLING_TIME_CSR_TYPE2'/>"
WRITE #1 "        <register address='0xb9f0140' value='0x" DATA.LONG(A:0xb9f0140) "' name='RPMH_VRM_VOLTAGE_FIXED_UP_SETTLING_TIME_CSR_TYPE3'/>"
WRITE #1 "        <register address='0xb9f01a0' value='0x" DATA.LONG(A:0xb9f01a0) "' name='RPMH_VRM_VOLTAGE_FIXED_UP_SETTLING_TIME_CSR_TYPE4'/>"
WRITE #1 "        <register address='0xb9f0200' value='0x" DATA.LONG(A:0xb9f0200) "' name='RPMH_VRM_VOLTAGE_FIXED_UP_SETTLING_TIME_CSR_TYPE5'/>"
WRITE #1 "        <register address='0xb9f0260' value='0x" DATA.LONG(A:0xb9f0260) "' name='RPMH_VRM_VOLTAGE_FIXED_UP_SETTLING_TIME_CSR_TYPE6'/>"
WRITE #1 "        <register address='0xb9f02c0' value='0x" DATA.LONG(A:0xb9f02c0) "' name='RPMH_VRM_VOLTAGE_FIXED_UP_SETTLING_TIME_CSR_TYPE7'/>"
WRITE #1 "        <register address='0xb9f0320' value='0x" DATA.LONG(A:0xb9f0320) "' name='RPMH_VRM_VOLTAGE_FIXED_UP_SETTLING_TIME_CSR_TYPE8'/>"
WRITE #1 "        <register address='0xb9f0380' value='0x" DATA.LONG(A:0xb9f0380) "' name='RPMH_VRM_VOLTAGE_FIXED_UP_SETTLING_TIME_CSR_TYPE9'/>"
WRITE #1 "        <register address='0xb9f03e0' value='0x" DATA.LONG(A:0xb9f03e0) "' name='RPMH_VRM_VOLTAGE_FIXED_UP_SETTLING_TIME_CSR_TYPE10'/>"
WRITE #1 "        <register address='0xb9f0440' value='0x" DATA.LONG(A:0xb9f0440) "' name='RPMH_VRM_VOLTAGE_FIXED_UP_SETTLING_TIME_CSR_TYPE11'/>"
WRITE #1 "        <register address='0xb9f04a0' value='0x" DATA.LONG(A:0xb9f04a0) "' name='RPMH_VRM_VOLTAGE_FIXED_UP_SETTLING_TIME_CSR_TYPE12'/>"
WRITE #1 "        <register address='0xb9f0500' value='0x" DATA.LONG(A:0xb9f0500) "' name='RPMH_VRM_VOLTAGE_FIXED_UP_SETTLING_TIME_CSR_TYPE13'/>"
WRITE #1 "        <register address='0xb9f0560' value='0x" DATA.LONG(A:0xb9f0560) "' name='RPMH_VRM_VOLTAGE_FIXED_UP_SETTLING_TIME_CSR_TYPE14'/>"
WRITE #1 "        <register address='0xb9f05c0' value='0x" DATA.LONG(A:0xb9f05c0) "' name='RPMH_VRM_VOLTAGE_FIXED_UP_SETTLING_TIME_CSR_TYPE15'/>"
WRITE #1 "        <register address='0xb9f0024' value='0x" DATA.LONG(A:0xb9f0024) "' name='RPMH_VRM_VOLTAGE_FIXED_DOWN_SETTLING_TIME_CSR_TYPE0'/>"
WRITE #1 "        <register address='0xb9f0084' value='0x" DATA.LONG(A:0xb9f0084) "' name='RPMH_VRM_VOLTAGE_FIXED_DOWN_SETTLING_TIME_CSR_TYPE1'/>"
WRITE #1 "        <register address='0xb9f00e4' value='0x" DATA.LONG(A:0xb9f00e4) "' name='RPMH_VRM_VOLTAGE_FIXED_DOWN_SETTLING_TIME_CSR_TYPE2'/>"
WRITE #1 "        <register address='0xb9f0144' value='0x" DATA.LONG(A:0xb9f0144) "' name='RPMH_VRM_VOLTAGE_FIXED_DOWN_SETTLING_TIME_CSR_TYPE3'/>"
WRITE #1 "        <register address='0xb9f01a4' value='0x" DATA.LONG(A:0xb9f01a4) "' name='RPMH_VRM_VOLTAGE_FIXED_DOWN_SETTLING_TIME_CSR_TYPE4'/>"
WRITE #1 "        <register address='0xb9f0204' value='0x" DATA.LONG(A:0xb9f0204) "' name='RPMH_VRM_VOLTAGE_FIXED_DOWN_SETTLING_TIME_CSR_TYPE5'/>"
WRITE #1 "        <register address='0xb9f0264' value='0x" DATA.LONG(A:0xb9f0264) "' name='RPMH_VRM_VOLTAGE_FIXED_DOWN_SETTLING_TIME_CSR_TYPE6'/>"
WRITE #1 "        <register address='0xb9f02c4' value='0x" DATA.LONG(A:0xb9f02c4) "' name='RPMH_VRM_VOLTAGE_FIXED_DOWN_SETTLING_TIME_CSR_TYPE7'/>"
WRITE #1 "        <register address='0xb9f0324' value='0x" DATA.LONG(A:0xb9f0324) "' name='RPMH_VRM_VOLTAGE_FIXED_DOWN_SETTLING_TIME_CSR_TYPE8'/>"
WRITE #1 "        <register address='0xb9f0384' value='0x" DATA.LONG(A:0xb9f0384) "' name='RPMH_VRM_VOLTAGE_FIXED_DOWN_SETTLING_TIME_CSR_TYPE9'/>"
WRITE #1 "        <register address='0xb9f03e4' value='0x" DATA.LONG(A:0xb9f03e4) "' name='RPMH_VRM_VOLTAGE_FIXED_DOWN_SETTLING_TIME_CSR_TYPE10'/>"
WRITE #1 "        <register address='0xb9f0444' value='0x" DATA.LONG(A:0xb9f0444) "' name='RPMH_VRM_VOLTAGE_FIXED_DOWN_SETTLING_TIME_CSR_TYPE11'/>"
WRITE #1 "        <register address='0xb9f04a4' value='0x" DATA.LONG(A:0xb9f04a4) "' name='RPMH_VRM_VOLTAGE_FIXED_DOWN_SETTLING_TIME_CSR_TYPE12'/>"
WRITE #1 "        <register address='0xb9f0504' value='0x" DATA.LONG(A:0xb9f0504) "' name='RPMH_VRM_VOLTAGE_FIXED_DOWN_SETTLING_TIME_CSR_TYPE13'/>"
WRITE #1 "        <register address='0xb9f0564' value='0x" DATA.LONG(A:0xb9f0564) "' name='RPMH_VRM_VOLTAGE_FIXED_DOWN_SETTLING_TIME_CSR_TYPE14'/>"
WRITE #1 "        <register address='0xb9f05c4' value='0x" DATA.LONG(A:0xb9f05c4) "' name='RPMH_VRM_VOLTAGE_FIXED_DOWN_SETTLING_TIME_CSR_TYPE15'/>"
WRITE #1 "        <register address='0xb9f0ff0' value='0x" DATA.LONG(A:0xb9f0ff0) "' name='RPMH_VRM_VOLTAGE_UP_SETTLING_TIME_SEL'/>"
WRITE #1 "        <register address='0xb9f0ff4' value='0x" DATA.LONG(A:0xb9f0ff4) "' name='RPMH_VRM_VOLTAGE_DOWN_SETTLING_TIME_SEL'/>"
WRITE #1 "        <register address='0xb9f0028' value='0x" DATA.LONG(A:0xb9f0028) "' name='RPMH_VRM_ENABLE_STEPPER_SETTLING_TIME_CSR_TYPE0'/>"
WRITE #1 "        <register address='0xb9f0088' value='0x" DATA.LONG(A:0xb9f0088) "' name='RPMH_VRM_ENABLE_STEPPER_SETTLING_TIME_CSR_TYPE1'/>"
WRITE #1 "        <register address='0xb9f00e8' value='0x" DATA.LONG(A:0xb9f00e8) "' name='RPMH_VRM_ENABLE_STEPPER_SETTLING_TIME_CSR_TYPE2'/>"
WRITE #1 "        <register address='0xb9f0148' value='0x" DATA.LONG(A:0xb9f0148) "' name='RPMH_VRM_ENABLE_STEPPER_SETTLING_TIME_CSR_TYPE3'/>"
WRITE #1 "        <register address='0xb9f01a8' value='0x" DATA.LONG(A:0xb9f01a8) "' name='RPMH_VRM_ENABLE_STEPPER_SETTLING_TIME_CSR_TYPE4'/>"
WRITE #1 "        <register address='0xb9f0208' value='0x" DATA.LONG(A:0xb9f0208) "' name='RPMH_VRM_ENABLE_STEPPER_SETTLING_TIME_CSR_TYPE5'/>"
WRITE #1 "        <register address='0xb9f0268' value='0x" DATA.LONG(A:0xb9f0268) "' name='RPMH_VRM_ENABLE_STEPPER_SETTLING_TIME_CSR_TYPE6'/>"
WRITE #1 "        <register address='0xb9f02c8' value='0x" DATA.LONG(A:0xb9f02c8) "' name='RPMH_VRM_ENABLE_STEPPER_SETTLING_TIME_CSR_TYPE7'/>"
WRITE #1 "        <register address='0xb9f0328' value='0x" DATA.LONG(A:0xb9f0328) "' name='RPMH_VRM_ENABLE_STEPPER_SETTLING_TIME_CSR_TYPE8'/>"
WRITE #1 "        <register address='0xb9f0388' value='0x" DATA.LONG(A:0xb9f0388) "' name='RPMH_VRM_ENABLE_STEPPER_SETTLING_TIME_CSR_TYPE9'/>"
WRITE #1 "        <register address='0xb9f03e8' value='0x" DATA.LONG(A:0xb9f03e8) "' name='RPMH_VRM_ENABLE_STEPPER_SETTLING_TIME_CSR_TYPE10'/>"
WRITE #1 "        <register address='0xb9f0448' value='0x" DATA.LONG(A:0xb9f0448) "' name='RPMH_VRM_ENABLE_STEPPER_SETTLING_TIME_CSR_TYPE11'/>"
WRITE #1 "        <register address='0xb9f04a8' value='0x" DATA.LONG(A:0xb9f04a8) "' name='RPMH_VRM_ENABLE_STEPPER_SETTLING_TIME_CSR_TYPE12'/>"
WRITE #1 "        <register address='0xb9f0508' value='0x" DATA.LONG(A:0xb9f0508) "' name='RPMH_VRM_ENABLE_STEPPER_SETTLING_TIME_CSR_TYPE13'/>"
WRITE #1 "        <register address='0xb9f0568' value='0x" DATA.LONG(A:0xb9f0568) "' name='RPMH_VRM_ENABLE_STEPPER_SETTLING_TIME_CSR_TYPE14'/>"
WRITE #1 "        <register address='0xb9f05c8' value='0x" DATA.LONG(A:0xb9f05c8) "' name='RPMH_VRM_ENABLE_STEPPER_SETTLING_TIME_CSR_TYPE15'/>"
WRITE #1 "        <register address='0xb9f002c' value='0x" DATA.LONG(A:0xb9f002c) "' name='RPMH_VRM_ENABLE_FIXED_SETTLING_TIME_CSR_TYPE0'/>"
WRITE #1 "        <register address='0xb9f008c' value='0x" DATA.LONG(A:0xb9f008c) "' name='RPMH_VRM_ENABLE_FIXED_SETTLING_TIME_CSR_TYPE1'/>"
WRITE #1 "        <register address='0xb9f00ec' value='0x" DATA.LONG(A:0xb9f00ec) "' name='RPMH_VRM_ENABLE_FIXED_SETTLING_TIME_CSR_TYPE2'/>"
WRITE #1 "        <register address='0xb9f014c' value='0x" DATA.LONG(A:0xb9f014c) "' name='RPMH_VRM_ENABLE_FIXED_SETTLING_TIME_CSR_TYPE3'/>"
WRITE #1 "        <register address='0xb9f01ac' value='0x" DATA.LONG(A:0xb9f01ac) "' name='RPMH_VRM_ENABLE_FIXED_SETTLING_TIME_CSR_TYPE4'/>"
WRITE #1 "        <register address='0xb9f020c' value='0x" DATA.LONG(A:0xb9f020c) "' name='RPMH_VRM_ENABLE_FIXED_SETTLING_TIME_CSR_TYPE5'/>"
WRITE #1 "        <register address='0xb9f026c' value='0x" DATA.LONG(A:0xb9f026c) "' name='RPMH_VRM_ENABLE_FIXED_SETTLING_TIME_CSR_TYPE6'/>"
WRITE #1 "        <register address='0xb9f02cc' value='0x" DATA.LONG(A:0xb9f02cc) "' name='RPMH_VRM_ENABLE_FIXED_SETTLING_TIME_CSR_TYPE7'/>"
WRITE #1 "        <register address='0xb9f032c' value='0x" DATA.LONG(A:0xb9f032c) "' name='RPMH_VRM_ENABLE_FIXED_SETTLING_TIME_CSR_TYPE8'/>"
WRITE #1 "        <register address='0xb9f038c' value='0x" DATA.LONG(A:0xb9f038c) "' name='RPMH_VRM_ENABLE_FIXED_SETTLING_TIME_CSR_TYPE9'/>"
WRITE #1 "        <register address='0xb9f03ec' value='0x" DATA.LONG(A:0xb9f03ec) "' name='RPMH_VRM_ENABLE_FIXED_SETTLING_TIME_CSR_TYPE10'/>"
WRITE #1 "        <register address='0xb9f044c' value='0x" DATA.LONG(A:0xb9f044c) "' name='RPMH_VRM_ENABLE_FIXED_SETTLING_TIME_CSR_TYPE11'/>"
WRITE #1 "        <register address='0xb9f04ac' value='0x" DATA.LONG(A:0xb9f04ac) "' name='RPMH_VRM_ENABLE_FIXED_SETTLING_TIME_CSR_TYPE12'/>"
WRITE #1 "        <register address='0xb9f050c' value='0x" DATA.LONG(A:0xb9f050c) "' name='RPMH_VRM_ENABLE_FIXED_SETTLING_TIME_CSR_TYPE13'/>"
WRITE #1 "        <register address='0xb9f056c' value='0x" DATA.LONG(A:0xb9f056c) "' name='RPMH_VRM_ENABLE_FIXED_SETTLING_TIME_CSR_TYPE14'/>"
WRITE #1 "        <register address='0xb9f05cc' value='0x" DATA.LONG(A:0xb9f05cc) "' name='RPMH_VRM_ENABLE_FIXED_SETTLING_TIME_CSR_TYPE15'/>"
WRITE #1 "        <register address='0xb9f0058' value='0x" DATA.LONG(A:0xb9f0058) "' name='RPMH_VRM_ENABLE_FIXED_DOWN_SETTLING_TIME_CSR_TYPE0'/>"
WRITE #1 "        <register address='0xb9f00b8' value='0x" DATA.LONG(A:0xb9f00b8) "' name='RPMH_VRM_ENABLE_FIXED_DOWN_SETTLING_TIME_CSR_TYPE1'/>"
WRITE #1 "        <register address='0xb9f0118' value='0x" DATA.LONG(A:0xb9f0118) "' name='RPMH_VRM_ENABLE_FIXED_DOWN_SETTLING_TIME_CSR_TYPE2'/>"
WRITE #1 "        <register address='0xb9f0178' value='0x" DATA.LONG(A:0xb9f0178) "' name='RPMH_VRM_ENABLE_FIXED_DOWN_SETTLING_TIME_CSR_TYPE3'/>"
WRITE #1 "        <register address='0xb9f01d8' value='0x" DATA.LONG(A:0xb9f01d8) "' name='RPMH_VRM_ENABLE_FIXED_DOWN_SETTLING_TIME_CSR_TYPE4'/>"
WRITE #1 "        <register address='0xb9f0238' value='0x" DATA.LONG(A:0xb9f0238) "' name='RPMH_VRM_ENABLE_FIXED_DOWN_SETTLING_TIME_CSR_TYPE5'/>"
WRITE #1 "        <register address='0xb9f0298' value='0x" DATA.LONG(A:0xb9f0298) "' name='RPMH_VRM_ENABLE_FIXED_DOWN_SETTLING_TIME_CSR_TYPE6'/>"
WRITE #1 "        <register address='0xb9f02f8' value='0x" DATA.LONG(A:0xb9f02f8) "' name='RPMH_VRM_ENABLE_FIXED_DOWN_SETTLING_TIME_CSR_TYPE7'/>"
WRITE #1 "        <register address='0xb9f0358' value='0x" DATA.LONG(A:0xb9f0358) "' name='RPMH_VRM_ENABLE_FIXED_DOWN_SETTLING_TIME_CSR_TYPE8'/>"
WRITE #1 "        <register address='0xb9f03b8' value='0x" DATA.LONG(A:0xb9f03b8) "' name='RPMH_VRM_ENABLE_FIXED_DOWN_SETTLING_TIME_CSR_TYPE9'/>"
WRITE #1 "        <register address='0xb9f0418' value='0x" DATA.LONG(A:0xb9f0418) "' name='RPMH_VRM_ENABLE_FIXED_DOWN_SETTLING_TIME_CSR_TYPE10'/>"
WRITE #1 "        <register address='0xb9f0478' value='0x" DATA.LONG(A:0xb9f0478) "' name='RPMH_VRM_ENABLE_FIXED_DOWN_SETTLING_TIME_CSR_TYPE11'/>"
WRITE #1 "        <register address='0xb9f04d8' value='0x" DATA.LONG(A:0xb9f04d8) "' name='RPMH_VRM_ENABLE_FIXED_DOWN_SETTLING_TIME_CSR_TYPE12'/>"
WRITE #1 "        <register address='0xb9f0538' value='0x" DATA.LONG(A:0xb9f0538) "' name='RPMH_VRM_ENABLE_FIXED_DOWN_SETTLING_TIME_CSR_TYPE13'/>"
WRITE #1 "        <register address='0xb9f0598' value='0x" DATA.LONG(A:0xb9f0598) "' name='RPMH_VRM_ENABLE_FIXED_DOWN_SETTLING_TIME_CSR_TYPE14'/>"
WRITE #1 "        <register address='0xb9f05f8' value='0x" DATA.LONG(A:0xb9f05f8) "' name='RPMH_VRM_ENABLE_FIXED_DOWN_SETTLING_TIME_CSR_TYPE15'/>"
WRITE #1 "        <register address='0xb9f0030' value='0x" DATA.LONG(A:0xb9f0030) "' name='RPMH_VRM_ENABLE_WARM_UP_TIME_CSR_TYPE0'/>"
WRITE #1 "        <register address='0xb9f0090' value='0x" DATA.LONG(A:0xb9f0090) "' name='RPMH_VRM_ENABLE_WARM_UP_TIME_CSR_TYPE1'/>"
WRITE #1 "        <register address='0xb9f00f0' value='0x" DATA.LONG(A:0xb9f00f0) "' name='RPMH_VRM_ENABLE_WARM_UP_TIME_CSR_TYPE2'/>"
WRITE #1 "        <register address='0xb9f0150' value='0x" DATA.LONG(A:0xb9f0150) "' name='RPMH_VRM_ENABLE_WARM_UP_TIME_CSR_TYPE3'/>"
WRITE #1 "        <register address='0xb9f01b0' value='0x" DATA.LONG(A:0xb9f01b0) "' name='RPMH_VRM_ENABLE_WARM_UP_TIME_CSR_TYPE4'/>"
WRITE #1 "        <register address='0xb9f0210' value='0x" DATA.LONG(A:0xb9f0210) "' name='RPMH_VRM_ENABLE_WARM_UP_TIME_CSR_TYPE5'/>"
WRITE #1 "        <register address='0xb9f0270' value='0x" DATA.LONG(A:0xb9f0270) "' name='RPMH_VRM_ENABLE_WARM_UP_TIME_CSR_TYPE6'/>"
WRITE #1 "        <register address='0xb9f02d0' value='0x" DATA.LONG(A:0xb9f02d0) "' name='RPMH_VRM_ENABLE_WARM_UP_TIME_CSR_TYPE7'/>"
WRITE #1 "        <register address='0xb9f0330' value='0x" DATA.LONG(A:0xb9f0330) "' name='RPMH_VRM_ENABLE_WARM_UP_TIME_CSR_TYPE8'/>"
WRITE #1 "        <register address='0xb9f0390' value='0x" DATA.LONG(A:0xb9f0390) "' name='RPMH_VRM_ENABLE_WARM_UP_TIME_CSR_TYPE9'/>"
WRITE #1 "        <register address='0xb9f03f0' value='0x" DATA.LONG(A:0xb9f03f0) "' name='RPMH_VRM_ENABLE_WARM_UP_TIME_CSR_TYPE10'/>"
WRITE #1 "        <register address='0xb9f0450' value='0x" DATA.LONG(A:0xb9f0450) "' name='RPMH_VRM_ENABLE_WARM_UP_TIME_CSR_TYPE11'/>"
WRITE #1 "        <register address='0xb9f04b0' value='0x" DATA.LONG(A:0xb9f04b0) "' name='RPMH_VRM_ENABLE_WARM_UP_TIME_CSR_TYPE12'/>"
WRITE #1 "        <register address='0xb9f0510' value='0x" DATA.LONG(A:0xb9f0510) "' name='RPMH_VRM_ENABLE_WARM_UP_TIME_CSR_TYPE13'/>"
WRITE #1 "        <register address='0xb9f0570' value='0x" DATA.LONG(A:0xb9f0570) "' name='RPMH_VRM_ENABLE_WARM_UP_TIME_CSR_TYPE14'/>"
WRITE #1 "        <register address='0xb9f05d0' value='0x" DATA.LONG(A:0xb9f05d0) "' name='RPMH_VRM_ENABLE_WARM_UP_TIME_CSR_TYPE15'/>"
WRITE #1 "        <register address='0xb9f0ff8' value='0x" DATA.LONG(A:0xb9f0ff8) "' name='RPMH_VRM_ENABLE_UP_SETTLING_TIME_SEL'/>"
WRITE #1 "        <register address='0xb9f0034' value='0x" DATA.LONG(A:0xb9f0034) "' name='RPMH_VRM_MODE_SETTLING_TIME_CSR_TYPE0'/>"
WRITE #1 "        <register address='0xb9f0094' value='0x" DATA.LONG(A:0xb9f0094) "' name='RPMH_VRM_MODE_SETTLING_TIME_CSR_TYPE1'/>"
WRITE #1 "        <register address='0xb9f00f4' value='0x" DATA.LONG(A:0xb9f00f4) "' name='RPMH_VRM_MODE_SETTLING_TIME_CSR_TYPE2'/>"
WRITE #1 "        <register address='0xb9f0154' value='0x" DATA.LONG(A:0xb9f0154) "' name='RPMH_VRM_MODE_SETTLING_TIME_CSR_TYPE3'/>"
WRITE #1 "        <register address='0xb9f01b4' value='0x" DATA.LONG(A:0xb9f01b4) "' name='RPMH_VRM_MODE_SETTLING_TIME_CSR_TYPE4'/>"
WRITE #1 "        <register address='0xb9f0214' value='0x" DATA.LONG(A:0xb9f0214) "' name='RPMH_VRM_MODE_SETTLING_TIME_CSR_TYPE5'/>"
WRITE #1 "        <register address='0xb9f0274' value='0x" DATA.LONG(A:0xb9f0274) "' name='RPMH_VRM_MODE_SETTLING_TIME_CSR_TYPE6'/>"
WRITE #1 "        <register address='0xb9f02d4' value='0x" DATA.LONG(A:0xb9f02d4) "' name='RPMH_VRM_MODE_SETTLING_TIME_CSR_TYPE7'/>"
WRITE #1 "        <register address='0xb9f0334' value='0x" DATA.LONG(A:0xb9f0334) "' name='RPMH_VRM_MODE_SETTLING_TIME_CSR_TYPE8'/>"
WRITE #1 "        <register address='0xb9f0394' value='0x" DATA.LONG(A:0xb9f0394) "' name='RPMH_VRM_MODE_SETTLING_TIME_CSR_TYPE9'/>"
WRITE #1 "        <register address='0xb9f03f4' value='0x" DATA.LONG(A:0xb9f03f4) "' name='RPMH_VRM_MODE_SETTLING_TIME_CSR_TYPE10'/>"
WRITE #1 "        <register address='0xb9f0454' value='0x" DATA.LONG(A:0xb9f0454) "' name='RPMH_VRM_MODE_SETTLING_TIME_CSR_TYPE11'/>"
WRITE #1 "        <register address='0xb9f04b4' value='0x" DATA.LONG(A:0xb9f04b4) "' name='RPMH_VRM_MODE_SETTLING_TIME_CSR_TYPE12'/>"
WRITE #1 "        <register address='0xb9f0514' value='0x" DATA.LONG(A:0xb9f0514) "' name='RPMH_VRM_MODE_SETTLING_TIME_CSR_TYPE13'/>"
WRITE #1 "        <register address='0xb9f0574' value='0x" DATA.LONG(A:0xb9f0574) "' name='RPMH_VRM_MODE_SETTLING_TIME_CSR_TYPE14'/>"
WRITE #1 "        <register address='0xb9f05d4' value='0x" DATA.LONG(A:0xb9f05d4) "' name='RPMH_VRM_MODE_SETTLING_TIME_CSR_TYPE15'/>"
WRITE #1 "        <register address='0xb9f003c' value='0x" DATA.LONG(A:0xb9f003c) "' name='RPMH_VRM_VREG_READY_WDOG_TIMER_MUL_CSR_TYPE0'/>"
WRITE #1 "        <register address='0xb9f009c' value='0x" DATA.LONG(A:0xb9f009c) "' name='RPMH_VRM_VREG_READY_WDOG_TIMER_MUL_CSR_TYPE1'/>"
WRITE #1 "        <register address='0xb9f00fc' value='0x" DATA.LONG(A:0xb9f00fc) "' name='RPMH_VRM_VREG_READY_WDOG_TIMER_MUL_CSR_TYPE2'/>"
WRITE #1 "        <register address='0xb9f015c' value='0x" DATA.LONG(A:0xb9f015c) "' name='RPMH_VRM_VREG_READY_WDOG_TIMER_MUL_CSR_TYPE3'/>"
WRITE #1 "        <register address='0xb9f01bc' value='0x" DATA.LONG(A:0xb9f01bc) "' name='RPMH_VRM_VREG_READY_WDOG_TIMER_MUL_CSR_TYPE4'/>"
WRITE #1 "        <register address='0xb9f021c' value='0x" DATA.LONG(A:0xb9f021c) "' name='RPMH_VRM_VREG_READY_WDOG_TIMER_MUL_CSR_TYPE5'/>"
WRITE #1 "        <register address='0xb9f027c' value='0x" DATA.LONG(A:0xb9f027c) "' name='RPMH_VRM_VREG_READY_WDOG_TIMER_MUL_CSR_TYPE6'/>"
WRITE #1 "        <register address='0xb9f02dc' value='0x" DATA.LONG(A:0xb9f02dc) "' name='RPMH_VRM_VREG_READY_WDOG_TIMER_MUL_CSR_TYPE7'/>"
WRITE #1 "        <register address='0xb9f033c' value='0x" DATA.LONG(A:0xb9f033c) "' name='RPMH_VRM_VREG_READY_WDOG_TIMER_MUL_CSR_TYPE8'/>"
WRITE #1 "        <register address='0xb9f039c' value='0x" DATA.LONG(A:0xb9f039c) "' name='RPMH_VRM_VREG_READY_WDOG_TIMER_MUL_CSR_TYPE9'/>"
WRITE #1 "        <register address='0xb9f03fc' value='0x" DATA.LONG(A:0xb9f03fc) "' name='RPMH_VRM_VREG_READY_WDOG_TIMER_MUL_CSR_TYPE10'/>"
WRITE #1 "        <register address='0xb9f045c' value='0x" DATA.LONG(A:0xb9f045c) "' name='RPMH_VRM_VREG_READY_WDOG_TIMER_MUL_CSR_TYPE11'/>"
WRITE #1 "        <register address='0xb9f04bc' value='0x" DATA.LONG(A:0xb9f04bc) "' name='RPMH_VRM_VREG_READY_WDOG_TIMER_MUL_CSR_TYPE12'/>"
WRITE #1 "        <register address='0xb9f051c' value='0x" DATA.LONG(A:0xb9f051c) "' name='RPMH_VRM_VREG_READY_WDOG_TIMER_MUL_CSR_TYPE13'/>"
WRITE #1 "        <register address='0xb9f057c' value='0x" DATA.LONG(A:0xb9f057c) "' name='RPMH_VRM_VREG_READY_WDOG_TIMER_MUL_CSR_TYPE14'/>"
WRITE #1 "        <register address='0xb9f05dc' value='0x" DATA.LONG(A:0xb9f05dc) "' name='RPMH_VRM_VREG_READY_WDOG_TIMER_MUL_CSR_TYPE15'/>"
WRITE #1 "        <register address='0xb9f0040' value='0x" DATA.LONG(A:0xb9f0040) "' name='RPMH_VRM_VOLTAGE_UP_EXTRA_TIME_TYPE0'/>"
WRITE #1 "        <register address='0xb9f00a0' value='0x" DATA.LONG(A:0xb9f00a0) "' name='RPMH_VRM_VOLTAGE_UP_EXTRA_TIME_TYPE1'/>"
WRITE #1 "        <register address='0xb9f0100' value='0x" DATA.LONG(A:0xb9f0100) "' name='RPMH_VRM_VOLTAGE_UP_EXTRA_TIME_TYPE2'/>"
WRITE #1 "        <register address='0xb9f0160' value='0x" DATA.LONG(A:0xb9f0160) "' name='RPMH_VRM_VOLTAGE_UP_EXTRA_TIME_TYPE3'/>"
WRITE #1 "        <register address='0xb9f01c0' value='0x" DATA.LONG(A:0xb9f01c0) "' name='RPMH_VRM_VOLTAGE_UP_EXTRA_TIME_TYPE4'/>"
WRITE #1 "        <register address='0xb9f0220' value='0x" DATA.LONG(A:0xb9f0220) "' name='RPMH_VRM_VOLTAGE_UP_EXTRA_TIME_TYPE5'/>"
WRITE #1 "        <register address='0xb9f0280' value='0x" DATA.LONG(A:0xb9f0280) "' name='RPMH_VRM_VOLTAGE_UP_EXTRA_TIME_TYPE6'/>"
WRITE #1 "        <register address='0xb9f02e0' value='0x" DATA.LONG(A:0xb9f02e0) "' name='RPMH_VRM_VOLTAGE_UP_EXTRA_TIME_TYPE7'/>"
WRITE #1 "        <register address='0xb9f0340' value='0x" DATA.LONG(A:0xb9f0340) "' name='RPMH_VRM_VOLTAGE_UP_EXTRA_TIME_TYPE8'/>"
WRITE #1 "        <register address='0xb9f03a0' value='0x" DATA.LONG(A:0xb9f03a0) "' name='RPMH_VRM_VOLTAGE_UP_EXTRA_TIME_TYPE9'/>"
WRITE #1 "        <register address='0xb9f0400' value='0x" DATA.LONG(A:0xb9f0400) "' name='RPMH_VRM_VOLTAGE_UP_EXTRA_TIME_TYPE10'/>"
WRITE #1 "        <register address='0xb9f0460' value='0x" DATA.LONG(A:0xb9f0460) "' name='RPMH_VRM_VOLTAGE_UP_EXTRA_TIME_TYPE11'/>"
WRITE #1 "        <register address='0xb9f04c0' value='0x" DATA.LONG(A:0xb9f04c0) "' name='RPMH_VRM_VOLTAGE_UP_EXTRA_TIME_TYPE12'/>"
WRITE #1 "        <register address='0xb9f0520' value='0x" DATA.LONG(A:0xb9f0520) "' name='RPMH_VRM_VOLTAGE_UP_EXTRA_TIME_TYPE13'/>"
WRITE #1 "        <register address='0xb9f0580' value='0x" DATA.LONG(A:0xb9f0580) "' name='RPMH_VRM_VOLTAGE_UP_EXTRA_TIME_TYPE14'/>"
WRITE #1 "        <register address='0xb9f05e0' value='0x" DATA.LONG(A:0xb9f05e0) "' name='RPMH_VRM_VOLTAGE_UP_EXTRA_TIME_TYPE15'/>"
WRITE #1 "        <register address='0xb9f0044' value='0x" DATA.LONG(A:0xb9f0044) "' name='RPMH_VRM_VOLTAGE_DOWN_EXTRA_TIME_TYPE0'/>"
WRITE #1 "        <register address='0xb9f00a4' value='0x" DATA.LONG(A:0xb9f00a4) "' name='RPMH_VRM_VOLTAGE_DOWN_EXTRA_TIME_TYPE1'/>"
WRITE #1 "        <register address='0xb9f0104' value='0x" DATA.LONG(A:0xb9f0104) "' name='RPMH_VRM_VOLTAGE_DOWN_EXTRA_TIME_TYPE2'/>"
WRITE #1 "        <register address='0xb9f0164' value='0x" DATA.LONG(A:0xb9f0164) "' name='RPMH_VRM_VOLTAGE_DOWN_EXTRA_TIME_TYPE3'/>"
WRITE #1 "        <register address='0xb9f01c4' value='0x" DATA.LONG(A:0xb9f01c4) "' name='RPMH_VRM_VOLTAGE_DOWN_EXTRA_TIME_TYPE4'/>"
WRITE #1 "        <register address='0xb9f0224' value='0x" DATA.LONG(A:0xb9f0224) "' name='RPMH_VRM_VOLTAGE_DOWN_EXTRA_TIME_TYPE5'/>"
WRITE #1 "        <register address='0xb9f0284' value='0x" DATA.LONG(A:0xb9f0284) "' name='RPMH_VRM_VOLTAGE_DOWN_EXTRA_TIME_TYPE6'/>"
WRITE #1 "        <register address='0xb9f02e4' value='0x" DATA.LONG(A:0xb9f02e4) "' name='RPMH_VRM_VOLTAGE_DOWN_EXTRA_TIME_TYPE7'/>"
WRITE #1 "        <register address='0xb9f0344' value='0x" DATA.LONG(A:0xb9f0344) "' name='RPMH_VRM_VOLTAGE_DOWN_EXTRA_TIME_TYPE8'/>"
WRITE #1 "        <register address='0xb9f03a4' value='0x" DATA.LONG(A:0xb9f03a4) "' name='RPMH_VRM_VOLTAGE_DOWN_EXTRA_TIME_TYPE9'/>"
WRITE #1 "        <register address='0xb9f0404' value='0x" DATA.LONG(A:0xb9f0404) "' name='RPMH_VRM_VOLTAGE_DOWN_EXTRA_TIME_TYPE10'/>"
WRITE #1 "        <register address='0xb9f0464' value='0x" DATA.LONG(A:0xb9f0464) "' name='RPMH_VRM_VOLTAGE_DOWN_EXTRA_TIME_TYPE11'/>"
WRITE #1 "        <register address='0xb9f04c4' value='0x" DATA.LONG(A:0xb9f04c4) "' name='RPMH_VRM_VOLTAGE_DOWN_EXTRA_TIME_TYPE12'/>"
WRITE #1 "        <register address='0xb9f0524' value='0x" DATA.LONG(A:0xb9f0524) "' name='RPMH_VRM_VOLTAGE_DOWN_EXTRA_TIME_TYPE13'/>"
WRITE #1 "        <register address='0xb9f0584' value='0x" DATA.LONG(A:0xb9f0584) "' name='RPMH_VRM_VOLTAGE_DOWN_EXTRA_TIME_TYPE14'/>"
WRITE #1 "        <register address='0xb9f05e4' value='0x" DATA.LONG(A:0xb9f05e4) "' name='RPMH_VRM_VOLTAGE_DOWN_EXTRA_TIME_TYPE15'/>"
WRITE #1 "        <register address='0xb9f004c' value='0x" DATA.LONG(A:0xb9f004c) "' name='RPMH_VRM_VREG_CLR_ADDR_OFFSET_CSR_TYPE0'/>"
WRITE #1 "        <register address='0xb9f00ac' value='0x" DATA.LONG(A:0xb9f00ac) "' name='RPMH_VRM_VREG_CLR_ADDR_OFFSET_CSR_TYPE1'/>"
WRITE #1 "        <register address='0xb9f010c' value='0x" DATA.LONG(A:0xb9f010c) "' name='RPMH_VRM_VREG_CLR_ADDR_OFFSET_CSR_TYPE2'/>"
WRITE #1 "        <register address='0xb9f016c' value='0x" DATA.LONG(A:0xb9f016c) "' name='RPMH_VRM_VREG_CLR_ADDR_OFFSET_CSR_TYPE3'/>"
WRITE #1 "        <register address='0xb9f01cc' value='0x" DATA.LONG(A:0xb9f01cc) "' name='RPMH_VRM_VREG_CLR_ADDR_OFFSET_CSR_TYPE4'/>"
WRITE #1 "        <register address='0xb9f022c' value='0x" DATA.LONG(A:0xb9f022c) "' name='RPMH_VRM_VREG_CLR_ADDR_OFFSET_CSR_TYPE5'/>"
WRITE #1 "        <register address='0xb9f028c' value='0x" DATA.LONG(A:0xb9f028c) "' name='RPMH_VRM_VREG_CLR_ADDR_OFFSET_CSR_TYPE6'/>"
WRITE #1 "        <register address='0xb9f02ec' value='0x" DATA.LONG(A:0xb9f02ec) "' name='RPMH_VRM_VREG_CLR_ADDR_OFFSET_CSR_TYPE7'/>"
WRITE #1 "        <register address='0xb9f034c' value='0x" DATA.LONG(A:0xb9f034c) "' name='RPMH_VRM_VREG_CLR_ADDR_OFFSET_CSR_TYPE8'/>"
WRITE #1 "        <register address='0xb9f03ac' value='0x" DATA.LONG(A:0xb9f03ac) "' name='RPMH_VRM_VREG_CLR_ADDR_OFFSET_CSR_TYPE9'/>"
WRITE #1 "        <register address='0xb9f040c' value='0x" DATA.LONG(A:0xb9f040c) "' name='RPMH_VRM_VREG_CLR_ADDR_OFFSET_CSR_TYPE10'/>"
WRITE #1 "        <register address='0xb9f046c' value='0x" DATA.LONG(A:0xb9f046c) "' name='RPMH_VRM_VREG_CLR_ADDR_OFFSET_CSR_TYPE11'/>"
WRITE #1 "        <register address='0xb9f04cc' value='0x" DATA.LONG(A:0xb9f04cc) "' name='RPMH_VRM_VREG_CLR_ADDR_OFFSET_CSR_TYPE12'/>"
WRITE #1 "        <register address='0xb9f052c' value='0x" DATA.LONG(A:0xb9f052c) "' name='RPMH_VRM_VREG_CLR_ADDR_OFFSET_CSR_TYPE13'/>"
WRITE #1 "        <register address='0xb9f058c' value='0x" DATA.LONG(A:0xb9f058c) "' name='RPMH_VRM_VREG_CLR_ADDR_OFFSET_CSR_TYPE14'/>"
WRITE #1 "        <register address='0xb9f05ec' value='0x" DATA.LONG(A:0xb9f05ec) "' name='RPMH_VRM_VREG_CLR_ADDR_OFFSET_CSR_TYPE15'/>"
WRITE #1 "        <register address='0xb9f0050' value='0x" DATA.LONG(A:0xb9f0050) "' name='RPMH_VRM_VREG_CLR_DATA_CSR_TYPE0'/>"
WRITE #1 "        <register address='0xb9f00b0' value='0x" DATA.LONG(A:0xb9f00b0) "' name='RPMH_VRM_VREG_CLR_DATA_CSR_TYPE1'/>"
WRITE #1 "        <register address='0xb9f0110' value='0x" DATA.LONG(A:0xb9f0110) "' name='RPMH_VRM_VREG_CLR_DATA_CSR_TYPE2'/>"
WRITE #1 "        <register address='0xb9f0170' value='0x" DATA.LONG(A:0xb9f0170) "' name='RPMH_VRM_VREG_CLR_DATA_CSR_TYPE3'/>"
WRITE #1 "        <register address='0xb9f01d0' value='0x" DATA.LONG(A:0xb9f01d0) "' name='RPMH_VRM_VREG_CLR_DATA_CSR_TYPE4'/>"
WRITE #1 "        <register address='0xb9f0230' value='0x" DATA.LONG(A:0xb9f0230) "' name='RPMH_VRM_VREG_CLR_DATA_CSR_TYPE5'/>"
WRITE #1 "        <register address='0xb9f0290' value='0x" DATA.LONG(A:0xb9f0290) "' name='RPMH_VRM_VREG_CLR_DATA_CSR_TYPE6'/>"
WRITE #1 "        <register address='0xb9f02f0' value='0x" DATA.LONG(A:0xb9f02f0) "' name='RPMH_VRM_VREG_CLR_DATA_CSR_TYPE7'/>"
WRITE #1 "        <register address='0xb9f0350' value='0x" DATA.LONG(A:0xb9f0350) "' name='RPMH_VRM_VREG_CLR_DATA_CSR_TYPE8'/>"
WRITE #1 "        <register address='0xb9f03b0' value='0x" DATA.LONG(A:0xb9f03b0) "' name='RPMH_VRM_VREG_CLR_DATA_CSR_TYPE9'/>"
WRITE #1 "        <register address='0xb9f0410' value='0x" DATA.LONG(A:0xb9f0410) "' name='RPMH_VRM_VREG_CLR_DATA_CSR_TYPE10'/>"
WRITE #1 "        <register address='0xb9f0470' value='0x" DATA.LONG(A:0xb9f0470) "' name='RPMH_VRM_VREG_CLR_DATA_CSR_TYPE11'/>"
WRITE #1 "        <register address='0xb9f04d0' value='0x" DATA.LONG(A:0xb9f04d0) "' name='RPMH_VRM_VREG_CLR_DATA_CSR_TYPE12'/>"
WRITE #1 "        <register address='0xb9f0530' value='0x" DATA.LONG(A:0xb9f0530) "' name='RPMH_VRM_VREG_CLR_DATA_CSR_TYPE13'/>"
WRITE #1 "        <register address='0xb9f0590' value='0x" DATA.LONG(A:0xb9f0590) "' name='RPMH_VRM_VREG_CLR_DATA_CSR_TYPE14'/>"
WRITE #1 "        <register address='0xb9f05f0' value='0x" DATA.LONG(A:0xb9f05f0) "' name='RPMH_VRM_VREG_CLR_DATA_CSR_TYPE15'/>"
WRITE #1 "        <register address='0xb9f0054' value='0x" DATA.LONG(A:0xb9f0054) "' name='RPMH_VRM_DISCHARGE_TIME_CSR_TYPE0'/>"
WRITE #1 "        <register address='0xb9f00b4' value='0x" DATA.LONG(A:0xb9f00b4) "' name='RPMH_VRM_DISCHARGE_TIME_CSR_TYPE1'/>"
WRITE #1 "        <register address='0xb9f0114' value='0x" DATA.LONG(A:0xb9f0114) "' name='RPMH_VRM_DISCHARGE_TIME_CSR_TYPE2'/>"
WRITE #1 "        <register address='0xb9f0174' value='0x" DATA.LONG(A:0xb9f0174) "' name='RPMH_VRM_DISCHARGE_TIME_CSR_TYPE3'/>"
WRITE #1 "        <register address='0xb9f01d4' value='0x" DATA.LONG(A:0xb9f01d4) "' name='RPMH_VRM_DISCHARGE_TIME_CSR_TYPE4'/>"
WRITE #1 "        <register address='0xb9f0234' value='0x" DATA.LONG(A:0xb9f0234) "' name='RPMH_VRM_DISCHARGE_TIME_CSR_TYPE5'/>"
WRITE #1 "        <register address='0xb9f0294' value='0x" DATA.LONG(A:0xb9f0294) "' name='RPMH_VRM_DISCHARGE_TIME_CSR_TYPE6'/>"
WRITE #1 "        <register address='0xb9f02f4' value='0x" DATA.LONG(A:0xb9f02f4) "' name='RPMH_VRM_DISCHARGE_TIME_CSR_TYPE7'/>"
WRITE #1 "        <register address='0xb9f0354' value='0x" DATA.LONG(A:0xb9f0354) "' name='RPMH_VRM_DISCHARGE_TIME_CSR_TYPE8'/>"
WRITE #1 "        <register address='0xb9f03b4' value='0x" DATA.LONG(A:0xb9f03b4) "' name='RPMH_VRM_DISCHARGE_TIME_CSR_TYPE9'/>"
WRITE #1 "        <register address='0xb9f0414' value='0x" DATA.LONG(A:0xb9f0414) "' name='RPMH_VRM_DISCHARGE_TIME_CSR_TYPE10'/>"
WRITE #1 "        <register address='0xb9f0474' value='0x" DATA.LONG(A:0xb9f0474) "' name='RPMH_VRM_DISCHARGE_TIME_CSR_TYPE11'/>"
WRITE #1 "        <register address='0xb9f04d4' value='0x" DATA.LONG(A:0xb9f04d4) "' name='RPMH_VRM_DISCHARGE_TIME_CSR_TYPE12'/>"
WRITE #1 "        <register address='0xb9f0534' value='0x" DATA.LONG(A:0xb9f0534) "' name='RPMH_VRM_DISCHARGE_TIME_CSR_TYPE13'/>"
WRITE #1 "        <register address='0xb9f0594' value='0x" DATA.LONG(A:0xb9f0594) "' name='RPMH_VRM_DISCHARGE_TIME_CSR_TYPE14'/>"
WRITE #1 "        <register address='0xb9f05f4' value='0x" DATA.LONG(A:0xb9f05f4) "' name='RPMH_VRM_DISCHARGE_TIME_CSR_TYPE15'/>"
WRITE #1 "        <register address='0xb9f1000' value='0x" DATA.LONG(A:0xb9f1000) "' name='RPMH_VRM_VOLTAGE_DEP_IRQ_STATUS_0_CSR'/>"
WRITE #1 "        <register address='0xb9f1018' value='0x" DATA.LONG(A:0xb9f1018) "' name='RPMH_VRM_ENABLE_DEP_IRQ_STATUS_0_CSR'/>"
WRITE #1 "        <register address='0xb9f101c' value='0x" DATA.LONG(A:0xb9f101c) "' name='RPMH_VRM_ENABLE_DEP_IRQ_STATUS_1_CSR'/>"
WRITE #1 "        <register address='0xb9f1038' value='0x" DATA.LONG(A:0xb9f1038) "' name='RPMH_VRM_MODE_DEP_IRQ_STATUS_0_CSR'/>"
WRITE #1 "        <register address='0xb9f1108' value='0x" DATA.LONG(A:0xb9f1108) "' name='RPMH_VRM_VOLTAGE_CHANGE_IRQ_STATUS_0_CSR'/>"
WRITE #1 "        <register address='0xb9f1120' value='0x" DATA.LONG(A:0xb9f1120) "' name='RPMH_VRM_ENABLE_CHANGE_IRQ_STATUS_0_CSR'/>"
WRITE #1 "        <register address='0xb9f1124' value='0x" DATA.LONG(A:0xb9f1124) "' name='RPMH_VRM_ENABLE_CHANGE_IRQ_STATUS_1_CSR'/>"
WRITE #1 "        <register address='0xb9f1140' value='0x" DATA.LONG(A:0xb9f1140) "' name='RPMH_VRM_MODE_CHANGE_IRQ_STATUS_0_CSR'/>"
WRITE #1 "        <register address='0xb9f1170' value='0x" DATA.LONG(A:0xb9f1170) "' name='RPMH_VRM_VOLTAGE_SETTLED_IRQ_STATUS_0_CSR'/>"
WRITE #1 "        <register address='0xb9f1188' value='0x" DATA.LONG(A:0xb9f1188) "' name='RPMH_VRM_ENABLE_SETTLED_IRQ_STATUS_0_CSR'/>"
WRITE #1 "        <register address='0xb9f118c' value='0x" DATA.LONG(A:0xb9f118c) "' name='RPMH_VRM_ENABLE_SETTLED_IRQ_STATUS_1_CSR'/>"
WRITE #1 "        <register address='0xb9f11a0' value='0x" DATA.LONG(A:0xb9f11a0) "' name='RPMH_VRM_MODE_SETTLED_IRQ_STATUS_0_CSR'/>"
WRITE #1 "        <register address='0xb9f1270' value='0x" DATA.LONG(A:0xb9f1270) "' name='RPMH_VRM_VREG_READY_WDOG_IRQ_STATUS_0_CSR'/>"
WRITE #1 "        <register address='0xb9f12c0' value='0x" DATA.LONG(A:0xb9f12c0) "' name='RPMH_VRM_VOLTAGE_DEP_IRQ_ENABLE_0_CSR'/>"
WRITE #1 "        <register address='0xb9f12d8' value='0x" DATA.LONG(A:0xb9f12d8) "' name='RPMH_VRM_ENABLE_DEP_IRQ_ENABLE_0_CSR'/>"
WRITE #1 "        <register address='0xb9f12dc' value='0x" DATA.LONG(A:0xb9f12dc) "' name='RPMH_VRM_ENABLE_DEP_IRQ_ENABLE_1_CSR'/>"
WRITE #1 "        <register address='0xb9f12f8' value='0x" DATA.LONG(A:0xb9f12f8) "' name='RPMH_VRM_MODE_DEP_IRQ_ENABLE_0_CSR'/>"
WRITE #1 "        <register address='0xb9f13c8' value='0x" DATA.LONG(A:0xb9f13c8) "' name='RPMH_VRM_VOLTAGE_CHANGE_IRQ_ENABLE_0_CSR'/>"
WRITE #1 "        <register address='0xb9f13e0' value='0x" DATA.LONG(A:0xb9f13e0) "' name='RPMH_VRM_ENABLE_CHANGE_IRQ_ENABLE_0_CSR'/>"
WRITE #1 "        <register address='0xb9f13e4' value='0x" DATA.LONG(A:0xb9f13e4) "' name='RPMH_VRM_ENABLE_CHANGE_IRQ_ENABLE_1_CSR'/>"
WRITE #1 "        <register address='0xb9f1400' value='0x" DATA.LONG(A:0xb9f1400) "' name='RPMH_VRM_MODE_CHANGE_IRQ_ENABLE_0_CSR'/>"
WRITE #1 "        <register address='0xb9f14d0' value='0x" DATA.LONG(A:0xb9f14d0) "' name='RPMH_VRM_VOLTAGE_SETTLED_IRQ_ENABLE_0_CSR'/>"
WRITE #1 "        <register address='0xb9f14e8' value='0x" DATA.LONG(A:0xb9f14e8) "' name='RPMH_VRM_ENABLE_SETTLED_IRQ_ENABLE_0_CSR'/>"
WRITE #1 "        <register address='0xb9f14ec' value='0x" DATA.LONG(A:0xb9f14ec) "' name='RPMH_VRM_ENABLE_SETTLED_IRQ_ENABLE_1_CSR'/>"
WRITE #1 "        <register address='0xb9f1508' value='0x" DATA.LONG(A:0xb9f1508) "' name='RPMH_VRM_MODE_SETTLED_IRQ_ENABLE_0_CSR'/>"
WRITE #1 "        <register address='0xb9f1538' value='0x" DATA.LONG(A:0xb9f1538) "' name='RPMH_VRM_VREG_READY_WDOG_IRQ_ENABLE_0_CSR'/>"
WRITE #1 "        <register address='0xb9f17b4' value='0x" DATA.LONG(A:0xb9f17b4) "' name='RPMH_VRM_MAX_VOLTAGE_VIOLATION_IRQ_STATUS_0_CSR'/>"
WRITE #1 "        <register address='0xb9f17c0' value='0x" DATA.LONG(A:0xb9f17c0) "' name='RPMH_VRM_MAX_VOLTAGE_VIOLATION_IRQ_ENABLE_0_CSR'/>"
WRITE #1 "        <register address='0xb9f18cc' value='0x" DATA.LONG(A:0xb9f18cc) "' name='RPMH_VRM_CTT_OVERFLOW_IRQ_STATUS_CSR'/>"
WRITE #1 "        <register address='0xb9f18d0' value='0x" DATA.LONG(A:0xb9f18d0) "' name='RPMH_VRM_CTT_OVERFLOW_IRQ_ENABLE_CSR'/>"
WRITE #1 "        <register address='0xb9f18d8' value='0x" DATA.LONG(A:0xb9f18d8) "' name='RPMH_VRM_S_PORT_FAILURE_IRQ_STATUS_CSR'/>"
WRITE #1 "        <register address='0xb9f18dc' value='0x" DATA.LONG(A:0xb9f18dc) "' name='RPMH_VRM_S_PORT_FAILURE_IRQ_ENABLE_CSR'/>"
WRITE #1 "        <register address='0xb9f18f4' value='0x" DATA.LONG(A:0xb9f18f4) "' name='RPMH_VRM_SEQUENCER_IRQ_ENABLE_PRE_CSR'/>"
WRITE #1 "        <register address='0xb9f18f8' value='0x" DATA.LONG(A:0xb9f18f8) "' name='RPMH_VRM_SEQUENCER_IRQ_ENABLE_POST_CSR'/>"
WRITE #1 "        <register address='0xb9f18fc' value='0x" DATA.LONG(A:0xb9f18fc) "' name='RPMH_VRM_SEQUENCER_IRQ_STATUS_PRE_CSR'/>"
WRITE #1 "        <register address='0xb9f1900' value='0x" DATA.LONG(A:0xb9f1900) "' name='RPMH_VRM_SEQUENCER_IRQ_STATUS_POST_CSR'/>"
WRITE #1 "        <register address='0xb9f2000' value='0x" DATA.LONG(A:0xb9f2000) "' name='RPMH_VRM_SEQUENCER0_STATUS_CSR'/>"
WRITE #1 "        <register address='0xb9f2004' value='0x" DATA.LONG(A:0xb9f2004) "' name='RPMH_VRM_SEQUENCER1_STATUS_CSR'/>"
WRITE #1 "        <register address='0xb9f2008' value='0x" DATA.LONG(A:0xb9f2008) "' name='RPMH_VRM_SEQUENCER2_STATUS_CSR'/>"
WRITE #1 "        <register address='0xb9f200c' value='0x" DATA.LONG(A:0xb9f200c) "' name='RPMH_VRM_SEQUENCER3_STATUS_CSR'/>"
WRITE #1 "        <register address='0xb9f2010' value='0x" DATA.LONG(A:0xb9f2010) "' name='RPMH_VRM_SEQUENCER4_STATUS_CSR'/>"
WRITE #1 "        <register address='0xb9f2014' value='0x" DATA.LONG(A:0xb9f2014) "' name='RPMH_VRM_SEQUENCER5_STATUS_CSR'/>"
WRITE #1 "        <register address='0xb9f2018' value='0x" DATA.LONG(A:0xb9f2018) "' name='RPMH_VRM_SEQUENCER6_STATUS_CSR'/>"
WRITE #1 "        <register address='0xb9f201c' value='0x" DATA.LONG(A:0xb9f201c) "' name='RPMH_VRM_SEQUENCER7_STATUS_CSR'/>"
WRITE #1 "        <register address='0xb9f2020' value='0x" DATA.LONG(A:0xb9f2020) "' name='RPMH_VRM_SEQUENCER8_STATUS_CSR'/>"
WRITE #1 "        <register address='0xb9f2024' value='0x" DATA.LONG(A:0xb9f2024) "' name='RPMH_VRM_SEQUENCER9_STATUS_CSR'/>"
WRITE #1 "        <register address='0xb9f2028' value='0x" DATA.LONG(A:0xb9f2028) "' name='RPMH_VRM_SEQUENCER10_STATUS_CSR'/>"
WRITE #1 "        <register address='0xb9f202c' value='0x" DATA.LONG(A:0xb9f202c) "' name='RPMH_VRM_SEQUENCER11_STATUS_CSR'/>"
WRITE #1 "        <register address='0xb9f2030' value='0x" DATA.LONG(A:0xb9f2030) "' name='RPMH_VRM_SEQUENCER12_STATUS_CSR'/>"
WRITE #1 "        <register address='0xb9f2034' value='0x" DATA.LONG(A:0xb9f2034) "' name='RPMH_VRM_SEQUENCER13_STATUS_CSR'/>"
WRITE #1 "        <register address='0xb9f2038' value='0x" DATA.LONG(A:0xb9f2038) "' name='RPMH_VRM_SEQUENCER14_STATUS_CSR'/>"
WRITE #1 "        <register address='0xb9f203c' value='0x" DATA.LONG(A:0xb9f203c) "' name='RPMH_VRM_SEQUENCER15_STATUS_CSR'/>"
WRITE #1 "        <register address='0xb9f2040' value='0x" DATA.LONG(A:0xb9f2040) "' name='RPMH_VRM_SEQUENCER16_STATUS_CSR'/>"
WRITE #1 "        <register address='0xb9f2044' value='0x" DATA.LONG(A:0xb9f2044) "' name='RPMH_VRM_SEQUENCER17_STATUS_CSR'/>"
WRITE #1 "        <register address='0xb9f2048' value='0x" DATA.LONG(A:0xb9f2048) "' name='RPMH_VRM_SEQUENCER18_STATUS_CSR'/>"
WRITE #1 "        <register address='0xb9f204c' value='0x" DATA.LONG(A:0xb9f204c) "' name='RPMH_VRM_SEQUENCER19_STATUS_CSR'/>"
WRITE #1 "        <register address='0xb9f2100' value='0x" DATA.LONG(A:0xb9f2100) "' name='RPMH_VRM_VRM_IDLE_STATUS_CSR'/>"
WRITE #1 "        <register address='0xb9f3190' value='0x" DATA.LONG(A:0xb9f3190) "' name='RPMH_VRM_SEQ_START_ADDR0'/>"
WRITE #1 "        <register address='0xb9f3194' value='0x" DATA.LONG(A:0xb9f3194) "' name='RPMH_VRM_SEQ_START_ADDR1'/>"
WRITE #1 "        <register address='0xb9f3198' value='0x" DATA.LONG(A:0xb9f3198) "' name='RPMH_VRM_SEQ_START_ADDR2'/>"
WRITE #1 "        <register address='0xb9f319c' value='0x" DATA.LONG(A:0xb9f319c) "' name='RPMH_VRM_SEQ_START_ADDR3'/>"
WRITE #1 "        <register address='0xb9f31a0' value='0x" DATA.LONG(A:0xb9f31a0) "' name='RPMH_VRM_SEQ_START_ADDR4'/>"
WRITE #1 "        <register address='0xb9f31a4' value='0x" DATA.LONG(A:0xb9f31a4) "' name='RPMH_VRM_SEQ_START_ADDR5'/>"
WRITE #1 "        <register address='0xb9f31a8' value='0x" DATA.LONG(A:0xb9f31a8) "' name='RPMH_VRM_SEQ_START_ADDR6'/>"
WRITE #1 "        <register address='0xb9f31ac' value='0x" DATA.LONG(A:0xb9f31ac) "' name='RPMH_VRM_SEQ_START_ADDR7'/>"
WRITE #1 "        <register address='0xb9f31f4' value='0x" DATA.LONG(A:0xb9f31f4) "' name='RPMH_VRM_SEQ_WORD0'/>"
WRITE #1 "        <register address='0xb9f31f8' value='0x" DATA.LONG(A:0xb9f31f8) "' name='RPMH_VRM_SEQ_WORD1'/>"
WRITE #1 "        <register address='0xb9f31fc' value='0x" DATA.LONG(A:0xb9f31fc) "' name='RPMH_VRM_SEQ_WORD2'/>"
WRITE #1 "        <register address='0xb9f3200' value='0x" DATA.LONG(A:0xb9f3200) "' name='RPMH_VRM_SEQ_WORD3'/>"
WRITE #1 "        <register address='0xb9f3204' value='0x" DATA.LONG(A:0xb9f3204) "' name='RPMH_VRM_SEQ_WORD4'/>"
WRITE #1 "        <register address='0xb9f3208' value='0x" DATA.LONG(A:0xb9f3208) "' name='RPMH_VRM_SEQ_WORD5'/>"
WRITE #1 "        <register address='0xb9f320c' value='0x" DATA.LONG(A:0xb9f320c) "' name='RPMH_VRM_SEQ_WORD6'/>"
WRITE #1 "        <register address='0xb9f3210' value='0x" DATA.LONG(A:0xb9f3210) "' name='RPMH_VRM_SEQ_WORD7'/>"
WRITE #1 "        <register address='0xb9f3214' value='0x" DATA.LONG(A:0xb9f3214) "' name='RPMH_VRM_SEQ_WORD8'/>"
WRITE #1 "        <register address='0xb9f3218' value='0x" DATA.LONG(A:0xb9f3218) "' name='RPMH_VRM_SEQ_WORD9'/>"
WRITE #1 "        <register address='0xb9f321c' value='0x" DATA.LONG(A:0xb9f321c) "' name='RPMH_VRM_SEQ_WORD10'/>"
WRITE #1 "        <register address='0xb9f3220' value='0x" DATA.LONG(A:0xb9f3220) "' name='RPMH_VRM_SEQ_WORD11'/>"
WRITE #1 "        <register address='0xb9f3224' value='0x" DATA.LONG(A:0xb9f3224) "' name='RPMH_VRM_SEQ_WORD12'/>"
WRITE #1 "        <register address='0xb9f3228' value='0x" DATA.LONG(A:0xb9f3228) "' name='RPMH_VRM_SEQ_WORD13'/>"
WRITE #1 "        <register address='0xb9f322c' value='0x" DATA.LONG(A:0xb9f322c) "' name='RPMH_VRM_SEQ_WORD14'/>"
WRITE #1 "        <register address='0xb9f3230' value='0x" DATA.LONG(A:0xb9f3230) "' name='RPMH_VRM_SEQ_WORD15'/>"
WRITE #1 "        <register address='0xb9f3234' value='0x" DATA.LONG(A:0xb9f3234) "' name='RPMH_VRM_SEQ_WORD16'/>"
WRITE #1 "        <register address='0xb9f3238' value='0x" DATA.LONG(A:0xb9f3238) "' name='RPMH_VRM_SEQ_WORD17'/>"
WRITE #1 "        <register address='0xb9f323c' value='0x" DATA.LONG(A:0xb9f323c) "' name='RPMH_VRM_SEQ_WORD18'/>"
WRITE #1 "        <register address='0xb9f3240' value='0x" DATA.LONG(A:0xb9f3240) "' name='RPMH_VRM_SEQ_WORD19'/>"
WRITE #1 "        <register address='0xb9f3244' value='0x" DATA.LONG(A:0xb9f3244) "' name='RPMH_VRM_SEQ_WORD20'/>"
WRITE #1 "        <register address='0xb9f3248' value='0x" DATA.LONG(A:0xb9f3248) "' name='RPMH_VRM_SEQ_WORD21'/>"
WRITE #1 "        <register address='0xb9f324c' value='0x" DATA.LONG(A:0xb9f324c) "' name='RPMH_VRM_SEQ_WORD22'/>"
WRITE #1 "        <register address='0xb9f3250' value='0x" DATA.LONG(A:0xb9f3250) "' name='RPMH_VRM_SEQ_WORD23'/>"
WRITE #1 "        <register address='0xb9f3254' value='0x" DATA.LONG(A:0xb9f3254) "' name='RPMH_VRM_SEQ_WORD24'/>"
WRITE #1 "        <register address='0xb9f3258' value='0x" DATA.LONG(A:0xb9f3258) "' name='RPMH_VRM_SEQ_WORD25'/>"
WRITE #1 "        <register address='0xb9f325c' value='0x" DATA.LONG(A:0xb9f325c) "' name='RPMH_VRM_SEQ_WORD26'/>"
WRITE #1 "        <register address='0xb9f3260' value='0x" DATA.LONG(A:0xb9f3260) "' name='RPMH_VRM_SEQ_WORD27'/>"
WRITE #1 "        <register address='0xb9f3264' value='0x" DATA.LONG(A:0xb9f3264) "' name='RPMH_VRM_SEQ_WORD28'/>"
WRITE #1 "        <register address='0xb9f3268' value='0x" DATA.LONG(A:0xb9f3268) "' name='RPMH_VRM_SEQ_WORD29'/>"
WRITE #1 "        <register address='0xb9f326c' value='0x" DATA.LONG(A:0xb9f326c) "' name='RPMH_VRM_SEQ_WORD30'/>"
WRITE #1 "        <register address='0xb9f3270' value='0x" DATA.LONG(A:0xb9f3270) "' name='RPMH_VRM_SEQ_WORD31'/>"
WRITE #1 "        <register address='0xb9f35f4' value='0x" DATA.LONG(A:0xb9f35f4) "' name='RPMH_VRM_SEQ_DATA_0_SEQCERS0'/>"
WRITE #1 "        <register address='0xb9f3600' value='0x" DATA.LONG(A:0xb9f3600) "' name='RPMH_VRM_SEQ_DATA_0_SEQCERS1'/>"
WRITE #1 "        <register address='0xb9f360c' value='0x" DATA.LONG(A:0xb9f360c) "' name='RPMH_VRM_SEQ_DATA_0_SEQCERS2'/>"
WRITE #1 "        <register address='0xb9f3618' value='0x" DATA.LONG(A:0xb9f3618) "' name='RPMH_VRM_SEQ_DATA_0_SEQCERS3'/>"
WRITE #1 "        <register address='0xb9f3624' value='0x" DATA.LONG(A:0xb9f3624) "' name='RPMH_VRM_SEQ_DATA_0_SEQCERS4'/>"
WRITE #1 "        <register address='0xb9f3630' value='0x" DATA.LONG(A:0xb9f3630) "' name='RPMH_VRM_SEQ_DATA_0_SEQCERS5'/>"
WRITE #1 "        <register address='0xb9f363c' value='0x" DATA.LONG(A:0xb9f363c) "' name='RPMH_VRM_SEQ_DATA_0_SEQCERS6'/>"
WRITE #1 "        <register address='0xb9f3648' value='0x" DATA.LONG(A:0xb9f3648) "' name='RPMH_VRM_SEQ_DATA_0_SEQCERS7'/>"
WRITE #1 "        <register address='0xb9f3654' value='0x" DATA.LONG(A:0xb9f3654) "' name='RPMH_VRM_SEQ_DATA_0_SEQCERS8'/>"
WRITE #1 "        <register address='0xb9f3660' value='0x" DATA.LONG(A:0xb9f3660) "' name='RPMH_VRM_SEQ_DATA_0_SEQCERS9'/>"
WRITE #1 "        <register address='0xb9f366c' value='0x" DATA.LONG(A:0xb9f366c) "' name='RPMH_VRM_SEQ_DATA_0_SEQCERS10'/>"
WRITE #1 "        <register address='0xb9f3678' value='0x" DATA.LONG(A:0xb9f3678) "' name='RPMH_VRM_SEQ_DATA_0_SEQCERS11'/>"
WRITE #1 "        <register address='0xb9f3684' value='0x" DATA.LONG(A:0xb9f3684) "' name='RPMH_VRM_SEQ_DATA_0_SEQCERS12'/>"
WRITE #1 "        <register address='0xb9f3690' value='0x" DATA.LONG(A:0xb9f3690) "' name='RPMH_VRM_SEQ_DATA_0_SEQCERS13'/>"
WRITE #1 "        <register address='0xb9f369c' value='0x" DATA.LONG(A:0xb9f369c) "' name='RPMH_VRM_SEQ_DATA_0_SEQCERS14'/>"
WRITE #1 "        <register address='0xb9f36a8' value='0x" DATA.LONG(A:0xb9f36a8) "' name='RPMH_VRM_SEQ_DATA_0_SEQCERS15'/>"
WRITE #1 "        <register address='0xb9f36b4' value='0x" DATA.LONG(A:0xb9f36b4) "' name='RPMH_VRM_SEQ_DATA_0_SEQCERS16'/>"
WRITE #1 "        <register address='0xb9f36c0' value='0x" DATA.LONG(A:0xb9f36c0) "' name='RPMH_VRM_SEQ_DATA_0_SEQCERS17'/>"
WRITE #1 "        <register address='0xb9f36cc' value='0x" DATA.LONG(A:0xb9f36cc) "' name='RPMH_VRM_SEQ_DATA_0_SEQCERS18'/>"
WRITE #1 "        <register address='0xb9f36d8' value='0x" DATA.LONG(A:0xb9f36d8) "' name='RPMH_VRM_SEQ_DATA_0_SEQCERS19'/>"
WRITE #1 "        <register address='0xb9f35f8' value='0x" DATA.LONG(A:0xb9f35f8) "' name='RPMH_VRM_SEQ_DATA_1_SEQCERS0'/>"
WRITE #1 "        <register address='0xb9f3604' value='0x" DATA.LONG(A:0xb9f3604) "' name='RPMH_VRM_SEQ_DATA_1_SEQCERS1'/>"
WRITE #1 "        <register address='0xb9f3610' value='0x" DATA.LONG(A:0xb9f3610) "' name='RPMH_VRM_SEQ_DATA_1_SEQCERS2'/>"
WRITE #1 "        <register address='0xb9f361c' value='0x" DATA.LONG(A:0xb9f361c) "' name='RPMH_VRM_SEQ_DATA_1_SEQCERS3'/>"
WRITE #1 "        <register address='0xb9f3628' value='0x" DATA.LONG(A:0xb9f3628) "' name='RPMH_VRM_SEQ_DATA_1_SEQCERS4'/>"
WRITE #1 "        <register address='0xb9f3634' value='0x" DATA.LONG(A:0xb9f3634) "' name='RPMH_VRM_SEQ_DATA_1_SEQCERS5'/>"
WRITE #1 "        <register address='0xb9f3640' value='0x" DATA.LONG(A:0xb9f3640) "' name='RPMH_VRM_SEQ_DATA_1_SEQCERS6'/>"
WRITE #1 "        <register address='0xb9f364c' value='0x" DATA.LONG(A:0xb9f364c) "' name='RPMH_VRM_SEQ_DATA_1_SEQCERS7'/>"
WRITE #1 "        <register address='0xb9f3658' value='0x" DATA.LONG(A:0xb9f3658) "' name='RPMH_VRM_SEQ_DATA_1_SEQCERS8'/>"
WRITE #1 "        <register address='0xb9f3664' value='0x" DATA.LONG(A:0xb9f3664) "' name='RPMH_VRM_SEQ_DATA_1_SEQCERS9'/>"
WRITE #1 "        <register address='0xb9f3670' value='0x" DATA.LONG(A:0xb9f3670) "' name='RPMH_VRM_SEQ_DATA_1_SEQCERS10'/>"
WRITE #1 "        <register address='0xb9f367c' value='0x" DATA.LONG(A:0xb9f367c) "' name='RPMH_VRM_SEQ_DATA_1_SEQCERS11'/>"
WRITE #1 "        <register address='0xb9f3688' value='0x" DATA.LONG(A:0xb9f3688) "' name='RPMH_VRM_SEQ_DATA_1_SEQCERS12'/>"
WRITE #1 "        <register address='0xb9f3694' value='0x" DATA.LONG(A:0xb9f3694) "' name='RPMH_VRM_SEQ_DATA_1_SEQCERS13'/>"
WRITE #1 "        <register address='0xb9f36a0' value='0x" DATA.LONG(A:0xb9f36a0) "' name='RPMH_VRM_SEQ_DATA_1_SEQCERS14'/>"
WRITE #1 "        <register address='0xb9f36ac' value='0x" DATA.LONG(A:0xb9f36ac) "' name='RPMH_VRM_SEQ_DATA_1_SEQCERS15'/>"
WRITE #1 "        <register address='0xb9f36b8' value='0x" DATA.LONG(A:0xb9f36b8) "' name='RPMH_VRM_SEQ_DATA_1_SEQCERS16'/>"
WRITE #1 "        <register address='0xb9f36c4' value='0x" DATA.LONG(A:0xb9f36c4) "' name='RPMH_VRM_SEQ_DATA_1_SEQCERS17'/>"
WRITE #1 "        <register address='0xb9f36d0' value='0x" DATA.LONG(A:0xb9f36d0) "' name='RPMH_VRM_SEQ_DATA_1_SEQCERS18'/>"
WRITE #1 "        <register address='0xb9f36dc' value='0x" DATA.LONG(A:0xb9f36dc) "' name='RPMH_VRM_SEQ_DATA_1_SEQCERS19'/>"
WRITE #1 "        <register address='0xb9f35fc' value='0x" DATA.LONG(A:0xb9f35fc) "' name='RPMH_VRM_SEQ_DATA_2_SEQCERS0'/>"
WRITE #1 "        <register address='0xb9f3608' value='0x" DATA.LONG(A:0xb9f3608) "' name='RPMH_VRM_SEQ_DATA_2_SEQCERS1'/>"
WRITE #1 "        <register address='0xb9f3614' value='0x" DATA.LONG(A:0xb9f3614) "' name='RPMH_VRM_SEQ_DATA_2_SEQCERS2'/>"
WRITE #1 "        <register address='0xb9f3620' value='0x" DATA.LONG(A:0xb9f3620) "' name='RPMH_VRM_SEQ_DATA_2_SEQCERS3'/>"
WRITE #1 "        <register address='0xb9f362c' value='0x" DATA.LONG(A:0xb9f362c) "' name='RPMH_VRM_SEQ_DATA_2_SEQCERS4'/>"
WRITE #1 "        <register address='0xb9f3638' value='0x" DATA.LONG(A:0xb9f3638) "' name='RPMH_VRM_SEQ_DATA_2_SEQCERS5'/>"
WRITE #1 "        <register address='0xb9f3644' value='0x" DATA.LONG(A:0xb9f3644) "' name='RPMH_VRM_SEQ_DATA_2_SEQCERS6'/>"
WRITE #1 "        <register address='0xb9f3650' value='0x" DATA.LONG(A:0xb9f3650) "' name='RPMH_VRM_SEQ_DATA_2_SEQCERS7'/>"
WRITE #1 "        <register address='0xb9f365c' value='0x" DATA.LONG(A:0xb9f365c) "' name='RPMH_VRM_SEQ_DATA_2_SEQCERS8'/>"
WRITE #1 "        <register address='0xb9f3668' value='0x" DATA.LONG(A:0xb9f3668) "' name='RPMH_VRM_SEQ_DATA_2_SEQCERS9'/>"
WRITE #1 "        <register address='0xb9f3674' value='0x" DATA.LONG(A:0xb9f3674) "' name='RPMH_VRM_SEQ_DATA_2_SEQCERS10'/>"
WRITE #1 "        <register address='0xb9f3680' value='0x" DATA.LONG(A:0xb9f3680) "' name='RPMH_VRM_SEQ_DATA_2_SEQCERS11'/>"
WRITE #1 "        <register address='0xb9f368c' value='0x" DATA.LONG(A:0xb9f368c) "' name='RPMH_VRM_SEQ_DATA_2_SEQCERS12'/>"
WRITE #1 "        <register address='0xb9f3698' value='0x" DATA.LONG(A:0xb9f3698) "' name='RPMH_VRM_SEQ_DATA_2_SEQCERS13'/>"
WRITE #1 "        <register address='0xb9f36a4' value='0x" DATA.LONG(A:0xb9f36a4) "' name='RPMH_VRM_SEQ_DATA_2_SEQCERS14'/>"
WRITE #1 "        <register address='0xb9f36b0' value='0x" DATA.LONG(A:0xb9f36b0) "' name='RPMH_VRM_SEQ_DATA_2_SEQCERS15'/>"
WRITE #1 "        <register address='0xb9f36bc' value='0x" DATA.LONG(A:0xb9f36bc) "' name='RPMH_VRM_SEQ_DATA_2_SEQCERS16'/>"
WRITE #1 "        <register address='0xb9f36c8' value='0x" DATA.LONG(A:0xb9f36c8) "' name='RPMH_VRM_SEQ_DATA_2_SEQCERS17'/>"
WRITE #1 "        <register address='0xb9f36d4' value='0x" DATA.LONG(A:0xb9f36d4) "' name='RPMH_VRM_SEQ_DATA_2_SEQCERS18'/>"
WRITE #1 "        <register address='0xb9f36e0' value='0x" DATA.LONG(A:0xb9f36e0) "' name='RPMH_VRM_SEQ_DATA_2_SEQCERS19'/>"
WRITE #1 "        <register address='0xb9f5000' value='0x" DATA.LONG(A:0xb9f5000) "' name='RPMH_VRM_VRM_VERSION'/>"
WRITE #1 "        <register address='0xb9f5004' value='0x" DATA.LONG(A:0xb9f5004) "' name='RPMH_VRM_VREG_READY_EXTRA_TIME'/>"
WRITE #1 "        <register address='0xb9f5008' value='0x" DATA.LONG(A:0xb9f5008) "' name='RPMH_VRM_VREG_READY_WDOG_ERROR_ENABLE'/>"
WRITE #1 "        <register address='0xb9f500c' value='0x" DATA.LONG(A:0xb9f500c) "' name='RPMH_VRM_VREG_READY_CLR_BR_ADDR_CSR_REG'/>"
WRITE #1 "        <register address='0xb9f5010' value='0x" DATA.LONG(A:0xb9f5010) "' name='RPMH_VRM_CMD_SYN_UNBLOCK'/>"
WRITE #1 "        <register address='0xb9f5014' value='0x" DATA.LONG(A:0xb9f5014) "' name='RPMH_VRM_MIN_SETTLING_TIME_CSR_REG'/>"
WRITE #1 "        <register address='0xb9f5090' value='0x" DATA.LONG(A:0xb9f5090) "' name='RPMH_VRM_RESP_ADDR_DRV0'/>"
WRITE #1 "        <register address='0xb9f5094' value='0x" DATA.LONG(A:0xb9f5094) "' name='RPMH_VRM_RESP_ADDR_DRV1'/>"
WRITE #1 "        <register address='0xb9f5098' value='0x" DATA.LONG(A:0xb9f5098) "' name='RPMH_VRM_RESP_ADDR_DRV2'/>"
WRITE #1 "        <register address='0xb9f509c' value='0x" DATA.LONG(A:0xb9f509c) "' name='RPMH_VRM_RESP_ADDR_DRV3'/>"
WRITE #1 "        <register address='0xb9f50a0' value='0x" DATA.LONG(A:0xb9f50a0) "' name='RPMH_VRM_RESP_ADDR_DRV4'/>"
WRITE #1 "        <register address='0xb9f50a4' value='0x" DATA.LONG(A:0xb9f50a4) "' name='RPMH_VRM_RESP_ADDR_DRV5'/>"
WRITE #1 "        <register address='0xb9f50a8' value='0x" DATA.LONG(A:0xb9f50a8) "' name='RPMH_VRM_RESP_ADDR_DRV6'/>"
WRITE #1 "        <register address='0xb9f5100' value='0x" DATA.LONG(A:0xb9f5100) "' name='RPMH_VRM_RESP_ADDR2_DRV0'/>"
WRITE #1 "        <register address='0xb9f5104' value='0x" DATA.LONG(A:0xb9f5104) "' name='RPMH_VRM_RESP_ADDR2_DRV1'/>"
WRITE #1 "        <register address='0xb9f5108' value='0x" DATA.LONG(A:0xb9f5108) "' name='RPMH_VRM_RESP_ADDR2_DRV2'/>"
WRITE #1 "        <register address='0xb9f510c' value='0x" DATA.LONG(A:0xb9f510c) "' name='RPMH_VRM_RESP_ADDR2_DRV3'/>"
WRITE #1 "        <register address='0xb9f5110' value='0x" DATA.LONG(A:0xb9f5110) "' name='RPMH_VRM_RESP_ADDR2_DRV4'/>"
WRITE #1 "        <register address='0xb9f5114' value='0x" DATA.LONG(A:0xb9f5114) "' name='RPMH_VRM_RESP_ADDR2_DRV5'/>"
WRITE #1 "        <register address='0xb9f5118' value='0x" DATA.LONG(A:0xb9f5118) "' name='RPMH_VRM_RESP_ADDR2_DRV6'/>"
WRITE #1 "        <register address='0xb9f54a8' value='0x" DATA.LONG(A:0xb9f54a8) "' name='RPMH_VRM_VRM_CFG'/>"
WRITE #1 "        <register address='0xb9f54ac' value='0x" DATA.LONG(A:0xb9f54ac) "' name='RPMH_VRM_CMD_SYN_CFG'/>"
WRITE #1 "        <register address='0xb9f54b0' value='0x" DATA.LONG(A:0xb9f54b0) "' name='RPMH_VRM_SW_WORKAROUND_BR_ADDR0_CSR_REG'/>"
WRITE #1 "        <register address='0xb9f54b4' value='0x" DATA.LONG(A:0xb9f54b4) "' name='RPMH_VRM_SW_WORKAROUND_BR_ADDR1_CSR_REG'/>"
WRITE #1 "        <register address='0xb9f54b8' value='0x" DATA.LONG(A:0xb9f54b8) "' name='RPMH_VRM_SW_WORKAROUND_BR_ADDR2_CSR_REG'/>"
WRITE #1 "        <register address='0xb9f54bc' value='0x" DATA.LONG(A:0xb9f54bc) "' name='RPMH_VRM_VRM_CLK_GATING_EN_CFG'/>"
WRITE #1 "        <register address='0xb9f54c0' value='0x" DATA.LONG(A:0xb9f54c0) "' name='RPMH_VRM_VRM_DEBUG_BUS_EN_CFG'/>"
WRITE #1 "        <register address='0xb9f54c4' value='0x" DATA.LONG(A:0xb9f54c4) "' name='RPMH_VRM_VRM_DEBUG_BUS_CFG'/>"
WRITE #1 "        <register address='0xba00000' value='0x" DATA.LONG(A:0xba00000) "' name='RPMH_BCM_VOTETABLE_DRV0_ND0'/>"
WRITE #1 "        <register address='0xba00004' value='0x" DATA.LONG(A:0xba00004) "' name='RPMH_BCM_VOTETABLE_DRV0_ND1'/>"
WRITE #1 "        <register address='0xba00008' value='0x" DATA.LONG(A:0xba00008) "' name='RPMH_BCM_VOTETABLE_DRV0_ND2'/>"
WRITE #1 "        <register address='0xba0000c' value='0x" DATA.LONG(A:0xba0000c) "' name='RPMH_BCM_VOTETABLE_DRV0_ND3'/>"
WRITE #1 "        <register address='0xba00010' value='0x" DATA.LONG(A:0xba00010) "' name='RPMH_BCM_VOTETABLE_DRV0_ND4'/>"
WRITE #1 "        <register address='0xba00014' value='0x" DATA.LONG(A:0xba00014) "' name='RPMH_BCM_VOTETABLE_DRV0_ND5'/>"
WRITE #1 "        <register address='0xba00018' value='0x" DATA.LONG(A:0xba00018) "' name='RPMH_BCM_VOTETABLE_DRV0_ND6'/>"
WRITE #1 "        <register address='0xba0001c' value='0x" DATA.LONG(A:0xba0001c) "' name='RPMH_BCM_VOTETABLE_DRV0_ND7'/>"
WRITE #1 "        <register address='0xba00020' value='0x" DATA.LONG(A:0xba00020) "' name='RPMH_BCM_VOTETABLE_DRV0_ND8'/>"
WRITE #1 "        <register address='0xba00024' value='0x" DATA.LONG(A:0xba00024) "' name='RPMH_BCM_VOTETABLE_DRV0_ND9'/>"
WRITE #1 "        <register address='0xba00028' value='0x" DATA.LONG(A:0xba00028) "' name='RPMH_BCM_VOTETABLE_DRV0_ND10'/>"
WRITE #1 "        <register address='0xba0002c' value='0x" DATA.LONG(A:0xba0002c) "' name='RPMH_BCM_VOTETABLE_DRV0_ND11'/>"
WRITE #1 "        <register address='0xba00030' value='0x" DATA.LONG(A:0xba00030) "' name='RPMH_BCM_VOTETABLE_DRV0_ND12'/>"
WRITE #1 "        <register address='0xba00034' value='0x" DATA.LONG(A:0xba00034) "' name='RPMH_BCM_VOTETABLE_DRV0_ND13'/>"
WRITE #1 "        <register address='0xba00038' value='0x" DATA.LONG(A:0xba00038) "' name='RPMH_BCM_VOTETABLE_DRV0_ND14'/>"
WRITE #1 "        <register address='0xba0003c' value='0x" DATA.LONG(A:0xba0003c) "' name='RPMH_BCM_VOTETABLE_DRV0_ND15'/>"
WRITE #1 "        <register address='0xba00040' value='0x" DATA.LONG(A:0xba00040) "' name='RPMH_BCM_VOTETABLE_DRV0_ND16'/>"
WRITE #1 "        <register address='0xba00044' value='0x" DATA.LONG(A:0xba00044) "' name='RPMH_BCM_VOTETABLE_DRV0_ND17'/>"
WRITE #1 "        <register address='0xba00048' value='0x" DATA.LONG(A:0xba00048) "' name='RPMH_BCM_VOTETABLE_DRV0_ND18'/>"
WRITE #1 "        <register address='0xba0004c' value='0x" DATA.LONG(A:0xba0004c) "' name='RPMH_BCM_VOTETABLE_DRV0_ND19'/>"
WRITE #1 "        <register address='0xba00050' value='0x" DATA.LONG(A:0xba00050) "' name='RPMH_BCM_VOTETABLE_DRV0_ND20'/>"
WRITE #1 "        <register address='0xba00054' value='0x" DATA.LONG(A:0xba00054) "' name='RPMH_BCM_VOTETABLE_DRV0_ND21'/>"
WRITE #1 "        <register address='0xba00058' value='0x" DATA.LONG(A:0xba00058) "' name='RPMH_BCM_VOTETABLE_DRV0_ND22'/>"
WRITE #1 "        <register address='0xba0005c' value='0x" DATA.LONG(A:0xba0005c) "' name='RPMH_BCM_VOTETABLE_DRV0_ND23'/>"
WRITE #1 "        <register address='0xba00060' value='0x" DATA.LONG(A:0xba00060) "' name='RPMH_BCM_VOTETABLE_DRV0_ND24'/>"
WRITE #1 "        <register address='0xba00064' value='0x" DATA.LONG(A:0xba00064) "' name='RPMH_BCM_VOTETABLE_DRV0_ND25'/>"
WRITE #1 "        <register address='0xba00068' value='0x" DATA.LONG(A:0xba00068) "' name='RPMH_BCM_VOTETABLE_DRV0_ND26'/>"
WRITE #1 "        <register address='0xba0006c' value='0x" DATA.LONG(A:0xba0006c) "' name='RPMH_BCM_VOTETABLE_DRV0_ND27'/>"
WRITE #1 "        <register address='0xba00070' value='0x" DATA.LONG(A:0xba00070) "' name='RPMH_BCM_VOTETABLE_DRV0_ND28'/>"
WRITE #1 "        <register address='0xba00074' value='0x" DATA.LONG(A:0xba00074) "' name='RPMH_BCM_VOTETABLE_DRV0_ND29'/>"
WRITE #1 "        <register address='0xba00078' value='0x" DATA.LONG(A:0xba00078) "' name='RPMH_BCM_VOTETABLE_DRV0_ND30'/>"
WRITE #1 "        <register address='0xba0007c' value='0x" DATA.LONG(A:0xba0007c) "' name='RPMH_BCM_VOTETABLE_DRV0_ND31'/>"
WRITE #1 "        <register address='0xba00080' value='0x" DATA.LONG(A:0xba00080) "' name='RPMH_BCM_VOTETABLE_DRV0_ND32'/>"
WRITE #1 "        <register address='0xba00084' value='0x" DATA.LONG(A:0xba00084) "' name='RPMH_BCM_VOTETABLE_DRV0_ND33'/>"
WRITE #1 "        <register address='0xba00088' value='0x" DATA.LONG(A:0xba00088) "' name='RPMH_BCM_VOTETABLE_DRV0_ND34'/>"
WRITE #1 "        <register address='0xba0008c' value='0x" DATA.LONG(A:0xba0008c) "' name='RPMH_BCM_VOTETABLE_DRV0_ND35'/>"
WRITE #1 "        <register address='0xba00090' value='0x" DATA.LONG(A:0xba00090) "' name='RPMH_BCM_VOTETABLE_DRV0_ND36'/>"
WRITE #1 "        <register address='0xba00094' value='0x" DATA.LONG(A:0xba00094) "' name='RPMH_BCM_VOTETABLE_DRV0_ND37'/>"
WRITE #1 "        <register address='0xba00098' value='0x" DATA.LONG(A:0xba00098) "' name='RPMH_BCM_VOTETABLE_DRV0_ND38'/>"
WRITE #1 "        <register address='0xba0009c' value='0x" DATA.LONG(A:0xba0009c) "' name='RPMH_BCM_VOTETABLE_DRV0_ND39'/>"
WRITE #1 "        <register address='0xba000a0' value='0x" DATA.LONG(A:0xba000a0) "' name='RPMH_BCM_VOTETABLE_DRV0_ND40'/>"
WRITE #1 "        <register address='0xba000a4' value='0x" DATA.LONG(A:0xba000a4) "' name='RPMH_BCM_VOTETABLE_DRV0_ND41'/>"
WRITE #1 "        <register address='0xba000a8' value='0x" DATA.LONG(A:0xba000a8) "' name='RPMH_BCM_VOTETABLE_DRV0_ND42'/>"
WRITE #1 "        <register address='0xba000ac' value='0x" DATA.LONG(A:0xba000ac) "' name='RPMH_BCM_VOTETABLE_DRV0_ND43'/>"
WRITE #1 "        <register address='0xba10000' value='0x" DATA.LONG(A:0xba10000) "' name='RPMH_BCM_VOTETABLE_DRV1_ND0'/>"
WRITE #1 "        <register address='0xba10004' value='0x" DATA.LONG(A:0xba10004) "' name='RPMH_BCM_VOTETABLE_DRV1_ND1'/>"
WRITE #1 "        <register address='0xba10008' value='0x" DATA.LONG(A:0xba10008) "' name='RPMH_BCM_VOTETABLE_DRV1_ND2'/>"
WRITE #1 "        <register address='0xba1000c' value='0x" DATA.LONG(A:0xba1000c) "' name='RPMH_BCM_VOTETABLE_DRV1_ND3'/>"
WRITE #1 "        <register address='0xba10010' value='0x" DATA.LONG(A:0xba10010) "' name='RPMH_BCM_VOTETABLE_DRV1_ND4'/>"
WRITE #1 "        <register address='0xba10014' value='0x" DATA.LONG(A:0xba10014) "' name='RPMH_BCM_VOTETABLE_DRV1_ND5'/>"
WRITE #1 "        <register address='0xba10018' value='0x" DATA.LONG(A:0xba10018) "' name='RPMH_BCM_VOTETABLE_DRV1_ND6'/>"
WRITE #1 "        <register address='0xba1001c' value='0x" DATA.LONG(A:0xba1001c) "' name='RPMH_BCM_VOTETABLE_DRV1_ND7'/>"
WRITE #1 "        <register address='0xba10020' value='0x" DATA.LONG(A:0xba10020) "' name='RPMH_BCM_VOTETABLE_DRV1_ND8'/>"
WRITE #1 "        <register address='0xba10024' value='0x" DATA.LONG(A:0xba10024) "' name='RPMH_BCM_VOTETABLE_DRV1_ND9'/>"
WRITE #1 "        <register address='0xba10028' value='0x" DATA.LONG(A:0xba10028) "' name='RPMH_BCM_VOTETABLE_DRV1_ND10'/>"
WRITE #1 "        <register address='0xba1002c' value='0x" DATA.LONG(A:0xba1002c) "' name='RPMH_BCM_VOTETABLE_DRV1_ND11'/>"
WRITE #1 "        <register address='0xba10030' value='0x" DATA.LONG(A:0xba10030) "' name='RPMH_BCM_VOTETABLE_DRV1_ND12'/>"
WRITE #1 "        <register address='0xba10034' value='0x" DATA.LONG(A:0xba10034) "' name='RPMH_BCM_VOTETABLE_DRV1_ND13'/>"
WRITE #1 "        <register address='0xba10038' value='0x" DATA.LONG(A:0xba10038) "' name='RPMH_BCM_VOTETABLE_DRV1_ND14'/>"
WRITE #1 "        <register address='0xba1003c' value='0x" DATA.LONG(A:0xba1003c) "' name='RPMH_BCM_VOTETABLE_DRV1_ND15'/>"
WRITE #1 "        <register address='0xba10040' value='0x" DATA.LONG(A:0xba10040) "' name='RPMH_BCM_VOTETABLE_DRV1_ND16'/>"
WRITE #1 "        <register address='0xba10044' value='0x" DATA.LONG(A:0xba10044) "' name='RPMH_BCM_VOTETABLE_DRV1_ND17'/>"
WRITE #1 "        <register address='0xba10048' value='0x" DATA.LONG(A:0xba10048) "' name='RPMH_BCM_VOTETABLE_DRV1_ND18'/>"
WRITE #1 "        <register address='0xba1004c' value='0x" DATA.LONG(A:0xba1004c) "' name='RPMH_BCM_VOTETABLE_DRV1_ND19'/>"
WRITE #1 "        <register address='0xba10050' value='0x" DATA.LONG(A:0xba10050) "' name='RPMH_BCM_VOTETABLE_DRV1_ND20'/>"
WRITE #1 "        <register address='0xba10054' value='0x" DATA.LONG(A:0xba10054) "' name='RPMH_BCM_VOTETABLE_DRV1_ND21'/>"
WRITE #1 "        <register address='0xba10058' value='0x" DATA.LONG(A:0xba10058) "' name='RPMH_BCM_VOTETABLE_DRV1_ND22'/>"
WRITE #1 "        <register address='0xba1005c' value='0x" DATA.LONG(A:0xba1005c) "' name='RPMH_BCM_VOTETABLE_DRV1_ND23'/>"
WRITE #1 "        <register address='0xba10060' value='0x" DATA.LONG(A:0xba10060) "' name='RPMH_BCM_VOTETABLE_DRV1_ND24'/>"
WRITE #1 "        <register address='0xba10064' value='0x" DATA.LONG(A:0xba10064) "' name='RPMH_BCM_VOTETABLE_DRV1_ND25'/>"
WRITE #1 "        <register address='0xba10068' value='0x" DATA.LONG(A:0xba10068) "' name='RPMH_BCM_VOTETABLE_DRV1_ND26'/>"
WRITE #1 "        <register address='0xba1006c' value='0x" DATA.LONG(A:0xba1006c) "' name='RPMH_BCM_VOTETABLE_DRV1_ND27'/>"
WRITE #1 "        <register address='0xba10070' value='0x" DATA.LONG(A:0xba10070) "' name='RPMH_BCM_VOTETABLE_DRV1_ND28'/>"
WRITE #1 "        <register address='0xba10074' value='0x" DATA.LONG(A:0xba10074) "' name='RPMH_BCM_VOTETABLE_DRV1_ND29'/>"
WRITE #1 "        <register address='0xba10078' value='0x" DATA.LONG(A:0xba10078) "' name='RPMH_BCM_VOTETABLE_DRV1_ND30'/>"
WRITE #1 "        <register address='0xba1007c' value='0x" DATA.LONG(A:0xba1007c) "' name='RPMH_BCM_VOTETABLE_DRV1_ND31'/>"
WRITE #1 "        <register address='0xba10080' value='0x" DATA.LONG(A:0xba10080) "' name='RPMH_BCM_VOTETABLE_DRV1_ND32'/>"
WRITE #1 "        <register address='0xba10084' value='0x" DATA.LONG(A:0xba10084) "' name='RPMH_BCM_VOTETABLE_DRV1_ND33'/>"
WRITE #1 "        <register address='0xba10088' value='0x" DATA.LONG(A:0xba10088) "' name='RPMH_BCM_VOTETABLE_DRV1_ND34'/>"
WRITE #1 "        <register address='0xba1008c' value='0x" DATA.LONG(A:0xba1008c) "' name='RPMH_BCM_VOTETABLE_DRV1_ND35'/>"
WRITE #1 "        <register address='0xba10090' value='0x" DATA.LONG(A:0xba10090) "' name='RPMH_BCM_VOTETABLE_DRV1_ND36'/>"
WRITE #1 "        <register address='0xba10094' value='0x" DATA.LONG(A:0xba10094) "' name='RPMH_BCM_VOTETABLE_DRV1_ND37'/>"
WRITE #1 "        <register address='0xba10098' value='0x" DATA.LONG(A:0xba10098) "' name='RPMH_BCM_VOTETABLE_DRV1_ND38'/>"
WRITE #1 "        <register address='0xba1009c' value='0x" DATA.LONG(A:0xba1009c) "' name='RPMH_BCM_VOTETABLE_DRV1_ND39'/>"
WRITE #1 "        <register address='0xba100a0' value='0x" DATA.LONG(A:0xba100a0) "' name='RPMH_BCM_VOTETABLE_DRV1_ND40'/>"
WRITE #1 "        <register address='0xba100a4' value='0x" DATA.LONG(A:0xba100a4) "' name='RPMH_BCM_VOTETABLE_DRV1_ND41'/>"
WRITE #1 "        <register address='0xba100a8' value='0x" DATA.LONG(A:0xba100a8) "' name='RPMH_BCM_VOTETABLE_DRV1_ND42'/>"
WRITE #1 "        <register address='0xba100ac' value='0x" DATA.LONG(A:0xba100ac) "' name='RPMH_BCM_VOTETABLE_DRV1_ND43'/>"
WRITE #1 "        <register address='0xba20000' value='0x" DATA.LONG(A:0xba20000) "' name='RPMH_BCM_VOTETABLE_DRV2_ND0'/>"
WRITE #1 "        <register address='0xba20004' value='0x" DATA.LONG(A:0xba20004) "' name='RPMH_BCM_VOTETABLE_DRV2_ND1'/>"
WRITE #1 "        <register address='0xba20008' value='0x" DATA.LONG(A:0xba20008) "' name='RPMH_BCM_VOTETABLE_DRV2_ND2'/>"
WRITE #1 "        <register address='0xba2000c' value='0x" DATA.LONG(A:0xba2000c) "' name='RPMH_BCM_VOTETABLE_DRV2_ND3'/>"
WRITE #1 "        <register address='0xba20010' value='0x" DATA.LONG(A:0xba20010) "' name='RPMH_BCM_VOTETABLE_DRV2_ND4'/>"
WRITE #1 "        <register address='0xba20014' value='0x" DATA.LONG(A:0xba20014) "' name='RPMH_BCM_VOTETABLE_DRV2_ND5'/>"
WRITE #1 "        <register address='0xba20018' value='0x" DATA.LONG(A:0xba20018) "' name='RPMH_BCM_VOTETABLE_DRV2_ND6'/>"
WRITE #1 "        <register address='0xba2001c' value='0x" DATA.LONG(A:0xba2001c) "' name='RPMH_BCM_VOTETABLE_DRV2_ND7'/>"
WRITE #1 "        <register address='0xba20020' value='0x" DATA.LONG(A:0xba20020) "' name='RPMH_BCM_VOTETABLE_DRV2_ND8'/>"
WRITE #1 "        <register address='0xba20024' value='0x" DATA.LONG(A:0xba20024) "' name='RPMH_BCM_VOTETABLE_DRV2_ND9'/>"
WRITE #1 "        <register address='0xba20028' value='0x" DATA.LONG(A:0xba20028) "' name='RPMH_BCM_VOTETABLE_DRV2_ND10'/>"
WRITE #1 "        <register address='0xba2002c' value='0x" DATA.LONG(A:0xba2002c) "' name='RPMH_BCM_VOTETABLE_DRV2_ND11'/>"
WRITE #1 "        <register address='0xba20030' value='0x" DATA.LONG(A:0xba20030) "' name='RPMH_BCM_VOTETABLE_DRV2_ND12'/>"
WRITE #1 "        <register address='0xba20034' value='0x" DATA.LONG(A:0xba20034) "' name='RPMH_BCM_VOTETABLE_DRV2_ND13'/>"
WRITE #1 "        <register address='0xba20038' value='0x" DATA.LONG(A:0xba20038) "' name='RPMH_BCM_VOTETABLE_DRV2_ND14'/>"
WRITE #1 "        <register address='0xba2003c' value='0x" DATA.LONG(A:0xba2003c) "' name='RPMH_BCM_VOTETABLE_DRV2_ND15'/>"
WRITE #1 "        <register address='0xba20040' value='0x" DATA.LONG(A:0xba20040) "' name='RPMH_BCM_VOTETABLE_DRV2_ND16'/>"
WRITE #1 "        <register address='0xba20044' value='0x" DATA.LONG(A:0xba20044) "' name='RPMH_BCM_VOTETABLE_DRV2_ND17'/>"
WRITE #1 "        <register address='0xba20048' value='0x" DATA.LONG(A:0xba20048) "' name='RPMH_BCM_VOTETABLE_DRV2_ND18'/>"
WRITE #1 "        <register address='0xba2004c' value='0x" DATA.LONG(A:0xba2004c) "' name='RPMH_BCM_VOTETABLE_DRV2_ND19'/>"
WRITE #1 "        <register address='0xba20050' value='0x" DATA.LONG(A:0xba20050) "' name='RPMH_BCM_VOTETABLE_DRV2_ND20'/>"
WRITE #1 "        <register address='0xba20054' value='0x" DATA.LONG(A:0xba20054) "' name='RPMH_BCM_VOTETABLE_DRV2_ND21'/>"
WRITE #1 "        <register address='0xba20058' value='0x" DATA.LONG(A:0xba20058) "' name='RPMH_BCM_VOTETABLE_DRV2_ND22'/>"
WRITE #1 "        <register address='0xba2005c' value='0x" DATA.LONG(A:0xba2005c) "' name='RPMH_BCM_VOTETABLE_DRV2_ND23'/>"
WRITE #1 "        <register address='0xba20060' value='0x" DATA.LONG(A:0xba20060) "' name='RPMH_BCM_VOTETABLE_DRV2_ND24'/>"
WRITE #1 "        <register address='0xba20064' value='0x" DATA.LONG(A:0xba20064) "' name='RPMH_BCM_VOTETABLE_DRV2_ND25'/>"
WRITE #1 "        <register address='0xba20068' value='0x" DATA.LONG(A:0xba20068) "' name='RPMH_BCM_VOTETABLE_DRV2_ND26'/>"
WRITE #1 "        <register address='0xba2006c' value='0x" DATA.LONG(A:0xba2006c) "' name='RPMH_BCM_VOTETABLE_DRV2_ND27'/>"
WRITE #1 "        <register address='0xba20070' value='0x" DATA.LONG(A:0xba20070) "' name='RPMH_BCM_VOTETABLE_DRV2_ND28'/>"
WRITE #1 "        <register address='0xba20074' value='0x" DATA.LONG(A:0xba20074) "' name='RPMH_BCM_VOTETABLE_DRV2_ND29'/>"
WRITE #1 "        <register address='0xba20078' value='0x" DATA.LONG(A:0xba20078) "' name='RPMH_BCM_VOTETABLE_DRV2_ND30'/>"
WRITE #1 "        <register address='0xba2007c' value='0x" DATA.LONG(A:0xba2007c) "' name='RPMH_BCM_VOTETABLE_DRV2_ND31'/>"
WRITE #1 "        <register address='0xba20080' value='0x" DATA.LONG(A:0xba20080) "' name='RPMH_BCM_VOTETABLE_DRV2_ND32'/>"
WRITE #1 "        <register address='0xba20084' value='0x" DATA.LONG(A:0xba20084) "' name='RPMH_BCM_VOTETABLE_DRV2_ND33'/>"
WRITE #1 "        <register address='0xba20088' value='0x" DATA.LONG(A:0xba20088) "' name='RPMH_BCM_VOTETABLE_DRV2_ND34'/>"
WRITE #1 "        <register address='0xba2008c' value='0x" DATA.LONG(A:0xba2008c) "' name='RPMH_BCM_VOTETABLE_DRV2_ND35'/>"
WRITE #1 "        <register address='0xba20090' value='0x" DATA.LONG(A:0xba20090) "' name='RPMH_BCM_VOTETABLE_DRV2_ND36'/>"
WRITE #1 "        <register address='0xba20094' value='0x" DATA.LONG(A:0xba20094) "' name='RPMH_BCM_VOTETABLE_DRV2_ND37'/>"
WRITE #1 "        <register address='0xba20098' value='0x" DATA.LONG(A:0xba20098) "' name='RPMH_BCM_VOTETABLE_DRV2_ND38'/>"
WRITE #1 "        <register address='0xba2009c' value='0x" DATA.LONG(A:0xba2009c) "' name='RPMH_BCM_VOTETABLE_DRV2_ND39'/>"
WRITE #1 "        <register address='0xba200a0' value='0x" DATA.LONG(A:0xba200a0) "' name='RPMH_BCM_VOTETABLE_DRV2_ND40'/>"
WRITE #1 "        <register address='0xba200a4' value='0x" DATA.LONG(A:0xba200a4) "' name='RPMH_BCM_VOTETABLE_DRV2_ND41'/>"
WRITE #1 "        <register address='0xba200a8' value='0x" DATA.LONG(A:0xba200a8) "' name='RPMH_BCM_VOTETABLE_DRV2_ND42'/>"
WRITE #1 "        <register address='0xba200ac' value='0x" DATA.LONG(A:0xba200ac) "' name='RPMH_BCM_VOTETABLE_DRV2_ND43'/>"
WRITE #1 "        <register address='0xba30000' value='0x" DATA.LONG(A:0xba30000) "' name='RPMH_BCM_VOTETABLE_DRV3_ND0'/>"
WRITE #1 "        <register address='0xba30004' value='0x" DATA.LONG(A:0xba30004) "' name='RPMH_BCM_VOTETABLE_DRV3_ND1'/>"
WRITE #1 "        <register address='0xba30008' value='0x" DATA.LONG(A:0xba30008) "' name='RPMH_BCM_VOTETABLE_DRV3_ND2'/>"
WRITE #1 "        <register address='0xba3000c' value='0x" DATA.LONG(A:0xba3000c) "' name='RPMH_BCM_VOTETABLE_DRV3_ND3'/>"
WRITE #1 "        <register address='0xba30010' value='0x" DATA.LONG(A:0xba30010) "' name='RPMH_BCM_VOTETABLE_DRV3_ND4'/>"
WRITE #1 "        <register address='0xba30014' value='0x" DATA.LONG(A:0xba30014) "' name='RPMH_BCM_VOTETABLE_DRV3_ND5'/>"
WRITE #1 "        <register address='0xba30018' value='0x" DATA.LONG(A:0xba30018) "' name='RPMH_BCM_VOTETABLE_DRV3_ND6'/>"
WRITE #1 "        <register address='0xba3001c' value='0x" DATA.LONG(A:0xba3001c) "' name='RPMH_BCM_VOTETABLE_DRV3_ND7'/>"
WRITE #1 "        <register address='0xba30020' value='0x" DATA.LONG(A:0xba30020) "' name='RPMH_BCM_VOTETABLE_DRV3_ND8'/>"
WRITE #1 "        <register address='0xba30024' value='0x" DATA.LONG(A:0xba30024) "' name='RPMH_BCM_VOTETABLE_DRV3_ND9'/>"
WRITE #1 "        <register address='0xba30028' value='0x" DATA.LONG(A:0xba30028) "' name='RPMH_BCM_VOTETABLE_DRV3_ND10'/>"
WRITE #1 "        <register address='0xba3002c' value='0x" DATA.LONG(A:0xba3002c) "' name='RPMH_BCM_VOTETABLE_DRV3_ND11'/>"
WRITE #1 "        <register address='0xba30030' value='0x" DATA.LONG(A:0xba30030) "' name='RPMH_BCM_VOTETABLE_DRV3_ND12'/>"
WRITE #1 "        <register address='0xba30034' value='0x" DATA.LONG(A:0xba30034) "' name='RPMH_BCM_VOTETABLE_DRV3_ND13'/>"
WRITE #1 "        <register address='0xba30038' value='0x" DATA.LONG(A:0xba30038) "' name='RPMH_BCM_VOTETABLE_DRV3_ND14'/>"
WRITE #1 "        <register address='0xba3003c' value='0x" DATA.LONG(A:0xba3003c) "' name='RPMH_BCM_VOTETABLE_DRV3_ND15'/>"
WRITE #1 "        <register address='0xba30040' value='0x" DATA.LONG(A:0xba30040) "' name='RPMH_BCM_VOTETABLE_DRV3_ND16'/>"
WRITE #1 "        <register address='0xba30044' value='0x" DATA.LONG(A:0xba30044) "' name='RPMH_BCM_VOTETABLE_DRV3_ND17'/>"
WRITE #1 "        <register address='0xba30048' value='0x" DATA.LONG(A:0xba30048) "' name='RPMH_BCM_VOTETABLE_DRV3_ND18'/>"
WRITE #1 "        <register address='0xba3004c' value='0x" DATA.LONG(A:0xba3004c) "' name='RPMH_BCM_VOTETABLE_DRV3_ND19'/>"
WRITE #1 "        <register address='0xba30050' value='0x" DATA.LONG(A:0xba30050) "' name='RPMH_BCM_VOTETABLE_DRV3_ND20'/>"
WRITE #1 "        <register address='0xba30054' value='0x" DATA.LONG(A:0xba30054) "' name='RPMH_BCM_VOTETABLE_DRV3_ND21'/>"
WRITE #1 "        <register address='0xba30058' value='0x" DATA.LONG(A:0xba30058) "' name='RPMH_BCM_VOTETABLE_DRV3_ND22'/>"
WRITE #1 "        <register address='0xba3005c' value='0x" DATA.LONG(A:0xba3005c) "' name='RPMH_BCM_VOTETABLE_DRV3_ND23'/>"
WRITE #1 "        <register address='0xba30060' value='0x" DATA.LONG(A:0xba30060) "' name='RPMH_BCM_VOTETABLE_DRV3_ND24'/>"
WRITE #1 "        <register address='0xba30064' value='0x" DATA.LONG(A:0xba30064) "' name='RPMH_BCM_VOTETABLE_DRV3_ND25'/>"
WRITE #1 "        <register address='0xba30068' value='0x" DATA.LONG(A:0xba30068) "' name='RPMH_BCM_VOTETABLE_DRV3_ND26'/>"
WRITE #1 "        <register address='0xba3006c' value='0x" DATA.LONG(A:0xba3006c) "' name='RPMH_BCM_VOTETABLE_DRV3_ND27'/>"
WRITE #1 "        <register address='0xba30070' value='0x" DATA.LONG(A:0xba30070) "' name='RPMH_BCM_VOTETABLE_DRV3_ND28'/>"
WRITE #1 "        <register address='0xba30074' value='0x" DATA.LONG(A:0xba30074) "' name='RPMH_BCM_VOTETABLE_DRV3_ND29'/>"
WRITE #1 "        <register address='0xba30078' value='0x" DATA.LONG(A:0xba30078) "' name='RPMH_BCM_VOTETABLE_DRV3_ND30'/>"
WRITE #1 "        <register address='0xba3007c' value='0x" DATA.LONG(A:0xba3007c) "' name='RPMH_BCM_VOTETABLE_DRV3_ND31'/>"
WRITE #1 "        <register address='0xba30080' value='0x" DATA.LONG(A:0xba30080) "' name='RPMH_BCM_VOTETABLE_DRV3_ND32'/>"
WRITE #1 "        <register address='0xba30084' value='0x" DATA.LONG(A:0xba30084) "' name='RPMH_BCM_VOTETABLE_DRV3_ND33'/>"
WRITE #1 "        <register address='0xba30088' value='0x" DATA.LONG(A:0xba30088) "' name='RPMH_BCM_VOTETABLE_DRV3_ND34'/>"
WRITE #1 "        <register address='0xba3008c' value='0x" DATA.LONG(A:0xba3008c) "' name='RPMH_BCM_VOTETABLE_DRV3_ND35'/>"
WRITE #1 "        <register address='0xba30090' value='0x" DATA.LONG(A:0xba30090) "' name='RPMH_BCM_VOTETABLE_DRV3_ND36'/>"
WRITE #1 "        <register address='0xba30094' value='0x" DATA.LONG(A:0xba30094) "' name='RPMH_BCM_VOTETABLE_DRV3_ND37'/>"
WRITE #1 "        <register address='0xba30098' value='0x" DATA.LONG(A:0xba30098) "' name='RPMH_BCM_VOTETABLE_DRV3_ND38'/>"
WRITE #1 "        <register address='0xba3009c' value='0x" DATA.LONG(A:0xba3009c) "' name='RPMH_BCM_VOTETABLE_DRV3_ND39'/>"
WRITE #1 "        <register address='0xba300a0' value='0x" DATA.LONG(A:0xba300a0) "' name='RPMH_BCM_VOTETABLE_DRV3_ND40'/>"
WRITE #1 "        <register address='0xba300a4' value='0x" DATA.LONG(A:0xba300a4) "' name='RPMH_BCM_VOTETABLE_DRV3_ND41'/>"
WRITE #1 "        <register address='0xba300a8' value='0x" DATA.LONG(A:0xba300a8) "' name='RPMH_BCM_VOTETABLE_DRV3_ND42'/>"
WRITE #1 "        <register address='0xba300ac' value='0x" DATA.LONG(A:0xba300ac) "' name='RPMH_BCM_VOTETABLE_DRV3_ND43'/>"
WRITE #1 "        <register address='0xba40000' value='0x" DATA.LONG(A:0xba40000) "' name='RPMH_BCM_VOTETABLE_DRV4_ND0'/>"
WRITE #1 "        <register address='0xba40004' value='0x" DATA.LONG(A:0xba40004) "' name='RPMH_BCM_VOTETABLE_DRV4_ND1'/>"
WRITE #1 "        <register address='0xba40008' value='0x" DATA.LONG(A:0xba40008) "' name='RPMH_BCM_VOTETABLE_DRV4_ND2'/>"
WRITE #1 "        <register address='0xba4000c' value='0x" DATA.LONG(A:0xba4000c) "' name='RPMH_BCM_VOTETABLE_DRV4_ND3'/>"
WRITE #1 "        <register address='0xba40010' value='0x" DATA.LONG(A:0xba40010) "' name='RPMH_BCM_VOTETABLE_DRV4_ND4'/>"
WRITE #1 "        <register address='0xba40014' value='0x" DATA.LONG(A:0xba40014) "' name='RPMH_BCM_VOTETABLE_DRV4_ND5'/>"
WRITE #1 "        <register address='0xba40018' value='0x" DATA.LONG(A:0xba40018) "' name='RPMH_BCM_VOTETABLE_DRV4_ND6'/>"
WRITE #1 "        <register address='0xba4001c' value='0x" DATA.LONG(A:0xba4001c) "' name='RPMH_BCM_VOTETABLE_DRV4_ND7'/>"
WRITE #1 "        <register address='0xba40020' value='0x" DATA.LONG(A:0xba40020) "' name='RPMH_BCM_VOTETABLE_DRV4_ND8'/>"
WRITE #1 "        <register address='0xba40024' value='0x" DATA.LONG(A:0xba40024) "' name='RPMH_BCM_VOTETABLE_DRV4_ND9'/>"
WRITE #1 "        <register address='0xba40028' value='0x" DATA.LONG(A:0xba40028) "' name='RPMH_BCM_VOTETABLE_DRV4_ND10'/>"
WRITE #1 "        <register address='0xba4002c' value='0x" DATA.LONG(A:0xba4002c) "' name='RPMH_BCM_VOTETABLE_DRV4_ND11'/>"
WRITE #1 "        <register address='0xba40030' value='0x" DATA.LONG(A:0xba40030) "' name='RPMH_BCM_VOTETABLE_DRV4_ND12'/>"
WRITE #1 "        <register address='0xba40034' value='0x" DATA.LONG(A:0xba40034) "' name='RPMH_BCM_VOTETABLE_DRV4_ND13'/>"
WRITE #1 "        <register address='0xba40038' value='0x" DATA.LONG(A:0xba40038) "' name='RPMH_BCM_VOTETABLE_DRV4_ND14'/>"
WRITE #1 "        <register address='0xba4003c' value='0x" DATA.LONG(A:0xba4003c) "' name='RPMH_BCM_VOTETABLE_DRV4_ND15'/>"
WRITE #1 "        <register address='0xba40040' value='0x" DATA.LONG(A:0xba40040) "' name='RPMH_BCM_VOTETABLE_DRV4_ND16'/>"
WRITE #1 "        <register address='0xba40044' value='0x" DATA.LONG(A:0xba40044) "' name='RPMH_BCM_VOTETABLE_DRV4_ND17'/>"
WRITE #1 "        <register address='0xba40048' value='0x" DATA.LONG(A:0xba40048) "' name='RPMH_BCM_VOTETABLE_DRV4_ND18'/>"
WRITE #1 "        <register address='0xba4004c' value='0x" DATA.LONG(A:0xba4004c) "' name='RPMH_BCM_VOTETABLE_DRV4_ND19'/>"
WRITE #1 "        <register address='0xba40050' value='0x" DATA.LONG(A:0xba40050) "' name='RPMH_BCM_VOTETABLE_DRV4_ND20'/>"
WRITE #1 "        <register address='0xba40054' value='0x" DATA.LONG(A:0xba40054) "' name='RPMH_BCM_VOTETABLE_DRV4_ND21'/>"
WRITE #1 "        <register address='0xba40058' value='0x" DATA.LONG(A:0xba40058) "' name='RPMH_BCM_VOTETABLE_DRV4_ND22'/>"
WRITE #1 "        <register address='0xba4005c' value='0x" DATA.LONG(A:0xba4005c) "' name='RPMH_BCM_VOTETABLE_DRV4_ND23'/>"
WRITE #1 "        <register address='0xba40060' value='0x" DATA.LONG(A:0xba40060) "' name='RPMH_BCM_VOTETABLE_DRV4_ND24'/>"
WRITE #1 "        <register address='0xba40064' value='0x" DATA.LONG(A:0xba40064) "' name='RPMH_BCM_VOTETABLE_DRV4_ND25'/>"
WRITE #1 "        <register address='0xba40068' value='0x" DATA.LONG(A:0xba40068) "' name='RPMH_BCM_VOTETABLE_DRV4_ND26'/>"
WRITE #1 "        <register address='0xba4006c' value='0x" DATA.LONG(A:0xba4006c) "' name='RPMH_BCM_VOTETABLE_DRV4_ND27'/>"
WRITE #1 "        <register address='0xba40070' value='0x" DATA.LONG(A:0xba40070) "' name='RPMH_BCM_VOTETABLE_DRV4_ND28'/>"
WRITE #1 "        <register address='0xba40074' value='0x" DATA.LONG(A:0xba40074) "' name='RPMH_BCM_VOTETABLE_DRV4_ND29'/>"
WRITE #1 "        <register address='0xba40078' value='0x" DATA.LONG(A:0xba40078) "' name='RPMH_BCM_VOTETABLE_DRV4_ND30'/>"
WRITE #1 "        <register address='0xba4007c' value='0x" DATA.LONG(A:0xba4007c) "' name='RPMH_BCM_VOTETABLE_DRV4_ND31'/>"
WRITE #1 "        <register address='0xba40080' value='0x" DATA.LONG(A:0xba40080) "' name='RPMH_BCM_VOTETABLE_DRV4_ND32'/>"
WRITE #1 "        <register address='0xba40084' value='0x" DATA.LONG(A:0xba40084) "' name='RPMH_BCM_VOTETABLE_DRV4_ND33'/>"
WRITE #1 "        <register address='0xba40088' value='0x" DATA.LONG(A:0xba40088) "' name='RPMH_BCM_VOTETABLE_DRV4_ND34'/>"
WRITE #1 "        <register address='0xba4008c' value='0x" DATA.LONG(A:0xba4008c) "' name='RPMH_BCM_VOTETABLE_DRV4_ND35'/>"
WRITE #1 "        <register address='0xba40090' value='0x" DATA.LONG(A:0xba40090) "' name='RPMH_BCM_VOTETABLE_DRV4_ND36'/>"
WRITE #1 "        <register address='0xba40094' value='0x" DATA.LONG(A:0xba40094) "' name='RPMH_BCM_VOTETABLE_DRV4_ND37'/>"
WRITE #1 "        <register address='0xba40098' value='0x" DATA.LONG(A:0xba40098) "' name='RPMH_BCM_VOTETABLE_DRV4_ND38'/>"
WRITE #1 "        <register address='0xba4009c' value='0x" DATA.LONG(A:0xba4009c) "' name='RPMH_BCM_VOTETABLE_DRV4_ND39'/>"
WRITE #1 "        <register address='0xba400a0' value='0x" DATA.LONG(A:0xba400a0) "' name='RPMH_BCM_VOTETABLE_DRV4_ND40'/>"
WRITE #1 "        <register address='0xba400a4' value='0x" DATA.LONG(A:0xba400a4) "' name='RPMH_BCM_VOTETABLE_DRV4_ND41'/>"
WRITE #1 "        <register address='0xba400a8' value='0x" DATA.LONG(A:0xba400a8) "' name='RPMH_BCM_VOTETABLE_DRV4_ND42'/>"
WRITE #1 "        <register address='0xba400ac' value='0x" DATA.LONG(A:0xba400ac) "' name='RPMH_BCM_VOTETABLE_DRV4_ND43'/>"
WRITE #1 "        <register address='0xba00200' value='0x" DATA.LONG(A:0xba00200) "' name='RPMH_BCM_SHADOW_STATUS_DRV0_FE_AGG_FSM'/>"
WRITE #1 "        <register address='0xba10200' value='0x" DATA.LONG(A:0xba10200) "' name='RPMH_BCM_SHADOW_STATUS_DRV1_FE_AGG_FSM'/>"
WRITE #1 "        <register address='0xba20200' value='0x" DATA.LONG(A:0xba20200) "' name='RPMH_BCM_SHADOW_STATUS_DRV2_FE_AGG_FSM'/>"
WRITE #1 "        <register address='0xba30200' value='0x" DATA.LONG(A:0xba30200) "' name='RPMH_BCM_SHADOW_STATUS_DRV3_FE_AGG_FSM'/>"
WRITE #1 "        <register address='0xba40200' value='0x" DATA.LONG(A:0xba40200) "' name='RPMH_BCM_SHADOW_STATUS_DRV4_FE_AGG_FSM'/>"
WRITE #1 "        <register address='0xba00204' value='0x" DATA.LONG(A:0xba00204) "' name='RPMH_BCM_SHADOW_STATUS_DRV0_FE_CD0'/>"
WRITE #1 "        <register address='0xba00208' value='0x" DATA.LONG(A:0xba00208) "' name='RPMH_BCM_SHADOW_STATUS_DRV0_FE_CD1'/>"
WRITE #1 "        <register address='0xba0020c' value='0x" DATA.LONG(A:0xba0020c) "' name='RPMH_BCM_SHADOW_STATUS_DRV0_FE_CD2'/>"
WRITE #1 "        <register address='0xba00210' value='0x" DATA.LONG(A:0xba00210) "' name='RPMH_BCM_SHADOW_STATUS_DRV0_FE_CD3'/>"
WRITE #1 "        <register address='0xba00214' value='0x" DATA.LONG(A:0xba00214) "' name='RPMH_BCM_SHADOW_STATUS_DRV0_FE_CD4'/>"
WRITE #1 "        <register address='0xba00218' value='0x" DATA.LONG(A:0xba00218) "' name='RPMH_BCM_SHADOW_STATUS_DRV0_FE_CD5'/>"
WRITE #1 "        <register address='0xba0021c' value='0x" DATA.LONG(A:0xba0021c) "' name='RPMH_BCM_SHADOW_STATUS_DRV0_FE_CD6'/>"
WRITE #1 "        <register address='0xba00220' value='0x" DATA.LONG(A:0xba00220) "' name='RPMH_BCM_SHADOW_STATUS_DRV0_FE_CD7'/>"
WRITE #1 "        <register address='0xba00224' value='0x" DATA.LONG(A:0xba00224) "' name='RPMH_BCM_SHADOW_STATUS_DRV0_FE_CD8'/>"
WRITE #1 "        <register address='0xba00228' value='0x" DATA.LONG(A:0xba00228) "' name='RPMH_BCM_SHADOW_STATUS_DRV0_FE_CD9'/>"
WRITE #1 "        <register address='0xba0022c' value='0x" DATA.LONG(A:0xba0022c) "' name='RPMH_BCM_SHADOW_STATUS_DRV0_FE_CD10'/>"
WRITE #1 "        <register address='0xba00230' value='0x" DATA.LONG(A:0xba00230) "' name='RPMH_BCM_SHADOW_STATUS_DRV0_FE_CD11'/>"
WRITE #1 "        <register address='0xba10204' value='0x" DATA.LONG(A:0xba10204) "' name='RPMH_BCM_SHADOW_STATUS_DRV1_FE_CD0'/>"
WRITE #1 "        <register address='0xba10208' value='0x" DATA.LONG(A:0xba10208) "' name='RPMH_BCM_SHADOW_STATUS_DRV1_FE_CD1'/>"
WRITE #1 "        <register address='0xba1020c' value='0x" DATA.LONG(A:0xba1020c) "' name='RPMH_BCM_SHADOW_STATUS_DRV1_FE_CD2'/>"
WRITE #1 "        <register address='0xba10210' value='0x" DATA.LONG(A:0xba10210) "' name='RPMH_BCM_SHADOW_STATUS_DRV1_FE_CD3'/>"
WRITE #1 "        <register address='0xba10214' value='0x" DATA.LONG(A:0xba10214) "' name='RPMH_BCM_SHADOW_STATUS_DRV1_FE_CD4'/>"
WRITE #1 "        <register address='0xba10218' value='0x" DATA.LONG(A:0xba10218) "' name='RPMH_BCM_SHADOW_STATUS_DRV1_FE_CD5'/>"
WRITE #1 "        <register address='0xba1021c' value='0x" DATA.LONG(A:0xba1021c) "' name='RPMH_BCM_SHADOW_STATUS_DRV1_FE_CD6'/>"
WRITE #1 "        <register address='0xba10220' value='0x" DATA.LONG(A:0xba10220) "' name='RPMH_BCM_SHADOW_STATUS_DRV1_FE_CD7'/>"
WRITE #1 "        <register address='0xba10224' value='0x" DATA.LONG(A:0xba10224) "' name='RPMH_BCM_SHADOW_STATUS_DRV1_FE_CD8'/>"
WRITE #1 "        <register address='0xba10228' value='0x" DATA.LONG(A:0xba10228) "' name='RPMH_BCM_SHADOW_STATUS_DRV1_FE_CD9'/>"
WRITE #1 "        <register address='0xba1022c' value='0x" DATA.LONG(A:0xba1022c) "' name='RPMH_BCM_SHADOW_STATUS_DRV1_FE_CD10'/>"
WRITE #1 "        <register address='0xba10230' value='0x" DATA.LONG(A:0xba10230) "' name='RPMH_BCM_SHADOW_STATUS_DRV1_FE_CD11'/>"
WRITE #1 "        <register address='0xba20204' value='0x" DATA.LONG(A:0xba20204) "' name='RPMH_BCM_SHADOW_STATUS_DRV2_FE_CD0'/>"
WRITE #1 "        <register address='0xba20208' value='0x" DATA.LONG(A:0xba20208) "' name='RPMH_BCM_SHADOW_STATUS_DRV2_FE_CD1'/>"
WRITE #1 "        <register address='0xba2020c' value='0x" DATA.LONG(A:0xba2020c) "' name='RPMH_BCM_SHADOW_STATUS_DRV2_FE_CD2'/>"
WRITE #1 "        <register address='0xba20210' value='0x" DATA.LONG(A:0xba20210) "' name='RPMH_BCM_SHADOW_STATUS_DRV2_FE_CD3'/>"
WRITE #1 "        <register address='0xba20214' value='0x" DATA.LONG(A:0xba20214) "' name='RPMH_BCM_SHADOW_STATUS_DRV2_FE_CD4'/>"
WRITE #1 "        <register address='0xba20218' value='0x" DATA.LONG(A:0xba20218) "' name='RPMH_BCM_SHADOW_STATUS_DRV2_FE_CD5'/>"
WRITE #1 "        <register address='0xba2021c' value='0x" DATA.LONG(A:0xba2021c) "' name='RPMH_BCM_SHADOW_STATUS_DRV2_FE_CD6'/>"
WRITE #1 "        <register address='0xba20220' value='0x" DATA.LONG(A:0xba20220) "' name='RPMH_BCM_SHADOW_STATUS_DRV2_FE_CD7'/>"
WRITE #1 "        <register address='0xba20224' value='0x" DATA.LONG(A:0xba20224) "' name='RPMH_BCM_SHADOW_STATUS_DRV2_FE_CD8'/>"
WRITE #1 "        <register address='0xba20228' value='0x" DATA.LONG(A:0xba20228) "' name='RPMH_BCM_SHADOW_STATUS_DRV2_FE_CD9'/>"
WRITE #1 "        <register address='0xba2022c' value='0x" DATA.LONG(A:0xba2022c) "' name='RPMH_BCM_SHADOW_STATUS_DRV2_FE_CD10'/>"
WRITE #1 "        <register address='0xba20230' value='0x" DATA.LONG(A:0xba20230) "' name='RPMH_BCM_SHADOW_STATUS_DRV2_FE_CD11'/>"
WRITE #1 "        <register address='0xba30204' value='0x" DATA.LONG(A:0xba30204) "' name='RPMH_BCM_SHADOW_STATUS_DRV3_FE_CD0'/>"
WRITE #1 "        <register address='0xba30208' value='0x" DATA.LONG(A:0xba30208) "' name='RPMH_BCM_SHADOW_STATUS_DRV3_FE_CD1'/>"
WRITE #1 "        <register address='0xba3020c' value='0x" DATA.LONG(A:0xba3020c) "' name='RPMH_BCM_SHADOW_STATUS_DRV3_FE_CD2'/>"
WRITE #1 "        <register address='0xba30210' value='0x" DATA.LONG(A:0xba30210) "' name='RPMH_BCM_SHADOW_STATUS_DRV3_FE_CD3'/>"
WRITE #1 "        <register address='0xba30214' value='0x" DATA.LONG(A:0xba30214) "' name='RPMH_BCM_SHADOW_STATUS_DRV3_FE_CD4'/>"
WRITE #1 "        <register address='0xba30218' value='0x" DATA.LONG(A:0xba30218) "' name='RPMH_BCM_SHADOW_STATUS_DRV3_FE_CD5'/>"
WRITE #1 "        <register address='0xba3021c' value='0x" DATA.LONG(A:0xba3021c) "' name='RPMH_BCM_SHADOW_STATUS_DRV3_FE_CD6'/>"
WRITE #1 "        <register address='0xba30220' value='0x" DATA.LONG(A:0xba30220) "' name='RPMH_BCM_SHADOW_STATUS_DRV3_FE_CD7'/>"
WRITE #1 "        <register address='0xba30224' value='0x" DATA.LONG(A:0xba30224) "' name='RPMH_BCM_SHADOW_STATUS_DRV3_FE_CD8'/>"
WRITE #1 "        <register address='0xba30228' value='0x" DATA.LONG(A:0xba30228) "' name='RPMH_BCM_SHADOW_STATUS_DRV3_FE_CD9'/>"
WRITE #1 "        <register address='0xba3022c' value='0x" DATA.LONG(A:0xba3022c) "' name='RPMH_BCM_SHADOW_STATUS_DRV3_FE_CD10'/>"
WRITE #1 "        <register address='0xba30230' value='0x" DATA.LONG(A:0xba30230) "' name='RPMH_BCM_SHADOW_STATUS_DRV3_FE_CD11'/>"
WRITE #1 "        <register address='0xba40204' value='0x" DATA.LONG(A:0xba40204) "' name='RPMH_BCM_SHADOW_STATUS_DRV4_FE_CD0'/>"
WRITE #1 "        <register address='0xba40208' value='0x" DATA.LONG(A:0xba40208) "' name='RPMH_BCM_SHADOW_STATUS_DRV4_FE_CD1'/>"
WRITE #1 "        <register address='0xba4020c' value='0x" DATA.LONG(A:0xba4020c) "' name='RPMH_BCM_SHADOW_STATUS_DRV4_FE_CD2'/>"
WRITE #1 "        <register address='0xba40210' value='0x" DATA.LONG(A:0xba40210) "' name='RPMH_BCM_SHADOW_STATUS_DRV4_FE_CD3'/>"
WRITE #1 "        <register address='0xba40214' value='0x" DATA.LONG(A:0xba40214) "' name='RPMH_BCM_SHADOW_STATUS_DRV4_FE_CD4'/>"
WRITE #1 "        <register address='0xba40218' value='0x" DATA.LONG(A:0xba40218) "' name='RPMH_BCM_SHADOW_STATUS_DRV4_FE_CD5'/>"
WRITE #1 "        <register address='0xba4021c' value='0x" DATA.LONG(A:0xba4021c) "' name='RPMH_BCM_SHADOW_STATUS_DRV4_FE_CD6'/>"
WRITE #1 "        <register address='0xba40220' value='0x" DATA.LONG(A:0xba40220) "' name='RPMH_BCM_SHADOW_STATUS_DRV4_FE_CD7'/>"
WRITE #1 "        <register address='0xba40224' value='0x" DATA.LONG(A:0xba40224) "' name='RPMH_BCM_SHADOW_STATUS_DRV4_FE_CD8'/>"
WRITE #1 "        <register address='0xba40228' value='0x" DATA.LONG(A:0xba40228) "' name='RPMH_BCM_SHADOW_STATUS_DRV4_FE_CD9'/>"
WRITE #1 "        <register address='0xba4022c' value='0x" DATA.LONG(A:0xba4022c) "' name='RPMH_BCM_SHADOW_STATUS_DRV4_FE_CD10'/>"
WRITE #1 "        <register address='0xba40230' value='0x" DATA.LONG(A:0xba40230) "' name='RPMH_BCM_SHADOW_STATUS_DRV4_FE_CD11'/>"
WRITE #1 "        <register address='0xba00284' value='0x" DATA.LONG(A:0xba00284) "' name='RPMH_BCM_SHADOW_STATUS_DRV0_DIRTY_ND_0'/>"
WRITE #1 "        <register address='0xba10284' value='0x" DATA.LONG(A:0xba10284) "' name='RPMH_BCM_SHADOW_STATUS_DRV1_DIRTY_ND_0'/>"
WRITE #1 "        <register address='0xba20284' value='0x" DATA.LONG(A:0xba20284) "' name='RPMH_BCM_SHADOW_STATUS_DRV2_DIRTY_ND_0'/>"
WRITE #1 "        <register address='0xba30284' value='0x" DATA.LONG(A:0xba30284) "' name='RPMH_BCM_SHADOW_STATUS_DRV3_DIRTY_ND_0'/>"
WRITE #1 "        <register address='0xba40284' value='0x" DATA.LONG(A:0xba40284) "' name='RPMH_BCM_SHADOW_STATUS_DRV4_DIRTY_ND_0'/>"
WRITE #1 "        <register address='0xba00288' value='0x" DATA.LONG(A:0xba00288) "' name='RPMH_BCM_SHADOW_STATUS_DRV0_DIRTY_ND_1'/>"
WRITE #1 "        <register address='0xba10288' value='0x" DATA.LONG(A:0xba10288) "' name='RPMH_BCM_SHADOW_STATUS_DRV1_DIRTY_ND_1'/>"
WRITE #1 "        <register address='0xba20288' value='0x" DATA.LONG(A:0xba20288) "' name='RPMH_BCM_SHADOW_STATUS_DRV2_DIRTY_ND_1'/>"
WRITE #1 "        <register address='0xba30288' value='0x" DATA.LONG(A:0xba30288) "' name='RPMH_BCM_SHADOW_STATUS_DRV3_DIRTY_ND_1'/>"
WRITE #1 "        <register address='0xba40288' value='0x" DATA.LONG(A:0xba40288) "' name='RPMH_BCM_SHADOW_STATUS_DRV4_DIRTY_ND_1'/>"
WRITE #1 "        <register address='0xba0028c' value='0x" DATA.LONG(A:0xba0028c) "' name='RPMH_BCM_SHADOW_STATUS_DRV0_SND0'/>"
WRITE #1 "        <register address='0xba00290' value='0x" DATA.LONG(A:0xba00290) "' name='RPMH_BCM_SHADOW_STATUS_DRV0_SND1'/>"
WRITE #1 "        <register address='0xba00294' value='0x" DATA.LONG(A:0xba00294) "' name='RPMH_BCM_SHADOW_STATUS_DRV0_SND2'/>"
WRITE #1 "        <register address='0xba00298' value='0x" DATA.LONG(A:0xba00298) "' name='RPMH_BCM_SHADOW_STATUS_DRV0_SND3'/>"
WRITE #1 "        <register address='0xba1028c' value='0x" DATA.LONG(A:0xba1028c) "' name='RPMH_BCM_SHADOW_STATUS_DRV1_SND0'/>"
WRITE #1 "        <register address='0xba10290' value='0x" DATA.LONG(A:0xba10290) "' name='RPMH_BCM_SHADOW_STATUS_DRV1_SND1'/>"
WRITE #1 "        <register address='0xba10294' value='0x" DATA.LONG(A:0xba10294) "' name='RPMH_BCM_SHADOW_STATUS_DRV1_SND2'/>"
WRITE #1 "        <register address='0xba10298' value='0x" DATA.LONG(A:0xba10298) "' name='RPMH_BCM_SHADOW_STATUS_DRV1_SND3'/>"
WRITE #1 "        <register address='0xba2028c' value='0x" DATA.LONG(A:0xba2028c) "' name='RPMH_BCM_SHADOW_STATUS_DRV2_SND0'/>"
WRITE #1 "        <register address='0xba20290' value='0x" DATA.LONG(A:0xba20290) "' name='RPMH_BCM_SHADOW_STATUS_DRV2_SND1'/>"
WRITE #1 "        <register address='0xba20294' value='0x" DATA.LONG(A:0xba20294) "' name='RPMH_BCM_SHADOW_STATUS_DRV2_SND2'/>"
WRITE #1 "        <register address='0xba20298' value='0x" DATA.LONG(A:0xba20298) "' name='RPMH_BCM_SHADOW_STATUS_DRV2_SND3'/>"
WRITE #1 "        <register address='0xba3028c' value='0x" DATA.LONG(A:0xba3028c) "' name='RPMH_BCM_SHADOW_STATUS_DRV3_SND0'/>"
WRITE #1 "        <register address='0xba30290' value='0x" DATA.LONG(A:0xba30290) "' name='RPMH_BCM_SHADOW_STATUS_DRV3_SND1'/>"
WRITE #1 "        <register address='0xba30294' value='0x" DATA.LONG(A:0xba30294) "' name='RPMH_BCM_SHADOW_STATUS_DRV3_SND2'/>"
WRITE #1 "        <register address='0xba30298' value='0x" DATA.LONG(A:0xba30298) "' name='RPMH_BCM_SHADOW_STATUS_DRV3_SND3'/>"
WRITE #1 "        <register address='0xba4028c' value='0x" DATA.LONG(A:0xba4028c) "' name='RPMH_BCM_SHADOW_STATUS_DRV4_SND0'/>"
WRITE #1 "        <register address='0xba40290' value='0x" DATA.LONG(A:0xba40290) "' name='RPMH_BCM_SHADOW_STATUS_DRV4_SND1'/>"
WRITE #1 "        <register address='0xba40294' value='0x" DATA.LONG(A:0xba40294) "' name='RPMH_BCM_SHADOW_STATUS_DRV4_SND2'/>"
WRITE #1 "        <register address='0xba40298' value='0x" DATA.LONG(A:0xba40298) "' name='RPMH_BCM_SHADOW_STATUS_DRV4_SND3'/>"
WRITE #1 "        <register address='0xba0029c' value='0x" DATA.LONG(A:0xba0029c) "' name='RPMH_BCM_SHADOW_STATUS_DRV0_AGG_BW_ND0'/>"
WRITE #1 "        <register address='0xba002a0' value='0x" DATA.LONG(A:0xba002a0) "' name='RPMH_BCM_SHADOW_STATUS_DRV0_AGG_BW_ND1'/>"
WRITE #1 "        <register address='0xba002a4' value='0x" DATA.LONG(A:0xba002a4) "' name='RPMH_BCM_SHADOW_STATUS_DRV0_AGG_BW_ND2'/>"
WRITE #1 "        <register address='0xba002a8' value='0x" DATA.LONG(A:0xba002a8) "' name='RPMH_BCM_SHADOW_STATUS_DRV0_AGG_BW_ND3'/>"
WRITE #1 "        <register address='0xba002ac' value='0x" DATA.LONG(A:0xba002ac) "' name='RPMH_BCM_SHADOW_STATUS_DRV0_AGG_BW_ND4'/>"
WRITE #1 "        <register address='0xba002b0' value='0x" DATA.LONG(A:0xba002b0) "' name='RPMH_BCM_SHADOW_STATUS_DRV0_AGG_BW_ND5'/>"
WRITE #1 "        <register address='0xba002b4' value='0x" DATA.LONG(A:0xba002b4) "' name='RPMH_BCM_SHADOW_STATUS_DRV0_AGG_BW_ND6'/>"
WRITE #1 "        <register address='0xba002b8' value='0x" DATA.LONG(A:0xba002b8) "' name='RPMH_BCM_SHADOW_STATUS_DRV0_AGG_BW_ND7'/>"
WRITE #1 "        <register address='0xba002bc' value='0x" DATA.LONG(A:0xba002bc) "' name='RPMH_BCM_SHADOW_STATUS_DRV0_AGG_BW_ND8'/>"
WRITE #1 "        <register address='0xba002c0' value='0x" DATA.LONG(A:0xba002c0) "' name='RPMH_BCM_SHADOW_STATUS_DRV0_AGG_BW_ND9'/>"
WRITE #1 "        <register address='0xba002c4' value='0x" DATA.LONG(A:0xba002c4) "' name='RPMH_BCM_SHADOW_STATUS_DRV0_AGG_BW_ND10'/>"
WRITE #1 "        <register address='0xba002c8' value='0x" DATA.LONG(A:0xba002c8) "' name='RPMH_BCM_SHADOW_STATUS_DRV0_AGG_BW_ND11'/>"
WRITE #1 "        <register address='0xba002cc' value='0x" DATA.LONG(A:0xba002cc) "' name='RPMH_BCM_SHADOW_STATUS_DRV0_AGG_BW_ND12'/>"
WRITE #1 "        <register address='0xba002d0' value='0x" DATA.LONG(A:0xba002d0) "' name='RPMH_BCM_SHADOW_STATUS_DRV0_AGG_BW_ND13'/>"
WRITE #1 "        <register address='0xba002d4' value='0x" DATA.LONG(A:0xba002d4) "' name='RPMH_BCM_SHADOW_STATUS_DRV0_AGG_BW_ND14'/>"
WRITE #1 "        <register address='0xba002d8' value='0x" DATA.LONG(A:0xba002d8) "' name='RPMH_BCM_SHADOW_STATUS_DRV0_AGG_BW_ND15'/>"
WRITE #1 "        <register address='0xba002dc' value='0x" DATA.LONG(A:0xba002dc) "' name='RPMH_BCM_SHADOW_STATUS_DRV0_AGG_BW_ND16'/>"
WRITE #1 "        <register address='0xba002e0' value='0x" DATA.LONG(A:0xba002e0) "' name='RPMH_BCM_SHADOW_STATUS_DRV0_AGG_BW_ND17'/>"
WRITE #1 "        <register address='0xba002e4' value='0x" DATA.LONG(A:0xba002e4) "' name='RPMH_BCM_SHADOW_STATUS_DRV0_AGG_BW_ND18'/>"
WRITE #1 "        <register address='0xba002e8' value='0x" DATA.LONG(A:0xba002e8) "' name='RPMH_BCM_SHADOW_STATUS_DRV0_AGG_BW_ND19'/>"
WRITE #1 "        <register address='0xba002ec' value='0x" DATA.LONG(A:0xba002ec) "' name='RPMH_BCM_SHADOW_STATUS_DRV0_AGG_BW_ND20'/>"
WRITE #1 "        <register address='0xba002f0' value='0x" DATA.LONG(A:0xba002f0) "' name='RPMH_BCM_SHADOW_STATUS_DRV0_AGG_BW_ND21'/>"
WRITE #1 "        <register address='0xba002f4' value='0x" DATA.LONG(A:0xba002f4) "' name='RPMH_BCM_SHADOW_STATUS_DRV0_AGG_BW_ND22'/>"
WRITE #1 "        <register address='0xba002f8' value='0x" DATA.LONG(A:0xba002f8) "' name='RPMH_BCM_SHADOW_STATUS_DRV0_AGG_BW_ND23'/>"
WRITE #1 "        <register address='0xba002fc' value='0x" DATA.LONG(A:0xba002fc) "' name='RPMH_BCM_SHADOW_STATUS_DRV0_AGG_BW_ND24'/>"
WRITE #1 "        <register address='0xba00300' value='0x" DATA.LONG(A:0xba00300) "' name='RPMH_BCM_SHADOW_STATUS_DRV0_AGG_BW_ND25'/>"
WRITE #1 "        <register address='0xba00304' value='0x" DATA.LONG(A:0xba00304) "' name='RPMH_BCM_SHADOW_STATUS_DRV0_AGG_BW_ND26'/>"
WRITE #1 "        <register address='0xba00308' value='0x" DATA.LONG(A:0xba00308) "' name='RPMH_BCM_SHADOW_STATUS_DRV0_AGG_BW_ND27'/>"
WRITE #1 "        <register address='0xba0030c' value='0x" DATA.LONG(A:0xba0030c) "' name='RPMH_BCM_SHADOW_STATUS_DRV0_AGG_BW_ND28'/>"
WRITE #1 "        <register address='0xba00310' value='0x" DATA.LONG(A:0xba00310) "' name='RPMH_BCM_SHADOW_STATUS_DRV0_AGG_BW_ND29'/>"
WRITE #1 "        <register address='0xba00314' value='0x" DATA.LONG(A:0xba00314) "' name='RPMH_BCM_SHADOW_STATUS_DRV0_AGG_BW_ND30'/>"
WRITE #1 "        <register address='0xba00318' value='0x" DATA.LONG(A:0xba00318) "' name='RPMH_BCM_SHADOW_STATUS_DRV0_AGG_BW_ND31'/>"
WRITE #1 "        <register address='0xba0031c' value='0x" DATA.LONG(A:0xba0031c) "' name='RPMH_BCM_SHADOW_STATUS_DRV0_AGG_BW_ND32'/>"
WRITE #1 "        <register address='0xba00320' value='0x" DATA.LONG(A:0xba00320) "' name='RPMH_BCM_SHADOW_STATUS_DRV0_AGG_BW_ND33'/>"
WRITE #1 "        <register address='0xba00324' value='0x" DATA.LONG(A:0xba00324) "' name='RPMH_BCM_SHADOW_STATUS_DRV0_AGG_BW_ND34'/>"
WRITE #1 "        <register address='0xba00328' value='0x" DATA.LONG(A:0xba00328) "' name='RPMH_BCM_SHADOW_STATUS_DRV0_AGG_BW_ND35'/>"
WRITE #1 "        <register address='0xba0032c' value='0x" DATA.LONG(A:0xba0032c) "' name='RPMH_BCM_SHADOW_STATUS_DRV0_AGG_BW_ND36'/>"
WRITE #1 "        <register address='0xba00330' value='0x" DATA.LONG(A:0xba00330) "' name='RPMH_BCM_SHADOW_STATUS_DRV0_AGG_BW_ND37'/>"
WRITE #1 "        <register address='0xba00334' value='0x" DATA.LONG(A:0xba00334) "' name='RPMH_BCM_SHADOW_STATUS_DRV0_AGG_BW_ND38'/>"
WRITE #1 "        <register address='0xba00338' value='0x" DATA.LONG(A:0xba00338) "' name='RPMH_BCM_SHADOW_STATUS_DRV0_AGG_BW_ND39'/>"
WRITE #1 "        <register address='0xba0033c' value='0x" DATA.LONG(A:0xba0033c) "' name='RPMH_BCM_SHADOW_STATUS_DRV0_AGG_BW_ND40'/>"
WRITE #1 "        <register address='0xba00340' value='0x" DATA.LONG(A:0xba00340) "' name='RPMH_BCM_SHADOW_STATUS_DRV0_AGG_BW_ND41'/>"
WRITE #1 "        <register address='0xba00344' value='0x" DATA.LONG(A:0xba00344) "' name='RPMH_BCM_SHADOW_STATUS_DRV0_AGG_BW_ND42'/>"
WRITE #1 "        <register address='0xba00348' value='0x" DATA.LONG(A:0xba00348) "' name='RPMH_BCM_SHADOW_STATUS_DRV0_AGG_BW_ND43'/>"
WRITE #1 "        <register address='0xba1029c' value='0x" DATA.LONG(A:0xba1029c) "' name='RPMH_BCM_SHADOW_STATUS_DRV1_AGG_BW_ND0'/>"
WRITE #1 "        <register address='0xba102a0' value='0x" DATA.LONG(A:0xba102a0) "' name='RPMH_BCM_SHADOW_STATUS_DRV1_AGG_BW_ND1'/>"
WRITE #1 "        <register address='0xba102a4' value='0x" DATA.LONG(A:0xba102a4) "' name='RPMH_BCM_SHADOW_STATUS_DRV1_AGG_BW_ND2'/>"
WRITE #1 "        <register address='0xba102a8' value='0x" DATA.LONG(A:0xba102a8) "' name='RPMH_BCM_SHADOW_STATUS_DRV1_AGG_BW_ND3'/>"
WRITE #1 "        <register address='0xba102ac' value='0x" DATA.LONG(A:0xba102ac) "' name='RPMH_BCM_SHADOW_STATUS_DRV1_AGG_BW_ND4'/>"
WRITE #1 "        <register address='0xba102b0' value='0x" DATA.LONG(A:0xba102b0) "' name='RPMH_BCM_SHADOW_STATUS_DRV1_AGG_BW_ND5'/>"
WRITE #1 "        <register address='0xba102b4' value='0x" DATA.LONG(A:0xba102b4) "' name='RPMH_BCM_SHADOW_STATUS_DRV1_AGG_BW_ND6'/>"
WRITE #1 "        <register address='0xba102b8' value='0x" DATA.LONG(A:0xba102b8) "' name='RPMH_BCM_SHADOW_STATUS_DRV1_AGG_BW_ND7'/>"
WRITE #1 "        <register address='0xba102bc' value='0x" DATA.LONG(A:0xba102bc) "' name='RPMH_BCM_SHADOW_STATUS_DRV1_AGG_BW_ND8'/>"
WRITE #1 "        <register address='0xba102c0' value='0x" DATA.LONG(A:0xba102c0) "' name='RPMH_BCM_SHADOW_STATUS_DRV1_AGG_BW_ND9'/>"
WRITE #1 "        <register address='0xba102c4' value='0x" DATA.LONG(A:0xba102c4) "' name='RPMH_BCM_SHADOW_STATUS_DRV1_AGG_BW_ND10'/>"
WRITE #1 "        <register address='0xba102c8' value='0x" DATA.LONG(A:0xba102c8) "' name='RPMH_BCM_SHADOW_STATUS_DRV1_AGG_BW_ND11'/>"
WRITE #1 "        <register address='0xba102cc' value='0x" DATA.LONG(A:0xba102cc) "' name='RPMH_BCM_SHADOW_STATUS_DRV1_AGG_BW_ND12'/>"
WRITE #1 "        <register address='0xba102d0' value='0x" DATA.LONG(A:0xba102d0) "' name='RPMH_BCM_SHADOW_STATUS_DRV1_AGG_BW_ND13'/>"
WRITE #1 "        <register address='0xba102d4' value='0x" DATA.LONG(A:0xba102d4) "' name='RPMH_BCM_SHADOW_STATUS_DRV1_AGG_BW_ND14'/>"
WRITE #1 "        <register address='0xba102d8' value='0x" DATA.LONG(A:0xba102d8) "' name='RPMH_BCM_SHADOW_STATUS_DRV1_AGG_BW_ND15'/>"
WRITE #1 "        <register address='0xba102dc' value='0x" DATA.LONG(A:0xba102dc) "' name='RPMH_BCM_SHADOW_STATUS_DRV1_AGG_BW_ND16'/>"
WRITE #1 "        <register address='0xba102e0' value='0x" DATA.LONG(A:0xba102e0) "' name='RPMH_BCM_SHADOW_STATUS_DRV1_AGG_BW_ND17'/>"
WRITE #1 "        <register address='0xba102e4' value='0x" DATA.LONG(A:0xba102e4) "' name='RPMH_BCM_SHADOW_STATUS_DRV1_AGG_BW_ND18'/>"
WRITE #1 "        <register address='0xba102e8' value='0x" DATA.LONG(A:0xba102e8) "' name='RPMH_BCM_SHADOW_STATUS_DRV1_AGG_BW_ND19'/>"
WRITE #1 "        <register address='0xba102ec' value='0x" DATA.LONG(A:0xba102ec) "' name='RPMH_BCM_SHADOW_STATUS_DRV1_AGG_BW_ND20'/>"
WRITE #1 "        <register address='0xba102f0' value='0x" DATA.LONG(A:0xba102f0) "' name='RPMH_BCM_SHADOW_STATUS_DRV1_AGG_BW_ND21'/>"
WRITE #1 "        <register address='0xba102f4' value='0x" DATA.LONG(A:0xba102f4) "' name='RPMH_BCM_SHADOW_STATUS_DRV1_AGG_BW_ND22'/>"
WRITE #1 "        <register address='0xba102f8' value='0x" DATA.LONG(A:0xba102f8) "' name='RPMH_BCM_SHADOW_STATUS_DRV1_AGG_BW_ND23'/>"
WRITE #1 "        <register address='0xba102fc' value='0x" DATA.LONG(A:0xba102fc) "' name='RPMH_BCM_SHADOW_STATUS_DRV1_AGG_BW_ND24'/>"
WRITE #1 "        <register address='0xba10300' value='0x" DATA.LONG(A:0xba10300) "' name='RPMH_BCM_SHADOW_STATUS_DRV1_AGG_BW_ND25'/>"
WRITE #1 "        <register address='0xba10304' value='0x" DATA.LONG(A:0xba10304) "' name='RPMH_BCM_SHADOW_STATUS_DRV1_AGG_BW_ND26'/>"
WRITE #1 "        <register address='0xba10308' value='0x" DATA.LONG(A:0xba10308) "' name='RPMH_BCM_SHADOW_STATUS_DRV1_AGG_BW_ND27'/>"
WRITE #1 "        <register address='0xba1030c' value='0x" DATA.LONG(A:0xba1030c) "' name='RPMH_BCM_SHADOW_STATUS_DRV1_AGG_BW_ND28'/>"
WRITE #1 "        <register address='0xba10310' value='0x" DATA.LONG(A:0xba10310) "' name='RPMH_BCM_SHADOW_STATUS_DRV1_AGG_BW_ND29'/>"
WRITE #1 "        <register address='0xba10314' value='0x" DATA.LONG(A:0xba10314) "' name='RPMH_BCM_SHADOW_STATUS_DRV1_AGG_BW_ND30'/>"
WRITE #1 "        <register address='0xba10318' value='0x" DATA.LONG(A:0xba10318) "' name='RPMH_BCM_SHADOW_STATUS_DRV1_AGG_BW_ND31'/>"
WRITE #1 "        <register address='0xba1031c' value='0x" DATA.LONG(A:0xba1031c) "' name='RPMH_BCM_SHADOW_STATUS_DRV1_AGG_BW_ND32'/>"
WRITE #1 "        <register address='0xba10320' value='0x" DATA.LONG(A:0xba10320) "' name='RPMH_BCM_SHADOW_STATUS_DRV1_AGG_BW_ND33'/>"
WRITE #1 "        <register address='0xba10324' value='0x" DATA.LONG(A:0xba10324) "' name='RPMH_BCM_SHADOW_STATUS_DRV1_AGG_BW_ND34'/>"
WRITE #1 "        <register address='0xba10328' value='0x" DATA.LONG(A:0xba10328) "' name='RPMH_BCM_SHADOW_STATUS_DRV1_AGG_BW_ND35'/>"
WRITE #1 "        <register address='0xba1032c' value='0x" DATA.LONG(A:0xba1032c) "' name='RPMH_BCM_SHADOW_STATUS_DRV1_AGG_BW_ND36'/>"
WRITE #1 "        <register address='0xba10330' value='0x" DATA.LONG(A:0xba10330) "' name='RPMH_BCM_SHADOW_STATUS_DRV1_AGG_BW_ND37'/>"
WRITE #1 "        <register address='0xba10334' value='0x" DATA.LONG(A:0xba10334) "' name='RPMH_BCM_SHADOW_STATUS_DRV1_AGG_BW_ND38'/>"
WRITE #1 "        <register address='0xba10338' value='0x" DATA.LONG(A:0xba10338) "' name='RPMH_BCM_SHADOW_STATUS_DRV1_AGG_BW_ND39'/>"
WRITE #1 "        <register address='0xba1033c' value='0x" DATA.LONG(A:0xba1033c) "' name='RPMH_BCM_SHADOW_STATUS_DRV1_AGG_BW_ND40'/>"
WRITE #1 "        <register address='0xba10340' value='0x" DATA.LONG(A:0xba10340) "' name='RPMH_BCM_SHADOW_STATUS_DRV1_AGG_BW_ND41'/>"
WRITE #1 "        <register address='0xba10344' value='0x" DATA.LONG(A:0xba10344) "' name='RPMH_BCM_SHADOW_STATUS_DRV1_AGG_BW_ND42'/>"
WRITE #1 "        <register address='0xba10348' value='0x" DATA.LONG(A:0xba10348) "' name='RPMH_BCM_SHADOW_STATUS_DRV1_AGG_BW_ND43'/>"
WRITE #1 "        <register address='0xba2029c' value='0x" DATA.LONG(A:0xba2029c) "' name='RPMH_BCM_SHADOW_STATUS_DRV2_AGG_BW_ND0'/>"
WRITE #1 "        <register address='0xba202a0' value='0x" DATA.LONG(A:0xba202a0) "' name='RPMH_BCM_SHADOW_STATUS_DRV2_AGG_BW_ND1'/>"
WRITE #1 "        <register address='0xba202a4' value='0x" DATA.LONG(A:0xba202a4) "' name='RPMH_BCM_SHADOW_STATUS_DRV2_AGG_BW_ND2'/>"
WRITE #1 "        <register address='0xba202a8' value='0x" DATA.LONG(A:0xba202a8) "' name='RPMH_BCM_SHADOW_STATUS_DRV2_AGG_BW_ND3'/>"
WRITE #1 "        <register address='0xba202ac' value='0x" DATA.LONG(A:0xba202ac) "' name='RPMH_BCM_SHADOW_STATUS_DRV2_AGG_BW_ND4'/>"
WRITE #1 "        <register address='0xba202b0' value='0x" DATA.LONG(A:0xba202b0) "' name='RPMH_BCM_SHADOW_STATUS_DRV2_AGG_BW_ND5'/>"
WRITE #1 "        <register address='0xba202b4' value='0x" DATA.LONG(A:0xba202b4) "' name='RPMH_BCM_SHADOW_STATUS_DRV2_AGG_BW_ND6'/>"
WRITE #1 "        <register address='0xba202b8' value='0x" DATA.LONG(A:0xba202b8) "' name='RPMH_BCM_SHADOW_STATUS_DRV2_AGG_BW_ND7'/>"
WRITE #1 "        <register address='0xba202bc' value='0x" DATA.LONG(A:0xba202bc) "' name='RPMH_BCM_SHADOW_STATUS_DRV2_AGG_BW_ND8'/>"
WRITE #1 "        <register address='0xba202c0' value='0x" DATA.LONG(A:0xba202c0) "' name='RPMH_BCM_SHADOW_STATUS_DRV2_AGG_BW_ND9'/>"
WRITE #1 "        <register address='0xba202c4' value='0x" DATA.LONG(A:0xba202c4) "' name='RPMH_BCM_SHADOW_STATUS_DRV2_AGG_BW_ND10'/>"
WRITE #1 "        <register address='0xba202c8' value='0x" DATA.LONG(A:0xba202c8) "' name='RPMH_BCM_SHADOW_STATUS_DRV2_AGG_BW_ND11'/>"
WRITE #1 "        <register address='0xba202cc' value='0x" DATA.LONG(A:0xba202cc) "' name='RPMH_BCM_SHADOW_STATUS_DRV2_AGG_BW_ND12'/>"
WRITE #1 "        <register address='0xba202d0' value='0x" DATA.LONG(A:0xba202d0) "' name='RPMH_BCM_SHADOW_STATUS_DRV2_AGG_BW_ND13'/>"
WRITE #1 "        <register address='0xba202d4' value='0x" DATA.LONG(A:0xba202d4) "' name='RPMH_BCM_SHADOW_STATUS_DRV2_AGG_BW_ND14'/>"
WRITE #1 "        <register address='0xba202d8' value='0x" DATA.LONG(A:0xba202d8) "' name='RPMH_BCM_SHADOW_STATUS_DRV2_AGG_BW_ND15'/>"
WRITE #1 "        <register address='0xba202dc' value='0x" DATA.LONG(A:0xba202dc) "' name='RPMH_BCM_SHADOW_STATUS_DRV2_AGG_BW_ND16'/>"
WRITE #1 "        <register address='0xba202e0' value='0x" DATA.LONG(A:0xba202e0) "' name='RPMH_BCM_SHADOW_STATUS_DRV2_AGG_BW_ND17'/>"
WRITE #1 "        <register address='0xba202e4' value='0x" DATA.LONG(A:0xba202e4) "' name='RPMH_BCM_SHADOW_STATUS_DRV2_AGG_BW_ND18'/>"
WRITE #1 "        <register address='0xba202e8' value='0x" DATA.LONG(A:0xba202e8) "' name='RPMH_BCM_SHADOW_STATUS_DRV2_AGG_BW_ND19'/>"
WRITE #1 "        <register address='0xba202ec' value='0x" DATA.LONG(A:0xba202ec) "' name='RPMH_BCM_SHADOW_STATUS_DRV2_AGG_BW_ND20'/>"
WRITE #1 "        <register address='0xba202f0' value='0x" DATA.LONG(A:0xba202f0) "' name='RPMH_BCM_SHADOW_STATUS_DRV2_AGG_BW_ND21'/>"
WRITE #1 "        <register address='0xba202f4' value='0x" DATA.LONG(A:0xba202f4) "' name='RPMH_BCM_SHADOW_STATUS_DRV2_AGG_BW_ND22'/>"
WRITE #1 "        <register address='0xba202f8' value='0x" DATA.LONG(A:0xba202f8) "' name='RPMH_BCM_SHADOW_STATUS_DRV2_AGG_BW_ND23'/>"
WRITE #1 "        <register address='0xba202fc' value='0x" DATA.LONG(A:0xba202fc) "' name='RPMH_BCM_SHADOW_STATUS_DRV2_AGG_BW_ND24'/>"
WRITE #1 "        <register address='0xba20300' value='0x" DATA.LONG(A:0xba20300) "' name='RPMH_BCM_SHADOW_STATUS_DRV2_AGG_BW_ND25'/>"
WRITE #1 "        <register address='0xba20304' value='0x" DATA.LONG(A:0xba20304) "' name='RPMH_BCM_SHADOW_STATUS_DRV2_AGG_BW_ND26'/>"
WRITE #1 "        <register address='0xba20308' value='0x" DATA.LONG(A:0xba20308) "' name='RPMH_BCM_SHADOW_STATUS_DRV2_AGG_BW_ND27'/>"
WRITE #1 "        <register address='0xba2030c' value='0x" DATA.LONG(A:0xba2030c) "' name='RPMH_BCM_SHADOW_STATUS_DRV2_AGG_BW_ND28'/>"
WRITE #1 "        <register address='0xba20310' value='0x" DATA.LONG(A:0xba20310) "' name='RPMH_BCM_SHADOW_STATUS_DRV2_AGG_BW_ND29'/>"
WRITE #1 "        <register address='0xba20314' value='0x" DATA.LONG(A:0xba20314) "' name='RPMH_BCM_SHADOW_STATUS_DRV2_AGG_BW_ND30'/>"
WRITE #1 "        <register address='0xba20318' value='0x" DATA.LONG(A:0xba20318) "' name='RPMH_BCM_SHADOW_STATUS_DRV2_AGG_BW_ND31'/>"
WRITE #1 "        <register address='0xba2031c' value='0x" DATA.LONG(A:0xba2031c) "' name='RPMH_BCM_SHADOW_STATUS_DRV2_AGG_BW_ND32'/>"
WRITE #1 "        <register address='0xba20320' value='0x" DATA.LONG(A:0xba20320) "' name='RPMH_BCM_SHADOW_STATUS_DRV2_AGG_BW_ND33'/>"
WRITE #1 "        <register address='0xba20324' value='0x" DATA.LONG(A:0xba20324) "' name='RPMH_BCM_SHADOW_STATUS_DRV2_AGG_BW_ND34'/>"
WRITE #1 "        <register address='0xba20328' value='0x" DATA.LONG(A:0xba20328) "' name='RPMH_BCM_SHADOW_STATUS_DRV2_AGG_BW_ND35'/>"
WRITE #1 "        <register address='0xba2032c' value='0x" DATA.LONG(A:0xba2032c) "' name='RPMH_BCM_SHADOW_STATUS_DRV2_AGG_BW_ND36'/>"
WRITE #1 "        <register address='0xba20330' value='0x" DATA.LONG(A:0xba20330) "' name='RPMH_BCM_SHADOW_STATUS_DRV2_AGG_BW_ND37'/>"
WRITE #1 "        <register address='0xba20334' value='0x" DATA.LONG(A:0xba20334) "' name='RPMH_BCM_SHADOW_STATUS_DRV2_AGG_BW_ND38'/>"
WRITE #1 "        <register address='0xba20338' value='0x" DATA.LONG(A:0xba20338) "' name='RPMH_BCM_SHADOW_STATUS_DRV2_AGG_BW_ND39'/>"
WRITE #1 "        <register address='0xba2033c' value='0x" DATA.LONG(A:0xba2033c) "' name='RPMH_BCM_SHADOW_STATUS_DRV2_AGG_BW_ND40'/>"
WRITE #1 "        <register address='0xba20340' value='0x" DATA.LONG(A:0xba20340) "' name='RPMH_BCM_SHADOW_STATUS_DRV2_AGG_BW_ND41'/>"
WRITE #1 "        <register address='0xba20344' value='0x" DATA.LONG(A:0xba20344) "' name='RPMH_BCM_SHADOW_STATUS_DRV2_AGG_BW_ND42'/>"
WRITE #1 "        <register address='0xba20348' value='0x" DATA.LONG(A:0xba20348) "' name='RPMH_BCM_SHADOW_STATUS_DRV2_AGG_BW_ND43'/>"
WRITE #1 "        <register address='0xba3029c' value='0x" DATA.LONG(A:0xba3029c) "' name='RPMH_BCM_SHADOW_STATUS_DRV3_AGG_BW_ND0'/>"
WRITE #1 "        <register address='0xba302a0' value='0x" DATA.LONG(A:0xba302a0) "' name='RPMH_BCM_SHADOW_STATUS_DRV3_AGG_BW_ND1'/>"
WRITE #1 "        <register address='0xba302a4' value='0x" DATA.LONG(A:0xba302a4) "' name='RPMH_BCM_SHADOW_STATUS_DRV3_AGG_BW_ND2'/>"
WRITE #1 "        <register address='0xba302a8' value='0x" DATA.LONG(A:0xba302a8) "' name='RPMH_BCM_SHADOW_STATUS_DRV3_AGG_BW_ND3'/>"
WRITE #1 "        <register address='0xba302ac' value='0x" DATA.LONG(A:0xba302ac) "' name='RPMH_BCM_SHADOW_STATUS_DRV3_AGG_BW_ND4'/>"
WRITE #1 "        <register address='0xba302b0' value='0x" DATA.LONG(A:0xba302b0) "' name='RPMH_BCM_SHADOW_STATUS_DRV3_AGG_BW_ND5'/>"
WRITE #1 "        <register address='0xba302b4' value='0x" DATA.LONG(A:0xba302b4) "' name='RPMH_BCM_SHADOW_STATUS_DRV3_AGG_BW_ND6'/>"
WRITE #1 "        <register address='0xba302b8' value='0x" DATA.LONG(A:0xba302b8) "' name='RPMH_BCM_SHADOW_STATUS_DRV3_AGG_BW_ND7'/>"
WRITE #1 "        <register address='0xba302bc' value='0x" DATA.LONG(A:0xba302bc) "' name='RPMH_BCM_SHADOW_STATUS_DRV3_AGG_BW_ND8'/>"
WRITE #1 "        <register address='0xba302c0' value='0x" DATA.LONG(A:0xba302c0) "' name='RPMH_BCM_SHADOW_STATUS_DRV3_AGG_BW_ND9'/>"
WRITE #1 "        <register address='0xba302c4' value='0x" DATA.LONG(A:0xba302c4) "' name='RPMH_BCM_SHADOW_STATUS_DRV3_AGG_BW_ND10'/>"
WRITE #1 "        <register address='0xba302c8' value='0x" DATA.LONG(A:0xba302c8) "' name='RPMH_BCM_SHADOW_STATUS_DRV3_AGG_BW_ND11'/>"
WRITE #1 "        <register address='0xba302cc' value='0x" DATA.LONG(A:0xba302cc) "' name='RPMH_BCM_SHADOW_STATUS_DRV3_AGG_BW_ND12'/>"
WRITE #1 "        <register address='0xba302d0' value='0x" DATA.LONG(A:0xba302d0) "' name='RPMH_BCM_SHADOW_STATUS_DRV3_AGG_BW_ND13'/>"
WRITE #1 "        <register address='0xba302d4' value='0x" DATA.LONG(A:0xba302d4) "' name='RPMH_BCM_SHADOW_STATUS_DRV3_AGG_BW_ND14'/>"
WRITE #1 "        <register address='0xba302d8' value='0x" DATA.LONG(A:0xba302d8) "' name='RPMH_BCM_SHADOW_STATUS_DRV3_AGG_BW_ND15'/>"
WRITE #1 "        <register address='0xba302dc' value='0x" DATA.LONG(A:0xba302dc) "' name='RPMH_BCM_SHADOW_STATUS_DRV3_AGG_BW_ND16'/>"
WRITE #1 "        <register address='0xba302e0' value='0x" DATA.LONG(A:0xba302e0) "' name='RPMH_BCM_SHADOW_STATUS_DRV3_AGG_BW_ND17'/>"
WRITE #1 "        <register address='0xba302e4' value='0x" DATA.LONG(A:0xba302e4) "' name='RPMH_BCM_SHADOW_STATUS_DRV3_AGG_BW_ND18'/>"
WRITE #1 "        <register address='0xba302e8' value='0x" DATA.LONG(A:0xba302e8) "' name='RPMH_BCM_SHADOW_STATUS_DRV3_AGG_BW_ND19'/>"
WRITE #1 "        <register address='0xba302ec' value='0x" DATA.LONG(A:0xba302ec) "' name='RPMH_BCM_SHADOW_STATUS_DRV3_AGG_BW_ND20'/>"
WRITE #1 "        <register address='0xba302f0' value='0x" DATA.LONG(A:0xba302f0) "' name='RPMH_BCM_SHADOW_STATUS_DRV3_AGG_BW_ND21'/>"
WRITE #1 "        <register address='0xba302f4' value='0x" DATA.LONG(A:0xba302f4) "' name='RPMH_BCM_SHADOW_STATUS_DRV3_AGG_BW_ND22'/>"
WRITE #1 "        <register address='0xba302f8' value='0x" DATA.LONG(A:0xba302f8) "' name='RPMH_BCM_SHADOW_STATUS_DRV3_AGG_BW_ND23'/>"
WRITE #1 "        <register address='0xba302fc' value='0x" DATA.LONG(A:0xba302fc) "' name='RPMH_BCM_SHADOW_STATUS_DRV3_AGG_BW_ND24'/>"
WRITE #1 "        <register address='0xba30300' value='0x" DATA.LONG(A:0xba30300) "' name='RPMH_BCM_SHADOW_STATUS_DRV3_AGG_BW_ND25'/>"
WRITE #1 "        <register address='0xba30304' value='0x" DATA.LONG(A:0xba30304) "' name='RPMH_BCM_SHADOW_STATUS_DRV3_AGG_BW_ND26'/>"
WRITE #1 "        <register address='0xba30308' value='0x" DATA.LONG(A:0xba30308) "' name='RPMH_BCM_SHADOW_STATUS_DRV3_AGG_BW_ND27'/>"
WRITE #1 "        <register address='0xba3030c' value='0x" DATA.LONG(A:0xba3030c) "' name='RPMH_BCM_SHADOW_STATUS_DRV3_AGG_BW_ND28'/>"
WRITE #1 "        <register address='0xba30310' value='0x" DATA.LONG(A:0xba30310) "' name='RPMH_BCM_SHADOW_STATUS_DRV3_AGG_BW_ND29'/>"
WRITE #1 "        <register address='0xba30314' value='0x" DATA.LONG(A:0xba30314) "' name='RPMH_BCM_SHADOW_STATUS_DRV3_AGG_BW_ND30'/>"
WRITE #1 "        <register address='0xba30318' value='0x" DATA.LONG(A:0xba30318) "' name='RPMH_BCM_SHADOW_STATUS_DRV3_AGG_BW_ND31'/>"
WRITE #1 "        <register address='0xba3031c' value='0x" DATA.LONG(A:0xba3031c) "' name='RPMH_BCM_SHADOW_STATUS_DRV3_AGG_BW_ND32'/>"
WRITE #1 "        <register address='0xba30320' value='0x" DATA.LONG(A:0xba30320) "' name='RPMH_BCM_SHADOW_STATUS_DRV3_AGG_BW_ND33'/>"
WRITE #1 "        <register address='0xba30324' value='0x" DATA.LONG(A:0xba30324) "' name='RPMH_BCM_SHADOW_STATUS_DRV3_AGG_BW_ND34'/>"
WRITE #1 "        <register address='0xba30328' value='0x" DATA.LONG(A:0xba30328) "' name='RPMH_BCM_SHADOW_STATUS_DRV3_AGG_BW_ND35'/>"
WRITE #1 "        <register address='0xba3032c' value='0x" DATA.LONG(A:0xba3032c) "' name='RPMH_BCM_SHADOW_STATUS_DRV3_AGG_BW_ND36'/>"
WRITE #1 "        <register address='0xba30330' value='0x" DATA.LONG(A:0xba30330) "' name='RPMH_BCM_SHADOW_STATUS_DRV3_AGG_BW_ND37'/>"
WRITE #1 "        <register address='0xba30334' value='0x" DATA.LONG(A:0xba30334) "' name='RPMH_BCM_SHADOW_STATUS_DRV3_AGG_BW_ND38'/>"
WRITE #1 "        <register address='0xba30338' value='0x" DATA.LONG(A:0xba30338) "' name='RPMH_BCM_SHADOW_STATUS_DRV3_AGG_BW_ND39'/>"
WRITE #1 "        <register address='0xba3033c' value='0x" DATA.LONG(A:0xba3033c) "' name='RPMH_BCM_SHADOW_STATUS_DRV3_AGG_BW_ND40'/>"
WRITE #1 "        <register address='0xba30340' value='0x" DATA.LONG(A:0xba30340) "' name='RPMH_BCM_SHADOW_STATUS_DRV3_AGG_BW_ND41'/>"
WRITE #1 "        <register address='0xba30344' value='0x" DATA.LONG(A:0xba30344) "' name='RPMH_BCM_SHADOW_STATUS_DRV3_AGG_BW_ND42'/>"
WRITE #1 "        <register address='0xba30348' value='0x" DATA.LONG(A:0xba30348) "' name='RPMH_BCM_SHADOW_STATUS_DRV3_AGG_BW_ND43'/>"
WRITE #1 "        <register address='0xba4029c' value='0x" DATA.LONG(A:0xba4029c) "' name='RPMH_BCM_SHADOW_STATUS_DRV4_AGG_BW_ND0'/>"
WRITE #1 "        <register address='0xba402a0' value='0x" DATA.LONG(A:0xba402a0) "' name='RPMH_BCM_SHADOW_STATUS_DRV4_AGG_BW_ND1'/>"
WRITE #1 "        <register address='0xba402a4' value='0x" DATA.LONG(A:0xba402a4) "' name='RPMH_BCM_SHADOW_STATUS_DRV4_AGG_BW_ND2'/>"
WRITE #1 "        <register address='0xba402a8' value='0x" DATA.LONG(A:0xba402a8) "' name='RPMH_BCM_SHADOW_STATUS_DRV4_AGG_BW_ND3'/>"
WRITE #1 "        <register address='0xba402ac' value='0x" DATA.LONG(A:0xba402ac) "' name='RPMH_BCM_SHADOW_STATUS_DRV4_AGG_BW_ND4'/>"
WRITE #1 "        <register address='0xba402b0' value='0x" DATA.LONG(A:0xba402b0) "' name='RPMH_BCM_SHADOW_STATUS_DRV4_AGG_BW_ND5'/>"
WRITE #1 "        <register address='0xba402b4' value='0x" DATA.LONG(A:0xba402b4) "' name='RPMH_BCM_SHADOW_STATUS_DRV4_AGG_BW_ND6'/>"
WRITE #1 "        <register address='0xba402b8' value='0x" DATA.LONG(A:0xba402b8) "' name='RPMH_BCM_SHADOW_STATUS_DRV4_AGG_BW_ND7'/>"
WRITE #1 "        <register address='0xba402bc' value='0x" DATA.LONG(A:0xba402bc) "' name='RPMH_BCM_SHADOW_STATUS_DRV4_AGG_BW_ND8'/>"
WRITE #1 "        <register address='0xba402c0' value='0x" DATA.LONG(A:0xba402c0) "' name='RPMH_BCM_SHADOW_STATUS_DRV4_AGG_BW_ND9'/>"
WRITE #1 "        <register address='0xba402c4' value='0x" DATA.LONG(A:0xba402c4) "' name='RPMH_BCM_SHADOW_STATUS_DRV4_AGG_BW_ND10'/>"
WRITE #1 "        <register address='0xba402c8' value='0x" DATA.LONG(A:0xba402c8) "' name='RPMH_BCM_SHADOW_STATUS_DRV4_AGG_BW_ND11'/>"
WRITE #1 "        <register address='0xba402cc' value='0x" DATA.LONG(A:0xba402cc) "' name='RPMH_BCM_SHADOW_STATUS_DRV4_AGG_BW_ND12'/>"
WRITE #1 "        <register address='0xba402d0' value='0x" DATA.LONG(A:0xba402d0) "' name='RPMH_BCM_SHADOW_STATUS_DRV4_AGG_BW_ND13'/>"
WRITE #1 "        <register address='0xba402d4' value='0x" DATA.LONG(A:0xba402d4) "' name='RPMH_BCM_SHADOW_STATUS_DRV4_AGG_BW_ND14'/>"
WRITE #1 "        <register address='0xba402d8' value='0x" DATA.LONG(A:0xba402d8) "' name='RPMH_BCM_SHADOW_STATUS_DRV4_AGG_BW_ND15'/>"
WRITE #1 "        <register address='0xba402dc' value='0x" DATA.LONG(A:0xba402dc) "' name='RPMH_BCM_SHADOW_STATUS_DRV4_AGG_BW_ND16'/>"
WRITE #1 "        <register address='0xba402e0' value='0x" DATA.LONG(A:0xba402e0) "' name='RPMH_BCM_SHADOW_STATUS_DRV4_AGG_BW_ND17'/>"
WRITE #1 "        <register address='0xba402e4' value='0x" DATA.LONG(A:0xba402e4) "' name='RPMH_BCM_SHADOW_STATUS_DRV4_AGG_BW_ND18'/>"
WRITE #1 "        <register address='0xba402e8' value='0x" DATA.LONG(A:0xba402e8) "' name='RPMH_BCM_SHADOW_STATUS_DRV4_AGG_BW_ND19'/>"
WRITE #1 "        <register address='0xba402ec' value='0x" DATA.LONG(A:0xba402ec) "' name='RPMH_BCM_SHADOW_STATUS_DRV4_AGG_BW_ND20'/>"
WRITE #1 "        <register address='0xba402f0' value='0x" DATA.LONG(A:0xba402f0) "' name='RPMH_BCM_SHADOW_STATUS_DRV4_AGG_BW_ND21'/>"
WRITE #1 "        <register address='0xba402f4' value='0x" DATA.LONG(A:0xba402f4) "' name='RPMH_BCM_SHADOW_STATUS_DRV4_AGG_BW_ND22'/>"
WRITE #1 "        <register address='0xba402f8' value='0x" DATA.LONG(A:0xba402f8) "' name='RPMH_BCM_SHADOW_STATUS_DRV4_AGG_BW_ND23'/>"
WRITE #1 "        <register address='0xba402fc' value='0x" DATA.LONG(A:0xba402fc) "' name='RPMH_BCM_SHADOW_STATUS_DRV4_AGG_BW_ND24'/>"
WRITE #1 "        <register address='0xba40300' value='0x" DATA.LONG(A:0xba40300) "' name='RPMH_BCM_SHADOW_STATUS_DRV4_AGG_BW_ND25'/>"
WRITE #1 "        <register address='0xba40304' value='0x" DATA.LONG(A:0xba40304) "' name='RPMH_BCM_SHADOW_STATUS_DRV4_AGG_BW_ND26'/>"
WRITE #1 "        <register address='0xba40308' value='0x" DATA.LONG(A:0xba40308) "' name='RPMH_BCM_SHADOW_STATUS_DRV4_AGG_BW_ND27'/>"
WRITE #1 "        <register address='0xba4030c' value='0x" DATA.LONG(A:0xba4030c) "' name='RPMH_BCM_SHADOW_STATUS_DRV4_AGG_BW_ND28'/>"
WRITE #1 "        <register address='0xba40310' value='0x" DATA.LONG(A:0xba40310) "' name='RPMH_BCM_SHADOW_STATUS_DRV4_AGG_BW_ND29'/>"
WRITE #1 "        <register address='0xba40314' value='0x" DATA.LONG(A:0xba40314) "' name='RPMH_BCM_SHADOW_STATUS_DRV4_AGG_BW_ND30'/>"
WRITE #1 "        <register address='0xba40318' value='0x" DATA.LONG(A:0xba40318) "' name='RPMH_BCM_SHADOW_STATUS_DRV4_AGG_BW_ND31'/>"
WRITE #1 "        <register address='0xba4031c' value='0x" DATA.LONG(A:0xba4031c) "' name='RPMH_BCM_SHADOW_STATUS_DRV4_AGG_BW_ND32'/>"
WRITE #1 "        <register address='0xba40320' value='0x" DATA.LONG(A:0xba40320) "' name='RPMH_BCM_SHADOW_STATUS_DRV4_AGG_BW_ND33'/>"
WRITE #1 "        <register address='0xba40324' value='0x" DATA.LONG(A:0xba40324) "' name='RPMH_BCM_SHADOW_STATUS_DRV4_AGG_BW_ND34'/>"
WRITE #1 "        <register address='0xba40328' value='0x" DATA.LONG(A:0xba40328) "' name='RPMH_BCM_SHADOW_STATUS_DRV4_AGG_BW_ND35'/>"
WRITE #1 "        <register address='0xba4032c' value='0x" DATA.LONG(A:0xba4032c) "' name='RPMH_BCM_SHADOW_STATUS_DRV4_AGG_BW_ND36'/>"
WRITE #1 "        <register address='0xba40330' value='0x" DATA.LONG(A:0xba40330) "' name='RPMH_BCM_SHADOW_STATUS_DRV4_AGG_BW_ND37'/>"
WRITE #1 "        <register address='0xba40334' value='0x" DATA.LONG(A:0xba40334) "' name='RPMH_BCM_SHADOW_STATUS_DRV4_AGG_BW_ND38'/>"
WRITE #1 "        <register address='0xba40338' value='0x" DATA.LONG(A:0xba40338) "' name='RPMH_BCM_SHADOW_STATUS_DRV4_AGG_BW_ND39'/>"
WRITE #1 "        <register address='0xba4033c' value='0x" DATA.LONG(A:0xba4033c) "' name='RPMH_BCM_SHADOW_STATUS_DRV4_AGG_BW_ND40'/>"
WRITE #1 "        <register address='0xba40340' value='0x" DATA.LONG(A:0xba40340) "' name='RPMH_BCM_SHADOW_STATUS_DRV4_AGG_BW_ND41'/>"
WRITE #1 "        <register address='0xba40344' value='0x" DATA.LONG(A:0xba40344) "' name='RPMH_BCM_SHADOW_STATUS_DRV4_AGG_BW_ND42'/>"
WRITE #1 "        <register address='0xba40348' value='0x" DATA.LONG(A:0xba40348) "' name='RPMH_BCM_SHADOW_STATUS_DRV4_AGG_BW_ND43'/>"
WRITE #1 "        <register address='0xba0049c' value='0x" DATA.LONG(A:0xba0049c) "' name='RPMH_BCM_SHADOW_STATUS_DRV0_AGG_BW_Z_ND0'/>"
WRITE #1 "        <register address='0xba004a0' value='0x" DATA.LONG(A:0xba004a0) "' name='RPMH_BCM_SHADOW_STATUS_DRV0_AGG_BW_Z_ND1'/>"
WRITE #1 "        <register address='0xba004a4' value='0x" DATA.LONG(A:0xba004a4) "' name='RPMH_BCM_SHADOW_STATUS_DRV0_AGG_BW_Z_ND2'/>"
WRITE #1 "        <register address='0xba004a8' value='0x" DATA.LONG(A:0xba004a8) "' name='RPMH_BCM_SHADOW_STATUS_DRV0_AGG_BW_Z_ND3'/>"
WRITE #1 "        <register address='0xba1049c' value='0x" DATA.LONG(A:0xba1049c) "' name='RPMH_BCM_SHADOW_STATUS_DRV1_AGG_BW_Z_ND0'/>"
WRITE #1 "        <register address='0xba104a0' value='0x" DATA.LONG(A:0xba104a0) "' name='RPMH_BCM_SHADOW_STATUS_DRV1_AGG_BW_Z_ND1'/>"
WRITE #1 "        <register address='0xba104a4' value='0x" DATA.LONG(A:0xba104a4) "' name='RPMH_BCM_SHADOW_STATUS_DRV1_AGG_BW_Z_ND2'/>"
WRITE #1 "        <register address='0xba104a8' value='0x" DATA.LONG(A:0xba104a8) "' name='RPMH_BCM_SHADOW_STATUS_DRV1_AGG_BW_Z_ND3'/>"
WRITE #1 "        <register address='0xba2049c' value='0x" DATA.LONG(A:0xba2049c) "' name='RPMH_BCM_SHADOW_STATUS_DRV2_AGG_BW_Z_ND0'/>"
WRITE #1 "        <register address='0xba204a0' value='0x" DATA.LONG(A:0xba204a0) "' name='RPMH_BCM_SHADOW_STATUS_DRV2_AGG_BW_Z_ND1'/>"
WRITE #1 "        <register address='0xba204a4' value='0x" DATA.LONG(A:0xba204a4) "' name='RPMH_BCM_SHADOW_STATUS_DRV2_AGG_BW_Z_ND2'/>"
WRITE #1 "        <register address='0xba204a8' value='0x" DATA.LONG(A:0xba204a8) "' name='RPMH_BCM_SHADOW_STATUS_DRV2_AGG_BW_Z_ND3'/>"
WRITE #1 "        <register address='0xba3049c' value='0x" DATA.LONG(A:0xba3049c) "' name='RPMH_BCM_SHADOW_STATUS_DRV3_AGG_BW_Z_ND0'/>"
WRITE #1 "        <register address='0xba304a0' value='0x" DATA.LONG(A:0xba304a0) "' name='RPMH_BCM_SHADOW_STATUS_DRV3_AGG_BW_Z_ND1'/>"
WRITE #1 "        <register address='0xba304a4' value='0x" DATA.LONG(A:0xba304a4) "' name='RPMH_BCM_SHADOW_STATUS_DRV3_AGG_BW_Z_ND2'/>"
WRITE #1 "        <register address='0xba304a8' value='0x" DATA.LONG(A:0xba304a8) "' name='RPMH_BCM_SHADOW_STATUS_DRV3_AGG_BW_Z_ND3'/>"
WRITE #1 "        <register address='0xba4049c' value='0x" DATA.LONG(A:0xba4049c) "' name='RPMH_BCM_SHADOW_STATUS_DRV4_AGG_BW_Z_ND0'/>"
WRITE #1 "        <register address='0xba404a0' value='0x" DATA.LONG(A:0xba404a0) "' name='RPMH_BCM_SHADOW_STATUS_DRV4_AGG_BW_Z_ND1'/>"
WRITE #1 "        <register address='0xba404a4' value='0x" DATA.LONG(A:0xba404a4) "' name='RPMH_BCM_SHADOW_STATUS_DRV4_AGG_BW_Z_ND2'/>"
WRITE #1 "        <register address='0xba404a8' value='0x" DATA.LONG(A:0xba404a8) "' name='RPMH_BCM_SHADOW_STATUS_DRV4_AGG_BW_Z_ND3'/>"
WRITE #1 "        <register address='0xba004ac' value='0x" DATA.LONG(A:0xba004ac) "' name='RPMH_BCM_SHADOW_STATUS_DRV0_BE_CD0'/>"
WRITE #1 "        <register address='0xba004b0' value='0x" DATA.LONG(A:0xba004b0) "' name='RPMH_BCM_SHADOW_STATUS_DRV0_BE_CD1'/>"
WRITE #1 "        <register address='0xba004b4' value='0x" DATA.LONG(A:0xba004b4) "' name='RPMH_BCM_SHADOW_STATUS_DRV0_BE_CD2'/>"
WRITE #1 "        <register address='0xba004b8' value='0x" DATA.LONG(A:0xba004b8) "' name='RPMH_BCM_SHADOW_STATUS_DRV0_BE_CD3'/>"
WRITE #1 "        <register address='0xba004bc' value='0x" DATA.LONG(A:0xba004bc) "' name='RPMH_BCM_SHADOW_STATUS_DRV0_BE_CD4'/>"
WRITE #1 "        <register address='0xba004c0' value='0x" DATA.LONG(A:0xba004c0) "' name='RPMH_BCM_SHADOW_STATUS_DRV0_BE_CD5'/>"
WRITE #1 "        <register address='0xba004c4' value='0x" DATA.LONG(A:0xba004c4) "' name='RPMH_BCM_SHADOW_STATUS_DRV0_BE_CD6'/>"
WRITE #1 "        <register address='0xba004c8' value='0x" DATA.LONG(A:0xba004c8) "' name='RPMH_BCM_SHADOW_STATUS_DRV0_BE_CD7'/>"
WRITE #1 "        <register address='0xba004cc' value='0x" DATA.LONG(A:0xba004cc) "' name='RPMH_BCM_SHADOW_STATUS_DRV0_BE_CD8'/>"
WRITE #1 "        <register address='0xba004d0' value='0x" DATA.LONG(A:0xba004d0) "' name='RPMH_BCM_SHADOW_STATUS_DRV0_BE_CD9'/>"
WRITE #1 "        <register address='0xba004d4' value='0x" DATA.LONG(A:0xba004d4) "' name='RPMH_BCM_SHADOW_STATUS_DRV0_BE_CD10'/>"
WRITE #1 "        <register address='0xba004d8' value='0x" DATA.LONG(A:0xba004d8) "' name='RPMH_BCM_SHADOW_STATUS_DRV0_BE_CD11'/>"
WRITE #1 "        <register address='0xba104ac' value='0x" DATA.LONG(A:0xba104ac) "' name='RPMH_BCM_SHADOW_STATUS_DRV1_BE_CD0'/>"
WRITE #1 "        <register address='0xba104b0' value='0x" DATA.LONG(A:0xba104b0) "' name='RPMH_BCM_SHADOW_STATUS_DRV1_BE_CD1'/>"
WRITE #1 "        <register address='0xba104b4' value='0x" DATA.LONG(A:0xba104b4) "' name='RPMH_BCM_SHADOW_STATUS_DRV1_BE_CD2'/>"
WRITE #1 "        <register address='0xba104b8' value='0x" DATA.LONG(A:0xba104b8) "' name='RPMH_BCM_SHADOW_STATUS_DRV1_BE_CD3'/>"
WRITE #1 "        <register address='0xba104bc' value='0x" DATA.LONG(A:0xba104bc) "' name='RPMH_BCM_SHADOW_STATUS_DRV1_BE_CD4'/>"
WRITE #1 "        <register address='0xba104c0' value='0x" DATA.LONG(A:0xba104c0) "' name='RPMH_BCM_SHADOW_STATUS_DRV1_BE_CD5'/>"
WRITE #1 "        <register address='0xba104c4' value='0x" DATA.LONG(A:0xba104c4) "' name='RPMH_BCM_SHADOW_STATUS_DRV1_BE_CD6'/>"
WRITE #1 "        <register address='0xba104c8' value='0x" DATA.LONG(A:0xba104c8) "' name='RPMH_BCM_SHADOW_STATUS_DRV1_BE_CD7'/>"
WRITE #1 "        <register address='0xba104cc' value='0x" DATA.LONG(A:0xba104cc) "' name='RPMH_BCM_SHADOW_STATUS_DRV1_BE_CD8'/>"
WRITE #1 "        <register address='0xba104d0' value='0x" DATA.LONG(A:0xba104d0) "' name='RPMH_BCM_SHADOW_STATUS_DRV1_BE_CD9'/>"
WRITE #1 "        <register address='0xba104d4' value='0x" DATA.LONG(A:0xba104d4) "' name='RPMH_BCM_SHADOW_STATUS_DRV1_BE_CD10'/>"
WRITE #1 "        <register address='0xba104d8' value='0x" DATA.LONG(A:0xba104d8) "' name='RPMH_BCM_SHADOW_STATUS_DRV1_BE_CD11'/>"
WRITE #1 "        <register address='0xba204ac' value='0x" DATA.LONG(A:0xba204ac) "' name='RPMH_BCM_SHADOW_STATUS_DRV2_BE_CD0'/>"
WRITE #1 "        <register address='0xba204b0' value='0x" DATA.LONG(A:0xba204b0) "' name='RPMH_BCM_SHADOW_STATUS_DRV2_BE_CD1'/>"
WRITE #1 "        <register address='0xba204b4' value='0x" DATA.LONG(A:0xba204b4) "' name='RPMH_BCM_SHADOW_STATUS_DRV2_BE_CD2'/>"
WRITE #1 "        <register address='0xba204b8' value='0x" DATA.LONG(A:0xba204b8) "' name='RPMH_BCM_SHADOW_STATUS_DRV2_BE_CD3'/>"
WRITE #1 "        <register address='0xba204bc' value='0x" DATA.LONG(A:0xba204bc) "' name='RPMH_BCM_SHADOW_STATUS_DRV2_BE_CD4'/>"
WRITE #1 "        <register address='0xba204c0' value='0x" DATA.LONG(A:0xba204c0) "' name='RPMH_BCM_SHADOW_STATUS_DRV2_BE_CD5'/>"
WRITE #1 "        <register address='0xba204c4' value='0x" DATA.LONG(A:0xba204c4) "' name='RPMH_BCM_SHADOW_STATUS_DRV2_BE_CD6'/>"
WRITE #1 "        <register address='0xba204c8' value='0x" DATA.LONG(A:0xba204c8) "' name='RPMH_BCM_SHADOW_STATUS_DRV2_BE_CD7'/>"
WRITE #1 "        <register address='0xba204cc' value='0x" DATA.LONG(A:0xba204cc) "' name='RPMH_BCM_SHADOW_STATUS_DRV2_BE_CD8'/>"
WRITE #1 "        <register address='0xba204d0' value='0x" DATA.LONG(A:0xba204d0) "' name='RPMH_BCM_SHADOW_STATUS_DRV2_BE_CD9'/>"
WRITE #1 "        <register address='0xba204d4' value='0x" DATA.LONG(A:0xba204d4) "' name='RPMH_BCM_SHADOW_STATUS_DRV2_BE_CD10'/>"
WRITE #1 "        <register address='0xba204d8' value='0x" DATA.LONG(A:0xba204d8) "' name='RPMH_BCM_SHADOW_STATUS_DRV2_BE_CD11'/>"
WRITE #1 "        <register address='0xba304ac' value='0x" DATA.LONG(A:0xba304ac) "' name='RPMH_BCM_SHADOW_STATUS_DRV3_BE_CD0'/>"
WRITE #1 "        <register address='0xba304b0' value='0x" DATA.LONG(A:0xba304b0) "' name='RPMH_BCM_SHADOW_STATUS_DRV3_BE_CD1'/>"
WRITE #1 "        <register address='0xba304b4' value='0x" DATA.LONG(A:0xba304b4) "' name='RPMH_BCM_SHADOW_STATUS_DRV3_BE_CD2'/>"
WRITE #1 "        <register address='0xba304b8' value='0x" DATA.LONG(A:0xba304b8) "' name='RPMH_BCM_SHADOW_STATUS_DRV3_BE_CD3'/>"
WRITE #1 "        <register address='0xba304bc' value='0x" DATA.LONG(A:0xba304bc) "' name='RPMH_BCM_SHADOW_STATUS_DRV3_BE_CD4'/>"
WRITE #1 "        <register address='0xba304c0' value='0x" DATA.LONG(A:0xba304c0) "' name='RPMH_BCM_SHADOW_STATUS_DRV3_BE_CD5'/>"
WRITE #1 "        <register address='0xba304c4' value='0x" DATA.LONG(A:0xba304c4) "' name='RPMH_BCM_SHADOW_STATUS_DRV3_BE_CD6'/>"
WRITE #1 "        <register address='0xba304c8' value='0x" DATA.LONG(A:0xba304c8) "' name='RPMH_BCM_SHADOW_STATUS_DRV3_BE_CD7'/>"
WRITE #1 "        <register address='0xba304cc' value='0x" DATA.LONG(A:0xba304cc) "' name='RPMH_BCM_SHADOW_STATUS_DRV3_BE_CD8'/>"
WRITE #1 "        <register address='0xba304d0' value='0x" DATA.LONG(A:0xba304d0) "' name='RPMH_BCM_SHADOW_STATUS_DRV3_BE_CD9'/>"
WRITE #1 "        <register address='0xba304d4' value='0x" DATA.LONG(A:0xba304d4) "' name='RPMH_BCM_SHADOW_STATUS_DRV3_BE_CD10'/>"
WRITE #1 "        <register address='0xba304d8' value='0x" DATA.LONG(A:0xba304d8) "' name='RPMH_BCM_SHADOW_STATUS_DRV3_BE_CD11'/>"
WRITE #1 "        <register address='0xba404ac' value='0x" DATA.LONG(A:0xba404ac) "' name='RPMH_BCM_SHADOW_STATUS_DRV4_BE_CD0'/>"
WRITE #1 "        <register address='0xba404b0' value='0x" DATA.LONG(A:0xba404b0) "' name='RPMH_BCM_SHADOW_STATUS_DRV4_BE_CD1'/>"
WRITE #1 "        <register address='0xba404b4' value='0x" DATA.LONG(A:0xba404b4) "' name='RPMH_BCM_SHADOW_STATUS_DRV4_BE_CD2'/>"
WRITE #1 "        <register address='0xba404b8' value='0x" DATA.LONG(A:0xba404b8) "' name='RPMH_BCM_SHADOW_STATUS_DRV4_BE_CD3'/>"
WRITE #1 "        <register address='0xba404bc' value='0x" DATA.LONG(A:0xba404bc) "' name='RPMH_BCM_SHADOW_STATUS_DRV4_BE_CD4'/>"
WRITE #1 "        <register address='0xba404c0' value='0x" DATA.LONG(A:0xba404c0) "' name='RPMH_BCM_SHADOW_STATUS_DRV4_BE_CD5'/>"
WRITE #1 "        <register address='0xba404c4' value='0x" DATA.LONG(A:0xba404c4) "' name='RPMH_BCM_SHADOW_STATUS_DRV4_BE_CD6'/>"
WRITE #1 "        <register address='0xba404c8' value='0x" DATA.LONG(A:0xba404c8) "' name='RPMH_BCM_SHADOW_STATUS_DRV4_BE_CD7'/>"
WRITE #1 "        <register address='0xba404cc' value='0x" DATA.LONG(A:0xba404cc) "' name='RPMH_BCM_SHADOW_STATUS_DRV4_BE_CD8'/>"
WRITE #1 "        <register address='0xba404d0' value='0x" DATA.LONG(A:0xba404d0) "' name='RPMH_BCM_SHADOW_STATUS_DRV4_BE_CD9'/>"
WRITE #1 "        <register address='0xba404d4' value='0x" DATA.LONG(A:0xba404d4) "' name='RPMH_BCM_SHADOW_STATUS_DRV4_BE_CD10'/>"
WRITE #1 "        <register address='0xba404d8' value='0x" DATA.LONG(A:0xba404d8) "' name='RPMH_BCM_SHADOW_STATUS_DRV4_BE_CD11'/>"
WRITE #1 "        <register address='0xba0052c' value='0x" DATA.LONG(A:0xba0052c) "' name='RPMH_BCM_SHADOW_STATUS_DRV0_BE_SEQ_CD0'/>"
WRITE #1 "        <register address='0xba00530' value='0x" DATA.LONG(A:0xba00530) "' name='RPMH_BCM_SHADOW_STATUS_DRV0_BE_SEQ_CD1'/>"
WRITE #1 "        <register address='0xba00534' value='0x" DATA.LONG(A:0xba00534) "' name='RPMH_BCM_SHADOW_STATUS_DRV0_BE_SEQ_CD2'/>"
WRITE #1 "        <register address='0xba00538' value='0x" DATA.LONG(A:0xba00538) "' name='RPMH_BCM_SHADOW_STATUS_DRV0_BE_SEQ_CD3'/>"
WRITE #1 "        <register address='0xba0053c' value='0x" DATA.LONG(A:0xba0053c) "' name='RPMH_BCM_SHADOW_STATUS_DRV0_BE_SEQ_CD4'/>"
WRITE #1 "        <register address='0xba00540' value='0x" DATA.LONG(A:0xba00540) "' name='RPMH_BCM_SHADOW_STATUS_DRV0_BE_SEQ_CD5'/>"
WRITE #1 "        <register address='0xba00544' value='0x" DATA.LONG(A:0xba00544) "' name='RPMH_BCM_SHADOW_STATUS_DRV0_BE_SEQ_CD6'/>"
WRITE #1 "        <register address='0xba00548' value='0x" DATA.LONG(A:0xba00548) "' name='RPMH_BCM_SHADOW_STATUS_DRV0_BE_SEQ_CD7'/>"
WRITE #1 "        <register address='0xba0054c' value='0x" DATA.LONG(A:0xba0054c) "' name='RPMH_BCM_SHADOW_STATUS_DRV0_BE_SEQ_CD8'/>"
WRITE #1 "        <register address='0xba00550' value='0x" DATA.LONG(A:0xba00550) "' name='RPMH_BCM_SHADOW_STATUS_DRV0_BE_SEQ_CD9'/>"
WRITE #1 "        <register address='0xba00554' value='0x" DATA.LONG(A:0xba00554) "' name='RPMH_BCM_SHADOW_STATUS_DRV0_BE_SEQ_CD10'/>"
WRITE #1 "        <register address='0xba00558' value='0x" DATA.LONG(A:0xba00558) "' name='RPMH_BCM_SHADOW_STATUS_DRV0_BE_SEQ_CD11'/>"
WRITE #1 "        <register address='0xba1052c' value='0x" DATA.LONG(A:0xba1052c) "' name='RPMH_BCM_SHADOW_STATUS_DRV1_BE_SEQ_CD0'/>"
WRITE #1 "        <register address='0xba10530' value='0x" DATA.LONG(A:0xba10530) "' name='RPMH_BCM_SHADOW_STATUS_DRV1_BE_SEQ_CD1'/>"
WRITE #1 "        <register address='0xba10534' value='0x" DATA.LONG(A:0xba10534) "' name='RPMH_BCM_SHADOW_STATUS_DRV1_BE_SEQ_CD2'/>"
WRITE #1 "        <register address='0xba10538' value='0x" DATA.LONG(A:0xba10538) "' name='RPMH_BCM_SHADOW_STATUS_DRV1_BE_SEQ_CD3'/>"
WRITE #1 "        <register address='0xba1053c' value='0x" DATA.LONG(A:0xba1053c) "' name='RPMH_BCM_SHADOW_STATUS_DRV1_BE_SEQ_CD4'/>"
WRITE #1 "        <register address='0xba10540' value='0x" DATA.LONG(A:0xba10540) "' name='RPMH_BCM_SHADOW_STATUS_DRV1_BE_SEQ_CD5'/>"
WRITE #1 "        <register address='0xba10544' value='0x" DATA.LONG(A:0xba10544) "' name='RPMH_BCM_SHADOW_STATUS_DRV1_BE_SEQ_CD6'/>"
WRITE #1 "        <register address='0xba10548' value='0x" DATA.LONG(A:0xba10548) "' name='RPMH_BCM_SHADOW_STATUS_DRV1_BE_SEQ_CD7'/>"
WRITE #1 "        <register address='0xba1054c' value='0x" DATA.LONG(A:0xba1054c) "' name='RPMH_BCM_SHADOW_STATUS_DRV1_BE_SEQ_CD8'/>"
WRITE #1 "        <register address='0xba10550' value='0x" DATA.LONG(A:0xba10550) "' name='RPMH_BCM_SHADOW_STATUS_DRV1_BE_SEQ_CD9'/>"
WRITE #1 "        <register address='0xba10554' value='0x" DATA.LONG(A:0xba10554) "' name='RPMH_BCM_SHADOW_STATUS_DRV1_BE_SEQ_CD10'/>"
WRITE #1 "        <register address='0xba10558' value='0x" DATA.LONG(A:0xba10558) "' name='RPMH_BCM_SHADOW_STATUS_DRV1_BE_SEQ_CD11'/>"
WRITE #1 "        <register address='0xba2052c' value='0x" DATA.LONG(A:0xba2052c) "' name='RPMH_BCM_SHADOW_STATUS_DRV2_BE_SEQ_CD0'/>"
WRITE #1 "        <register address='0xba20530' value='0x" DATA.LONG(A:0xba20530) "' name='RPMH_BCM_SHADOW_STATUS_DRV2_BE_SEQ_CD1'/>"
WRITE #1 "        <register address='0xba20534' value='0x" DATA.LONG(A:0xba20534) "' name='RPMH_BCM_SHADOW_STATUS_DRV2_BE_SEQ_CD2'/>"
WRITE #1 "        <register address='0xba20538' value='0x" DATA.LONG(A:0xba20538) "' name='RPMH_BCM_SHADOW_STATUS_DRV2_BE_SEQ_CD3'/>"
WRITE #1 "        <register address='0xba2053c' value='0x" DATA.LONG(A:0xba2053c) "' name='RPMH_BCM_SHADOW_STATUS_DRV2_BE_SEQ_CD4'/>"
WRITE #1 "        <register address='0xba20540' value='0x" DATA.LONG(A:0xba20540) "' name='RPMH_BCM_SHADOW_STATUS_DRV2_BE_SEQ_CD5'/>"
WRITE #1 "        <register address='0xba20544' value='0x" DATA.LONG(A:0xba20544) "' name='RPMH_BCM_SHADOW_STATUS_DRV2_BE_SEQ_CD6'/>"
WRITE #1 "        <register address='0xba20548' value='0x" DATA.LONG(A:0xba20548) "' name='RPMH_BCM_SHADOW_STATUS_DRV2_BE_SEQ_CD7'/>"
WRITE #1 "        <register address='0xba2054c' value='0x" DATA.LONG(A:0xba2054c) "' name='RPMH_BCM_SHADOW_STATUS_DRV2_BE_SEQ_CD8'/>"
WRITE #1 "        <register address='0xba20550' value='0x" DATA.LONG(A:0xba20550) "' name='RPMH_BCM_SHADOW_STATUS_DRV2_BE_SEQ_CD9'/>"
WRITE #1 "        <register address='0xba20554' value='0x" DATA.LONG(A:0xba20554) "' name='RPMH_BCM_SHADOW_STATUS_DRV2_BE_SEQ_CD10'/>"
WRITE #1 "        <register address='0xba20558' value='0x" DATA.LONG(A:0xba20558) "' name='RPMH_BCM_SHADOW_STATUS_DRV2_BE_SEQ_CD11'/>"
WRITE #1 "        <register address='0xba3052c' value='0x" DATA.LONG(A:0xba3052c) "' name='RPMH_BCM_SHADOW_STATUS_DRV3_BE_SEQ_CD0'/>"
WRITE #1 "        <register address='0xba30530' value='0x" DATA.LONG(A:0xba30530) "' name='RPMH_BCM_SHADOW_STATUS_DRV3_BE_SEQ_CD1'/>"
WRITE #1 "        <register address='0xba30534' value='0x" DATA.LONG(A:0xba30534) "' name='RPMH_BCM_SHADOW_STATUS_DRV3_BE_SEQ_CD2'/>"
WRITE #1 "        <register address='0xba30538' value='0x" DATA.LONG(A:0xba30538) "' name='RPMH_BCM_SHADOW_STATUS_DRV3_BE_SEQ_CD3'/>"
WRITE #1 "        <register address='0xba3053c' value='0x" DATA.LONG(A:0xba3053c) "' name='RPMH_BCM_SHADOW_STATUS_DRV3_BE_SEQ_CD4'/>"
WRITE #1 "        <register address='0xba30540' value='0x" DATA.LONG(A:0xba30540) "' name='RPMH_BCM_SHADOW_STATUS_DRV3_BE_SEQ_CD5'/>"
WRITE #1 "        <register address='0xba30544' value='0x" DATA.LONG(A:0xba30544) "' name='RPMH_BCM_SHADOW_STATUS_DRV3_BE_SEQ_CD6'/>"
WRITE #1 "        <register address='0xba30548' value='0x" DATA.LONG(A:0xba30548) "' name='RPMH_BCM_SHADOW_STATUS_DRV3_BE_SEQ_CD7'/>"
WRITE #1 "        <register address='0xba3054c' value='0x" DATA.LONG(A:0xba3054c) "' name='RPMH_BCM_SHADOW_STATUS_DRV3_BE_SEQ_CD8'/>"
WRITE #1 "        <register address='0xba30550' value='0x" DATA.LONG(A:0xba30550) "' name='RPMH_BCM_SHADOW_STATUS_DRV3_BE_SEQ_CD9'/>"
WRITE #1 "        <register address='0xba30554' value='0x" DATA.LONG(A:0xba30554) "' name='RPMH_BCM_SHADOW_STATUS_DRV3_BE_SEQ_CD10'/>"
WRITE #1 "        <register address='0xba30558' value='0x" DATA.LONG(A:0xba30558) "' name='RPMH_BCM_SHADOW_STATUS_DRV3_BE_SEQ_CD11'/>"
WRITE #1 "        <register address='0xba4052c' value='0x" DATA.LONG(A:0xba4052c) "' name='RPMH_BCM_SHADOW_STATUS_DRV4_BE_SEQ_CD0'/>"
WRITE #1 "        <register address='0xba40530' value='0x" DATA.LONG(A:0xba40530) "' name='RPMH_BCM_SHADOW_STATUS_DRV4_BE_SEQ_CD1'/>"
WRITE #1 "        <register address='0xba40534' value='0x" DATA.LONG(A:0xba40534) "' name='RPMH_BCM_SHADOW_STATUS_DRV4_BE_SEQ_CD2'/>"
WRITE #1 "        <register address='0xba40538' value='0x" DATA.LONG(A:0xba40538) "' name='RPMH_BCM_SHADOW_STATUS_DRV4_BE_SEQ_CD3'/>"
WRITE #1 "        <register address='0xba4053c' value='0x" DATA.LONG(A:0xba4053c) "' name='RPMH_BCM_SHADOW_STATUS_DRV4_BE_SEQ_CD4'/>"
WRITE #1 "        <register address='0xba40540' value='0x" DATA.LONG(A:0xba40540) "' name='RPMH_BCM_SHADOW_STATUS_DRV4_BE_SEQ_CD5'/>"
WRITE #1 "        <register address='0xba40544' value='0x" DATA.LONG(A:0xba40544) "' name='RPMH_BCM_SHADOW_STATUS_DRV4_BE_SEQ_CD6'/>"
WRITE #1 "        <register address='0xba40548' value='0x" DATA.LONG(A:0xba40548) "' name='RPMH_BCM_SHADOW_STATUS_DRV4_BE_SEQ_CD7'/>"
WRITE #1 "        <register address='0xba4054c' value='0x" DATA.LONG(A:0xba4054c) "' name='RPMH_BCM_SHADOW_STATUS_DRV4_BE_SEQ_CD8'/>"
WRITE #1 "        <register address='0xba40550' value='0x" DATA.LONG(A:0xba40550) "' name='RPMH_BCM_SHADOW_STATUS_DRV4_BE_SEQ_CD9'/>"
WRITE #1 "        <register address='0xba40554' value='0x" DATA.LONG(A:0xba40554) "' name='RPMH_BCM_SHADOW_STATUS_DRV4_BE_SEQ_CD10'/>"
WRITE #1 "        <register address='0xba40558' value='0x" DATA.LONG(A:0xba40558) "' name='RPMH_BCM_SHADOW_STATUS_DRV4_BE_SEQ_CD11'/>"
WRITE #1 "        <register address='0xba005ac' value='0x" DATA.LONG(A:0xba005ac) "' name='RPMH_BCM_SHADOW_STATUS_DRV0_BE_CMD_ISSUE_STATUS_CD0'/>"
WRITE #1 "        <register address='0xba005b0' value='0x" DATA.LONG(A:0xba005b0) "' name='RPMH_BCM_SHADOW_STATUS_DRV0_BE_CMD_ISSUE_STATUS_CD1'/>"
WRITE #1 "        <register address='0xba005b4' value='0x" DATA.LONG(A:0xba005b4) "' name='RPMH_BCM_SHADOW_STATUS_DRV0_BE_CMD_ISSUE_STATUS_CD2'/>"
WRITE #1 "        <register address='0xba005b8' value='0x" DATA.LONG(A:0xba005b8) "' name='RPMH_BCM_SHADOW_STATUS_DRV0_BE_CMD_ISSUE_STATUS_CD3'/>"
WRITE #1 "        <register address='0xba005bc' value='0x" DATA.LONG(A:0xba005bc) "' name='RPMH_BCM_SHADOW_STATUS_DRV0_BE_CMD_ISSUE_STATUS_CD4'/>"
WRITE #1 "        <register address='0xba005c0' value='0x" DATA.LONG(A:0xba005c0) "' name='RPMH_BCM_SHADOW_STATUS_DRV0_BE_CMD_ISSUE_STATUS_CD5'/>"
WRITE #1 "        <register address='0xba005c4' value='0x" DATA.LONG(A:0xba005c4) "' name='RPMH_BCM_SHADOW_STATUS_DRV0_BE_CMD_ISSUE_STATUS_CD6'/>"
WRITE #1 "        <register address='0xba005c8' value='0x" DATA.LONG(A:0xba005c8) "' name='RPMH_BCM_SHADOW_STATUS_DRV0_BE_CMD_ISSUE_STATUS_CD7'/>"
WRITE #1 "        <register address='0xba005cc' value='0x" DATA.LONG(A:0xba005cc) "' name='RPMH_BCM_SHADOW_STATUS_DRV0_BE_CMD_ISSUE_STATUS_CD8'/>"
WRITE #1 "        <register address='0xba005d0' value='0x" DATA.LONG(A:0xba005d0) "' name='RPMH_BCM_SHADOW_STATUS_DRV0_BE_CMD_ISSUE_STATUS_CD9'/>"
WRITE #1 "        <register address='0xba005d4' value='0x" DATA.LONG(A:0xba005d4) "' name='RPMH_BCM_SHADOW_STATUS_DRV0_BE_CMD_ISSUE_STATUS_CD10'/>"
WRITE #1 "        <register address='0xba005d8' value='0x" DATA.LONG(A:0xba005d8) "' name='RPMH_BCM_SHADOW_STATUS_DRV0_BE_CMD_ISSUE_STATUS_CD11'/>"
WRITE #1 "        <register address='0xba105ac' value='0x" DATA.LONG(A:0xba105ac) "' name='RPMH_BCM_SHADOW_STATUS_DRV1_BE_CMD_ISSUE_STATUS_CD0'/>"
WRITE #1 "        <register address='0xba105b0' value='0x" DATA.LONG(A:0xba105b0) "' name='RPMH_BCM_SHADOW_STATUS_DRV1_BE_CMD_ISSUE_STATUS_CD1'/>"
WRITE #1 "        <register address='0xba105b4' value='0x" DATA.LONG(A:0xba105b4) "' name='RPMH_BCM_SHADOW_STATUS_DRV1_BE_CMD_ISSUE_STATUS_CD2'/>"
WRITE #1 "        <register address='0xba105b8' value='0x" DATA.LONG(A:0xba105b8) "' name='RPMH_BCM_SHADOW_STATUS_DRV1_BE_CMD_ISSUE_STATUS_CD3'/>"
WRITE #1 "        <register address='0xba105bc' value='0x" DATA.LONG(A:0xba105bc) "' name='RPMH_BCM_SHADOW_STATUS_DRV1_BE_CMD_ISSUE_STATUS_CD4'/>"
WRITE #1 "        <register address='0xba105c0' value='0x" DATA.LONG(A:0xba105c0) "' name='RPMH_BCM_SHADOW_STATUS_DRV1_BE_CMD_ISSUE_STATUS_CD5'/>"
WRITE #1 "        <register address='0xba105c4' value='0x" DATA.LONG(A:0xba105c4) "' name='RPMH_BCM_SHADOW_STATUS_DRV1_BE_CMD_ISSUE_STATUS_CD6'/>"
WRITE #1 "        <register address='0xba105c8' value='0x" DATA.LONG(A:0xba105c8) "' name='RPMH_BCM_SHADOW_STATUS_DRV1_BE_CMD_ISSUE_STATUS_CD7'/>"
WRITE #1 "        <register address='0xba105cc' value='0x" DATA.LONG(A:0xba105cc) "' name='RPMH_BCM_SHADOW_STATUS_DRV1_BE_CMD_ISSUE_STATUS_CD8'/>"
WRITE #1 "        <register address='0xba105d0' value='0x" DATA.LONG(A:0xba105d0) "' name='RPMH_BCM_SHADOW_STATUS_DRV1_BE_CMD_ISSUE_STATUS_CD9'/>"
WRITE #1 "        <register address='0xba105d4' value='0x" DATA.LONG(A:0xba105d4) "' name='RPMH_BCM_SHADOW_STATUS_DRV1_BE_CMD_ISSUE_STATUS_CD10'/>"
WRITE #1 "        <register address='0xba105d8' value='0x" DATA.LONG(A:0xba105d8) "' name='RPMH_BCM_SHADOW_STATUS_DRV1_BE_CMD_ISSUE_STATUS_CD11'/>"
WRITE #1 "        <register address='0xba205ac' value='0x" DATA.LONG(A:0xba205ac) "' name='RPMH_BCM_SHADOW_STATUS_DRV2_BE_CMD_ISSUE_STATUS_CD0'/>"
WRITE #1 "        <register address='0xba205b0' value='0x" DATA.LONG(A:0xba205b0) "' name='RPMH_BCM_SHADOW_STATUS_DRV2_BE_CMD_ISSUE_STATUS_CD1'/>"
WRITE #1 "        <register address='0xba205b4' value='0x" DATA.LONG(A:0xba205b4) "' name='RPMH_BCM_SHADOW_STATUS_DRV2_BE_CMD_ISSUE_STATUS_CD2'/>"
WRITE #1 "        <register address='0xba205b8' value='0x" DATA.LONG(A:0xba205b8) "' name='RPMH_BCM_SHADOW_STATUS_DRV2_BE_CMD_ISSUE_STATUS_CD3'/>"
WRITE #1 "        <register address='0xba205bc' value='0x" DATA.LONG(A:0xba205bc) "' name='RPMH_BCM_SHADOW_STATUS_DRV2_BE_CMD_ISSUE_STATUS_CD4'/>"
WRITE #1 "        <register address='0xba205c0' value='0x" DATA.LONG(A:0xba205c0) "' name='RPMH_BCM_SHADOW_STATUS_DRV2_BE_CMD_ISSUE_STATUS_CD5'/>"
WRITE #1 "        <register address='0xba205c4' value='0x" DATA.LONG(A:0xba205c4) "' name='RPMH_BCM_SHADOW_STATUS_DRV2_BE_CMD_ISSUE_STATUS_CD6'/>"
WRITE #1 "        <register address='0xba205c8' value='0x" DATA.LONG(A:0xba205c8) "' name='RPMH_BCM_SHADOW_STATUS_DRV2_BE_CMD_ISSUE_STATUS_CD7'/>"
WRITE #1 "        <register address='0xba205cc' value='0x" DATA.LONG(A:0xba205cc) "' name='RPMH_BCM_SHADOW_STATUS_DRV2_BE_CMD_ISSUE_STATUS_CD8'/>"
WRITE #1 "        <register address='0xba205d0' value='0x" DATA.LONG(A:0xba205d0) "' name='RPMH_BCM_SHADOW_STATUS_DRV2_BE_CMD_ISSUE_STATUS_CD9'/>"
WRITE #1 "        <register address='0xba205d4' value='0x" DATA.LONG(A:0xba205d4) "' name='RPMH_BCM_SHADOW_STATUS_DRV2_BE_CMD_ISSUE_STATUS_CD10'/>"
WRITE #1 "        <register address='0xba205d8' value='0x" DATA.LONG(A:0xba205d8) "' name='RPMH_BCM_SHADOW_STATUS_DRV2_BE_CMD_ISSUE_STATUS_CD11'/>"
WRITE #1 "        <register address='0xba305ac' value='0x" DATA.LONG(A:0xba305ac) "' name='RPMH_BCM_SHADOW_STATUS_DRV3_BE_CMD_ISSUE_STATUS_CD0'/>"
WRITE #1 "        <register address='0xba305b0' value='0x" DATA.LONG(A:0xba305b0) "' name='RPMH_BCM_SHADOW_STATUS_DRV3_BE_CMD_ISSUE_STATUS_CD1'/>"
WRITE #1 "        <register address='0xba305b4' value='0x" DATA.LONG(A:0xba305b4) "' name='RPMH_BCM_SHADOW_STATUS_DRV3_BE_CMD_ISSUE_STATUS_CD2'/>"
WRITE #1 "        <register address='0xba305b8' value='0x" DATA.LONG(A:0xba305b8) "' name='RPMH_BCM_SHADOW_STATUS_DRV3_BE_CMD_ISSUE_STATUS_CD3'/>"
WRITE #1 "        <register address='0xba305bc' value='0x" DATA.LONG(A:0xba305bc) "' name='RPMH_BCM_SHADOW_STATUS_DRV3_BE_CMD_ISSUE_STATUS_CD4'/>"
WRITE #1 "        <register address='0xba305c0' value='0x" DATA.LONG(A:0xba305c0) "' name='RPMH_BCM_SHADOW_STATUS_DRV3_BE_CMD_ISSUE_STATUS_CD5'/>"
WRITE #1 "        <register address='0xba305c4' value='0x" DATA.LONG(A:0xba305c4) "' name='RPMH_BCM_SHADOW_STATUS_DRV3_BE_CMD_ISSUE_STATUS_CD6'/>"
WRITE #1 "        <register address='0xba305c8' value='0x" DATA.LONG(A:0xba305c8) "' name='RPMH_BCM_SHADOW_STATUS_DRV3_BE_CMD_ISSUE_STATUS_CD7'/>"
WRITE #1 "        <register address='0xba305cc' value='0x" DATA.LONG(A:0xba305cc) "' name='RPMH_BCM_SHADOW_STATUS_DRV3_BE_CMD_ISSUE_STATUS_CD8'/>"
WRITE #1 "        <register address='0xba305d0' value='0x" DATA.LONG(A:0xba305d0) "' name='RPMH_BCM_SHADOW_STATUS_DRV3_BE_CMD_ISSUE_STATUS_CD9'/>"
WRITE #1 "        <register address='0xba305d4' value='0x" DATA.LONG(A:0xba305d4) "' name='RPMH_BCM_SHADOW_STATUS_DRV3_BE_CMD_ISSUE_STATUS_CD10'/>"
WRITE #1 "        <register address='0xba305d8' value='0x" DATA.LONG(A:0xba305d8) "' name='RPMH_BCM_SHADOW_STATUS_DRV3_BE_CMD_ISSUE_STATUS_CD11'/>"
WRITE #1 "        <register address='0xba405ac' value='0x" DATA.LONG(A:0xba405ac) "' name='RPMH_BCM_SHADOW_STATUS_DRV4_BE_CMD_ISSUE_STATUS_CD0'/>"
WRITE #1 "        <register address='0xba405b0' value='0x" DATA.LONG(A:0xba405b0) "' name='RPMH_BCM_SHADOW_STATUS_DRV4_BE_CMD_ISSUE_STATUS_CD1'/>"
WRITE #1 "        <register address='0xba405b4' value='0x" DATA.LONG(A:0xba405b4) "' name='RPMH_BCM_SHADOW_STATUS_DRV4_BE_CMD_ISSUE_STATUS_CD2'/>"
WRITE #1 "        <register address='0xba405b8' value='0x" DATA.LONG(A:0xba405b8) "' name='RPMH_BCM_SHADOW_STATUS_DRV4_BE_CMD_ISSUE_STATUS_CD3'/>"
WRITE #1 "        <register address='0xba405bc' value='0x" DATA.LONG(A:0xba405bc) "' name='RPMH_BCM_SHADOW_STATUS_DRV4_BE_CMD_ISSUE_STATUS_CD4'/>"
WRITE #1 "        <register address='0xba405c0' value='0x" DATA.LONG(A:0xba405c0) "' name='RPMH_BCM_SHADOW_STATUS_DRV4_BE_CMD_ISSUE_STATUS_CD5'/>"
WRITE #1 "        <register address='0xba405c4' value='0x" DATA.LONG(A:0xba405c4) "' name='RPMH_BCM_SHADOW_STATUS_DRV4_BE_CMD_ISSUE_STATUS_CD6'/>"
WRITE #1 "        <register address='0xba405c8' value='0x" DATA.LONG(A:0xba405c8) "' name='RPMH_BCM_SHADOW_STATUS_DRV4_BE_CMD_ISSUE_STATUS_CD7'/>"
WRITE #1 "        <register address='0xba405cc' value='0x" DATA.LONG(A:0xba405cc) "' name='RPMH_BCM_SHADOW_STATUS_DRV4_BE_CMD_ISSUE_STATUS_CD8'/>"
WRITE #1 "        <register address='0xba405d0' value='0x" DATA.LONG(A:0xba405d0) "' name='RPMH_BCM_SHADOW_STATUS_DRV4_BE_CMD_ISSUE_STATUS_CD9'/>"
WRITE #1 "        <register address='0xba405d4' value='0x" DATA.LONG(A:0xba405d4) "' name='RPMH_BCM_SHADOW_STATUS_DRV4_BE_CMD_ISSUE_STATUS_CD10'/>"
WRITE #1 "        <register address='0xba405d8' value='0x" DATA.LONG(A:0xba405d8) "' name='RPMH_BCM_SHADOW_STATUS_DRV4_BE_CMD_ISSUE_STATUS_CD11'/>"
WRITE #1 "        <register address='0xba0062c' value='0x" DATA.LONG(A:0xba0062c) "' name='RPMH_BCM_SHADOW_STATUS_DRV0_BE_CMD_SENT_STATUS_CD0'/>"
WRITE #1 "        <register address='0xba00630' value='0x" DATA.LONG(A:0xba00630) "' name='RPMH_BCM_SHADOW_STATUS_DRV0_BE_CMD_SENT_STATUS_CD1'/>"
WRITE #1 "        <register address='0xba00634' value='0x" DATA.LONG(A:0xba00634) "' name='RPMH_BCM_SHADOW_STATUS_DRV0_BE_CMD_SENT_STATUS_CD2'/>"
WRITE #1 "        <register address='0xba00638' value='0x" DATA.LONG(A:0xba00638) "' name='RPMH_BCM_SHADOW_STATUS_DRV0_BE_CMD_SENT_STATUS_CD3'/>"
WRITE #1 "        <register address='0xba0063c' value='0x" DATA.LONG(A:0xba0063c) "' name='RPMH_BCM_SHADOW_STATUS_DRV0_BE_CMD_SENT_STATUS_CD4'/>"
WRITE #1 "        <register address='0xba00640' value='0x" DATA.LONG(A:0xba00640) "' name='RPMH_BCM_SHADOW_STATUS_DRV0_BE_CMD_SENT_STATUS_CD5'/>"
WRITE #1 "        <register address='0xba00644' value='0x" DATA.LONG(A:0xba00644) "' name='RPMH_BCM_SHADOW_STATUS_DRV0_BE_CMD_SENT_STATUS_CD6'/>"
WRITE #1 "        <register address='0xba00648' value='0x" DATA.LONG(A:0xba00648) "' name='RPMH_BCM_SHADOW_STATUS_DRV0_BE_CMD_SENT_STATUS_CD7'/>"
WRITE #1 "        <register address='0xba0064c' value='0x" DATA.LONG(A:0xba0064c) "' name='RPMH_BCM_SHADOW_STATUS_DRV0_BE_CMD_SENT_STATUS_CD8'/>"
WRITE #1 "        <register address='0xba00650' value='0x" DATA.LONG(A:0xba00650) "' name='RPMH_BCM_SHADOW_STATUS_DRV0_BE_CMD_SENT_STATUS_CD9'/>"
WRITE #1 "        <register address='0xba00654' value='0x" DATA.LONG(A:0xba00654) "' name='RPMH_BCM_SHADOW_STATUS_DRV0_BE_CMD_SENT_STATUS_CD10'/>"
WRITE #1 "        <register address='0xba00658' value='0x" DATA.LONG(A:0xba00658) "' name='RPMH_BCM_SHADOW_STATUS_DRV0_BE_CMD_SENT_STATUS_CD11'/>"
WRITE #1 "        <register address='0xba1062c' value='0x" DATA.LONG(A:0xba1062c) "' name='RPMH_BCM_SHADOW_STATUS_DRV1_BE_CMD_SENT_STATUS_CD0'/>"
WRITE #1 "        <register address='0xba10630' value='0x" DATA.LONG(A:0xba10630) "' name='RPMH_BCM_SHADOW_STATUS_DRV1_BE_CMD_SENT_STATUS_CD1'/>"
WRITE #1 "        <register address='0xba10634' value='0x" DATA.LONG(A:0xba10634) "' name='RPMH_BCM_SHADOW_STATUS_DRV1_BE_CMD_SENT_STATUS_CD2'/>"
WRITE #1 "        <register address='0xba10638' value='0x" DATA.LONG(A:0xba10638) "' name='RPMH_BCM_SHADOW_STATUS_DRV1_BE_CMD_SENT_STATUS_CD3'/>"
WRITE #1 "        <register address='0xba1063c' value='0x" DATA.LONG(A:0xba1063c) "' name='RPMH_BCM_SHADOW_STATUS_DRV1_BE_CMD_SENT_STATUS_CD4'/>"
WRITE #1 "        <register address='0xba10640' value='0x" DATA.LONG(A:0xba10640) "' name='RPMH_BCM_SHADOW_STATUS_DRV1_BE_CMD_SENT_STATUS_CD5'/>"
WRITE #1 "        <register address='0xba10644' value='0x" DATA.LONG(A:0xba10644) "' name='RPMH_BCM_SHADOW_STATUS_DRV1_BE_CMD_SENT_STATUS_CD6'/>"
WRITE #1 "        <register address='0xba10648' value='0x" DATA.LONG(A:0xba10648) "' name='RPMH_BCM_SHADOW_STATUS_DRV1_BE_CMD_SENT_STATUS_CD7'/>"
WRITE #1 "        <register address='0xba1064c' value='0x" DATA.LONG(A:0xba1064c) "' name='RPMH_BCM_SHADOW_STATUS_DRV1_BE_CMD_SENT_STATUS_CD8'/>"
WRITE #1 "        <register address='0xba10650' value='0x" DATA.LONG(A:0xba10650) "' name='RPMH_BCM_SHADOW_STATUS_DRV1_BE_CMD_SENT_STATUS_CD9'/>"
WRITE #1 "        <register address='0xba10654' value='0x" DATA.LONG(A:0xba10654) "' name='RPMH_BCM_SHADOW_STATUS_DRV1_BE_CMD_SENT_STATUS_CD10'/>"
WRITE #1 "        <register address='0xba10658' value='0x" DATA.LONG(A:0xba10658) "' name='RPMH_BCM_SHADOW_STATUS_DRV1_BE_CMD_SENT_STATUS_CD11'/>"
WRITE #1 "        <register address='0xba2062c' value='0x" DATA.LONG(A:0xba2062c) "' name='RPMH_BCM_SHADOW_STATUS_DRV2_BE_CMD_SENT_STATUS_CD0'/>"
WRITE #1 "        <register address='0xba20630' value='0x" DATA.LONG(A:0xba20630) "' name='RPMH_BCM_SHADOW_STATUS_DRV2_BE_CMD_SENT_STATUS_CD1'/>"
WRITE #1 "        <register address='0xba20634' value='0x" DATA.LONG(A:0xba20634) "' name='RPMH_BCM_SHADOW_STATUS_DRV2_BE_CMD_SENT_STATUS_CD2'/>"
WRITE #1 "        <register address='0xba20638' value='0x" DATA.LONG(A:0xba20638) "' name='RPMH_BCM_SHADOW_STATUS_DRV2_BE_CMD_SENT_STATUS_CD3'/>"
WRITE #1 "        <register address='0xba2063c' value='0x" DATA.LONG(A:0xba2063c) "' name='RPMH_BCM_SHADOW_STATUS_DRV2_BE_CMD_SENT_STATUS_CD4'/>"
WRITE #1 "        <register address='0xba20640' value='0x" DATA.LONG(A:0xba20640) "' name='RPMH_BCM_SHADOW_STATUS_DRV2_BE_CMD_SENT_STATUS_CD5'/>"
WRITE #1 "        <register address='0xba20644' value='0x" DATA.LONG(A:0xba20644) "' name='RPMH_BCM_SHADOW_STATUS_DRV2_BE_CMD_SENT_STATUS_CD6'/>"
WRITE #1 "        <register address='0xba20648' value='0x" DATA.LONG(A:0xba20648) "' name='RPMH_BCM_SHADOW_STATUS_DRV2_BE_CMD_SENT_STATUS_CD7'/>"
WRITE #1 "        <register address='0xba2064c' value='0x" DATA.LONG(A:0xba2064c) "' name='RPMH_BCM_SHADOW_STATUS_DRV2_BE_CMD_SENT_STATUS_CD8'/>"
WRITE #1 "        <register address='0xba20650' value='0x" DATA.LONG(A:0xba20650) "' name='RPMH_BCM_SHADOW_STATUS_DRV2_BE_CMD_SENT_STATUS_CD9'/>"
WRITE #1 "        <register address='0xba20654' value='0x" DATA.LONG(A:0xba20654) "' name='RPMH_BCM_SHADOW_STATUS_DRV2_BE_CMD_SENT_STATUS_CD10'/>"
WRITE #1 "        <register address='0xba20658' value='0x" DATA.LONG(A:0xba20658) "' name='RPMH_BCM_SHADOW_STATUS_DRV2_BE_CMD_SENT_STATUS_CD11'/>"
WRITE #1 "        <register address='0xba3062c' value='0x" DATA.LONG(A:0xba3062c) "' name='RPMH_BCM_SHADOW_STATUS_DRV3_BE_CMD_SENT_STATUS_CD0'/>"
WRITE #1 "        <register address='0xba30630' value='0x" DATA.LONG(A:0xba30630) "' name='RPMH_BCM_SHADOW_STATUS_DRV3_BE_CMD_SENT_STATUS_CD1'/>"
WRITE #1 "        <register address='0xba30634' value='0x" DATA.LONG(A:0xba30634) "' name='RPMH_BCM_SHADOW_STATUS_DRV3_BE_CMD_SENT_STATUS_CD2'/>"
WRITE #1 "        <register address='0xba30638' value='0x" DATA.LONG(A:0xba30638) "' name='RPMH_BCM_SHADOW_STATUS_DRV3_BE_CMD_SENT_STATUS_CD3'/>"
WRITE #1 "        <register address='0xba3063c' value='0x" DATA.LONG(A:0xba3063c) "' name='RPMH_BCM_SHADOW_STATUS_DRV3_BE_CMD_SENT_STATUS_CD4'/>"
WRITE #1 "        <register address='0xba30640' value='0x" DATA.LONG(A:0xba30640) "' name='RPMH_BCM_SHADOW_STATUS_DRV3_BE_CMD_SENT_STATUS_CD5'/>"
WRITE #1 "        <register address='0xba30644' value='0x" DATA.LONG(A:0xba30644) "' name='RPMH_BCM_SHADOW_STATUS_DRV3_BE_CMD_SENT_STATUS_CD6'/>"
WRITE #1 "        <register address='0xba30648' value='0x" DATA.LONG(A:0xba30648) "' name='RPMH_BCM_SHADOW_STATUS_DRV3_BE_CMD_SENT_STATUS_CD7'/>"
WRITE #1 "        <register address='0xba3064c' value='0x" DATA.LONG(A:0xba3064c) "' name='RPMH_BCM_SHADOW_STATUS_DRV3_BE_CMD_SENT_STATUS_CD8'/>"
WRITE #1 "        <register address='0xba30650' value='0x" DATA.LONG(A:0xba30650) "' name='RPMH_BCM_SHADOW_STATUS_DRV3_BE_CMD_SENT_STATUS_CD9'/>"
WRITE #1 "        <register address='0xba30654' value='0x" DATA.LONG(A:0xba30654) "' name='RPMH_BCM_SHADOW_STATUS_DRV3_BE_CMD_SENT_STATUS_CD10'/>"
WRITE #1 "        <register address='0xba30658' value='0x" DATA.LONG(A:0xba30658) "' name='RPMH_BCM_SHADOW_STATUS_DRV3_BE_CMD_SENT_STATUS_CD11'/>"
WRITE #1 "        <register address='0xba4062c' value='0x" DATA.LONG(A:0xba4062c) "' name='RPMH_BCM_SHADOW_STATUS_DRV4_BE_CMD_SENT_STATUS_CD0'/>"
WRITE #1 "        <register address='0xba40630' value='0x" DATA.LONG(A:0xba40630) "' name='RPMH_BCM_SHADOW_STATUS_DRV4_BE_CMD_SENT_STATUS_CD1'/>"
WRITE #1 "        <register address='0xba40634' value='0x" DATA.LONG(A:0xba40634) "' name='RPMH_BCM_SHADOW_STATUS_DRV4_BE_CMD_SENT_STATUS_CD2'/>"
WRITE #1 "        <register address='0xba40638' value='0x" DATA.LONG(A:0xba40638) "' name='RPMH_BCM_SHADOW_STATUS_DRV4_BE_CMD_SENT_STATUS_CD3'/>"
WRITE #1 "        <register address='0xba4063c' value='0x" DATA.LONG(A:0xba4063c) "' name='RPMH_BCM_SHADOW_STATUS_DRV4_BE_CMD_SENT_STATUS_CD4'/>"
WRITE #1 "        <register address='0xba40640' value='0x" DATA.LONG(A:0xba40640) "' name='RPMH_BCM_SHADOW_STATUS_DRV4_BE_CMD_SENT_STATUS_CD5'/>"
WRITE #1 "        <register address='0xba40644' value='0x" DATA.LONG(A:0xba40644) "' name='RPMH_BCM_SHADOW_STATUS_DRV4_BE_CMD_SENT_STATUS_CD6'/>"
WRITE #1 "        <register address='0xba40648' value='0x" DATA.LONG(A:0xba40648) "' name='RPMH_BCM_SHADOW_STATUS_DRV4_BE_CMD_SENT_STATUS_CD7'/>"
WRITE #1 "        <register address='0xba4064c' value='0x" DATA.LONG(A:0xba4064c) "' name='RPMH_BCM_SHADOW_STATUS_DRV4_BE_CMD_SENT_STATUS_CD8'/>"
WRITE #1 "        <register address='0xba40650' value='0x" DATA.LONG(A:0xba40650) "' name='RPMH_BCM_SHADOW_STATUS_DRV4_BE_CMD_SENT_STATUS_CD9'/>"
WRITE #1 "        <register address='0xba40654' value='0x" DATA.LONG(A:0xba40654) "' name='RPMH_BCM_SHADOW_STATUS_DRV4_BE_CMD_SENT_STATUS_CD10'/>"
WRITE #1 "        <register address='0xba40658' value='0x" DATA.LONG(A:0xba40658) "' name='RPMH_BCM_SHADOW_STATUS_DRV4_BE_CMD_SENT_STATUS_CD11'/>"
WRITE #1 "        <register address='0xba006ac' value='0x" DATA.LONG(A:0xba006ac) "' name='RPMH_BCM_SHADOW_STATUS_DRV0_BE_CMD_CMPL_STATUS_CD0'/>"
WRITE #1 "        <register address='0xba006b0' value='0x" DATA.LONG(A:0xba006b0) "' name='RPMH_BCM_SHADOW_STATUS_DRV0_BE_CMD_CMPL_STATUS_CD1'/>"
WRITE #1 "        <register address='0xba006b4' value='0x" DATA.LONG(A:0xba006b4) "' name='RPMH_BCM_SHADOW_STATUS_DRV0_BE_CMD_CMPL_STATUS_CD2'/>"
WRITE #1 "        <register address='0xba006b8' value='0x" DATA.LONG(A:0xba006b8) "' name='RPMH_BCM_SHADOW_STATUS_DRV0_BE_CMD_CMPL_STATUS_CD3'/>"
WRITE #1 "        <register address='0xba006bc' value='0x" DATA.LONG(A:0xba006bc) "' name='RPMH_BCM_SHADOW_STATUS_DRV0_BE_CMD_CMPL_STATUS_CD4'/>"
WRITE #1 "        <register address='0xba006c0' value='0x" DATA.LONG(A:0xba006c0) "' name='RPMH_BCM_SHADOW_STATUS_DRV0_BE_CMD_CMPL_STATUS_CD5'/>"
WRITE #1 "        <register address='0xba006c4' value='0x" DATA.LONG(A:0xba006c4) "' name='RPMH_BCM_SHADOW_STATUS_DRV0_BE_CMD_CMPL_STATUS_CD6'/>"
WRITE #1 "        <register address='0xba006c8' value='0x" DATA.LONG(A:0xba006c8) "' name='RPMH_BCM_SHADOW_STATUS_DRV0_BE_CMD_CMPL_STATUS_CD7'/>"
WRITE #1 "        <register address='0xba006cc' value='0x" DATA.LONG(A:0xba006cc) "' name='RPMH_BCM_SHADOW_STATUS_DRV0_BE_CMD_CMPL_STATUS_CD8'/>"
WRITE #1 "        <register address='0xba006d0' value='0x" DATA.LONG(A:0xba006d0) "' name='RPMH_BCM_SHADOW_STATUS_DRV0_BE_CMD_CMPL_STATUS_CD9'/>"
WRITE #1 "        <register address='0xba006d4' value='0x" DATA.LONG(A:0xba006d4) "' name='RPMH_BCM_SHADOW_STATUS_DRV0_BE_CMD_CMPL_STATUS_CD10'/>"
WRITE #1 "        <register address='0xba006d8' value='0x" DATA.LONG(A:0xba006d8) "' name='RPMH_BCM_SHADOW_STATUS_DRV0_BE_CMD_CMPL_STATUS_CD11'/>"
WRITE #1 "        <register address='0xba106ac' value='0x" DATA.LONG(A:0xba106ac) "' name='RPMH_BCM_SHADOW_STATUS_DRV1_BE_CMD_CMPL_STATUS_CD0'/>"
WRITE #1 "        <register address='0xba106b0' value='0x" DATA.LONG(A:0xba106b0) "' name='RPMH_BCM_SHADOW_STATUS_DRV1_BE_CMD_CMPL_STATUS_CD1'/>"
WRITE #1 "        <register address='0xba106b4' value='0x" DATA.LONG(A:0xba106b4) "' name='RPMH_BCM_SHADOW_STATUS_DRV1_BE_CMD_CMPL_STATUS_CD2'/>"
WRITE #1 "        <register address='0xba106b8' value='0x" DATA.LONG(A:0xba106b8) "' name='RPMH_BCM_SHADOW_STATUS_DRV1_BE_CMD_CMPL_STATUS_CD3'/>"
WRITE #1 "        <register address='0xba106bc' value='0x" DATA.LONG(A:0xba106bc) "' name='RPMH_BCM_SHADOW_STATUS_DRV1_BE_CMD_CMPL_STATUS_CD4'/>"
WRITE #1 "        <register address='0xba106c0' value='0x" DATA.LONG(A:0xba106c0) "' name='RPMH_BCM_SHADOW_STATUS_DRV1_BE_CMD_CMPL_STATUS_CD5'/>"
WRITE #1 "        <register address='0xba106c4' value='0x" DATA.LONG(A:0xba106c4) "' name='RPMH_BCM_SHADOW_STATUS_DRV1_BE_CMD_CMPL_STATUS_CD6'/>"
WRITE #1 "        <register address='0xba106c8' value='0x" DATA.LONG(A:0xba106c8) "' name='RPMH_BCM_SHADOW_STATUS_DRV1_BE_CMD_CMPL_STATUS_CD7'/>"
WRITE #1 "        <register address='0xba106cc' value='0x" DATA.LONG(A:0xba106cc) "' name='RPMH_BCM_SHADOW_STATUS_DRV1_BE_CMD_CMPL_STATUS_CD8'/>"
WRITE #1 "        <register address='0xba106d0' value='0x" DATA.LONG(A:0xba106d0) "' name='RPMH_BCM_SHADOW_STATUS_DRV1_BE_CMD_CMPL_STATUS_CD9'/>"
WRITE #1 "        <register address='0xba106d4' value='0x" DATA.LONG(A:0xba106d4) "' name='RPMH_BCM_SHADOW_STATUS_DRV1_BE_CMD_CMPL_STATUS_CD10'/>"
WRITE #1 "        <register address='0xba106d8' value='0x" DATA.LONG(A:0xba106d8) "' name='RPMH_BCM_SHADOW_STATUS_DRV1_BE_CMD_CMPL_STATUS_CD11'/>"
WRITE #1 "        <register address='0xba206ac' value='0x" DATA.LONG(A:0xba206ac) "' name='RPMH_BCM_SHADOW_STATUS_DRV2_BE_CMD_CMPL_STATUS_CD0'/>"
WRITE #1 "        <register address='0xba206b0' value='0x" DATA.LONG(A:0xba206b0) "' name='RPMH_BCM_SHADOW_STATUS_DRV2_BE_CMD_CMPL_STATUS_CD1'/>"
WRITE #1 "        <register address='0xba206b4' value='0x" DATA.LONG(A:0xba206b4) "' name='RPMH_BCM_SHADOW_STATUS_DRV2_BE_CMD_CMPL_STATUS_CD2'/>"
WRITE #1 "        <register address='0xba206b8' value='0x" DATA.LONG(A:0xba206b8) "' name='RPMH_BCM_SHADOW_STATUS_DRV2_BE_CMD_CMPL_STATUS_CD3'/>"
WRITE #1 "        <register address='0xba206bc' value='0x" DATA.LONG(A:0xba206bc) "' name='RPMH_BCM_SHADOW_STATUS_DRV2_BE_CMD_CMPL_STATUS_CD4'/>"
WRITE #1 "        <register address='0xba206c0' value='0x" DATA.LONG(A:0xba206c0) "' name='RPMH_BCM_SHADOW_STATUS_DRV2_BE_CMD_CMPL_STATUS_CD5'/>"
WRITE #1 "        <register address='0xba206c4' value='0x" DATA.LONG(A:0xba206c4) "' name='RPMH_BCM_SHADOW_STATUS_DRV2_BE_CMD_CMPL_STATUS_CD6'/>"
WRITE #1 "        <register address='0xba206c8' value='0x" DATA.LONG(A:0xba206c8) "' name='RPMH_BCM_SHADOW_STATUS_DRV2_BE_CMD_CMPL_STATUS_CD7'/>"
WRITE #1 "        <register address='0xba206cc' value='0x" DATA.LONG(A:0xba206cc) "' name='RPMH_BCM_SHADOW_STATUS_DRV2_BE_CMD_CMPL_STATUS_CD8'/>"
WRITE #1 "        <register address='0xba206d0' value='0x" DATA.LONG(A:0xba206d0) "' name='RPMH_BCM_SHADOW_STATUS_DRV2_BE_CMD_CMPL_STATUS_CD9'/>"
WRITE #1 "        <register address='0xba206d4' value='0x" DATA.LONG(A:0xba206d4) "' name='RPMH_BCM_SHADOW_STATUS_DRV2_BE_CMD_CMPL_STATUS_CD10'/>"
WRITE #1 "        <register address='0xba206d8' value='0x" DATA.LONG(A:0xba206d8) "' name='RPMH_BCM_SHADOW_STATUS_DRV2_BE_CMD_CMPL_STATUS_CD11'/>"
WRITE #1 "        <register address='0xba306ac' value='0x" DATA.LONG(A:0xba306ac) "' name='RPMH_BCM_SHADOW_STATUS_DRV3_BE_CMD_CMPL_STATUS_CD0'/>"
WRITE #1 "        <register address='0xba306b0' value='0x" DATA.LONG(A:0xba306b0) "' name='RPMH_BCM_SHADOW_STATUS_DRV3_BE_CMD_CMPL_STATUS_CD1'/>"
WRITE #1 "        <register address='0xba306b4' value='0x" DATA.LONG(A:0xba306b4) "' name='RPMH_BCM_SHADOW_STATUS_DRV3_BE_CMD_CMPL_STATUS_CD2'/>"
WRITE #1 "        <register address='0xba306b8' value='0x" DATA.LONG(A:0xba306b8) "' name='RPMH_BCM_SHADOW_STATUS_DRV3_BE_CMD_CMPL_STATUS_CD3'/>"
WRITE #1 "        <register address='0xba306bc' value='0x" DATA.LONG(A:0xba306bc) "' name='RPMH_BCM_SHADOW_STATUS_DRV3_BE_CMD_CMPL_STATUS_CD4'/>"
WRITE #1 "        <register address='0xba306c0' value='0x" DATA.LONG(A:0xba306c0) "' name='RPMH_BCM_SHADOW_STATUS_DRV3_BE_CMD_CMPL_STATUS_CD5'/>"
WRITE #1 "        <register address='0xba306c4' value='0x" DATA.LONG(A:0xba306c4) "' name='RPMH_BCM_SHADOW_STATUS_DRV3_BE_CMD_CMPL_STATUS_CD6'/>"
WRITE #1 "        <register address='0xba306c8' value='0x" DATA.LONG(A:0xba306c8) "' name='RPMH_BCM_SHADOW_STATUS_DRV3_BE_CMD_CMPL_STATUS_CD7'/>"
WRITE #1 "        <register address='0xba306cc' value='0x" DATA.LONG(A:0xba306cc) "' name='RPMH_BCM_SHADOW_STATUS_DRV3_BE_CMD_CMPL_STATUS_CD8'/>"
WRITE #1 "        <register address='0xba306d0' value='0x" DATA.LONG(A:0xba306d0) "' name='RPMH_BCM_SHADOW_STATUS_DRV3_BE_CMD_CMPL_STATUS_CD9'/>"
WRITE #1 "        <register address='0xba306d4' value='0x" DATA.LONG(A:0xba306d4) "' name='RPMH_BCM_SHADOW_STATUS_DRV3_BE_CMD_CMPL_STATUS_CD10'/>"
WRITE #1 "        <register address='0xba306d8' value='0x" DATA.LONG(A:0xba306d8) "' name='RPMH_BCM_SHADOW_STATUS_DRV3_BE_CMD_CMPL_STATUS_CD11'/>"
WRITE #1 "        <register address='0xba406ac' value='0x" DATA.LONG(A:0xba406ac) "' name='RPMH_BCM_SHADOW_STATUS_DRV4_BE_CMD_CMPL_STATUS_CD0'/>"
WRITE #1 "        <register address='0xba406b0' value='0x" DATA.LONG(A:0xba406b0) "' name='RPMH_BCM_SHADOW_STATUS_DRV4_BE_CMD_CMPL_STATUS_CD1'/>"
WRITE #1 "        <register address='0xba406b4' value='0x" DATA.LONG(A:0xba406b4) "' name='RPMH_BCM_SHADOW_STATUS_DRV4_BE_CMD_CMPL_STATUS_CD2'/>"
WRITE #1 "        <register address='0xba406b8' value='0x" DATA.LONG(A:0xba406b8) "' name='RPMH_BCM_SHADOW_STATUS_DRV4_BE_CMD_CMPL_STATUS_CD3'/>"
WRITE #1 "        <register address='0xba406bc' value='0x" DATA.LONG(A:0xba406bc) "' name='RPMH_BCM_SHADOW_STATUS_DRV4_BE_CMD_CMPL_STATUS_CD4'/>"
WRITE #1 "        <register address='0xba406c0' value='0x" DATA.LONG(A:0xba406c0) "' name='RPMH_BCM_SHADOW_STATUS_DRV4_BE_CMD_CMPL_STATUS_CD5'/>"
WRITE #1 "        <register address='0xba406c4' value='0x" DATA.LONG(A:0xba406c4) "' name='RPMH_BCM_SHADOW_STATUS_DRV4_BE_CMD_CMPL_STATUS_CD6'/>"
WRITE #1 "        <register address='0xba406c8' value='0x" DATA.LONG(A:0xba406c8) "' name='RPMH_BCM_SHADOW_STATUS_DRV4_BE_CMD_CMPL_STATUS_CD7'/>"
WRITE #1 "        <register address='0xba406cc' value='0x" DATA.LONG(A:0xba406cc) "' name='RPMH_BCM_SHADOW_STATUS_DRV4_BE_CMD_CMPL_STATUS_CD8'/>"
WRITE #1 "        <register address='0xba406d0' value='0x" DATA.LONG(A:0xba406d0) "' name='RPMH_BCM_SHADOW_STATUS_DRV4_BE_CMD_CMPL_STATUS_CD9'/>"
WRITE #1 "        <register address='0xba406d4' value='0x" DATA.LONG(A:0xba406d4) "' name='RPMH_BCM_SHADOW_STATUS_DRV4_BE_CMD_CMPL_STATUS_CD10'/>"
WRITE #1 "        <register address='0xba406d8' value='0x" DATA.LONG(A:0xba406d8) "' name='RPMH_BCM_SHADOW_STATUS_DRV4_BE_CMD_CMPL_STATUS_CD11'/>"
WRITE #1 "        <register address='0xba0072c' value='0x" DATA.LONG(A:0xba0072c) "' name='RPMH_BCM_SHADOW_STATUS_DRV0_BE_TCS_STATUS_CD0'/>"
WRITE #1 "        <register address='0xba00730' value='0x" DATA.LONG(A:0xba00730) "' name='RPMH_BCM_SHADOW_STATUS_DRV0_BE_TCS_STATUS_CD1'/>"
WRITE #1 "        <register address='0xba00734' value='0x" DATA.LONG(A:0xba00734) "' name='RPMH_BCM_SHADOW_STATUS_DRV0_BE_TCS_STATUS_CD2'/>"
WRITE #1 "        <register address='0xba00738' value='0x" DATA.LONG(A:0xba00738) "' name='RPMH_BCM_SHADOW_STATUS_DRV0_BE_TCS_STATUS_CD3'/>"
WRITE #1 "        <register address='0xba0073c' value='0x" DATA.LONG(A:0xba0073c) "' name='RPMH_BCM_SHADOW_STATUS_DRV0_BE_TCS_STATUS_CD4'/>"
WRITE #1 "        <register address='0xba00740' value='0x" DATA.LONG(A:0xba00740) "' name='RPMH_BCM_SHADOW_STATUS_DRV0_BE_TCS_STATUS_CD5'/>"
WRITE #1 "        <register address='0xba00744' value='0x" DATA.LONG(A:0xba00744) "' name='RPMH_BCM_SHADOW_STATUS_DRV0_BE_TCS_STATUS_CD6'/>"
WRITE #1 "        <register address='0xba00748' value='0x" DATA.LONG(A:0xba00748) "' name='RPMH_BCM_SHADOW_STATUS_DRV0_BE_TCS_STATUS_CD7'/>"
WRITE #1 "        <register address='0xba0074c' value='0x" DATA.LONG(A:0xba0074c) "' name='RPMH_BCM_SHADOW_STATUS_DRV0_BE_TCS_STATUS_CD8'/>"
WRITE #1 "        <register address='0xba00750' value='0x" DATA.LONG(A:0xba00750) "' name='RPMH_BCM_SHADOW_STATUS_DRV0_BE_TCS_STATUS_CD9'/>"
WRITE #1 "        <register address='0xba00754' value='0x" DATA.LONG(A:0xba00754) "' name='RPMH_BCM_SHADOW_STATUS_DRV0_BE_TCS_STATUS_CD10'/>"
WRITE #1 "        <register address='0xba00758' value='0x" DATA.LONG(A:0xba00758) "' name='RPMH_BCM_SHADOW_STATUS_DRV0_BE_TCS_STATUS_CD11'/>"
WRITE #1 "        <register address='0xba1072c' value='0x" DATA.LONG(A:0xba1072c) "' name='RPMH_BCM_SHADOW_STATUS_DRV1_BE_TCS_STATUS_CD0'/>"
WRITE #1 "        <register address='0xba10730' value='0x" DATA.LONG(A:0xba10730) "' name='RPMH_BCM_SHADOW_STATUS_DRV1_BE_TCS_STATUS_CD1'/>"
WRITE #1 "        <register address='0xba10734' value='0x" DATA.LONG(A:0xba10734) "' name='RPMH_BCM_SHADOW_STATUS_DRV1_BE_TCS_STATUS_CD2'/>"
WRITE #1 "        <register address='0xba10738' value='0x" DATA.LONG(A:0xba10738) "' name='RPMH_BCM_SHADOW_STATUS_DRV1_BE_TCS_STATUS_CD3'/>"
WRITE #1 "        <register address='0xba1073c' value='0x" DATA.LONG(A:0xba1073c) "' name='RPMH_BCM_SHADOW_STATUS_DRV1_BE_TCS_STATUS_CD4'/>"
WRITE #1 "        <register address='0xba10740' value='0x" DATA.LONG(A:0xba10740) "' name='RPMH_BCM_SHADOW_STATUS_DRV1_BE_TCS_STATUS_CD5'/>"
WRITE #1 "        <register address='0xba10744' value='0x" DATA.LONG(A:0xba10744) "' name='RPMH_BCM_SHADOW_STATUS_DRV1_BE_TCS_STATUS_CD6'/>"
WRITE #1 "        <register address='0xba10748' value='0x" DATA.LONG(A:0xba10748) "' name='RPMH_BCM_SHADOW_STATUS_DRV1_BE_TCS_STATUS_CD7'/>"
WRITE #1 "        <register address='0xba1074c' value='0x" DATA.LONG(A:0xba1074c) "' name='RPMH_BCM_SHADOW_STATUS_DRV1_BE_TCS_STATUS_CD8'/>"
WRITE #1 "        <register address='0xba10750' value='0x" DATA.LONG(A:0xba10750) "' name='RPMH_BCM_SHADOW_STATUS_DRV1_BE_TCS_STATUS_CD9'/>"
WRITE #1 "        <register address='0xba10754' value='0x" DATA.LONG(A:0xba10754) "' name='RPMH_BCM_SHADOW_STATUS_DRV1_BE_TCS_STATUS_CD10'/>"
WRITE #1 "        <register address='0xba10758' value='0x" DATA.LONG(A:0xba10758) "' name='RPMH_BCM_SHADOW_STATUS_DRV1_BE_TCS_STATUS_CD11'/>"
WRITE #1 "        <register address='0xba2072c' value='0x" DATA.LONG(A:0xba2072c) "' name='RPMH_BCM_SHADOW_STATUS_DRV2_BE_TCS_STATUS_CD0'/>"
WRITE #1 "        <register address='0xba20730' value='0x" DATA.LONG(A:0xba20730) "' name='RPMH_BCM_SHADOW_STATUS_DRV2_BE_TCS_STATUS_CD1'/>"
WRITE #1 "        <register address='0xba20734' value='0x" DATA.LONG(A:0xba20734) "' name='RPMH_BCM_SHADOW_STATUS_DRV2_BE_TCS_STATUS_CD2'/>"
WRITE #1 "        <register address='0xba20738' value='0x" DATA.LONG(A:0xba20738) "' name='RPMH_BCM_SHADOW_STATUS_DRV2_BE_TCS_STATUS_CD3'/>"
WRITE #1 "        <register address='0xba2073c' value='0x" DATA.LONG(A:0xba2073c) "' name='RPMH_BCM_SHADOW_STATUS_DRV2_BE_TCS_STATUS_CD4'/>"
WRITE #1 "        <register address='0xba20740' value='0x" DATA.LONG(A:0xba20740) "' name='RPMH_BCM_SHADOW_STATUS_DRV2_BE_TCS_STATUS_CD5'/>"
WRITE #1 "        <register address='0xba20744' value='0x" DATA.LONG(A:0xba20744) "' name='RPMH_BCM_SHADOW_STATUS_DRV2_BE_TCS_STATUS_CD6'/>"
WRITE #1 "        <register address='0xba20748' value='0x" DATA.LONG(A:0xba20748) "' name='RPMH_BCM_SHADOW_STATUS_DRV2_BE_TCS_STATUS_CD7'/>"
WRITE #1 "        <register address='0xba2074c' value='0x" DATA.LONG(A:0xba2074c) "' name='RPMH_BCM_SHADOW_STATUS_DRV2_BE_TCS_STATUS_CD8'/>"
WRITE #1 "        <register address='0xba20750' value='0x" DATA.LONG(A:0xba20750) "' name='RPMH_BCM_SHADOW_STATUS_DRV2_BE_TCS_STATUS_CD9'/>"
WRITE #1 "        <register address='0xba20754' value='0x" DATA.LONG(A:0xba20754) "' name='RPMH_BCM_SHADOW_STATUS_DRV2_BE_TCS_STATUS_CD10'/>"
WRITE #1 "        <register address='0xba20758' value='0x" DATA.LONG(A:0xba20758) "' name='RPMH_BCM_SHADOW_STATUS_DRV2_BE_TCS_STATUS_CD11'/>"
WRITE #1 "        <register address='0xba3072c' value='0x" DATA.LONG(A:0xba3072c) "' name='RPMH_BCM_SHADOW_STATUS_DRV3_BE_TCS_STATUS_CD0'/>"
WRITE #1 "        <register address='0xba30730' value='0x" DATA.LONG(A:0xba30730) "' name='RPMH_BCM_SHADOW_STATUS_DRV3_BE_TCS_STATUS_CD1'/>"
WRITE #1 "        <register address='0xba30734' value='0x" DATA.LONG(A:0xba30734) "' name='RPMH_BCM_SHADOW_STATUS_DRV3_BE_TCS_STATUS_CD2'/>"
WRITE #1 "        <register address='0xba30738' value='0x" DATA.LONG(A:0xba30738) "' name='RPMH_BCM_SHADOW_STATUS_DRV3_BE_TCS_STATUS_CD3'/>"
WRITE #1 "        <register address='0xba3073c' value='0x" DATA.LONG(A:0xba3073c) "' name='RPMH_BCM_SHADOW_STATUS_DRV3_BE_TCS_STATUS_CD4'/>"
WRITE #1 "        <register address='0xba30740' value='0x" DATA.LONG(A:0xba30740) "' name='RPMH_BCM_SHADOW_STATUS_DRV3_BE_TCS_STATUS_CD5'/>"
WRITE #1 "        <register address='0xba30744' value='0x" DATA.LONG(A:0xba30744) "' name='RPMH_BCM_SHADOW_STATUS_DRV3_BE_TCS_STATUS_CD6'/>"
WRITE #1 "        <register address='0xba30748' value='0x" DATA.LONG(A:0xba30748) "' name='RPMH_BCM_SHADOW_STATUS_DRV3_BE_TCS_STATUS_CD7'/>"
WRITE #1 "        <register address='0xba3074c' value='0x" DATA.LONG(A:0xba3074c) "' name='RPMH_BCM_SHADOW_STATUS_DRV3_BE_TCS_STATUS_CD8'/>"
WRITE #1 "        <register address='0xba30750' value='0x" DATA.LONG(A:0xba30750) "' name='RPMH_BCM_SHADOW_STATUS_DRV3_BE_TCS_STATUS_CD9'/>"
WRITE #1 "        <register address='0xba30754' value='0x" DATA.LONG(A:0xba30754) "' name='RPMH_BCM_SHADOW_STATUS_DRV3_BE_TCS_STATUS_CD10'/>"
WRITE #1 "        <register address='0xba30758' value='0x" DATA.LONG(A:0xba30758) "' name='RPMH_BCM_SHADOW_STATUS_DRV3_BE_TCS_STATUS_CD11'/>"
WRITE #1 "        <register address='0xba4072c' value='0x" DATA.LONG(A:0xba4072c) "' name='RPMH_BCM_SHADOW_STATUS_DRV4_BE_TCS_STATUS_CD0'/>"
WRITE #1 "        <register address='0xba40730' value='0x" DATA.LONG(A:0xba40730) "' name='RPMH_BCM_SHADOW_STATUS_DRV4_BE_TCS_STATUS_CD1'/>"
WRITE #1 "        <register address='0xba40734' value='0x" DATA.LONG(A:0xba40734) "' name='RPMH_BCM_SHADOW_STATUS_DRV4_BE_TCS_STATUS_CD2'/>"
WRITE #1 "        <register address='0xba40738' value='0x" DATA.LONG(A:0xba40738) "' name='RPMH_BCM_SHADOW_STATUS_DRV4_BE_TCS_STATUS_CD3'/>"
WRITE #1 "        <register address='0xba4073c' value='0x" DATA.LONG(A:0xba4073c) "' name='RPMH_BCM_SHADOW_STATUS_DRV4_BE_TCS_STATUS_CD4'/>"
WRITE #1 "        <register address='0xba40740' value='0x" DATA.LONG(A:0xba40740) "' name='RPMH_BCM_SHADOW_STATUS_DRV4_BE_TCS_STATUS_CD5'/>"
WRITE #1 "        <register address='0xba40744' value='0x" DATA.LONG(A:0xba40744) "' name='RPMH_BCM_SHADOW_STATUS_DRV4_BE_TCS_STATUS_CD6'/>"
WRITE #1 "        <register address='0xba40748' value='0x" DATA.LONG(A:0xba40748) "' name='RPMH_BCM_SHADOW_STATUS_DRV4_BE_TCS_STATUS_CD7'/>"
WRITE #1 "        <register address='0xba4074c' value='0x" DATA.LONG(A:0xba4074c) "' name='RPMH_BCM_SHADOW_STATUS_DRV4_BE_TCS_STATUS_CD8'/>"
WRITE #1 "        <register address='0xba40750' value='0x" DATA.LONG(A:0xba40750) "' name='RPMH_BCM_SHADOW_STATUS_DRV4_BE_TCS_STATUS_CD9'/>"
WRITE #1 "        <register address='0xba40754' value='0x" DATA.LONG(A:0xba40754) "' name='RPMH_BCM_SHADOW_STATUS_DRV4_BE_TCS_STATUS_CD10'/>"
WRITE #1 "        <register address='0xba40758' value='0x" DATA.LONG(A:0xba40758) "' name='RPMH_BCM_SHADOW_STATUS_DRV4_BE_TCS_STATUS_CD11'/>"
WRITE #1 "        <register address='0xba00820' value='0x" DATA.LONG(A:0xba00820) "' name='RPMH_BCM_SHADOW_STATUS_DRV0_CE_CTT_EMPTY'/>"
WRITE #1 "        <register address='0xba10820' value='0x" DATA.LONG(A:0xba10820) "' name='RPMH_BCM_SHADOW_STATUS_DRV1_CE_CTT_EMPTY'/>"
WRITE #1 "        <register address='0xba20820' value='0x" DATA.LONG(A:0xba20820) "' name='RPMH_BCM_SHADOW_STATUS_DRV2_CE_CTT_EMPTY'/>"
WRITE #1 "        <register address='0xba30820' value='0x" DATA.LONG(A:0xba30820) "' name='RPMH_BCM_SHADOW_STATUS_DRV3_CE_CTT_EMPTY'/>"
WRITE #1 "        <register address='0xba40820' value='0x" DATA.LONG(A:0xba40820) "' name='RPMH_BCM_SHADOW_STATUS_DRV4_CE_CTT_EMPTY'/>"
WRITE #1 "        <register address='0xba00824' value='0x" DATA.LONG(A:0xba00824) "' name='RPMH_BCM_SHADOW_STATUS_DRV0_BCM'/>"
WRITE #1 "        <register address='0xba10824' value='0x" DATA.LONG(A:0xba10824) "' name='RPMH_BCM_SHADOW_STATUS_DRV1_BCM'/>"
WRITE #1 "        <register address='0xba20824' value='0x" DATA.LONG(A:0xba20824) "' name='RPMH_BCM_SHADOW_STATUS_DRV2_BCM'/>"
WRITE #1 "        <register address='0xba30824' value='0x" DATA.LONG(A:0xba30824) "' name='RPMH_BCM_SHADOW_STATUS_DRV3_BCM'/>"
WRITE #1 "        <register address='0xba40824' value='0x" DATA.LONG(A:0xba40824) "' name='RPMH_BCM_SHADOW_STATUS_DRV4_BCM'/>"
WRITE #1 "        <register address='0xba00828' value='0x" DATA.LONG(A:0xba00828) "' name='RPMH_BCM_SHADOW_STATUS_DRV0_HW_VERSION'/>"
WRITE #1 "        <register address='0xba10828' value='0x" DATA.LONG(A:0xba10828) "' name='RPMH_BCM_SHADOW_STATUS_DRV1_HW_VERSION'/>"
WRITE #1 "        <register address='0xba20828' value='0x" DATA.LONG(A:0xba20828) "' name='RPMH_BCM_SHADOW_STATUS_DRV2_HW_VERSION'/>"
WRITE #1 "        <register address='0xba30828' value='0x" DATA.LONG(A:0xba30828) "' name='RPMH_BCM_SHADOW_STATUS_DRV3_HW_VERSION'/>"
WRITE #1 "        <register address='0xba40828' value='0x" DATA.LONG(A:0xba40828) "' name='RPMH_BCM_SHADOW_STATUS_DRV4_HW_VERSION'/>"
WRITE #1 "        <register address='0xbbe0000' value='0x" DATA.LONG(A:0xbbe0000) "' name='RPMH_BCM_ND_CFG_ND0'/>"
WRITE #1 "        <register address='0xbbe0004' value='0x" DATA.LONG(A:0xbbe0004) "' name='RPMH_BCM_ND_CFG_ND1'/>"
WRITE #1 "        <register address='0xbbe0008' value='0x" DATA.LONG(A:0xbbe0008) "' name='RPMH_BCM_ND_CFG_ND2'/>"
WRITE #1 "        <register address='0xbbe000c' value='0x" DATA.LONG(A:0xbbe000c) "' name='RPMH_BCM_ND_CFG_ND3'/>"
WRITE #1 "        <register address='0xbbe0010' value='0x" DATA.LONG(A:0xbbe0010) "' name='RPMH_BCM_ND_CFG_ND4'/>"
WRITE #1 "        <register address='0xbbe0014' value='0x" DATA.LONG(A:0xbbe0014) "' name='RPMH_BCM_ND_CFG_ND5'/>"
WRITE #1 "        <register address='0xbbe0018' value='0x" DATA.LONG(A:0xbbe0018) "' name='RPMH_BCM_ND_CFG_ND6'/>"
WRITE #1 "        <register address='0xbbe001c' value='0x" DATA.LONG(A:0xbbe001c) "' name='RPMH_BCM_ND_CFG_ND7'/>"
WRITE #1 "        <register address='0xbbe0020' value='0x" DATA.LONG(A:0xbbe0020) "' name='RPMH_BCM_ND_CFG_ND8'/>"
WRITE #1 "        <register address='0xbbe0024' value='0x" DATA.LONG(A:0xbbe0024) "' name='RPMH_BCM_ND_CFG_ND9'/>"
WRITE #1 "        <register address='0xbbe0028' value='0x" DATA.LONG(A:0xbbe0028) "' name='RPMH_BCM_ND_CFG_ND10'/>"
WRITE #1 "        <register address='0xbbe002c' value='0x" DATA.LONG(A:0xbbe002c) "' name='RPMH_BCM_ND_CFG_ND11'/>"
WRITE #1 "        <register address='0xbbe0030' value='0x" DATA.LONG(A:0xbbe0030) "' name='RPMH_BCM_ND_CFG_ND12'/>"
WRITE #1 "        <register address='0xbbe0034' value='0x" DATA.LONG(A:0xbbe0034) "' name='RPMH_BCM_ND_CFG_ND13'/>"
WRITE #1 "        <register address='0xbbe0038' value='0x" DATA.LONG(A:0xbbe0038) "' name='RPMH_BCM_ND_CFG_ND14'/>"
WRITE #1 "        <register address='0xbbe003c' value='0x" DATA.LONG(A:0xbbe003c) "' name='RPMH_BCM_ND_CFG_ND15'/>"
WRITE #1 "        <register address='0xbbe0040' value='0x" DATA.LONG(A:0xbbe0040) "' name='RPMH_BCM_ND_CFG_ND16'/>"
WRITE #1 "        <register address='0xbbe0044' value='0x" DATA.LONG(A:0xbbe0044) "' name='RPMH_BCM_ND_CFG_ND17'/>"
WRITE #1 "        <register address='0xbbe0048' value='0x" DATA.LONG(A:0xbbe0048) "' name='RPMH_BCM_ND_CFG_ND18'/>"
WRITE #1 "        <register address='0xbbe004c' value='0x" DATA.LONG(A:0xbbe004c) "' name='RPMH_BCM_ND_CFG_ND19'/>"
WRITE #1 "        <register address='0xbbe0050' value='0x" DATA.LONG(A:0xbbe0050) "' name='RPMH_BCM_ND_CFG_ND20'/>"
WRITE #1 "        <register address='0xbbe0054' value='0x" DATA.LONG(A:0xbbe0054) "' name='RPMH_BCM_ND_CFG_ND21'/>"
WRITE #1 "        <register address='0xbbe0058' value='0x" DATA.LONG(A:0xbbe0058) "' name='RPMH_BCM_ND_CFG_ND22'/>"
WRITE #1 "        <register address='0xbbe005c' value='0x" DATA.LONG(A:0xbbe005c) "' name='RPMH_BCM_ND_CFG_ND23'/>"
WRITE #1 "        <register address='0xbbe0060' value='0x" DATA.LONG(A:0xbbe0060) "' name='RPMH_BCM_ND_CFG_ND24'/>"
WRITE #1 "        <register address='0xbbe0064' value='0x" DATA.LONG(A:0xbbe0064) "' name='RPMH_BCM_ND_CFG_ND25'/>"
WRITE #1 "        <register address='0xbbe0068' value='0x" DATA.LONG(A:0xbbe0068) "' name='RPMH_BCM_ND_CFG_ND26'/>"
WRITE #1 "        <register address='0xbbe006c' value='0x" DATA.LONG(A:0xbbe006c) "' name='RPMH_BCM_ND_CFG_ND27'/>"
WRITE #1 "        <register address='0xbbe0070' value='0x" DATA.LONG(A:0xbbe0070) "' name='RPMH_BCM_ND_CFG_ND28'/>"
WRITE #1 "        <register address='0xbbe0074' value='0x" DATA.LONG(A:0xbbe0074) "' name='RPMH_BCM_ND_CFG_ND29'/>"
WRITE #1 "        <register address='0xbbe0078' value='0x" DATA.LONG(A:0xbbe0078) "' name='RPMH_BCM_ND_CFG_ND30'/>"
WRITE #1 "        <register address='0xbbe007c' value='0x" DATA.LONG(A:0xbbe007c) "' name='RPMH_BCM_ND_CFG_ND31'/>"
WRITE #1 "        <register address='0xbbe0080' value='0x" DATA.LONG(A:0xbbe0080) "' name='RPMH_BCM_ND_CFG_ND32'/>"
WRITE #1 "        <register address='0xbbe0084' value='0x" DATA.LONG(A:0xbbe0084) "' name='RPMH_BCM_ND_CFG_ND33'/>"
WRITE #1 "        <register address='0xbbe0088' value='0x" DATA.LONG(A:0xbbe0088) "' name='RPMH_BCM_ND_CFG_ND34'/>"
WRITE #1 "        <register address='0xbbe008c' value='0x" DATA.LONG(A:0xbbe008c) "' name='RPMH_BCM_ND_CFG_ND35'/>"
WRITE #1 "        <register address='0xbbe0090' value='0x" DATA.LONG(A:0xbbe0090) "' name='RPMH_BCM_ND_CFG_ND36'/>"
WRITE #1 "        <register address='0xbbe0094' value='0x" DATA.LONG(A:0xbbe0094) "' name='RPMH_BCM_ND_CFG_ND37'/>"
WRITE #1 "        <register address='0xbbe0098' value='0x" DATA.LONG(A:0xbbe0098) "' name='RPMH_BCM_ND_CFG_ND38'/>"
WRITE #1 "        <register address='0xbbe009c' value='0x" DATA.LONG(A:0xbbe009c) "' name='RPMH_BCM_ND_CFG_ND39'/>"
WRITE #1 "        <register address='0xbbe00a0' value='0x" DATA.LONG(A:0xbbe00a0) "' name='RPMH_BCM_ND_CFG_ND40'/>"
WRITE #1 "        <register address='0xbbe00a4' value='0x" DATA.LONG(A:0xbbe00a4) "' name='RPMH_BCM_ND_CFG_ND41'/>"
WRITE #1 "        <register address='0xbbe00a8' value='0x" DATA.LONG(A:0xbbe00a8) "' name='RPMH_BCM_ND_CFG_ND42'/>"
WRITE #1 "        <register address='0xbbe00ac' value='0x" DATA.LONG(A:0xbbe00ac) "' name='RPMH_BCM_ND_CFG_ND43'/>"
WRITE #1 "        <register address='0xbbe0200' value='0x" DATA.LONG(A:0xbbe0200) "' name='RPMH_BCM_SND_CFG_SND0'/>"
WRITE #1 "        <register address='0xbbe0204' value='0x" DATA.LONG(A:0xbbe0204) "' name='RPMH_BCM_SND_CFG_SND1'/>"
WRITE #1 "        <register address='0xbbe0208' value='0x" DATA.LONG(A:0xbbe0208) "' name='RPMH_BCM_SND_CFG_SND2'/>"
WRITE #1 "        <register address='0xbbe020c' value='0x" DATA.LONG(A:0xbbe020c) "' name='RPMH_BCM_SND_CFG_SND3'/>"
WRITE #1 "        <register address='0xbbe0300' value='0x" DATA.LONG(A:0xbbe0300) "' name='RPMH_BCM_SND_LUT_SND0_COL0'/>"
WRITE #1 "        <register address='0xbbe0304' value='0x" DATA.LONG(A:0xbbe0304) "' name='RPMH_BCM_SND_LUT_SND0_COL1'/>"
WRITE #1 "        <register address='0xbbe0308' value='0x" DATA.LONG(A:0xbbe0308) "' name='RPMH_BCM_SND_LUT_SND0_COL2'/>"
WRITE #1 "        <register address='0xbbe030c' value='0x" DATA.LONG(A:0xbbe030c) "' name='RPMH_BCM_SND_LUT_SND0_COL3'/>"
WRITE #1 "        <register address='0xbbe0310' value='0x" DATA.LONG(A:0xbbe0310) "' name='RPMH_BCM_SND_LUT_SND1_COL0'/>"
WRITE #1 "        <register address='0xbbe0314' value='0x" DATA.LONG(A:0xbbe0314) "' name='RPMH_BCM_SND_LUT_SND1_COL1'/>"
WRITE #1 "        <register address='0xbbe0318' value='0x" DATA.LONG(A:0xbbe0318) "' name='RPMH_BCM_SND_LUT_SND1_COL2'/>"
WRITE #1 "        <register address='0xbbe031c' value='0x" DATA.LONG(A:0xbbe031c) "' name='RPMH_BCM_SND_LUT_SND1_COL3'/>"
WRITE #1 "        <register address='0xbbe0320' value='0x" DATA.LONG(A:0xbbe0320) "' name='RPMH_BCM_SND_LUT_SND2_COL0'/>"
WRITE #1 "        <register address='0xbbe0324' value='0x" DATA.LONG(A:0xbbe0324) "' name='RPMH_BCM_SND_LUT_SND2_COL1'/>"
WRITE #1 "        <register address='0xbbe0328' value='0x" DATA.LONG(A:0xbbe0328) "' name='RPMH_BCM_SND_LUT_SND2_COL2'/>"
WRITE #1 "        <register address='0xbbe032c' value='0x" DATA.LONG(A:0xbbe032c) "' name='RPMH_BCM_SND_LUT_SND2_COL3'/>"
WRITE #1 "        <register address='0xbbe0330' value='0x" DATA.LONG(A:0xbbe0330) "' name='RPMH_BCM_SND_LUT_SND3_COL0'/>"
WRITE #1 "        <register address='0xbbe0334' value='0x" DATA.LONG(A:0xbbe0334) "' name='RPMH_BCM_SND_LUT_SND3_COL1'/>"
WRITE #1 "        <register address='0xbbe0338' value='0x" DATA.LONG(A:0xbbe0338) "' name='RPMH_BCM_SND_LUT_SND3_COL2'/>"
WRITE #1 "        <register address='0xbbe033c' value='0x" DATA.LONG(A:0xbbe033c) "' name='RPMH_BCM_SND_LUT_SND3_COL3'/>"
WRITE #1 "        <register address='0xbbe0500' value='0x" DATA.LONG(A:0xbbe0500) "' name='RPMH_BCM_SND_LUT_SND0_COL0_CP0'/>"
WRITE #1 "        <register address='0xbbe0504' value='0x" DATA.LONG(A:0xbbe0504) "' name='RPMH_BCM_SND_LUT_SND0_COL0_CP1'/>"
WRITE #1 "        <register address='0xbbe0508' value='0x" DATA.LONG(A:0xbbe0508) "' name='RPMH_BCM_SND_LUT_SND0_COL0_CP2'/>"
WRITE #1 "        <register address='0xbbe050c' value='0x" DATA.LONG(A:0xbbe050c) "' name='RPMH_BCM_SND_LUT_SND0_COL0_CP3'/>"
WRITE #1 "        <register address='0xbbe0510' value='0x" DATA.LONG(A:0xbbe0510) "' name='RPMH_BCM_SND_LUT_SND0_COL0_CP4'/>"
WRITE #1 "        <register address='0xbbe0514' value='0x" DATA.LONG(A:0xbbe0514) "' name='RPMH_BCM_SND_LUT_SND0_COL0_CP5'/>"
WRITE #1 "        <register address='0xbbe0518' value='0x" DATA.LONG(A:0xbbe0518) "' name='RPMH_BCM_SND_LUT_SND0_COL0_CP6'/>"
WRITE #1 "        <register address='0xbbe051c' value='0x" DATA.LONG(A:0xbbe051c) "' name='RPMH_BCM_SND_LUT_SND0_COL0_CP7'/>"
WRITE #1 "        <register address='0xbbe0520' value='0x" DATA.LONG(A:0xbbe0520) "' name='RPMH_BCM_SND_LUT_SND0_COL0_CP8'/>"
WRITE #1 "        <register address='0xbbe0524' value='0x" DATA.LONG(A:0xbbe0524) "' name='RPMH_BCM_SND_LUT_SND0_COL0_CP9'/>"
WRITE #1 "        <register address='0xbbe0528' value='0x" DATA.LONG(A:0xbbe0528) "' name='RPMH_BCM_SND_LUT_SND0_COL0_CP10'/>"
WRITE #1 "        <register address='0xbbe052c' value='0x" DATA.LONG(A:0xbbe052c) "' name='RPMH_BCM_SND_LUT_SND0_COL0_CP11'/>"
WRITE #1 "        <register address='0xbbe0530' value='0x" DATA.LONG(A:0xbbe0530) "' name='RPMH_BCM_SND_LUT_SND0_COL0_CP12'/>"
WRITE #1 "        <register address='0xbbe0534' value='0x" DATA.LONG(A:0xbbe0534) "' name='RPMH_BCM_SND_LUT_SND0_COL0_CP13'/>"
WRITE #1 "        <register address='0xbbe0538' value='0x" DATA.LONG(A:0xbbe0538) "' name='RPMH_BCM_SND_LUT_SND0_COL0_CP14'/>"
WRITE #1 "        <register address='0xbbe053c' value='0x" DATA.LONG(A:0xbbe053c) "' name='RPMH_BCM_SND_LUT_SND0_COL0_CP15'/>"
WRITE #1 "        <register address='0xbbe0540' value='0x" DATA.LONG(A:0xbbe0540) "' name='RPMH_BCM_SND_LUT_SND0_COL1_CP0'/>"
WRITE #1 "        <register address='0xbbe0544' value='0x" DATA.LONG(A:0xbbe0544) "' name='RPMH_BCM_SND_LUT_SND0_COL1_CP1'/>"
WRITE #1 "        <register address='0xbbe0548' value='0x" DATA.LONG(A:0xbbe0548) "' name='RPMH_BCM_SND_LUT_SND0_COL1_CP2'/>"
WRITE #1 "        <register address='0xbbe054c' value='0x" DATA.LONG(A:0xbbe054c) "' name='RPMH_BCM_SND_LUT_SND0_COL1_CP3'/>"
WRITE #1 "        <register address='0xbbe0550' value='0x" DATA.LONG(A:0xbbe0550) "' name='RPMH_BCM_SND_LUT_SND0_COL1_CP4'/>"
WRITE #1 "        <register address='0xbbe0554' value='0x" DATA.LONG(A:0xbbe0554) "' name='RPMH_BCM_SND_LUT_SND0_COL1_CP5'/>"
WRITE #1 "        <register address='0xbbe0558' value='0x" DATA.LONG(A:0xbbe0558) "' name='RPMH_BCM_SND_LUT_SND0_COL1_CP6'/>"
WRITE #1 "        <register address='0xbbe055c' value='0x" DATA.LONG(A:0xbbe055c) "' name='RPMH_BCM_SND_LUT_SND0_COL1_CP7'/>"
WRITE #1 "        <register address='0xbbe0560' value='0x" DATA.LONG(A:0xbbe0560) "' name='RPMH_BCM_SND_LUT_SND0_COL1_CP8'/>"
WRITE #1 "        <register address='0xbbe0564' value='0x" DATA.LONG(A:0xbbe0564) "' name='RPMH_BCM_SND_LUT_SND0_COL1_CP9'/>"
WRITE #1 "        <register address='0xbbe0568' value='0x" DATA.LONG(A:0xbbe0568) "' name='RPMH_BCM_SND_LUT_SND0_COL1_CP10'/>"
WRITE #1 "        <register address='0xbbe056c' value='0x" DATA.LONG(A:0xbbe056c) "' name='RPMH_BCM_SND_LUT_SND0_COL1_CP11'/>"
WRITE #1 "        <register address='0xbbe0570' value='0x" DATA.LONG(A:0xbbe0570) "' name='RPMH_BCM_SND_LUT_SND0_COL1_CP12'/>"
WRITE #1 "        <register address='0xbbe0574' value='0x" DATA.LONG(A:0xbbe0574) "' name='RPMH_BCM_SND_LUT_SND0_COL1_CP13'/>"
WRITE #1 "        <register address='0xbbe0578' value='0x" DATA.LONG(A:0xbbe0578) "' name='RPMH_BCM_SND_LUT_SND0_COL1_CP14'/>"
WRITE #1 "        <register address='0xbbe057c' value='0x" DATA.LONG(A:0xbbe057c) "' name='RPMH_BCM_SND_LUT_SND0_COL1_CP15'/>"
WRITE #1 "        <register address='0xbbe0580' value='0x" DATA.LONG(A:0xbbe0580) "' name='RPMH_BCM_SND_LUT_SND0_COL2_CP0'/>"
WRITE #1 "        <register address='0xbbe0584' value='0x" DATA.LONG(A:0xbbe0584) "' name='RPMH_BCM_SND_LUT_SND0_COL2_CP1'/>"
WRITE #1 "        <register address='0xbbe0588' value='0x" DATA.LONG(A:0xbbe0588) "' name='RPMH_BCM_SND_LUT_SND0_COL2_CP2'/>"
WRITE #1 "        <register address='0xbbe058c' value='0x" DATA.LONG(A:0xbbe058c) "' name='RPMH_BCM_SND_LUT_SND0_COL2_CP3'/>"
WRITE #1 "        <register address='0xbbe0590' value='0x" DATA.LONG(A:0xbbe0590) "' name='RPMH_BCM_SND_LUT_SND0_COL2_CP4'/>"
WRITE #1 "        <register address='0xbbe0594' value='0x" DATA.LONG(A:0xbbe0594) "' name='RPMH_BCM_SND_LUT_SND0_COL2_CP5'/>"
WRITE #1 "        <register address='0xbbe0598' value='0x" DATA.LONG(A:0xbbe0598) "' name='RPMH_BCM_SND_LUT_SND0_COL2_CP6'/>"
WRITE #1 "        <register address='0xbbe059c' value='0x" DATA.LONG(A:0xbbe059c) "' name='RPMH_BCM_SND_LUT_SND0_COL2_CP7'/>"
WRITE #1 "        <register address='0xbbe05a0' value='0x" DATA.LONG(A:0xbbe05a0) "' name='RPMH_BCM_SND_LUT_SND0_COL2_CP8'/>"
WRITE #1 "        <register address='0xbbe05a4' value='0x" DATA.LONG(A:0xbbe05a4) "' name='RPMH_BCM_SND_LUT_SND0_COL2_CP9'/>"
WRITE #1 "        <register address='0xbbe05a8' value='0x" DATA.LONG(A:0xbbe05a8) "' name='RPMH_BCM_SND_LUT_SND0_COL2_CP10'/>"
WRITE #1 "        <register address='0xbbe05ac' value='0x" DATA.LONG(A:0xbbe05ac) "' name='RPMH_BCM_SND_LUT_SND0_COL2_CP11'/>"
WRITE #1 "        <register address='0xbbe05b0' value='0x" DATA.LONG(A:0xbbe05b0) "' name='RPMH_BCM_SND_LUT_SND0_COL2_CP12'/>"
WRITE #1 "        <register address='0xbbe05b4' value='0x" DATA.LONG(A:0xbbe05b4) "' name='RPMH_BCM_SND_LUT_SND0_COL2_CP13'/>"
WRITE #1 "        <register address='0xbbe05b8' value='0x" DATA.LONG(A:0xbbe05b8) "' name='RPMH_BCM_SND_LUT_SND0_COL2_CP14'/>"
WRITE #1 "        <register address='0xbbe05bc' value='0x" DATA.LONG(A:0xbbe05bc) "' name='RPMH_BCM_SND_LUT_SND0_COL2_CP15'/>"
WRITE #1 "        <register address='0xbbe05c0' value='0x" DATA.LONG(A:0xbbe05c0) "' name='RPMH_BCM_SND_LUT_SND0_COL3_CP0'/>"
WRITE #1 "        <register address='0xbbe05c4' value='0x" DATA.LONG(A:0xbbe05c4) "' name='RPMH_BCM_SND_LUT_SND0_COL3_CP1'/>"
WRITE #1 "        <register address='0xbbe05c8' value='0x" DATA.LONG(A:0xbbe05c8) "' name='RPMH_BCM_SND_LUT_SND0_COL3_CP2'/>"
WRITE #1 "        <register address='0xbbe05cc' value='0x" DATA.LONG(A:0xbbe05cc) "' name='RPMH_BCM_SND_LUT_SND0_COL3_CP3'/>"
WRITE #1 "        <register address='0xbbe05d0' value='0x" DATA.LONG(A:0xbbe05d0) "' name='RPMH_BCM_SND_LUT_SND0_COL3_CP4'/>"
WRITE #1 "        <register address='0xbbe05d4' value='0x" DATA.LONG(A:0xbbe05d4) "' name='RPMH_BCM_SND_LUT_SND0_COL3_CP5'/>"
WRITE #1 "        <register address='0xbbe05d8' value='0x" DATA.LONG(A:0xbbe05d8) "' name='RPMH_BCM_SND_LUT_SND0_COL3_CP6'/>"
WRITE #1 "        <register address='0xbbe05dc' value='0x" DATA.LONG(A:0xbbe05dc) "' name='RPMH_BCM_SND_LUT_SND0_COL3_CP7'/>"
WRITE #1 "        <register address='0xbbe05e0' value='0x" DATA.LONG(A:0xbbe05e0) "' name='RPMH_BCM_SND_LUT_SND0_COL3_CP8'/>"
WRITE #1 "        <register address='0xbbe05e4' value='0x" DATA.LONG(A:0xbbe05e4) "' name='RPMH_BCM_SND_LUT_SND0_COL3_CP9'/>"
WRITE #1 "        <register address='0xbbe05e8' value='0x" DATA.LONG(A:0xbbe05e8) "' name='RPMH_BCM_SND_LUT_SND0_COL3_CP10'/>"
WRITE #1 "        <register address='0xbbe05ec' value='0x" DATA.LONG(A:0xbbe05ec) "' name='RPMH_BCM_SND_LUT_SND0_COL3_CP11'/>"
WRITE #1 "        <register address='0xbbe05f0' value='0x" DATA.LONG(A:0xbbe05f0) "' name='RPMH_BCM_SND_LUT_SND0_COL3_CP12'/>"
WRITE #1 "        <register address='0xbbe05f4' value='0x" DATA.LONG(A:0xbbe05f4) "' name='RPMH_BCM_SND_LUT_SND0_COL3_CP13'/>"
WRITE #1 "        <register address='0xbbe05f8' value='0x" DATA.LONG(A:0xbbe05f8) "' name='RPMH_BCM_SND_LUT_SND0_COL3_CP14'/>"
WRITE #1 "        <register address='0xbbe05fc' value='0x" DATA.LONG(A:0xbbe05fc) "' name='RPMH_BCM_SND_LUT_SND0_COL3_CP15'/>"
WRITE #1 "        <register address='0xbbe0600' value='0x" DATA.LONG(A:0xbbe0600) "' name='RPMH_BCM_SND_LUT_SND1_COL0_CP0'/>"
WRITE #1 "        <register address='0xbbe0604' value='0x" DATA.LONG(A:0xbbe0604) "' name='RPMH_BCM_SND_LUT_SND1_COL0_CP1'/>"
WRITE #1 "        <register address='0xbbe0608' value='0x" DATA.LONG(A:0xbbe0608) "' name='RPMH_BCM_SND_LUT_SND1_COL0_CP2'/>"
WRITE #1 "        <register address='0xbbe060c' value='0x" DATA.LONG(A:0xbbe060c) "' name='RPMH_BCM_SND_LUT_SND1_COL0_CP3'/>"
WRITE #1 "        <register address='0xbbe0610' value='0x" DATA.LONG(A:0xbbe0610) "' name='RPMH_BCM_SND_LUT_SND1_COL0_CP4'/>"
WRITE #1 "        <register address='0xbbe0614' value='0x" DATA.LONG(A:0xbbe0614) "' name='RPMH_BCM_SND_LUT_SND1_COL0_CP5'/>"
WRITE #1 "        <register address='0xbbe0618' value='0x" DATA.LONG(A:0xbbe0618) "' name='RPMH_BCM_SND_LUT_SND1_COL0_CP6'/>"
WRITE #1 "        <register address='0xbbe061c' value='0x" DATA.LONG(A:0xbbe061c) "' name='RPMH_BCM_SND_LUT_SND1_COL0_CP7'/>"
WRITE #1 "        <register address='0xbbe0620' value='0x" DATA.LONG(A:0xbbe0620) "' name='RPMH_BCM_SND_LUT_SND1_COL0_CP8'/>"
WRITE #1 "        <register address='0xbbe0624' value='0x" DATA.LONG(A:0xbbe0624) "' name='RPMH_BCM_SND_LUT_SND1_COL0_CP9'/>"
WRITE #1 "        <register address='0xbbe0628' value='0x" DATA.LONG(A:0xbbe0628) "' name='RPMH_BCM_SND_LUT_SND1_COL0_CP10'/>"
WRITE #1 "        <register address='0xbbe062c' value='0x" DATA.LONG(A:0xbbe062c) "' name='RPMH_BCM_SND_LUT_SND1_COL0_CP11'/>"
WRITE #1 "        <register address='0xbbe0630' value='0x" DATA.LONG(A:0xbbe0630) "' name='RPMH_BCM_SND_LUT_SND1_COL0_CP12'/>"
WRITE #1 "        <register address='0xbbe0634' value='0x" DATA.LONG(A:0xbbe0634) "' name='RPMH_BCM_SND_LUT_SND1_COL0_CP13'/>"
WRITE #1 "        <register address='0xbbe0638' value='0x" DATA.LONG(A:0xbbe0638) "' name='RPMH_BCM_SND_LUT_SND1_COL0_CP14'/>"
WRITE #1 "        <register address='0xbbe063c' value='0x" DATA.LONG(A:0xbbe063c) "' name='RPMH_BCM_SND_LUT_SND1_COL0_CP15'/>"
WRITE #1 "        <register address='0xbbe0640' value='0x" DATA.LONG(A:0xbbe0640) "' name='RPMH_BCM_SND_LUT_SND1_COL1_CP0'/>"
WRITE #1 "        <register address='0xbbe0644' value='0x" DATA.LONG(A:0xbbe0644) "' name='RPMH_BCM_SND_LUT_SND1_COL1_CP1'/>"
WRITE #1 "        <register address='0xbbe0648' value='0x" DATA.LONG(A:0xbbe0648) "' name='RPMH_BCM_SND_LUT_SND1_COL1_CP2'/>"
WRITE #1 "        <register address='0xbbe064c' value='0x" DATA.LONG(A:0xbbe064c) "' name='RPMH_BCM_SND_LUT_SND1_COL1_CP3'/>"
WRITE #1 "        <register address='0xbbe0650' value='0x" DATA.LONG(A:0xbbe0650) "' name='RPMH_BCM_SND_LUT_SND1_COL1_CP4'/>"
WRITE #1 "        <register address='0xbbe0654' value='0x" DATA.LONG(A:0xbbe0654) "' name='RPMH_BCM_SND_LUT_SND1_COL1_CP5'/>"
WRITE #1 "        <register address='0xbbe0658' value='0x" DATA.LONG(A:0xbbe0658) "' name='RPMH_BCM_SND_LUT_SND1_COL1_CP6'/>"
WRITE #1 "        <register address='0xbbe065c' value='0x" DATA.LONG(A:0xbbe065c) "' name='RPMH_BCM_SND_LUT_SND1_COL1_CP7'/>"
WRITE #1 "        <register address='0xbbe0660' value='0x" DATA.LONG(A:0xbbe0660) "' name='RPMH_BCM_SND_LUT_SND1_COL1_CP8'/>"
WRITE #1 "        <register address='0xbbe0664' value='0x" DATA.LONG(A:0xbbe0664) "' name='RPMH_BCM_SND_LUT_SND1_COL1_CP9'/>"
WRITE #1 "        <register address='0xbbe0668' value='0x" DATA.LONG(A:0xbbe0668) "' name='RPMH_BCM_SND_LUT_SND1_COL1_CP10'/>"
WRITE #1 "        <register address='0xbbe066c' value='0x" DATA.LONG(A:0xbbe066c) "' name='RPMH_BCM_SND_LUT_SND1_COL1_CP11'/>"
WRITE #1 "        <register address='0xbbe0670' value='0x" DATA.LONG(A:0xbbe0670) "' name='RPMH_BCM_SND_LUT_SND1_COL1_CP12'/>"
WRITE #1 "        <register address='0xbbe0674' value='0x" DATA.LONG(A:0xbbe0674) "' name='RPMH_BCM_SND_LUT_SND1_COL1_CP13'/>"
WRITE #1 "        <register address='0xbbe0678' value='0x" DATA.LONG(A:0xbbe0678) "' name='RPMH_BCM_SND_LUT_SND1_COL1_CP14'/>"
WRITE #1 "        <register address='0xbbe067c' value='0x" DATA.LONG(A:0xbbe067c) "' name='RPMH_BCM_SND_LUT_SND1_COL1_CP15'/>"
WRITE #1 "        <register address='0xbbe0680' value='0x" DATA.LONG(A:0xbbe0680) "' name='RPMH_BCM_SND_LUT_SND1_COL2_CP0'/>"
WRITE #1 "        <register address='0xbbe0684' value='0x" DATA.LONG(A:0xbbe0684) "' name='RPMH_BCM_SND_LUT_SND1_COL2_CP1'/>"
WRITE #1 "        <register address='0xbbe0688' value='0x" DATA.LONG(A:0xbbe0688) "' name='RPMH_BCM_SND_LUT_SND1_COL2_CP2'/>"
WRITE #1 "        <register address='0xbbe068c' value='0x" DATA.LONG(A:0xbbe068c) "' name='RPMH_BCM_SND_LUT_SND1_COL2_CP3'/>"
WRITE #1 "        <register address='0xbbe0690' value='0x" DATA.LONG(A:0xbbe0690) "' name='RPMH_BCM_SND_LUT_SND1_COL2_CP4'/>"
WRITE #1 "        <register address='0xbbe0694' value='0x" DATA.LONG(A:0xbbe0694) "' name='RPMH_BCM_SND_LUT_SND1_COL2_CP5'/>"
WRITE #1 "        <register address='0xbbe0698' value='0x" DATA.LONG(A:0xbbe0698) "' name='RPMH_BCM_SND_LUT_SND1_COL2_CP6'/>"
WRITE #1 "        <register address='0xbbe069c' value='0x" DATA.LONG(A:0xbbe069c) "' name='RPMH_BCM_SND_LUT_SND1_COL2_CP7'/>"
WRITE #1 "        <register address='0xbbe06a0' value='0x" DATA.LONG(A:0xbbe06a0) "' name='RPMH_BCM_SND_LUT_SND1_COL2_CP8'/>"
WRITE #1 "        <register address='0xbbe06a4' value='0x" DATA.LONG(A:0xbbe06a4) "' name='RPMH_BCM_SND_LUT_SND1_COL2_CP9'/>"
WRITE #1 "        <register address='0xbbe06a8' value='0x" DATA.LONG(A:0xbbe06a8) "' name='RPMH_BCM_SND_LUT_SND1_COL2_CP10'/>"
WRITE #1 "        <register address='0xbbe06ac' value='0x" DATA.LONG(A:0xbbe06ac) "' name='RPMH_BCM_SND_LUT_SND1_COL2_CP11'/>"
WRITE #1 "        <register address='0xbbe06b0' value='0x" DATA.LONG(A:0xbbe06b0) "' name='RPMH_BCM_SND_LUT_SND1_COL2_CP12'/>"
WRITE #1 "        <register address='0xbbe06b4' value='0x" DATA.LONG(A:0xbbe06b4) "' name='RPMH_BCM_SND_LUT_SND1_COL2_CP13'/>"
WRITE #1 "        <register address='0xbbe06b8' value='0x" DATA.LONG(A:0xbbe06b8) "' name='RPMH_BCM_SND_LUT_SND1_COL2_CP14'/>"
WRITE #1 "        <register address='0xbbe06bc' value='0x" DATA.LONG(A:0xbbe06bc) "' name='RPMH_BCM_SND_LUT_SND1_COL2_CP15'/>"
WRITE #1 "        <register address='0xbbe06c0' value='0x" DATA.LONG(A:0xbbe06c0) "' name='RPMH_BCM_SND_LUT_SND1_COL3_CP0'/>"
WRITE #1 "        <register address='0xbbe06c4' value='0x" DATA.LONG(A:0xbbe06c4) "' name='RPMH_BCM_SND_LUT_SND1_COL3_CP1'/>"
WRITE #1 "        <register address='0xbbe06c8' value='0x" DATA.LONG(A:0xbbe06c8) "' name='RPMH_BCM_SND_LUT_SND1_COL3_CP2'/>"
WRITE #1 "        <register address='0xbbe06cc' value='0x" DATA.LONG(A:0xbbe06cc) "' name='RPMH_BCM_SND_LUT_SND1_COL3_CP3'/>"
WRITE #1 "        <register address='0xbbe06d0' value='0x" DATA.LONG(A:0xbbe06d0) "' name='RPMH_BCM_SND_LUT_SND1_COL3_CP4'/>"
WRITE #1 "        <register address='0xbbe06d4' value='0x" DATA.LONG(A:0xbbe06d4) "' name='RPMH_BCM_SND_LUT_SND1_COL3_CP5'/>"
WRITE #1 "        <register address='0xbbe06d8' value='0x" DATA.LONG(A:0xbbe06d8) "' name='RPMH_BCM_SND_LUT_SND1_COL3_CP6'/>"
WRITE #1 "        <register address='0xbbe06dc' value='0x" DATA.LONG(A:0xbbe06dc) "' name='RPMH_BCM_SND_LUT_SND1_COL3_CP7'/>"
WRITE #1 "        <register address='0xbbe06e0' value='0x" DATA.LONG(A:0xbbe06e0) "' name='RPMH_BCM_SND_LUT_SND1_COL3_CP8'/>"
WRITE #1 "        <register address='0xbbe06e4' value='0x" DATA.LONG(A:0xbbe06e4) "' name='RPMH_BCM_SND_LUT_SND1_COL3_CP9'/>"
WRITE #1 "        <register address='0xbbe06e8' value='0x" DATA.LONG(A:0xbbe06e8) "' name='RPMH_BCM_SND_LUT_SND1_COL3_CP10'/>"
WRITE #1 "        <register address='0xbbe06ec' value='0x" DATA.LONG(A:0xbbe06ec) "' name='RPMH_BCM_SND_LUT_SND1_COL3_CP11'/>"
WRITE #1 "        <register address='0xbbe06f0' value='0x" DATA.LONG(A:0xbbe06f0) "' name='RPMH_BCM_SND_LUT_SND1_COL3_CP12'/>"
WRITE #1 "        <register address='0xbbe06f4' value='0x" DATA.LONG(A:0xbbe06f4) "' name='RPMH_BCM_SND_LUT_SND1_COL3_CP13'/>"
WRITE #1 "        <register address='0xbbe06f8' value='0x" DATA.LONG(A:0xbbe06f8) "' name='RPMH_BCM_SND_LUT_SND1_COL3_CP14'/>"
WRITE #1 "        <register address='0xbbe06fc' value='0x" DATA.LONG(A:0xbbe06fc) "' name='RPMH_BCM_SND_LUT_SND1_COL3_CP15'/>"
WRITE #1 "        <register address='0xbbe0700' value='0x" DATA.LONG(A:0xbbe0700) "' name='RPMH_BCM_SND_LUT_SND2_COL0_CP0'/>"
WRITE #1 "        <register address='0xbbe0704' value='0x" DATA.LONG(A:0xbbe0704) "' name='RPMH_BCM_SND_LUT_SND2_COL0_CP1'/>"
WRITE #1 "        <register address='0xbbe0708' value='0x" DATA.LONG(A:0xbbe0708) "' name='RPMH_BCM_SND_LUT_SND2_COL0_CP2'/>"
WRITE #1 "        <register address='0xbbe070c' value='0x" DATA.LONG(A:0xbbe070c) "' name='RPMH_BCM_SND_LUT_SND2_COL0_CP3'/>"
WRITE #1 "        <register address='0xbbe0710' value='0x" DATA.LONG(A:0xbbe0710) "' name='RPMH_BCM_SND_LUT_SND2_COL0_CP4'/>"
WRITE #1 "        <register address='0xbbe0714' value='0x" DATA.LONG(A:0xbbe0714) "' name='RPMH_BCM_SND_LUT_SND2_COL0_CP5'/>"
WRITE #1 "        <register address='0xbbe0718' value='0x" DATA.LONG(A:0xbbe0718) "' name='RPMH_BCM_SND_LUT_SND2_COL0_CP6'/>"
WRITE #1 "        <register address='0xbbe071c' value='0x" DATA.LONG(A:0xbbe071c) "' name='RPMH_BCM_SND_LUT_SND2_COL0_CP7'/>"
WRITE #1 "        <register address='0xbbe0720' value='0x" DATA.LONG(A:0xbbe0720) "' name='RPMH_BCM_SND_LUT_SND2_COL0_CP8'/>"
WRITE #1 "        <register address='0xbbe0724' value='0x" DATA.LONG(A:0xbbe0724) "' name='RPMH_BCM_SND_LUT_SND2_COL0_CP9'/>"
WRITE #1 "        <register address='0xbbe0728' value='0x" DATA.LONG(A:0xbbe0728) "' name='RPMH_BCM_SND_LUT_SND2_COL0_CP10'/>"
WRITE #1 "        <register address='0xbbe072c' value='0x" DATA.LONG(A:0xbbe072c) "' name='RPMH_BCM_SND_LUT_SND2_COL0_CP11'/>"
WRITE #1 "        <register address='0xbbe0730' value='0x" DATA.LONG(A:0xbbe0730) "' name='RPMH_BCM_SND_LUT_SND2_COL0_CP12'/>"
WRITE #1 "        <register address='0xbbe0734' value='0x" DATA.LONG(A:0xbbe0734) "' name='RPMH_BCM_SND_LUT_SND2_COL0_CP13'/>"
WRITE #1 "        <register address='0xbbe0738' value='0x" DATA.LONG(A:0xbbe0738) "' name='RPMH_BCM_SND_LUT_SND2_COL0_CP14'/>"
WRITE #1 "        <register address='0xbbe073c' value='0x" DATA.LONG(A:0xbbe073c) "' name='RPMH_BCM_SND_LUT_SND2_COL0_CP15'/>"
WRITE #1 "        <register address='0xbbe0740' value='0x" DATA.LONG(A:0xbbe0740) "' name='RPMH_BCM_SND_LUT_SND2_COL1_CP0'/>"
WRITE #1 "        <register address='0xbbe0744' value='0x" DATA.LONG(A:0xbbe0744) "' name='RPMH_BCM_SND_LUT_SND2_COL1_CP1'/>"
WRITE #1 "        <register address='0xbbe0748' value='0x" DATA.LONG(A:0xbbe0748) "' name='RPMH_BCM_SND_LUT_SND2_COL1_CP2'/>"
WRITE #1 "        <register address='0xbbe074c' value='0x" DATA.LONG(A:0xbbe074c) "' name='RPMH_BCM_SND_LUT_SND2_COL1_CP3'/>"
WRITE #1 "        <register address='0xbbe0750' value='0x" DATA.LONG(A:0xbbe0750) "' name='RPMH_BCM_SND_LUT_SND2_COL1_CP4'/>"
WRITE #1 "        <register address='0xbbe0754' value='0x" DATA.LONG(A:0xbbe0754) "' name='RPMH_BCM_SND_LUT_SND2_COL1_CP5'/>"
WRITE #1 "        <register address='0xbbe0758' value='0x" DATA.LONG(A:0xbbe0758) "' name='RPMH_BCM_SND_LUT_SND2_COL1_CP6'/>"
WRITE #1 "        <register address='0xbbe075c' value='0x" DATA.LONG(A:0xbbe075c) "' name='RPMH_BCM_SND_LUT_SND2_COL1_CP7'/>"
WRITE #1 "        <register address='0xbbe0760' value='0x" DATA.LONG(A:0xbbe0760) "' name='RPMH_BCM_SND_LUT_SND2_COL1_CP8'/>"
WRITE #1 "        <register address='0xbbe0764' value='0x" DATA.LONG(A:0xbbe0764) "' name='RPMH_BCM_SND_LUT_SND2_COL1_CP9'/>"
WRITE #1 "        <register address='0xbbe0768' value='0x" DATA.LONG(A:0xbbe0768) "' name='RPMH_BCM_SND_LUT_SND2_COL1_CP10'/>"
WRITE #1 "        <register address='0xbbe076c' value='0x" DATA.LONG(A:0xbbe076c) "' name='RPMH_BCM_SND_LUT_SND2_COL1_CP11'/>"
WRITE #1 "        <register address='0xbbe0770' value='0x" DATA.LONG(A:0xbbe0770) "' name='RPMH_BCM_SND_LUT_SND2_COL1_CP12'/>"
WRITE #1 "        <register address='0xbbe0774' value='0x" DATA.LONG(A:0xbbe0774) "' name='RPMH_BCM_SND_LUT_SND2_COL1_CP13'/>"
WRITE #1 "        <register address='0xbbe0778' value='0x" DATA.LONG(A:0xbbe0778) "' name='RPMH_BCM_SND_LUT_SND2_COL1_CP14'/>"
WRITE #1 "        <register address='0xbbe077c' value='0x" DATA.LONG(A:0xbbe077c) "' name='RPMH_BCM_SND_LUT_SND2_COL1_CP15'/>"
WRITE #1 "        <register address='0xbbe0780' value='0x" DATA.LONG(A:0xbbe0780) "' name='RPMH_BCM_SND_LUT_SND2_COL2_CP0'/>"
WRITE #1 "        <register address='0xbbe0784' value='0x" DATA.LONG(A:0xbbe0784) "' name='RPMH_BCM_SND_LUT_SND2_COL2_CP1'/>"
WRITE #1 "        <register address='0xbbe0788' value='0x" DATA.LONG(A:0xbbe0788) "' name='RPMH_BCM_SND_LUT_SND2_COL2_CP2'/>"
WRITE #1 "        <register address='0xbbe078c' value='0x" DATA.LONG(A:0xbbe078c) "' name='RPMH_BCM_SND_LUT_SND2_COL2_CP3'/>"
WRITE #1 "        <register address='0xbbe0790' value='0x" DATA.LONG(A:0xbbe0790) "' name='RPMH_BCM_SND_LUT_SND2_COL2_CP4'/>"
WRITE #1 "        <register address='0xbbe0794' value='0x" DATA.LONG(A:0xbbe0794) "' name='RPMH_BCM_SND_LUT_SND2_COL2_CP5'/>"
WRITE #1 "        <register address='0xbbe0798' value='0x" DATA.LONG(A:0xbbe0798) "' name='RPMH_BCM_SND_LUT_SND2_COL2_CP6'/>"
WRITE #1 "        <register address='0xbbe079c' value='0x" DATA.LONG(A:0xbbe079c) "' name='RPMH_BCM_SND_LUT_SND2_COL2_CP7'/>"
WRITE #1 "        <register address='0xbbe07a0' value='0x" DATA.LONG(A:0xbbe07a0) "' name='RPMH_BCM_SND_LUT_SND2_COL2_CP8'/>"
WRITE #1 "        <register address='0xbbe07a4' value='0x" DATA.LONG(A:0xbbe07a4) "' name='RPMH_BCM_SND_LUT_SND2_COL2_CP9'/>"
WRITE #1 "        <register address='0xbbe07a8' value='0x" DATA.LONG(A:0xbbe07a8) "' name='RPMH_BCM_SND_LUT_SND2_COL2_CP10'/>"
WRITE #1 "        <register address='0xbbe07ac' value='0x" DATA.LONG(A:0xbbe07ac) "' name='RPMH_BCM_SND_LUT_SND2_COL2_CP11'/>"
WRITE #1 "        <register address='0xbbe07b0' value='0x" DATA.LONG(A:0xbbe07b0) "' name='RPMH_BCM_SND_LUT_SND2_COL2_CP12'/>"
WRITE #1 "        <register address='0xbbe07b4' value='0x" DATA.LONG(A:0xbbe07b4) "' name='RPMH_BCM_SND_LUT_SND2_COL2_CP13'/>"
WRITE #1 "        <register address='0xbbe07b8' value='0x" DATA.LONG(A:0xbbe07b8) "' name='RPMH_BCM_SND_LUT_SND2_COL2_CP14'/>"
WRITE #1 "        <register address='0xbbe07bc' value='0x" DATA.LONG(A:0xbbe07bc) "' name='RPMH_BCM_SND_LUT_SND2_COL2_CP15'/>"
WRITE #1 "        <register address='0xbbe07c0' value='0x" DATA.LONG(A:0xbbe07c0) "' name='RPMH_BCM_SND_LUT_SND2_COL3_CP0'/>"
WRITE #1 "        <register address='0xbbe07c4' value='0x" DATA.LONG(A:0xbbe07c4) "' name='RPMH_BCM_SND_LUT_SND2_COL3_CP1'/>"
WRITE #1 "        <register address='0xbbe07c8' value='0x" DATA.LONG(A:0xbbe07c8) "' name='RPMH_BCM_SND_LUT_SND2_COL3_CP2'/>"
WRITE #1 "        <register address='0xbbe07cc' value='0x" DATA.LONG(A:0xbbe07cc) "' name='RPMH_BCM_SND_LUT_SND2_COL3_CP3'/>"
WRITE #1 "        <register address='0xbbe07d0' value='0x" DATA.LONG(A:0xbbe07d0) "' name='RPMH_BCM_SND_LUT_SND2_COL3_CP4'/>"
WRITE #1 "        <register address='0xbbe07d4' value='0x" DATA.LONG(A:0xbbe07d4) "' name='RPMH_BCM_SND_LUT_SND2_COL3_CP5'/>"
WRITE #1 "        <register address='0xbbe07d8' value='0x" DATA.LONG(A:0xbbe07d8) "' name='RPMH_BCM_SND_LUT_SND2_COL3_CP6'/>"
WRITE #1 "        <register address='0xbbe07dc' value='0x" DATA.LONG(A:0xbbe07dc) "' name='RPMH_BCM_SND_LUT_SND2_COL3_CP7'/>"
WRITE #1 "        <register address='0xbbe07e0' value='0x" DATA.LONG(A:0xbbe07e0) "' name='RPMH_BCM_SND_LUT_SND2_COL3_CP8'/>"
WRITE #1 "        <register address='0xbbe07e4' value='0x" DATA.LONG(A:0xbbe07e4) "' name='RPMH_BCM_SND_LUT_SND2_COL3_CP9'/>"
WRITE #1 "        <register address='0xbbe07e8' value='0x" DATA.LONG(A:0xbbe07e8) "' name='RPMH_BCM_SND_LUT_SND2_COL3_CP10'/>"
WRITE #1 "        <register address='0xbbe07ec' value='0x" DATA.LONG(A:0xbbe07ec) "' name='RPMH_BCM_SND_LUT_SND2_COL3_CP11'/>"
WRITE #1 "        <register address='0xbbe07f0' value='0x" DATA.LONG(A:0xbbe07f0) "' name='RPMH_BCM_SND_LUT_SND2_COL3_CP12'/>"
WRITE #1 "        <register address='0xbbe07f4' value='0x" DATA.LONG(A:0xbbe07f4) "' name='RPMH_BCM_SND_LUT_SND2_COL3_CP13'/>"
WRITE #1 "        <register address='0xbbe07f8' value='0x" DATA.LONG(A:0xbbe07f8) "' name='RPMH_BCM_SND_LUT_SND2_COL3_CP14'/>"
WRITE #1 "        <register address='0xbbe07fc' value='0x" DATA.LONG(A:0xbbe07fc) "' name='RPMH_BCM_SND_LUT_SND2_COL3_CP15'/>"
WRITE #1 "        <register address='0xbbe0800' value='0x" DATA.LONG(A:0xbbe0800) "' name='RPMH_BCM_SND_LUT_SND3_COL0_CP0'/>"
WRITE #1 "        <register address='0xbbe0804' value='0x" DATA.LONG(A:0xbbe0804) "' name='RPMH_BCM_SND_LUT_SND3_COL0_CP1'/>"
WRITE #1 "        <register address='0xbbe0808' value='0x" DATA.LONG(A:0xbbe0808) "' name='RPMH_BCM_SND_LUT_SND3_COL0_CP2'/>"
WRITE #1 "        <register address='0xbbe080c' value='0x" DATA.LONG(A:0xbbe080c) "' name='RPMH_BCM_SND_LUT_SND3_COL0_CP3'/>"
WRITE #1 "        <register address='0xbbe0810' value='0x" DATA.LONG(A:0xbbe0810) "' name='RPMH_BCM_SND_LUT_SND3_COL0_CP4'/>"
WRITE #1 "        <register address='0xbbe0814' value='0x" DATA.LONG(A:0xbbe0814) "' name='RPMH_BCM_SND_LUT_SND3_COL0_CP5'/>"
WRITE #1 "        <register address='0xbbe0818' value='0x" DATA.LONG(A:0xbbe0818) "' name='RPMH_BCM_SND_LUT_SND3_COL0_CP6'/>"
WRITE #1 "        <register address='0xbbe081c' value='0x" DATA.LONG(A:0xbbe081c) "' name='RPMH_BCM_SND_LUT_SND3_COL0_CP7'/>"
WRITE #1 "        <register address='0xbbe0820' value='0x" DATA.LONG(A:0xbbe0820) "' name='RPMH_BCM_SND_LUT_SND3_COL0_CP8'/>"
WRITE #1 "        <register address='0xbbe0824' value='0x" DATA.LONG(A:0xbbe0824) "' name='RPMH_BCM_SND_LUT_SND3_COL0_CP9'/>"
WRITE #1 "        <register address='0xbbe0828' value='0x" DATA.LONG(A:0xbbe0828) "' name='RPMH_BCM_SND_LUT_SND3_COL0_CP10'/>"
WRITE #1 "        <register address='0xbbe082c' value='0x" DATA.LONG(A:0xbbe082c) "' name='RPMH_BCM_SND_LUT_SND3_COL0_CP11'/>"
WRITE #1 "        <register address='0xbbe0830' value='0x" DATA.LONG(A:0xbbe0830) "' name='RPMH_BCM_SND_LUT_SND3_COL0_CP12'/>"
WRITE #1 "        <register address='0xbbe0834' value='0x" DATA.LONG(A:0xbbe0834) "' name='RPMH_BCM_SND_LUT_SND3_COL0_CP13'/>"
WRITE #1 "        <register address='0xbbe0838' value='0x" DATA.LONG(A:0xbbe0838) "' name='RPMH_BCM_SND_LUT_SND3_COL0_CP14'/>"
WRITE #1 "        <register address='0xbbe083c' value='0x" DATA.LONG(A:0xbbe083c) "' name='RPMH_BCM_SND_LUT_SND3_COL0_CP15'/>"
WRITE #1 "        <register address='0xbbe0840' value='0x" DATA.LONG(A:0xbbe0840) "' name='RPMH_BCM_SND_LUT_SND3_COL1_CP0'/>"
WRITE #1 "        <register address='0xbbe0844' value='0x" DATA.LONG(A:0xbbe0844) "' name='RPMH_BCM_SND_LUT_SND3_COL1_CP1'/>"
WRITE #1 "        <register address='0xbbe0848' value='0x" DATA.LONG(A:0xbbe0848) "' name='RPMH_BCM_SND_LUT_SND3_COL1_CP2'/>"
WRITE #1 "        <register address='0xbbe084c' value='0x" DATA.LONG(A:0xbbe084c) "' name='RPMH_BCM_SND_LUT_SND3_COL1_CP3'/>"
WRITE #1 "        <register address='0xbbe0850' value='0x" DATA.LONG(A:0xbbe0850) "' name='RPMH_BCM_SND_LUT_SND3_COL1_CP4'/>"
WRITE #1 "        <register address='0xbbe0854' value='0x" DATA.LONG(A:0xbbe0854) "' name='RPMH_BCM_SND_LUT_SND3_COL1_CP5'/>"
WRITE #1 "        <register address='0xbbe0858' value='0x" DATA.LONG(A:0xbbe0858) "' name='RPMH_BCM_SND_LUT_SND3_COL1_CP6'/>"
WRITE #1 "        <register address='0xbbe085c' value='0x" DATA.LONG(A:0xbbe085c) "' name='RPMH_BCM_SND_LUT_SND3_COL1_CP7'/>"
WRITE #1 "        <register address='0xbbe0860' value='0x" DATA.LONG(A:0xbbe0860) "' name='RPMH_BCM_SND_LUT_SND3_COL1_CP8'/>"
WRITE #1 "        <register address='0xbbe0864' value='0x" DATA.LONG(A:0xbbe0864) "' name='RPMH_BCM_SND_LUT_SND3_COL1_CP9'/>"
WRITE #1 "        <register address='0xbbe0868' value='0x" DATA.LONG(A:0xbbe0868) "' name='RPMH_BCM_SND_LUT_SND3_COL1_CP10'/>"
WRITE #1 "        <register address='0xbbe086c' value='0x" DATA.LONG(A:0xbbe086c) "' name='RPMH_BCM_SND_LUT_SND3_COL1_CP11'/>"
WRITE #1 "        <register address='0xbbe0870' value='0x" DATA.LONG(A:0xbbe0870) "' name='RPMH_BCM_SND_LUT_SND3_COL1_CP12'/>"
WRITE #1 "        <register address='0xbbe0874' value='0x" DATA.LONG(A:0xbbe0874) "' name='RPMH_BCM_SND_LUT_SND3_COL1_CP13'/>"
WRITE #1 "        <register address='0xbbe0878' value='0x" DATA.LONG(A:0xbbe0878) "' name='RPMH_BCM_SND_LUT_SND3_COL1_CP14'/>"
WRITE #1 "        <register address='0xbbe087c' value='0x" DATA.LONG(A:0xbbe087c) "' name='RPMH_BCM_SND_LUT_SND3_COL1_CP15'/>"
WRITE #1 "        <register address='0xbbe0880' value='0x" DATA.LONG(A:0xbbe0880) "' name='RPMH_BCM_SND_LUT_SND3_COL2_CP0'/>"
WRITE #1 "        <register address='0xbbe0884' value='0x" DATA.LONG(A:0xbbe0884) "' name='RPMH_BCM_SND_LUT_SND3_COL2_CP1'/>"
WRITE #1 "        <register address='0xbbe0888' value='0x" DATA.LONG(A:0xbbe0888) "' name='RPMH_BCM_SND_LUT_SND3_COL2_CP2'/>"
WRITE #1 "        <register address='0xbbe088c' value='0x" DATA.LONG(A:0xbbe088c) "' name='RPMH_BCM_SND_LUT_SND3_COL2_CP3'/>"
WRITE #1 "        <register address='0xbbe0890' value='0x" DATA.LONG(A:0xbbe0890) "' name='RPMH_BCM_SND_LUT_SND3_COL2_CP4'/>"
WRITE #1 "        <register address='0xbbe0894' value='0x" DATA.LONG(A:0xbbe0894) "' name='RPMH_BCM_SND_LUT_SND3_COL2_CP5'/>"
WRITE #1 "        <register address='0xbbe0898' value='0x" DATA.LONG(A:0xbbe0898) "' name='RPMH_BCM_SND_LUT_SND3_COL2_CP6'/>"
WRITE #1 "        <register address='0xbbe089c' value='0x" DATA.LONG(A:0xbbe089c) "' name='RPMH_BCM_SND_LUT_SND3_COL2_CP7'/>"
WRITE #1 "        <register address='0xbbe08a0' value='0x" DATA.LONG(A:0xbbe08a0) "' name='RPMH_BCM_SND_LUT_SND3_COL2_CP8'/>"
WRITE #1 "        <register address='0xbbe08a4' value='0x" DATA.LONG(A:0xbbe08a4) "' name='RPMH_BCM_SND_LUT_SND3_COL2_CP9'/>"
WRITE #1 "        <register address='0xbbe08a8' value='0x" DATA.LONG(A:0xbbe08a8) "' name='RPMH_BCM_SND_LUT_SND3_COL2_CP10'/>"
WRITE #1 "        <register address='0xbbe08ac' value='0x" DATA.LONG(A:0xbbe08ac) "' name='RPMH_BCM_SND_LUT_SND3_COL2_CP11'/>"
WRITE #1 "        <register address='0xbbe08b0' value='0x" DATA.LONG(A:0xbbe08b0) "' name='RPMH_BCM_SND_LUT_SND3_COL2_CP12'/>"
WRITE #1 "        <register address='0xbbe08b4' value='0x" DATA.LONG(A:0xbbe08b4) "' name='RPMH_BCM_SND_LUT_SND3_COL2_CP13'/>"
WRITE #1 "        <register address='0xbbe08b8' value='0x" DATA.LONG(A:0xbbe08b8) "' name='RPMH_BCM_SND_LUT_SND3_COL2_CP14'/>"
WRITE #1 "        <register address='0xbbe08bc' value='0x" DATA.LONG(A:0xbbe08bc) "' name='RPMH_BCM_SND_LUT_SND3_COL2_CP15'/>"
WRITE #1 "        <register address='0xbbe08c0' value='0x" DATA.LONG(A:0xbbe08c0) "' name='RPMH_BCM_SND_LUT_SND3_COL3_CP0'/>"
WRITE #1 "        <register address='0xbbe08c4' value='0x" DATA.LONG(A:0xbbe08c4) "' name='RPMH_BCM_SND_LUT_SND3_COL3_CP1'/>"
WRITE #1 "        <register address='0xbbe08c8' value='0x" DATA.LONG(A:0xbbe08c8) "' name='RPMH_BCM_SND_LUT_SND3_COL3_CP2'/>"
WRITE #1 "        <register address='0xbbe08cc' value='0x" DATA.LONG(A:0xbbe08cc) "' name='RPMH_BCM_SND_LUT_SND3_COL3_CP3'/>"
WRITE #1 "        <register address='0xbbe08d0' value='0x" DATA.LONG(A:0xbbe08d0) "' name='RPMH_BCM_SND_LUT_SND3_COL3_CP4'/>"
WRITE #1 "        <register address='0xbbe08d4' value='0x" DATA.LONG(A:0xbbe08d4) "' name='RPMH_BCM_SND_LUT_SND3_COL3_CP5'/>"
WRITE #1 "        <register address='0xbbe08d8' value='0x" DATA.LONG(A:0xbbe08d8) "' name='RPMH_BCM_SND_LUT_SND3_COL3_CP6'/>"
WRITE #1 "        <register address='0xbbe08dc' value='0x" DATA.LONG(A:0xbbe08dc) "' name='RPMH_BCM_SND_LUT_SND3_COL3_CP7'/>"
WRITE #1 "        <register address='0xbbe08e0' value='0x" DATA.LONG(A:0xbbe08e0) "' name='RPMH_BCM_SND_LUT_SND3_COL3_CP8'/>"
WRITE #1 "        <register address='0xbbe08e4' value='0x" DATA.LONG(A:0xbbe08e4) "' name='RPMH_BCM_SND_LUT_SND3_COL3_CP9'/>"
WRITE #1 "        <register address='0xbbe08e8' value='0x" DATA.LONG(A:0xbbe08e8) "' name='RPMH_BCM_SND_LUT_SND3_COL3_CP10'/>"
WRITE #1 "        <register address='0xbbe08ec' value='0x" DATA.LONG(A:0xbbe08ec) "' name='RPMH_BCM_SND_LUT_SND3_COL3_CP11'/>"
WRITE #1 "        <register address='0xbbe08f0' value='0x" DATA.LONG(A:0xbbe08f0) "' name='RPMH_BCM_SND_LUT_SND3_COL3_CP12'/>"
WRITE #1 "        <register address='0xbbe08f4' value='0x" DATA.LONG(A:0xbbe08f4) "' name='RPMH_BCM_SND_LUT_SND3_COL3_CP13'/>"
WRITE #1 "        <register address='0xbbe08f8' value='0x" DATA.LONG(A:0xbbe08f8) "' name='RPMH_BCM_SND_LUT_SND3_COL3_CP14'/>"
WRITE #1 "        <register address='0xbbe08fc' value='0x" DATA.LONG(A:0xbbe08fc) "' name='RPMH_BCM_SND_LUT_SND3_COL3_CP15'/>"
WRITE #1 "        <register address='0xbbe3000' value='0x" DATA.LONG(A:0xbbe3000) "' name='RPMH_BCM_CD_CFG_CD0'/>"
WRITE #1 "        <register address='0xbbe3004' value='0x" DATA.LONG(A:0xbbe3004) "' name='RPMH_BCM_CD_CFG_CD1'/>"
WRITE #1 "        <register address='0xbbe3008' value='0x" DATA.LONG(A:0xbbe3008) "' name='RPMH_BCM_CD_CFG_CD2'/>"
WRITE #1 "        <register address='0xbbe300c' value='0x" DATA.LONG(A:0xbbe300c) "' name='RPMH_BCM_CD_CFG_CD3'/>"
WRITE #1 "        <register address='0xbbe3010' value='0x" DATA.LONG(A:0xbbe3010) "' name='RPMH_BCM_CD_CFG_CD4'/>"
WRITE #1 "        <register address='0xbbe3014' value='0x" DATA.LONG(A:0xbbe3014) "' name='RPMH_BCM_CD_CFG_CD5'/>"
WRITE #1 "        <register address='0xbbe3018' value='0x" DATA.LONG(A:0xbbe3018) "' name='RPMH_BCM_CD_CFG_CD6'/>"
WRITE #1 "        <register address='0xbbe301c' value='0x" DATA.LONG(A:0xbbe301c) "' name='RPMH_BCM_CD_CFG_CD7'/>"
WRITE #1 "        <register address='0xbbe3020' value='0x" DATA.LONG(A:0xbbe3020) "' name='RPMH_BCM_CD_CFG_CD8'/>"
WRITE #1 "        <register address='0xbbe3024' value='0x" DATA.LONG(A:0xbbe3024) "' name='RPMH_BCM_CD_CFG_CD9'/>"
WRITE #1 "        <register address='0xbbe3028' value='0x" DATA.LONG(A:0xbbe3028) "' name='RPMH_BCM_CD_CFG_CD10'/>"
WRITE #1 "        <register address='0xbbe302c' value='0x" DATA.LONG(A:0xbbe302c) "' name='RPMH_BCM_CD_CFG_CD11'/>"
WRITE #1 "        <register address='0xbbe3080' value='0x" DATA.LONG(A:0xbbe3080) "' name='RPMH_BCM_CD_CFG_ENABLE_CD0'/>"
WRITE #1 "        <register address='0xbbe3084' value='0x" DATA.LONG(A:0xbbe3084) "' name='RPMH_BCM_CD_CFG_ENABLE_CD1'/>"
WRITE #1 "        <register address='0xbbe3088' value='0x" DATA.LONG(A:0xbbe3088) "' name='RPMH_BCM_CD_CFG_ENABLE_CD2'/>"
WRITE #1 "        <register address='0xbbe308c' value='0x" DATA.LONG(A:0xbbe308c) "' name='RPMH_BCM_CD_CFG_ENABLE_CD3'/>"
WRITE #1 "        <register address='0xbbe3090' value='0x" DATA.LONG(A:0xbbe3090) "' name='RPMH_BCM_CD_CFG_ENABLE_CD4'/>"
WRITE #1 "        <register address='0xbbe3094' value='0x" DATA.LONG(A:0xbbe3094) "' name='RPMH_BCM_CD_CFG_ENABLE_CD5'/>"
WRITE #1 "        <register address='0xbbe3098' value='0x" DATA.LONG(A:0xbbe3098) "' name='RPMH_BCM_CD_CFG_ENABLE_CD6'/>"
WRITE #1 "        <register address='0xbbe309c' value='0x" DATA.LONG(A:0xbbe309c) "' name='RPMH_BCM_CD_CFG_ENABLE_CD7'/>"
WRITE #1 "        <register address='0xbbe30a0' value='0x" DATA.LONG(A:0xbbe30a0) "' name='RPMH_BCM_CD_CFG_ENABLE_CD8'/>"
WRITE #1 "        <register address='0xbbe30a4' value='0x" DATA.LONG(A:0xbbe30a4) "' name='RPMH_BCM_CD_CFG_ENABLE_CD9'/>"
WRITE #1 "        <register address='0xbbe30a8' value='0x" DATA.LONG(A:0xbbe30a8) "' name='RPMH_BCM_CD_CFG_ENABLE_CD10'/>"
WRITE #1 "        <register address='0xbbe30ac' value='0x" DATA.LONG(A:0xbbe30ac) "' name='RPMH_BCM_CD_CFG_ENABLE_CD11'/>"
WRITE #1 "        <register address='0xbbe3200' value='0x" DATA.LONG(A:0xbbe3200) "' name='RPMH_BCM_CD_CFG_CD0_AU_INPUT0'/>"
WRITE #1 "        <register address='0xbbe3204' value='0x" DATA.LONG(A:0xbbe3204) "' name='RPMH_BCM_CD_CFG_CD0_AU_INPUT1'/>"
WRITE #1 "        <register address='0xbbe3208' value='0x" DATA.LONG(A:0xbbe3208) "' name='RPMH_BCM_CD_CFG_CD0_AU_INPUT2'/>"
WRITE #1 "        <register address='0xbbe320c' value='0x" DATA.LONG(A:0xbbe320c) "' name='RPMH_BCM_CD_CFG_CD0_AU_INPUT3'/>"
WRITE #1 "        <register address='0xbbe3210' value='0x" DATA.LONG(A:0xbbe3210) "' name='RPMH_BCM_CD_CFG_CD0_AU_INPUT4'/>"
WRITE #1 "        <register address='0xbbe3214' value='0x" DATA.LONG(A:0xbbe3214) "' name='RPMH_BCM_CD_CFG_CD0_AU_INPUT5'/>"
WRITE #1 "        <register address='0xbbe3218' value='0x" DATA.LONG(A:0xbbe3218) "' name='RPMH_BCM_CD_CFG_CD0_AU_INPUT6'/>"
WRITE #1 "        <register address='0xbbe321c' value='0x" DATA.LONG(A:0xbbe321c) "' name='RPMH_BCM_CD_CFG_CD0_AU_INPUT7'/>"
WRITE #1 "        <register address='0xbbe3220' value='0x" DATA.LONG(A:0xbbe3220) "' name='RPMH_BCM_CD_CFG_CD0_AU_INPUT8'/>"
WRITE #1 "        <register address='0xbbe3224' value='0x" DATA.LONG(A:0xbbe3224) "' name='RPMH_BCM_CD_CFG_CD0_AU_INPUT9'/>"
WRITE #1 "        <register address='0xbbe3228' value='0x" DATA.LONG(A:0xbbe3228) "' name='RPMH_BCM_CD_CFG_CD0_AU_INPUT10'/>"
WRITE #1 "        <register address='0xbbe322c' value='0x" DATA.LONG(A:0xbbe322c) "' name='RPMH_BCM_CD_CFG_CD0_AU_INPUT11'/>"
WRITE #1 "        <register address='0xbbe3230' value='0x" DATA.LONG(A:0xbbe3230) "' name='RPMH_BCM_CD_CFG_CD0_AU_INPUT12'/>"
WRITE #1 "        <register address='0xbbe3234' value='0x" DATA.LONG(A:0xbbe3234) "' name='RPMH_BCM_CD_CFG_CD0_AU_INPUT13'/>"
WRITE #1 "        <register address='0xbbe3238' value='0x" DATA.LONG(A:0xbbe3238) "' name='RPMH_BCM_CD_CFG_CD0_AU_INPUT14'/>"
WRITE #1 "        <register address='0xbbe323c' value='0x" DATA.LONG(A:0xbbe323c) "' name='RPMH_BCM_CD_CFG_CD0_AU_INPUT15'/>"
WRITE #1 "        <register address='0xbbe3240' value='0x" DATA.LONG(A:0xbbe3240) "' name='RPMH_BCM_CD_CFG_CD1_AU_INPUT0'/>"
WRITE #1 "        <register address='0xbbe3244' value='0x" DATA.LONG(A:0xbbe3244) "' name='RPMH_BCM_CD_CFG_CD1_AU_INPUT1'/>"
WRITE #1 "        <register address='0xbbe3248' value='0x" DATA.LONG(A:0xbbe3248) "' name='RPMH_BCM_CD_CFG_CD1_AU_INPUT2'/>"
WRITE #1 "        <register address='0xbbe324c' value='0x" DATA.LONG(A:0xbbe324c) "' name='RPMH_BCM_CD_CFG_CD1_AU_INPUT3'/>"
WRITE #1 "        <register address='0xbbe3250' value='0x" DATA.LONG(A:0xbbe3250) "' name='RPMH_BCM_CD_CFG_CD1_AU_INPUT4'/>"
WRITE #1 "        <register address='0xbbe3254' value='0x" DATA.LONG(A:0xbbe3254) "' name='RPMH_BCM_CD_CFG_CD1_AU_INPUT5'/>"
WRITE #1 "        <register address='0xbbe3258' value='0x" DATA.LONG(A:0xbbe3258) "' name='RPMH_BCM_CD_CFG_CD1_AU_INPUT6'/>"
WRITE #1 "        <register address='0xbbe325c' value='0x" DATA.LONG(A:0xbbe325c) "' name='RPMH_BCM_CD_CFG_CD1_AU_INPUT7'/>"
WRITE #1 "        <register address='0xbbe3260' value='0x" DATA.LONG(A:0xbbe3260) "' name='RPMH_BCM_CD_CFG_CD1_AU_INPUT8'/>"
WRITE #1 "        <register address='0xbbe3264' value='0x" DATA.LONG(A:0xbbe3264) "' name='RPMH_BCM_CD_CFG_CD1_AU_INPUT9'/>"
WRITE #1 "        <register address='0xbbe3268' value='0x" DATA.LONG(A:0xbbe3268) "' name='RPMH_BCM_CD_CFG_CD1_AU_INPUT10'/>"
WRITE #1 "        <register address='0xbbe326c' value='0x" DATA.LONG(A:0xbbe326c) "' name='RPMH_BCM_CD_CFG_CD1_AU_INPUT11'/>"
WRITE #1 "        <register address='0xbbe3270' value='0x" DATA.LONG(A:0xbbe3270) "' name='RPMH_BCM_CD_CFG_CD1_AU_INPUT12'/>"
WRITE #1 "        <register address='0xbbe3274' value='0x" DATA.LONG(A:0xbbe3274) "' name='RPMH_BCM_CD_CFG_CD1_AU_INPUT13'/>"
WRITE #1 "        <register address='0xbbe3278' value='0x" DATA.LONG(A:0xbbe3278) "' name='RPMH_BCM_CD_CFG_CD1_AU_INPUT14'/>"
WRITE #1 "        <register address='0xbbe327c' value='0x" DATA.LONG(A:0xbbe327c) "' name='RPMH_BCM_CD_CFG_CD1_AU_INPUT15'/>"
WRITE #1 "        <register address='0xbbe3280' value='0x" DATA.LONG(A:0xbbe3280) "' name='RPMH_BCM_CD_CFG_CD2_AU_INPUT0'/>"
WRITE #1 "        <register address='0xbbe3284' value='0x" DATA.LONG(A:0xbbe3284) "' name='RPMH_BCM_CD_CFG_CD2_AU_INPUT1'/>"
WRITE #1 "        <register address='0xbbe3288' value='0x" DATA.LONG(A:0xbbe3288) "' name='RPMH_BCM_CD_CFG_CD2_AU_INPUT2'/>"
WRITE #1 "        <register address='0xbbe328c' value='0x" DATA.LONG(A:0xbbe328c) "' name='RPMH_BCM_CD_CFG_CD2_AU_INPUT3'/>"
WRITE #1 "        <register address='0xbbe3290' value='0x" DATA.LONG(A:0xbbe3290) "' name='RPMH_BCM_CD_CFG_CD2_AU_INPUT4'/>"
WRITE #1 "        <register address='0xbbe3294' value='0x" DATA.LONG(A:0xbbe3294) "' name='RPMH_BCM_CD_CFG_CD2_AU_INPUT5'/>"
WRITE #1 "        <register address='0xbbe3298' value='0x" DATA.LONG(A:0xbbe3298) "' name='RPMH_BCM_CD_CFG_CD2_AU_INPUT6'/>"
WRITE #1 "        <register address='0xbbe329c' value='0x" DATA.LONG(A:0xbbe329c) "' name='RPMH_BCM_CD_CFG_CD2_AU_INPUT7'/>"
WRITE #1 "        <register address='0xbbe32a0' value='0x" DATA.LONG(A:0xbbe32a0) "' name='RPMH_BCM_CD_CFG_CD2_AU_INPUT8'/>"
WRITE #1 "        <register address='0xbbe32a4' value='0x" DATA.LONG(A:0xbbe32a4) "' name='RPMH_BCM_CD_CFG_CD2_AU_INPUT9'/>"
WRITE #1 "        <register address='0xbbe32a8' value='0x" DATA.LONG(A:0xbbe32a8) "' name='RPMH_BCM_CD_CFG_CD2_AU_INPUT10'/>"
WRITE #1 "        <register address='0xbbe32ac' value='0x" DATA.LONG(A:0xbbe32ac) "' name='RPMH_BCM_CD_CFG_CD2_AU_INPUT11'/>"
WRITE #1 "        <register address='0xbbe32b0' value='0x" DATA.LONG(A:0xbbe32b0) "' name='RPMH_BCM_CD_CFG_CD2_AU_INPUT12'/>"
WRITE #1 "        <register address='0xbbe32b4' value='0x" DATA.LONG(A:0xbbe32b4) "' name='RPMH_BCM_CD_CFG_CD2_AU_INPUT13'/>"
WRITE #1 "        <register address='0xbbe32b8' value='0x" DATA.LONG(A:0xbbe32b8) "' name='RPMH_BCM_CD_CFG_CD2_AU_INPUT14'/>"
WRITE #1 "        <register address='0xbbe32bc' value='0x" DATA.LONG(A:0xbbe32bc) "' name='RPMH_BCM_CD_CFG_CD2_AU_INPUT15'/>"
WRITE #1 "        <register address='0xbbe32c0' value='0x" DATA.LONG(A:0xbbe32c0) "' name='RPMH_BCM_CD_CFG_CD3_AU_INPUT0'/>"
WRITE #1 "        <register address='0xbbe32c4' value='0x" DATA.LONG(A:0xbbe32c4) "' name='RPMH_BCM_CD_CFG_CD3_AU_INPUT1'/>"
WRITE #1 "        <register address='0xbbe32c8' value='0x" DATA.LONG(A:0xbbe32c8) "' name='RPMH_BCM_CD_CFG_CD3_AU_INPUT2'/>"
WRITE #1 "        <register address='0xbbe32cc' value='0x" DATA.LONG(A:0xbbe32cc) "' name='RPMH_BCM_CD_CFG_CD3_AU_INPUT3'/>"
WRITE #1 "        <register address='0xbbe32d0' value='0x" DATA.LONG(A:0xbbe32d0) "' name='RPMH_BCM_CD_CFG_CD3_AU_INPUT4'/>"
WRITE #1 "        <register address='0xbbe32d4' value='0x" DATA.LONG(A:0xbbe32d4) "' name='RPMH_BCM_CD_CFG_CD3_AU_INPUT5'/>"
WRITE #1 "        <register address='0xbbe32d8' value='0x" DATA.LONG(A:0xbbe32d8) "' name='RPMH_BCM_CD_CFG_CD3_AU_INPUT6'/>"
WRITE #1 "        <register address='0xbbe32dc' value='0x" DATA.LONG(A:0xbbe32dc) "' name='RPMH_BCM_CD_CFG_CD3_AU_INPUT7'/>"
WRITE #1 "        <register address='0xbbe32e0' value='0x" DATA.LONG(A:0xbbe32e0) "' name='RPMH_BCM_CD_CFG_CD3_AU_INPUT8'/>"
WRITE #1 "        <register address='0xbbe32e4' value='0x" DATA.LONG(A:0xbbe32e4) "' name='RPMH_BCM_CD_CFG_CD3_AU_INPUT9'/>"
WRITE #1 "        <register address='0xbbe32e8' value='0x" DATA.LONG(A:0xbbe32e8) "' name='RPMH_BCM_CD_CFG_CD3_AU_INPUT10'/>"
WRITE #1 "        <register address='0xbbe32ec' value='0x" DATA.LONG(A:0xbbe32ec) "' name='RPMH_BCM_CD_CFG_CD3_AU_INPUT11'/>"
WRITE #1 "        <register address='0xbbe32f0' value='0x" DATA.LONG(A:0xbbe32f0) "' name='RPMH_BCM_CD_CFG_CD3_AU_INPUT12'/>"
WRITE #1 "        <register address='0xbbe32f4' value='0x" DATA.LONG(A:0xbbe32f4) "' name='RPMH_BCM_CD_CFG_CD3_AU_INPUT13'/>"
WRITE #1 "        <register address='0xbbe32f8' value='0x" DATA.LONG(A:0xbbe32f8) "' name='RPMH_BCM_CD_CFG_CD3_AU_INPUT14'/>"
WRITE #1 "        <register address='0xbbe32fc' value='0x" DATA.LONG(A:0xbbe32fc) "' name='RPMH_BCM_CD_CFG_CD3_AU_INPUT15'/>"
WRITE #1 "        <register address='0xbbe3300' value='0x" DATA.LONG(A:0xbbe3300) "' name='RPMH_BCM_CD_CFG_CD4_AU_INPUT0'/>"
WRITE #1 "        <register address='0xbbe3304' value='0x" DATA.LONG(A:0xbbe3304) "' name='RPMH_BCM_CD_CFG_CD4_AU_INPUT1'/>"
WRITE #1 "        <register address='0xbbe3308' value='0x" DATA.LONG(A:0xbbe3308) "' name='RPMH_BCM_CD_CFG_CD4_AU_INPUT2'/>"
WRITE #1 "        <register address='0xbbe330c' value='0x" DATA.LONG(A:0xbbe330c) "' name='RPMH_BCM_CD_CFG_CD4_AU_INPUT3'/>"
WRITE #1 "        <register address='0xbbe3310' value='0x" DATA.LONG(A:0xbbe3310) "' name='RPMH_BCM_CD_CFG_CD4_AU_INPUT4'/>"
WRITE #1 "        <register address='0xbbe3314' value='0x" DATA.LONG(A:0xbbe3314) "' name='RPMH_BCM_CD_CFG_CD4_AU_INPUT5'/>"
WRITE #1 "        <register address='0xbbe3318' value='0x" DATA.LONG(A:0xbbe3318) "' name='RPMH_BCM_CD_CFG_CD4_AU_INPUT6'/>"
WRITE #1 "        <register address='0xbbe331c' value='0x" DATA.LONG(A:0xbbe331c) "' name='RPMH_BCM_CD_CFG_CD4_AU_INPUT7'/>"
WRITE #1 "        <register address='0xbbe3320' value='0x" DATA.LONG(A:0xbbe3320) "' name='RPMH_BCM_CD_CFG_CD4_AU_INPUT8'/>"
WRITE #1 "        <register address='0xbbe3324' value='0x" DATA.LONG(A:0xbbe3324) "' name='RPMH_BCM_CD_CFG_CD4_AU_INPUT9'/>"
WRITE #1 "        <register address='0xbbe3328' value='0x" DATA.LONG(A:0xbbe3328) "' name='RPMH_BCM_CD_CFG_CD4_AU_INPUT10'/>"
WRITE #1 "        <register address='0xbbe332c' value='0x" DATA.LONG(A:0xbbe332c) "' name='RPMH_BCM_CD_CFG_CD4_AU_INPUT11'/>"
WRITE #1 "        <register address='0xbbe3330' value='0x" DATA.LONG(A:0xbbe3330) "' name='RPMH_BCM_CD_CFG_CD4_AU_INPUT12'/>"
WRITE #1 "        <register address='0xbbe3334' value='0x" DATA.LONG(A:0xbbe3334) "' name='RPMH_BCM_CD_CFG_CD4_AU_INPUT13'/>"
WRITE #1 "        <register address='0xbbe3338' value='0x" DATA.LONG(A:0xbbe3338) "' name='RPMH_BCM_CD_CFG_CD4_AU_INPUT14'/>"
WRITE #1 "        <register address='0xbbe333c' value='0x" DATA.LONG(A:0xbbe333c) "' name='RPMH_BCM_CD_CFG_CD4_AU_INPUT15'/>"
WRITE #1 "        <register address='0xbbe3340' value='0x" DATA.LONG(A:0xbbe3340) "' name='RPMH_BCM_CD_CFG_CD5_AU_INPUT0'/>"
WRITE #1 "        <register address='0xbbe3344' value='0x" DATA.LONG(A:0xbbe3344) "' name='RPMH_BCM_CD_CFG_CD5_AU_INPUT1'/>"
WRITE #1 "        <register address='0xbbe3348' value='0x" DATA.LONG(A:0xbbe3348) "' name='RPMH_BCM_CD_CFG_CD5_AU_INPUT2'/>"
WRITE #1 "        <register address='0xbbe334c' value='0x" DATA.LONG(A:0xbbe334c) "' name='RPMH_BCM_CD_CFG_CD5_AU_INPUT3'/>"
WRITE #1 "        <register address='0xbbe3350' value='0x" DATA.LONG(A:0xbbe3350) "' name='RPMH_BCM_CD_CFG_CD5_AU_INPUT4'/>"
WRITE #1 "        <register address='0xbbe3354' value='0x" DATA.LONG(A:0xbbe3354) "' name='RPMH_BCM_CD_CFG_CD5_AU_INPUT5'/>"
WRITE #1 "        <register address='0xbbe3358' value='0x" DATA.LONG(A:0xbbe3358) "' name='RPMH_BCM_CD_CFG_CD5_AU_INPUT6'/>"
WRITE #1 "        <register address='0xbbe335c' value='0x" DATA.LONG(A:0xbbe335c) "' name='RPMH_BCM_CD_CFG_CD5_AU_INPUT7'/>"
WRITE #1 "        <register address='0xbbe3360' value='0x" DATA.LONG(A:0xbbe3360) "' name='RPMH_BCM_CD_CFG_CD5_AU_INPUT8'/>"
WRITE #1 "        <register address='0xbbe3364' value='0x" DATA.LONG(A:0xbbe3364) "' name='RPMH_BCM_CD_CFG_CD5_AU_INPUT9'/>"
WRITE #1 "        <register address='0xbbe3368' value='0x" DATA.LONG(A:0xbbe3368) "' name='RPMH_BCM_CD_CFG_CD5_AU_INPUT10'/>"
WRITE #1 "        <register address='0xbbe336c' value='0x" DATA.LONG(A:0xbbe336c) "' name='RPMH_BCM_CD_CFG_CD5_AU_INPUT11'/>"
WRITE #1 "        <register address='0xbbe3370' value='0x" DATA.LONG(A:0xbbe3370) "' name='RPMH_BCM_CD_CFG_CD5_AU_INPUT12'/>"
WRITE #1 "        <register address='0xbbe3374' value='0x" DATA.LONG(A:0xbbe3374) "' name='RPMH_BCM_CD_CFG_CD5_AU_INPUT13'/>"
WRITE #1 "        <register address='0xbbe3378' value='0x" DATA.LONG(A:0xbbe3378) "' name='RPMH_BCM_CD_CFG_CD5_AU_INPUT14'/>"
WRITE #1 "        <register address='0xbbe337c' value='0x" DATA.LONG(A:0xbbe337c) "' name='RPMH_BCM_CD_CFG_CD5_AU_INPUT15'/>"
WRITE #1 "        <register address='0xbbe3380' value='0x" DATA.LONG(A:0xbbe3380) "' name='RPMH_BCM_CD_CFG_CD6_AU_INPUT0'/>"
WRITE #1 "        <register address='0xbbe3384' value='0x" DATA.LONG(A:0xbbe3384) "' name='RPMH_BCM_CD_CFG_CD6_AU_INPUT1'/>"
WRITE #1 "        <register address='0xbbe3388' value='0x" DATA.LONG(A:0xbbe3388) "' name='RPMH_BCM_CD_CFG_CD6_AU_INPUT2'/>"
WRITE #1 "        <register address='0xbbe338c' value='0x" DATA.LONG(A:0xbbe338c) "' name='RPMH_BCM_CD_CFG_CD6_AU_INPUT3'/>"
WRITE #1 "        <register address='0xbbe3390' value='0x" DATA.LONG(A:0xbbe3390) "' name='RPMH_BCM_CD_CFG_CD6_AU_INPUT4'/>"
WRITE #1 "        <register address='0xbbe3394' value='0x" DATA.LONG(A:0xbbe3394) "' name='RPMH_BCM_CD_CFG_CD6_AU_INPUT5'/>"
WRITE #1 "        <register address='0xbbe3398' value='0x" DATA.LONG(A:0xbbe3398) "' name='RPMH_BCM_CD_CFG_CD6_AU_INPUT6'/>"
WRITE #1 "        <register address='0xbbe339c' value='0x" DATA.LONG(A:0xbbe339c) "' name='RPMH_BCM_CD_CFG_CD6_AU_INPUT7'/>"
WRITE #1 "        <register address='0xbbe33a0' value='0x" DATA.LONG(A:0xbbe33a0) "' name='RPMH_BCM_CD_CFG_CD6_AU_INPUT8'/>"
WRITE #1 "        <register address='0xbbe33a4' value='0x" DATA.LONG(A:0xbbe33a4) "' name='RPMH_BCM_CD_CFG_CD6_AU_INPUT9'/>"
WRITE #1 "        <register address='0xbbe33a8' value='0x" DATA.LONG(A:0xbbe33a8) "' name='RPMH_BCM_CD_CFG_CD6_AU_INPUT10'/>"
WRITE #1 "        <register address='0xbbe33ac' value='0x" DATA.LONG(A:0xbbe33ac) "' name='RPMH_BCM_CD_CFG_CD6_AU_INPUT11'/>"
WRITE #1 "        <register address='0xbbe33b0' value='0x" DATA.LONG(A:0xbbe33b0) "' name='RPMH_BCM_CD_CFG_CD6_AU_INPUT12'/>"
WRITE #1 "        <register address='0xbbe33b4' value='0x" DATA.LONG(A:0xbbe33b4) "' name='RPMH_BCM_CD_CFG_CD6_AU_INPUT13'/>"
WRITE #1 "        <register address='0xbbe33b8' value='0x" DATA.LONG(A:0xbbe33b8) "' name='RPMH_BCM_CD_CFG_CD6_AU_INPUT14'/>"
WRITE #1 "        <register address='0xbbe33bc' value='0x" DATA.LONG(A:0xbbe33bc) "' name='RPMH_BCM_CD_CFG_CD6_AU_INPUT15'/>"
WRITE #1 "        <register address='0xbbe33c0' value='0x" DATA.LONG(A:0xbbe33c0) "' name='RPMH_BCM_CD_CFG_CD7_AU_INPUT0'/>"
WRITE #1 "        <register address='0xbbe33c4' value='0x" DATA.LONG(A:0xbbe33c4) "' name='RPMH_BCM_CD_CFG_CD7_AU_INPUT1'/>"
WRITE #1 "        <register address='0xbbe33c8' value='0x" DATA.LONG(A:0xbbe33c8) "' name='RPMH_BCM_CD_CFG_CD7_AU_INPUT2'/>"
WRITE #1 "        <register address='0xbbe33cc' value='0x" DATA.LONG(A:0xbbe33cc) "' name='RPMH_BCM_CD_CFG_CD7_AU_INPUT3'/>"
WRITE #1 "        <register address='0xbbe33d0' value='0x" DATA.LONG(A:0xbbe33d0) "' name='RPMH_BCM_CD_CFG_CD7_AU_INPUT4'/>"
WRITE #1 "        <register address='0xbbe33d4' value='0x" DATA.LONG(A:0xbbe33d4) "' name='RPMH_BCM_CD_CFG_CD7_AU_INPUT5'/>"
WRITE #1 "        <register address='0xbbe33d8' value='0x" DATA.LONG(A:0xbbe33d8) "' name='RPMH_BCM_CD_CFG_CD7_AU_INPUT6'/>"
WRITE #1 "        <register address='0xbbe33dc' value='0x" DATA.LONG(A:0xbbe33dc) "' name='RPMH_BCM_CD_CFG_CD7_AU_INPUT7'/>"
WRITE #1 "        <register address='0xbbe33e0' value='0x" DATA.LONG(A:0xbbe33e0) "' name='RPMH_BCM_CD_CFG_CD7_AU_INPUT8'/>"
WRITE #1 "        <register address='0xbbe33e4' value='0x" DATA.LONG(A:0xbbe33e4) "' name='RPMH_BCM_CD_CFG_CD7_AU_INPUT9'/>"
WRITE #1 "        <register address='0xbbe33e8' value='0x" DATA.LONG(A:0xbbe33e8) "' name='RPMH_BCM_CD_CFG_CD7_AU_INPUT10'/>"
WRITE #1 "        <register address='0xbbe33ec' value='0x" DATA.LONG(A:0xbbe33ec) "' name='RPMH_BCM_CD_CFG_CD7_AU_INPUT11'/>"
WRITE #1 "        <register address='0xbbe33f0' value='0x" DATA.LONG(A:0xbbe33f0) "' name='RPMH_BCM_CD_CFG_CD7_AU_INPUT12'/>"
WRITE #1 "        <register address='0xbbe33f4' value='0x" DATA.LONG(A:0xbbe33f4) "' name='RPMH_BCM_CD_CFG_CD7_AU_INPUT13'/>"
WRITE #1 "        <register address='0xbbe33f8' value='0x" DATA.LONG(A:0xbbe33f8) "' name='RPMH_BCM_CD_CFG_CD7_AU_INPUT14'/>"
WRITE #1 "        <register address='0xbbe33fc' value='0x" DATA.LONG(A:0xbbe33fc) "' name='RPMH_BCM_CD_CFG_CD7_AU_INPUT15'/>"
WRITE #1 "        <register address='0xbbe3400' value='0x" DATA.LONG(A:0xbbe3400) "' name='RPMH_BCM_CD_CFG_CD8_AU_INPUT0'/>"
WRITE #1 "        <register address='0xbbe3404' value='0x" DATA.LONG(A:0xbbe3404) "' name='RPMH_BCM_CD_CFG_CD8_AU_INPUT1'/>"
WRITE #1 "        <register address='0xbbe3408' value='0x" DATA.LONG(A:0xbbe3408) "' name='RPMH_BCM_CD_CFG_CD8_AU_INPUT2'/>"
WRITE #1 "        <register address='0xbbe340c' value='0x" DATA.LONG(A:0xbbe340c) "' name='RPMH_BCM_CD_CFG_CD8_AU_INPUT3'/>"
WRITE #1 "        <register address='0xbbe3410' value='0x" DATA.LONG(A:0xbbe3410) "' name='RPMH_BCM_CD_CFG_CD8_AU_INPUT4'/>"
WRITE #1 "        <register address='0xbbe3414' value='0x" DATA.LONG(A:0xbbe3414) "' name='RPMH_BCM_CD_CFG_CD8_AU_INPUT5'/>"
WRITE #1 "        <register address='0xbbe3418' value='0x" DATA.LONG(A:0xbbe3418) "' name='RPMH_BCM_CD_CFG_CD8_AU_INPUT6'/>"
WRITE #1 "        <register address='0xbbe341c' value='0x" DATA.LONG(A:0xbbe341c) "' name='RPMH_BCM_CD_CFG_CD8_AU_INPUT7'/>"
WRITE #1 "        <register address='0xbbe3420' value='0x" DATA.LONG(A:0xbbe3420) "' name='RPMH_BCM_CD_CFG_CD8_AU_INPUT8'/>"
WRITE #1 "        <register address='0xbbe3424' value='0x" DATA.LONG(A:0xbbe3424) "' name='RPMH_BCM_CD_CFG_CD8_AU_INPUT9'/>"
WRITE #1 "        <register address='0xbbe3428' value='0x" DATA.LONG(A:0xbbe3428) "' name='RPMH_BCM_CD_CFG_CD8_AU_INPUT10'/>"
WRITE #1 "        <register address='0xbbe342c' value='0x" DATA.LONG(A:0xbbe342c) "' name='RPMH_BCM_CD_CFG_CD8_AU_INPUT11'/>"
WRITE #1 "        <register address='0xbbe3430' value='0x" DATA.LONG(A:0xbbe3430) "' name='RPMH_BCM_CD_CFG_CD8_AU_INPUT12'/>"
WRITE #1 "        <register address='0xbbe3434' value='0x" DATA.LONG(A:0xbbe3434) "' name='RPMH_BCM_CD_CFG_CD8_AU_INPUT13'/>"
WRITE #1 "        <register address='0xbbe3438' value='0x" DATA.LONG(A:0xbbe3438) "' name='RPMH_BCM_CD_CFG_CD8_AU_INPUT14'/>"
WRITE #1 "        <register address='0xbbe343c' value='0x" DATA.LONG(A:0xbbe343c) "' name='RPMH_BCM_CD_CFG_CD8_AU_INPUT15'/>"
WRITE #1 "        <register address='0xbbe3440' value='0x" DATA.LONG(A:0xbbe3440) "' name='RPMH_BCM_CD_CFG_CD9_AU_INPUT0'/>"
WRITE #1 "        <register address='0xbbe3444' value='0x" DATA.LONG(A:0xbbe3444) "' name='RPMH_BCM_CD_CFG_CD9_AU_INPUT1'/>"
WRITE #1 "        <register address='0xbbe3448' value='0x" DATA.LONG(A:0xbbe3448) "' name='RPMH_BCM_CD_CFG_CD9_AU_INPUT2'/>"
WRITE #1 "        <register address='0xbbe344c' value='0x" DATA.LONG(A:0xbbe344c) "' name='RPMH_BCM_CD_CFG_CD9_AU_INPUT3'/>"
WRITE #1 "        <register address='0xbbe3450' value='0x" DATA.LONG(A:0xbbe3450) "' name='RPMH_BCM_CD_CFG_CD9_AU_INPUT4'/>"
WRITE #1 "        <register address='0xbbe3454' value='0x" DATA.LONG(A:0xbbe3454) "' name='RPMH_BCM_CD_CFG_CD9_AU_INPUT5'/>"
WRITE #1 "        <register address='0xbbe3458' value='0x" DATA.LONG(A:0xbbe3458) "' name='RPMH_BCM_CD_CFG_CD9_AU_INPUT6'/>"
WRITE #1 "        <register address='0xbbe345c' value='0x" DATA.LONG(A:0xbbe345c) "' name='RPMH_BCM_CD_CFG_CD9_AU_INPUT7'/>"
WRITE #1 "        <register address='0xbbe3460' value='0x" DATA.LONG(A:0xbbe3460) "' name='RPMH_BCM_CD_CFG_CD9_AU_INPUT8'/>"
WRITE #1 "        <register address='0xbbe3464' value='0x" DATA.LONG(A:0xbbe3464) "' name='RPMH_BCM_CD_CFG_CD9_AU_INPUT9'/>"
WRITE #1 "        <register address='0xbbe3468' value='0x" DATA.LONG(A:0xbbe3468) "' name='RPMH_BCM_CD_CFG_CD9_AU_INPUT10'/>"
WRITE #1 "        <register address='0xbbe346c' value='0x" DATA.LONG(A:0xbbe346c) "' name='RPMH_BCM_CD_CFG_CD9_AU_INPUT11'/>"
WRITE #1 "        <register address='0xbbe3470' value='0x" DATA.LONG(A:0xbbe3470) "' name='RPMH_BCM_CD_CFG_CD9_AU_INPUT12'/>"
WRITE #1 "        <register address='0xbbe3474' value='0x" DATA.LONG(A:0xbbe3474) "' name='RPMH_BCM_CD_CFG_CD9_AU_INPUT13'/>"
WRITE #1 "        <register address='0xbbe3478' value='0x" DATA.LONG(A:0xbbe3478) "' name='RPMH_BCM_CD_CFG_CD9_AU_INPUT14'/>"
WRITE #1 "        <register address='0xbbe347c' value='0x" DATA.LONG(A:0xbbe347c) "' name='RPMH_BCM_CD_CFG_CD9_AU_INPUT15'/>"
WRITE #1 "        <register address='0xbbe3480' value='0x" DATA.LONG(A:0xbbe3480) "' name='RPMH_BCM_CD_CFG_CD10_AU_INPUT0'/>"
WRITE #1 "        <register address='0xbbe3484' value='0x" DATA.LONG(A:0xbbe3484) "' name='RPMH_BCM_CD_CFG_CD10_AU_INPUT1'/>"
WRITE #1 "        <register address='0xbbe3488' value='0x" DATA.LONG(A:0xbbe3488) "' name='RPMH_BCM_CD_CFG_CD10_AU_INPUT2'/>"
WRITE #1 "        <register address='0xbbe348c' value='0x" DATA.LONG(A:0xbbe348c) "' name='RPMH_BCM_CD_CFG_CD10_AU_INPUT3'/>"
WRITE #1 "        <register address='0xbbe3490' value='0x" DATA.LONG(A:0xbbe3490) "' name='RPMH_BCM_CD_CFG_CD10_AU_INPUT4'/>"
WRITE #1 "        <register address='0xbbe3494' value='0x" DATA.LONG(A:0xbbe3494) "' name='RPMH_BCM_CD_CFG_CD10_AU_INPUT5'/>"
WRITE #1 "        <register address='0xbbe3498' value='0x" DATA.LONG(A:0xbbe3498) "' name='RPMH_BCM_CD_CFG_CD10_AU_INPUT6'/>"
WRITE #1 "        <register address='0xbbe349c' value='0x" DATA.LONG(A:0xbbe349c) "' name='RPMH_BCM_CD_CFG_CD10_AU_INPUT7'/>"
WRITE #1 "        <register address='0xbbe34a0' value='0x" DATA.LONG(A:0xbbe34a0) "' name='RPMH_BCM_CD_CFG_CD10_AU_INPUT8'/>"
WRITE #1 "        <register address='0xbbe34a4' value='0x" DATA.LONG(A:0xbbe34a4) "' name='RPMH_BCM_CD_CFG_CD10_AU_INPUT9'/>"
WRITE #1 "        <register address='0xbbe34a8' value='0x" DATA.LONG(A:0xbbe34a8) "' name='RPMH_BCM_CD_CFG_CD10_AU_INPUT10'/>"
WRITE #1 "        <register address='0xbbe34ac' value='0x" DATA.LONG(A:0xbbe34ac) "' name='RPMH_BCM_CD_CFG_CD10_AU_INPUT11'/>"
WRITE #1 "        <register address='0xbbe34b0' value='0x" DATA.LONG(A:0xbbe34b0) "' name='RPMH_BCM_CD_CFG_CD10_AU_INPUT12'/>"
WRITE #1 "        <register address='0xbbe34b4' value='0x" DATA.LONG(A:0xbbe34b4) "' name='RPMH_BCM_CD_CFG_CD10_AU_INPUT13'/>"
WRITE #1 "        <register address='0xbbe34b8' value='0x" DATA.LONG(A:0xbbe34b8) "' name='RPMH_BCM_CD_CFG_CD10_AU_INPUT14'/>"
WRITE #1 "        <register address='0xbbe34bc' value='0x" DATA.LONG(A:0xbbe34bc) "' name='RPMH_BCM_CD_CFG_CD10_AU_INPUT15'/>"
WRITE #1 "        <register address='0xbbe34c0' value='0x" DATA.LONG(A:0xbbe34c0) "' name='RPMH_BCM_CD_CFG_CD11_AU_INPUT0'/>"
WRITE #1 "        <register address='0xbbe34c4' value='0x" DATA.LONG(A:0xbbe34c4) "' name='RPMH_BCM_CD_CFG_CD11_AU_INPUT1'/>"
WRITE #1 "        <register address='0xbbe34c8' value='0x" DATA.LONG(A:0xbbe34c8) "' name='RPMH_BCM_CD_CFG_CD11_AU_INPUT2'/>"
WRITE #1 "        <register address='0xbbe34cc' value='0x" DATA.LONG(A:0xbbe34cc) "' name='RPMH_BCM_CD_CFG_CD11_AU_INPUT3'/>"
WRITE #1 "        <register address='0xbbe34d0' value='0x" DATA.LONG(A:0xbbe34d0) "' name='RPMH_BCM_CD_CFG_CD11_AU_INPUT4'/>"
WRITE #1 "        <register address='0xbbe34d4' value='0x" DATA.LONG(A:0xbbe34d4) "' name='RPMH_BCM_CD_CFG_CD11_AU_INPUT5'/>"
WRITE #1 "        <register address='0xbbe34d8' value='0x" DATA.LONG(A:0xbbe34d8) "' name='RPMH_BCM_CD_CFG_CD11_AU_INPUT6'/>"
WRITE #1 "        <register address='0xbbe34dc' value='0x" DATA.LONG(A:0xbbe34dc) "' name='RPMH_BCM_CD_CFG_CD11_AU_INPUT7'/>"
WRITE #1 "        <register address='0xbbe34e0' value='0x" DATA.LONG(A:0xbbe34e0) "' name='RPMH_BCM_CD_CFG_CD11_AU_INPUT8'/>"
WRITE #1 "        <register address='0xbbe34e4' value='0x" DATA.LONG(A:0xbbe34e4) "' name='RPMH_BCM_CD_CFG_CD11_AU_INPUT9'/>"
WRITE #1 "        <register address='0xbbe34e8' value='0x" DATA.LONG(A:0xbbe34e8) "' name='RPMH_BCM_CD_CFG_CD11_AU_INPUT10'/>"
WRITE #1 "        <register address='0xbbe34ec' value='0x" DATA.LONG(A:0xbbe34ec) "' name='RPMH_BCM_CD_CFG_CD11_AU_INPUT11'/>"
WRITE #1 "        <register address='0xbbe34f0' value='0x" DATA.LONG(A:0xbbe34f0) "' name='RPMH_BCM_CD_CFG_CD11_AU_INPUT12'/>"
WRITE #1 "        <register address='0xbbe34f4' value='0x" DATA.LONG(A:0xbbe34f4) "' name='RPMH_BCM_CD_CFG_CD11_AU_INPUT13'/>"
WRITE #1 "        <register address='0xbbe34f8' value='0x" DATA.LONG(A:0xbbe34f8) "' name='RPMH_BCM_CD_CFG_CD11_AU_INPUT14'/>"
WRITE #1 "        <register address='0xbbe34fc' value='0x" DATA.LONG(A:0xbbe34fc) "' name='RPMH_BCM_CD_CFG_CD11_AU_INPUT15'/>"
WRITE #1 "        <register address='0xbbe3800' value='0x" DATA.LONG(A:0xbbe3800) "' name='RPMH_BCM_CD_TH_CD0_CP0'/>"
WRITE #1 "        <register address='0xbbe3804' value='0x" DATA.LONG(A:0xbbe3804) "' name='RPMH_BCM_CD_TH_CD0_CP1'/>"
WRITE #1 "        <register address='0xbbe3808' value='0x" DATA.LONG(A:0xbbe3808) "' name='RPMH_BCM_CD_TH_CD0_CP2'/>"
WRITE #1 "        <register address='0xbbe380c' value='0x" DATA.LONG(A:0xbbe380c) "' name='RPMH_BCM_CD_TH_CD0_CP3'/>"
WRITE #1 "        <register address='0xbbe3810' value='0x" DATA.LONG(A:0xbbe3810) "' name='RPMH_BCM_CD_TH_CD0_CP4'/>"
WRITE #1 "        <register address='0xbbe3814' value='0x" DATA.LONG(A:0xbbe3814) "' name='RPMH_BCM_CD_TH_CD0_CP5'/>"
WRITE #1 "        <register address='0xbbe3818' value='0x" DATA.LONG(A:0xbbe3818) "' name='RPMH_BCM_CD_TH_CD0_CP6'/>"
WRITE #1 "        <register address='0xbbe381c' value='0x" DATA.LONG(A:0xbbe381c) "' name='RPMH_BCM_CD_TH_CD0_CP7'/>"
WRITE #1 "        <register address='0xbbe3820' value='0x" DATA.LONG(A:0xbbe3820) "' name='RPMH_BCM_CD_TH_CD0_CP8'/>"
WRITE #1 "        <register address='0xbbe3824' value='0x" DATA.LONG(A:0xbbe3824) "' name='RPMH_BCM_CD_TH_CD0_CP9'/>"
WRITE #1 "        <register address='0xbbe3828' value='0x" DATA.LONG(A:0xbbe3828) "' name='RPMH_BCM_CD_TH_CD0_CP10'/>"
WRITE #1 "        <register address='0xbbe382c' value='0x" DATA.LONG(A:0xbbe382c) "' name='RPMH_BCM_CD_TH_CD0_CP11'/>"
WRITE #1 "        <register address='0xbbe3830' value='0x" DATA.LONG(A:0xbbe3830) "' name='RPMH_BCM_CD_TH_CD0_CP12'/>"
WRITE #1 "        <register address='0xbbe3834' value='0x" DATA.LONG(A:0xbbe3834) "' name='RPMH_BCM_CD_TH_CD0_CP13'/>"
WRITE #1 "        <register address='0xbbe3838' value='0x" DATA.LONG(A:0xbbe3838) "' name='RPMH_BCM_CD_TH_CD0_CP14'/>"
WRITE #1 "        <register address='0xbbe383c' value='0x" DATA.LONG(A:0xbbe383c) "' name='RPMH_BCM_CD_TH_CD0_CP15'/>"
WRITE #1 "        <register address='0xbbe3840' value='0x" DATA.LONG(A:0xbbe3840) "' name='RPMH_BCM_CD_TH_CD1_CP0'/>"
WRITE #1 "        <register address='0xbbe3844' value='0x" DATA.LONG(A:0xbbe3844) "' name='RPMH_BCM_CD_TH_CD1_CP1'/>"
WRITE #1 "        <register address='0xbbe3848' value='0x" DATA.LONG(A:0xbbe3848) "' name='RPMH_BCM_CD_TH_CD1_CP2'/>"
WRITE #1 "        <register address='0xbbe384c' value='0x" DATA.LONG(A:0xbbe384c) "' name='RPMH_BCM_CD_TH_CD1_CP3'/>"
WRITE #1 "        <register address='0xbbe3850' value='0x" DATA.LONG(A:0xbbe3850) "' name='RPMH_BCM_CD_TH_CD1_CP4'/>"
WRITE #1 "        <register address='0xbbe3854' value='0x" DATA.LONG(A:0xbbe3854) "' name='RPMH_BCM_CD_TH_CD1_CP5'/>"
WRITE #1 "        <register address='0xbbe3858' value='0x" DATA.LONG(A:0xbbe3858) "' name='RPMH_BCM_CD_TH_CD1_CP6'/>"
WRITE #1 "        <register address='0xbbe385c' value='0x" DATA.LONG(A:0xbbe385c) "' name='RPMH_BCM_CD_TH_CD1_CP7'/>"
WRITE #1 "        <register address='0xbbe3860' value='0x" DATA.LONG(A:0xbbe3860) "' name='RPMH_BCM_CD_TH_CD1_CP8'/>"
WRITE #1 "        <register address='0xbbe3864' value='0x" DATA.LONG(A:0xbbe3864) "' name='RPMH_BCM_CD_TH_CD1_CP9'/>"
WRITE #1 "        <register address='0xbbe3868' value='0x" DATA.LONG(A:0xbbe3868) "' name='RPMH_BCM_CD_TH_CD1_CP10'/>"
WRITE #1 "        <register address='0xbbe386c' value='0x" DATA.LONG(A:0xbbe386c) "' name='RPMH_BCM_CD_TH_CD1_CP11'/>"
WRITE #1 "        <register address='0xbbe3870' value='0x" DATA.LONG(A:0xbbe3870) "' name='RPMH_BCM_CD_TH_CD1_CP12'/>"
WRITE #1 "        <register address='0xbbe3874' value='0x" DATA.LONG(A:0xbbe3874) "' name='RPMH_BCM_CD_TH_CD1_CP13'/>"
WRITE #1 "        <register address='0xbbe3878' value='0x" DATA.LONG(A:0xbbe3878) "' name='RPMH_BCM_CD_TH_CD1_CP14'/>"
WRITE #1 "        <register address='0xbbe387c' value='0x" DATA.LONG(A:0xbbe387c) "' name='RPMH_BCM_CD_TH_CD1_CP15'/>"
WRITE #1 "        <register address='0xbbe3880' value='0x" DATA.LONG(A:0xbbe3880) "' name='RPMH_BCM_CD_TH_CD2_CP0'/>"
WRITE #1 "        <register address='0xbbe3884' value='0x" DATA.LONG(A:0xbbe3884) "' name='RPMH_BCM_CD_TH_CD2_CP1'/>"
WRITE #1 "        <register address='0xbbe3888' value='0x" DATA.LONG(A:0xbbe3888) "' name='RPMH_BCM_CD_TH_CD2_CP2'/>"
WRITE #1 "        <register address='0xbbe388c' value='0x" DATA.LONG(A:0xbbe388c) "' name='RPMH_BCM_CD_TH_CD2_CP3'/>"
WRITE #1 "        <register address='0xbbe3890' value='0x" DATA.LONG(A:0xbbe3890) "' name='RPMH_BCM_CD_TH_CD2_CP4'/>"
WRITE #1 "        <register address='0xbbe3894' value='0x" DATA.LONG(A:0xbbe3894) "' name='RPMH_BCM_CD_TH_CD2_CP5'/>"
WRITE #1 "        <register address='0xbbe3898' value='0x" DATA.LONG(A:0xbbe3898) "' name='RPMH_BCM_CD_TH_CD2_CP6'/>"
WRITE #1 "        <register address='0xbbe389c' value='0x" DATA.LONG(A:0xbbe389c) "' name='RPMH_BCM_CD_TH_CD2_CP7'/>"
WRITE #1 "        <register address='0xbbe38c0' value='0x" DATA.LONG(A:0xbbe38c0) "' name='RPMH_BCM_CD_TH_CD3_CP0'/>"
WRITE #1 "        <register address='0xbbe38c4' value='0x" DATA.LONG(A:0xbbe38c4) "' name='RPMH_BCM_CD_TH_CD3_CP1'/>"
WRITE #1 "        <register address='0xbbe38c8' value='0x" DATA.LONG(A:0xbbe38c8) "' name='RPMH_BCM_CD_TH_CD3_CP2'/>"
WRITE #1 "        <register address='0xbbe38cc' value='0x" DATA.LONG(A:0xbbe38cc) "' name='RPMH_BCM_CD_TH_CD3_CP3'/>"
WRITE #1 "        <register address='0xbbe38d0' value='0x" DATA.LONG(A:0xbbe38d0) "' name='RPMH_BCM_CD_TH_CD3_CP4'/>"
WRITE #1 "        <register address='0xbbe38d4' value='0x" DATA.LONG(A:0xbbe38d4) "' name='RPMH_BCM_CD_TH_CD3_CP5'/>"
WRITE #1 "        <register address='0xbbe38d8' value='0x" DATA.LONG(A:0xbbe38d8) "' name='RPMH_BCM_CD_TH_CD3_CP6'/>"
WRITE #1 "        <register address='0xbbe38dc' value='0x" DATA.LONG(A:0xbbe38dc) "' name='RPMH_BCM_CD_TH_CD3_CP7'/>"
WRITE #1 "        <register address='0xbbe3900' value='0x" DATA.LONG(A:0xbbe3900) "' name='RPMH_BCM_CD_TH_CD4_CP0'/>"
WRITE #1 "        <register address='0xbbe3904' value='0x" DATA.LONG(A:0xbbe3904) "' name='RPMH_BCM_CD_TH_CD4_CP1'/>"
WRITE #1 "        <register address='0xbbe3908' value='0x" DATA.LONG(A:0xbbe3908) "' name='RPMH_BCM_CD_TH_CD4_CP2'/>"
WRITE #1 "        <register address='0xbbe390c' value='0x" DATA.LONG(A:0xbbe390c) "' name='RPMH_BCM_CD_TH_CD4_CP3'/>"
WRITE #1 "        <register address='0xbbe3910' value='0x" DATA.LONG(A:0xbbe3910) "' name='RPMH_BCM_CD_TH_CD4_CP4'/>"
WRITE #1 "        <register address='0xbbe3914' value='0x" DATA.LONG(A:0xbbe3914) "' name='RPMH_BCM_CD_TH_CD4_CP5'/>"
WRITE #1 "        <register address='0xbbe3918' value='0x" DATA.LONG(A:0xbbe3918) "' name='RPMH_BCM_CD_TH_CD4_CP6'/>"
WRITE #1 "        <register address='0xbbe391c' value='0x" DATA.LONG(A:0xbbe391c) "' name='RPMH_BCM_CD_TH_CD4_CP7'/>"
WRITE #1 "        <register address='0xbbe3940' value='0x" DATA.LONG(A:0xbbe3940) "' name='RPMH_BCM_CD_TH_CD5_CP0'/>"
WRITE #1 "        <register address='0xbbe3944' value='0x" DATA.LONG(A:0xbbe3944) "' name='RPMH_BCM_CD_TH_CD5_CP1'/>"
WRITE #1 "        <register address='0xbbe3948' value='0x" DATA.LONG(A:0xbbe3948) "' name='RPMH_BCM_CD_TH_CD5_CP2'/>"
WRITE #1 "        <register address='0xbbe394c' value='0x" DATA.LONG(A:0xbbe394c) "' name='RPMH_BCM_CD_TH_CD5_CP3'/>"
WRITE #1 "        <register address='0xbbe3950' value='0x" DATA.LONG(A:0xbbe3950) "' name='RPMH_BCM_CD_TH_CD5_CP4'/>"
WRITE #1 "        <register address='0xbbe3954' value='0x" DATA.LONG(A:0xbbe3954) "' name='RPMH_BCM_CD_TH_CD5_CP5'/>"
WRITE #1 "        <register address='0xbbe3958' value='0x" DATA.LONG(A:0xbbe3958) "' name='RPMH_BCM_CD_TH_CD5_CP6'/>"
WRITE #1 "        <register address='0xbbe395c' value='0x" DATA.LONG(A:0xbbe395c) "' name='RPMH_BCM_CD_TH_CD5_CP7'/>"
WRITE #1 "        <register address='0xbbe3980' value='0x" DATA.LONG(A:0xbbe3980) "' name='RPMH_BCM_CD_TH_CD6_CP0'/>"
WRITE #1 "        <register address='0xbbe3984' value='0x" DATA.LONG(A:0xbbe3984) "' name='RPMH_BCM_CD_TH_CD6_CP1'/>"
WRITE #1 "        <register address='0xbbe3988' value='0x" DATA.LONG(A:0xbbe3988) "' name='RPMH_BCM_CD_TH_CD6_CP2'/>"
WRITE #1 "        <register address='0xbbe398c' value='0x" DATA.LONG(A:0xbbe398c) "' name='RPMH_BCM_CD_TH_CD6_CP3'/>"
WRITE #1 "        <register address='0xbbe3990' value='0x" DATA.LONG(A:0xbbe3990) "' name='RPMH_BCM_CD_TH_CD6_CP4'/>"
WRITE #1 "        <register address='0xbbe3994' value='0x" DATA.LONG(A:0xbbe3994) "' name='RPMH_BCM_CD_TH_CD6_CP5'/>"
WRITE #1 "        <register address='0xbbe3998' value='0x" DATA.LONG(A:0xbbe3998) "' name='RPMH_BCM_CD_TH_CD6_CP6'/>"
WRITE #1 "        <register address='0xbbe399c' value='0x" DATA.LONG(A:0xbbe399c) "' name='RPMH_BCM_CD_TH_CD6_CP7'/>"
WRITE #1 "        <register address='0xbbe39a0' value='0x" DATA.LONG(A:0xbbe39a0) "' name='RPMH_BCM_CD_TH_CD6_CP8'/>"
WRITE #1 "        <register address='0xbbe39a4' value='0x" DATA.LONG(A:0xbbe39a4) "' name='RPMH_BCM_CD_TH_CD6_CP9'/>"
WRITE #1 "        <register address='0xbbe39a8' value='0x" DATA.LONG(A:0xbbe39a8) "' name='RPMH_BCM_CD_TH_CD6_CP10'/>"
WRITE #1 "        <register address='0xbbe39ac' value='0x" DATA.LONG(A:0xbbe39ac) "' name='RPMH_BCM_CD_TH_CD6_CP11'/>"
WRITE #1 "        <register address='0xbbe39b0' value='0x" DATA.LONG(A:0xbbe39b0) "' name='RPMH_BCM_CD_TH_CD6_CP12'/>"
WRITE #1 "        <register address='0xbbe39b4' value='0x" DATA.LONG(A:0xbbe39b4) "' name='RPMH_BCM_CD_TH_CD6_CP13'/>"
WRITE #1 "        <register address='0xbbe39b8' value='0x" DATA.LONG(A:0xbbe39b8) "' name='RPMH_BCM_CD_TH_CD6_CP14'/>"
WRITE #1 "        <register address='0xbbe39bc' value='0x" DATA.LONG(A:0xbbe39bc) "' name='RPMH_BCM_CD_TH_CD6_CP15'/>"
WRITE #1 "        <register address='0xbbe39c0' value='0x" DATA.LONG(A:0xbbe39c0) "' name='RPMH_BCM_CD_TH_CD7_CP0'/>"
WRITE #1 "        <register address='0xbbe39c4' value='0x" DATA.LONG(A:0xbbe39c4) "' name='RPMH_BCM_CD_TH_CD7_CP1'/>"
WRITE #1 "        <register address='0xbbe39c8' value='0x" DATA.LONG(A:0xbbe39c8) "' name='RPMH_BCM_CD_TH_CD7_CP2'/>"
WRITE #1 "        <register address='0xbbe39cc' value='0x" DATA.LONG(A:0xbbe39cc) "' name='RPMH_BCM_CD_TH_CD7_CP3'/>"
WRITE #1 "        <register address='0xbbe39d0' value='0x" DATA.LONG(A:0xbbe39d0) "' name='RPMH_BCM_CD_TH_CD7_CP4'/>"
WRITE #1 "        <register address='0xbbe39d4' value='0x" DATA.LONG(A:0xbbe39d4) "' name='RPMH_BCM_CD_TH_CD7_CP5'/>"
WRITE #1 "        <register address='0xbbe39d8' value='0x" DATA.LONG(A:0xbbe39d8) "' name='RPMH_BCM_CD_TH_CD7_CP6'/>"
WRITE #1 "        <register address='0xbbe39dc' value='0x" DATA.LONG(A:0xbbe39dc) "' name='RPMH_BCM_CD_TH_CD7_CP7'/>"
WRITE #1 "        <register address='0xbbe39e0' value='0x" DATA.LONG(A:0xbbe39e0) "' name='RPMH_BCM_CD_TH_CD7_CP8'/>"
WRITE #1 "        <register address='0xbbe39e4' value='0x" DATA.LONG(A:0xbbe39e4) "' name='RPMH_BCM_CD_TH_CD7_CP9'/>"
WRITE #1 "        <register address='0xbbe39e8' value='0x" DATA.LONG(A:0xbbe39e8) "' name='RPMH_BCM_CD_TH_CD7_CP10'/>"
WRITE #1 "        <register address='0xbbe39ec' value='0x" DATA.LONG(A:0xbbe39ec) "' name='RPMH_BCM_CD_TH_CD7_CP11'/>"
WRITE #1 "        <register address='0xbbe39f0' value='0x" DATA.LONG(A:0xbbe39f0) "' name='RPMH_BCM_CD_TH_CD7_CP12'/>"
WRITE #1 "        <register address='0xbbe39f4' value='0x" DATA.LONG(A:0xbbe39f4) "' name='RPMH_BCM_CD_TH_CD7_CP13'/>"
WRITE #1 "        <register address='0xbbe39f8' value='0x" DATA.LONG(A:0xbbe39f8) "' name='RPMH_BCM_CD_TH_CD7_CP14'/>"
WRITE #1 "        <register address='0xbbe39fc' value='0x" DATA.LONG(A:0xbbe39fc) "' name='RPMH_BCM_CD_TH_CD7_CP15'/>"
WRITE #1 "        <register address='0xbbe3a00' value='0x" DATA.LONG(A:0xbbe3a00) "' name='RPMH_BCM_CD_TH_CD8_CP0'/>"
WRITE #1 "        <register address='0xbbe3a04' value='0x" DATA.LONG(A:0xbbe3a04) "' name='RPMH_BCM_CD_TH_CD8_CP1'/>"
WRITE #1 "        <register address='0xbbe3a08' value='0x" DATA.LONG(A:0xbbe3a08) "' name='RPMH_BCM_CD_TH_CD8_CP2'/>"
WRITE #1 "        <register address='0xbbe3a0c' value='0x" DATA.LONG(A:0xbbe3a0c) "' name='RPMH_BCM_CD_TH_CD8_CP3'/>"
WRITE #1 "        <register address='0xbbe3a10' value='0x" DATA.LONG(A:0xbbe3a10) "' name='RPMH_BCM_CD_TH_CD8_CP4'/>"
WRITE #1 "        <register address='0xbbe3a14' value='0x" DATA.LONG(A:0xbbe3a14) "' name='RPMH_BCM_CD_TH_CD8_CP5'/>"
WRITE #1 "        <register address='0xbbe3a18' value='0x" DATA.LONG(A:0xbbe3a18) "' name='RPMH_BCM_CD_TH_CD8_CP6'/>"
WRITE #1 "        <register address='0xbbe3a1c' value='0x" DATA.LONG(A:0xbbe3a1c) "' name='RPMH_BCM_CD_TH_CD8_CP7'/>"
WRITE #1 "        <register address='0xbbe3a20' value='0x" DATA.LONG(A:0xbbe3a20) "' name='RPMH_BCM_CD_TH_CD8_CP8'/>"
WRITE #1 "        <register address='0xbbe3a24' value='0x" DATA.LONG(A:0xbbe3a24) "' name='RPMH_BCM_CD_TH_CD8_CP9'/>"
WRITE #1 "        <register address='0xbbe3a28' value='0x" DATA.LONG(A:0xbbe3a28) "' name='RPMH_BCM_CD_TH_CD8_CP10'/>"
WRITE #1 "        <register address='0xbbe3a2c' value='0x" DATA.LONG(A:0xbbe3a2c) "' name='RPMH_BCM_CD_TH_CD8_CP11'/>"
WRITE #1 "        <register address='0xbbe3a30' value='0x" DATA.LONG(A:0xbbe3a30) "' name='RPMH_BCM_CD_TH_CD8_CP12'/>"
WRITE #1 "        <register address='0xbbe3a34' value='0x" DATA.LONG(A:0xbbe3a34) "' name='RPMH_BCM_CD_TH_CD8_CP13'/>"
WRITE #1 "        <register address='0xbbe3a38' value='0x" DATA.LONG(A:0xbbe3a38) "' name='RPMH_BCM_CD_TH_CD8_CP14'/>"
WRITE #1 "        <register address='0xbbe3a3c' value='0x" DATA.LONG(A:0xbbe3a3c) "' name='RPMH_BCM_CD_TH_CD8_CP15'/>"
WRITE #1 "        <register address='0xbbe3a40' value='0x" DATA.LONG(A:0xbbe3a40) "' name='RPMH_BCM_CD_TH_CD9_CP0'/>"
WRITE #1 "        <register address='0xbbe3a44' value='0x" DATA.LONG(A:0xbbe3a44) "' name='RPMH_BCM_CD_TH_CD9_CP1'/>"
WRITE #1 "        <register address='0xbbe3a48' value='0x" DATA.LONG(A:0xbbe3a48) "' name='RPMH_BCM_CD_TH_CD9_CP2'/>"
WRITE #1 "        <register address='0xbbe3a4c' value='0x" DATA.LONG(A:0xbbe3a4c) "' name='RPMH_BCM_CD_TH_CD9_CP3'/>"
WRITE #1 "        <register address='0xbbe3a50' value='0x" DATA.LONG(A:0xbbe3a50) "' name='RPMH_BCM_CD_TH_CD9_CP4'/>"
WRITE #1 "        <register address='0xbbe3a54' value='0x" DATA.LONG(A:0xbbe3a54) "' name='RPMH_BCM_CD_TH_CD9_CP5'/>"
WRITE #1 "        <register address='0xbbe3a58' value='0x" DATA.LONG(A:0xbbe3a58) "' name='RPMH_BCM_CD_TH_CD9_CP6'/>"
WRITE #1 "        <register address='0xbbe3a5c' value='0x" DATA.LONG(A:0xbbe3a5c) "' name='RPMH_BCM_CD_TH_CD9_CP7'/>"
WRITE #1 "        <register address='0xbbe3a80' value='0x" DATA.LONG(A:0xbbe3a80) "' name='RPMH_BCM_CD_TH_CD10_CP0'/>"
WRITE #1 "        <register address='0xbbe3a84' value='0x" DATA.LONG(A:0xbbe3a84) "' name='RPMH_BCM_CD_TH_CD10_CP1'/>"
WRITE #1 "        <register address='0xbbe3a88' value='0x" DATA.LONG(A:0xbbe3a88) "' name='RPMH_BCM_CD_TH_CD10_CP2'/>"
WRITE #1 "        <register address='0xbbe3a8c' value='0x" DATA.LONG(A:0xbbe3a8c) "' name='RPMH_BCM_CD_TH_CD10_CP3'/>"
WRITE #1 "        <register address='0xbbe3a90' value='0x" DATA.LONG(A:0xbbe3a90) "' name='RPMH_BCM_CD_TH_CD10_CP4'/>"
WRITE #1 "        <register address='0xbbe3a94' value='0x" DATA.LONG(A:0xbbe3a94) "' name='RPMH_BCM_CD_TH_CD10_CP5'/>"
WRITE #1 "        <register address='0xbbe3a98' value='0x" DATA.LONG(A:0xbbe3a98) "' name='RPMH_BCM_CD_TH_CD10_CP6'/>"
WRITE #1 "        <register address='0xbbe3a9c' value='0x" DATA.LONG(A:0xbbe3a9c) "' name='RPMH_BCM_CD_TH_CD10_CP7'/>"
WRITE #1 "        <register address='0xbbe3ac0' value='0x" DATA.LONG(A:0xbbe3ac0) "' name='RPMH_BCM_CD_TH_CD11_CP0'/>"
WRITE #1 "        <register address='0xbbe3ac4' value='0x" DATA.LONG(A:0xbbe3ac4) "' name='RPMH_BCM_CD_TH_CD11_CP1'/>"
WRITE #1 "        <register address='0xbbe3ac8' value='0x" DATA.LONG(A:0xbbe3ac8) "' name='RPMH_BCM_CD_TH_CD11_CP2'/>"
WRITE #1 "        <register address='0xbbe3acc' value='0x" DATA.LONG(A:0xbbe3acc) "' name='RPMH_BCM_CD_TH_CD11_CP3'/>"
WRITE #1 "        <register address='0xbbe3ad0' value='0x" DATA.LONG(A:0xbbe3ad0) "' name='RPMH_BCM_CD_TH_CD11_CP4'/>"
WRITE #1 "        <register address='0xbbe3ad4' value='0x" DATA.LONG(A:0xbbe3ad4) "' name='RPMH_BCM_CD_TH_CD11_CP5'/>"
WRITE #1 "        <register address='0xbbe3ad8' value='0x" DATA.LONG(A:0xbbe3ad8) "' name='RPMH_BCM_CD_TH_CD11_CP6'/>"
WRITE #1 "        <register address='0xbbe3adc' value='0x" DATA.LONG(A:0xbbe3adc) "' name='RPMH_BCM_CD_TH_CD11_CP7'/>"
WRITE #1 "        <register address='0xbbe3ae0' value='0x" DATA.LONG(A:0xbbe3ae0) "' name='RPMH_BCM_CD_TH_CD11_CP8'/>"
WRITE #1 "        <register address='0xbbe3ae4' value='0x" DATA.LONG(A:0xbbe3ae4) "' name='RPMH_BCM_CD_TH_CD11_CP9'/>"
WRITE #1 "        <register address='0xbbe3ae8' value='0x" DATA.LONG(A:0xbbe3ae8) "' name='RPMH_BCM_CD_TH_CD11_CP10'/>"
WRITE #1 "        <register address='0xbbe3aec' value='0x" DATA.LONG(A:0xbbe3aec) "' name='RPMH_BCM_CD_TH_CD11_CP11'/>"
WRITE #1 "        <register address='0xbbe3af0' value='0x" DATA.LONG(A:0xbbe3af0) "' name='RPMH_BCM_CD_TH_CD11_CP12'/>"
WRITE #1 "        <register address='0xbbe3af4' value='0x" DATA.LONG(A:0xbbe3af4) "' name='RPMH_BCM_CD_TH_CD11_CP13'/>"
WRITE #1 "        <register address='0xbbe3af8' value='0x" DATA.LONG(A:0xbbe3af8) "' name='RPMH_BCM_CD_TH_CD11_CP14'/>"
WRITE #1 "        <register address='0xbbe3afc' value='0x" DATA.LONG(A:0xbbe3afc) "' name='RPMH_BCM_CD_TH_CD11_CP15'/>"
WRITE #1 "        <register address='0xbbe4080' value='0x" DATA.LONG(A:0xbbe4080) "' name='RPMH_BCM_SEQ_CFG_HW_START_ADDR_CD0'/>"
WRITE #1 "        <register address='0xbbe4084' value='0x" DATA.LONG(A:0xbbe4084) "' name='RPMH_BCM_SEQ_CFG_HW_START_ADDR_CD1'/>"
WRITE #1 "        <register address='0xbbe4088' value='0x" DATA.LONG(A:0xbbe4088) "' name='RPMH_BCM_SEQ_CFG_HW_START_ADDR_CD2'/>"
WRITE #1 "        <register address='0xbbe408c' value='0x" DATA.LONG(A:0xbbe408c) "' name='RPMH_BCM_SEQ_CFG_HW_START_ADDR_CD3'/>"
WRITE #1 "        <register address='0xbbe4090' value='0x" DATA.LONG(A:0xbbe4090) "' name='RPMH_BCM_SEQ_CFG_HW_START_ADDR_CD4'/>"
WRITE #1 "        <register address='0xbbe4094' value='0x" DATA.LONG(A:0xbbe4094) "' name='RPMH_BCM_SEQ_CFG_HW_START_ADDR_CD5'/>"
WRITE #1 "        <register address='0xbbe4098' value='0x" DATA.LONG(A:0xbbe4098) "' name='RPMH_BCM_SEQ_CFG_HW_START_ADDR_CD6'/>"
WRITE #1 "        <register address='0xbbe409c' value='0x" DATA.LONG(A:0xbbe409c) "' name='RPMH_BCM_SEQ_CFG_HW_START_ADDR_CD7'/>"
WRITE #1 "        <register address='0xbbe40a0' value='0x" DATA.LONG(A:0xbbe40a0) "' name='RPMH_BCM_SEQ_CFG_HW_START_ADDR_CD8'/>"
WRITE #1 "        <register address='0xbbe40a4' value='0x" DATA.LONG(A:0xbbe40a4) "' name='RPMH_BCM_SEQ_CFG_HW_START_ADDR_CD9'/>"
WRITE #1 "        <register address='0xbbe40a8' value='0x" DATA.LONG(A:0xbbe40a8) "' name='RPMH_BCM_SEQ_CFG_HW_START_ADDR_CD10'/>"
WRITE #1 "        <register address='0xbbe40ac' value='0x" DATA.LONG(A:0xbbe40ac) "' name='RPMH_BCM_SEQ_CFG_HW_START_ADDR_CD11'/>"
WRITE #1 "        <register address='0xbbe4100' value='0x" DATA.LONG(A:0xbbe4100) "' name='RPMH_BCM_SEQ_CFG_SW_START_ADDR_CD0'/>"
WRITE #1 "        <register address='0xbbe4104' value='0x" DATA.LONG(A:0xbbe4104) "' name='RPMH_BCM_SEQ_CFG_SW_START_ADDR_CD1'/>"
WRITE #1 "        <register address='0xbbe4108' value='0x" DATA.LONG(A:0xbbe4108) "' name='RPMH_BCM_SEQ_CFG_SW_START_ADDR_CD2'/>"
WRITE #1 "        <register address='0xbbe410c' value='0x" DATA.LONG(A:0xbbe410c) "' name='RPMH_BCM_SEQ_CFG_SW_START_ADDR_CD3'/>"
WRITE #1 "        <register address='0xbbe4110' value='0x" DATA.LONG(A:0xbbe4110) "' name='RPMH_BCM_SEQ_CFG_SW_START_ADDR_CD4'/>"
WRITE #1 "        <register address='0xbbe4114' value='0x" DATA.LONG(A:0xbbe4114) "' name='RPMH_BCM_SEQ_CFG_SW_START_ADDR_CD5'/>"
WRITE #1 "        <register address='0xbbe4118' value='0x" DATA.LONG(A:0xbbe4118) "' name='RPMH_BCM_SEQ_CFG_SW_START_ADDR_CD6'/>"
WRITE #1 "        <register address='0xbbe411c' value='0x" DATA.LONG(A:0xbbe411c) "' name='RPMH_BCM_SEQ_CFG_SW_START_ADDR_CD7'/>"
WRITE #1 "        <register address='0xbbe4120' value='0x" DATA.LONG(A:0xbbe4120) "' name='RPMH_BCM_SEQ_CFG_SW_START_ADDR_CD8'/>"
WRITE #1 "        <register address='0xbbe4124' value='0x" DATA.LONG(A:0xbbe4124) "' name='RPMH_BCM_SEQ_CFG_SW_START_ADDR_CD9'/>"
WRITE #1 "        <register address='0xbbe4128' value='0x" DATA.LONG(A:0xbbe4128) "' name='RPMH_BCM_SEQ_CFG_SW_START_ADDR_CD10'/>"
WRITE #1 "        <register address='0xbbe412c' value='0x" DATA.LONG(A:0xbbe412c) "' name='RPMH_BCM_SEQ_CFG_SW_START_ADDR_CD11'/>"
WRITE #1 "        <register address='0xbbe4180' value='0x" DATA.LONG(A:0xbbe4180) "' name='RPMH_BCM_SEQ_CFG_BRANCH_ADDR_CD0_BR0'/>"
WRITE #1 "        <register address='0xbbe4184' value='0x" DATA.LONG(A:0xbbe4184) "' name='RPMH_BCM_SEQ_CFG_BRANCH_ADDR_CD0_BR1'/>"
WRITE #1 "        <register address='0xbbe4188' value='0x" DATA.LONG(A:0xbbe4188) "' name='RPMH_BCM_SEQ_CFG_BRANCH_ADDR_CD0_BR2'/>"
WRITE #1 "        <register address='0xbbe418c' value='0x" DATA.LONG(A:0xbbe418c) "' name='RPMH_BCM_SEQ_CFG_BRANCH_ADDR_CD0_BR3'/>"
WRITE #1 "        <register address='0xbbe4190' value='0x" DATA.LONG(A:0xbbe4190) "' name='RPMH_BCM_SEQ_CFG_BRANCH_ADDR_CD0_BR4'/>"
WRITE #1 "        <register address='0xbbe4194' value='0x" DATA.LONG(A:0xbbe4194) "' name='RPMH_BCM_SEQ_CFG_BRANCH_ADDR_CD0_BR5'/>"
WRITE #1 "        <register address='0xbbe4198' value='0x" DATA.LONG(A:0xbbe4198) "' name='RPMH_BCM_SEQ_CFG_BRANCH_ADDR_CD0_BR6'/>"
WRITE #1 "        <register address='0xbbe419c' value='0x" DATA.LONG(A:0xbbe419c) "' name='RPMH_BCM_SEQ_CFG_BRANCH_ADDR_CD0_BR7'/>"
WRITE #1 "        <register address='0xbbe41a0' value='0x" DATA.LONG(A:0xbbe41a0) "' name='RPMH_BCM_SEQ_CFG_BRANCH_ADDR_CD0_BR8'/>"
WRITE #1 "        <register address='0xbbe41a4' value='0x" DATA.LONG(A:0xbbe41a4) "' name='RPMH_BCM_SEQ_CFG_BRANCH_ADDR_CD0_BR9'/>"
WRITE #1 "        <register address='0xbbe41a8' value='0x" DATA.LONG(A:0xbbe41a8) "' name='RPMH_BCM_SEQ_CFG_BRANCH_ADDR_CD0_BR10'/>"
WRITE #1 "        <register address='0xbbe41ac' value='0x" DATA.LONG(A:0xbbe41ac) "' name='RPMH_BCM_SEQ_CFG_BRANCH_ADDR_CD0_BR11'/>"
WRITE #1 "        <register address='0xbbe41b0' value='0x" DATA.LONG(A:0xbbe41b0) "' name='RPMH_BCM_SEQ_CFG_BRANCH_ADDR_CD0_BR12'/>"
WRITE #1 "        <register address='0xbbe41b4' value='0x" DATA.LONG(A:0xbbe41b4) "' name='RPMH_BCM_SEQ_CFG_BRANCH_ADDR_CD0_BR13'/>"
WRITE #1 "        <register address='0xbbe41b8' value='0x" DATA.LONG(A:0xbbe41b8) "' name='RPMH_BCM_SEQ_CFG_BRANCH_ADDR_CD0_BR14'/>"
WRITE #1 "        <register address='0xbbe41bc' value='0x" DATA.LONG(A:0xbbe41bc) "' name='RPMH_BCM_SEQ_CFG_BRANCH_ADDR_CD0_BR15'/>"
WRITE #1 "        <register address='0xbbe41c0' value='0x" DATA.LONG(A:0xbbe41c0) "' name='RPMH_BCM_SEQ_CFG_BRANCH_ADDR_CD1_BR0'/>"
WRITE #1 "        <register address='0xbbe41c4' value='0x" DATA.LONG(A:0xbbe41c4) "' name='RPMH_BCM_SEQ_CFG_BRANCH_ADDR_CD1_BR1'/>"
WRITE #1 "        <register address='0xbbe41c8' value='0x" DATA.LONG(A:0xbbe41c8) "' name='RPMH_BCM_SEQ_CFG_BRANCH_ADDR_CD1_BR2'/>"
WRITE #1 "        <register address='0xbbe41cc' value='0x" DATA.LONG(A:0xbbe41cc) "' name='RPMH_BCM_SEQ_CFG_BRANCH_ADDR_CD1_BR3'/>"
WRITE #1 "        <register address='0xbbe41d0' value='0x" DATA.LONG(A:0xbbe41d0) "' name='RPMH_BCM_SEQ_CFG_BRANCH_ADDR_CD1_BR4'/>"
WRITE #1 "        <register address='0xbbe41d4' value='0x" DATA.LONG(A:0xbbe41d4) "' name='RPMH_BCM_SEQ_CFG_BRANCH_ADDR_CD1_BR5'/>"
WRITE #1 "        <register address='0xbbe41d8' value='0x" DATA.LONG(A:0xbbe41d8) "' name='RPMH_BCM_SEQ_CFG_BRANCH_ADDR_CD1_BR6'/>"
WRITE #1 "        <register address='0xbbe41dc' value='0x" DATA.LONG(A:0xbbe41dc) "' name='RPMH_BCM_SEQ_CFG_BRANCH_ADDR_CD1_BR7'/>"
WRITE #1 "        <register address='0xbbe41e0' value='0x" DATA.LONG(A:0xbbe41e0) "' name='RPMH_BCM_SEQ_CFG_BRANCH_ADDR_CD1_BR8'/>"
WRITE #1 "        <register address='0xbbe41e4' value='0x" DATA.LONG(A:0xbbe41e4) "' name='RPMH_BCM_SEQ_CFG_BRANCH_ADDR_CD1_BR9'/>"
WRITE #1 "        <register address='0xbbe41e8' value='0x" DATA.LONG(A:0xbbe41e8) "' name='RPMH_BCM_SEQ_CFG_BRANCH_ADDR_CD1_BR10'/>"
WRITE #1 "        <register address='0xbbe41ec' value='0x" DATA.LONG(A:0xbbe41ec) "' name='RPMH_BCM_SEQ_CFG_BRANCH_ADDR_CD1_BR11'/>"
WRITE #1 "        <register address='0xbbe41f0' value='0x" DATA.LONG(A:0xbbe41f0) "' name='RPMH_BCM_SEQ_CFG_BRANCH_ADDR_CD1_BR12'/>"
WRITE #1 "        <register address='0xbbe41f4' value='0x" DATA.LONG(A:0xbbe41f4) "' name='RPMH_BCM_SEQ_CFG_BRANCH_ADDR_CD1_BR13'/>"
WRITE #1 "        <register address='0xbbe41f8' value='0x" DATA.LONG(A:0xbbe41f8) "' name='RPMH_BCM_SEQ_CFG_BRANCH_ADDR_CD1_BR14'/>"
WRITE #1 "        <register address='0xbbe41fc' value='0x" DATA.LONG(A:0xbbe41fc) "' name='RPMH_BCM_SEQ_CFG_BRANCH_ADDR_CD1_BR15'/>"
WRITE #1 "        <register address='0xbbe4200' value='0x" DATA.LONG(A:0xbbe4200) "' name='RPMH_BCM_SEQ_CFG_BRANCH_ADDR_CD2_BR0'/>"
WRITE #1 "        <register address='0xbbe4204' value='0x" DATA.LONG(A:0xbbe4204) "' name='RPMH_BCM_SEQ_CFG_BRANCH_ADDR_CD2_BR1'/>"
WRITE #1 "        <register address='0xbbe4208' value='0x" DATA.LONG(A:0xbbe4208) "' name='RPMH_BCM_SEQ_CFG_BRANCH_ADDR_CD2_BR2'/>"
WRITE #1 "        <register address='0xbbe420c' value='0x" DATA.LONG(A:0xbbe420c) "' name='RPMH_BCM_SEQ_CFG_BRANCH_ADDR_CD2_BR3'/>"
WRITE #1 "        <register address='0xbbe4210' value='0x" DATA.LONG(A:0xbbe4210) "' name='RPMH_BCM_SEQ_CFG_BRANCH_ADDR_CD2_BR4'/>"
WRITE #1 "        <register address='0xbbe4214' value='0x" DATA.LONG(A:0xbbe4214) "' name='RPMH_BCM_SEQ_CFG_BRANCH_ADDR_CD2_BR5'/>"
WRITE #1 "        <register address='0xbbe4218' value='0x" DATA.LONG(A:0xbbe4218) "' name='RPMH_BCM_SEQ_CFG_BRANCH_ADDR_CD2_BR6'/>"
WRITE #1 "        <register address='0xbbe421c' value='0x" DATA.LONG(A:0xbbe421c) "' name='RPMH_BCM_SEQ_CFG_BRANCH_ADDR_CD2_BR7'/>"
WRITE #1 "        <register address='0xbbe4220' value='0x" DATA.LONG(A:0xbbe4220) "' name='RPMH_BCM_SEQ_CFG_BRANCH_ADDR_CD2_BR8'/>"
WRITE #1 "        <register address='0xbbe4224' value='0x" DATA.LONG(A:0xbbe4224) "' name='RPMH_BCM_SEQ_CFG_BRANCH_ADDR_CD2_BR9'/>"
WRITE #1 "        <register address='0xbbe4228' value='0x" DATA.LONG(A:0xbbe4228) "' name='RPMH_BCM_SEQ_CFG_BRANCH_ADDR_CD2_BR10'/>"
WRITE #1 "        <register address='0xbbe422c' value='0x" DATA.LONG(A:0xbbe422c) "' name='RPMH_BCM_SEQ_CFG_BRANCH_ADDR_CD2_BR11'/>"
WRITE #1 "        <register address='0xbbe4230' value='0x" DATA.LONG(A:0xbbe4230) "' name='RPMH_BCM_SEQ_CFG_BRANCH_ADDR_CD2_BR12'/>"
WRITE #1 "        <register address='0xbbe4234' value='0x" DATA.LONG(A:0xbbe4234) "' name='RPMH_BCM_SEQ_CFG_BRANCH_ADDR_CD2_BR13'/>"
WRITE #1 "        <register address='0xbbe4238' value='0x" DATA.LONG(A:0xbbe4238) "' name='RPMH_BCM_SEQ_CFG_BRANCH_ADDR_CD2_BR14'/>"
WRITE #1 "        <register address='0xbbe423c' value='0x" DATA.LONG(A:0xbbe423c) "' name='RPMH_BCM_SEQ_CFG_BRANCH_ADDR_CD2_BR15'/>"
WRITE #1 "        <register address='0xbbe4240' value='0x" DATA.LONG(A:0xbbe4240) "' name='RPMH_BCM_SEQ_CFG_BRANCH_ADDR_CD3_BR0'/>"
WRITE #1 "        <register address='0xbbe4244' value='0x" DATA.LONG(A:0xbbe4244) "' name='RPMH_BCM_SEQ_CFG_BRANCH_ADDR_CD3_BR1'/>"
WRITE #1 "        <register address='0xbbe4248' value='0x" DATA.LONG(A:0xbbe4248) "' name='RPMH_BCM_SEQ_CFG_BRANCH_ADDR_CD3_BR2'/>"
WRITE #1 "        <register address='0xbbe424c' value='0x" DATA.LONG(A:0xbbe424c) "' name='RPMH_BCM_SEQ_CFG_BRANCH_ADDR_CD3_BR3'/>"
WRITE #1 "        <register address='0xbbe4250' value='0x" DATA.LONG(A:0xbbe4250) "' name='RPMH_BCM_SEQ_CFG_BRANCH_ADDR_CD3_BR4'/>"
WRITE #1 "        <register address='0xbbe4254' value='0x" DATA.LONG(A:0xbbe4254) "' name='RPMH_BCM_SEQ_CFG_BRANCH_ADDR_CD3_BR5'/>"
WRITE #1 "        <register address='0xbbe4258' value='0x" DATA.LONG(A:0xbbe4258) "' name='RPMH_BCM_SEQ_CFG_BRANCH_ADDR_CD3_BR6'/>"
WRITE #1 "        <register address='0xbbe425c' value='0x" DATA.LONG(A:0xbbe425c) "' name='RPMH_BCM_SEQ_CFG_BRANCH_ADDR_CD3_BR7'/>"
WRITE #1 "        <register address='0xbbe4260' value='0x" DATA.LONG(A:0xbbe4260) "' name='RPMH_BCM_SEQ_CFG_BRANCH_ADDR_CD3_BR8'/>"
WRITE #1 "        <register address='0xbbe4264' value='0x" DATA.LONG(A:0xbbe4264) "' name='RPMH_BCM_SEQ_CFG_BRANCH_ADDR_CD3_BR9'/>"
WRITE #1 "        <register address='0xbbe4268' value='0x" DATA.LONG(A:0xbbe4268) "' name='RPMH_BCM_SEQ_CFG_BRANCH_ADDR_CD3_BR10'/>"
WRITE #1 "        <register address='0xbbe426c' value='0x" DATA.LONG(A:0xbbe426c) "' name='RPMH_BCM_SEQ_CFG_BRANCH_ADDR_CD3_BR11'/>"
WRITE #1 "        <register address='0xbbe4270' value='0x" DATA.LONG(A:0xbbe4270) "' name='RPMH_BCM_SEQ_CFG_BRANCH_ADDR_CD3_BR12'/>"
WRITE #1 "        <register address='0xbbe4274' value='0x" DATA.LONG(A:0xbbe4274) "' name='RPMH_BCM_SEQ_CFG_BRANCH_ADDR_CD3_BR13'/>"
WRITE #1 "        <register address='0xbbe4278' value='0x" DATA.LONG(A:0xbbe4278) "' name='RPMH_BCM_SEQ_CFG_BRANCH_ADDR_CD3_BR14'/>"
WRITE #1 "        <register address='0xbbe427c' value='0x" DATA.LONG(A:0xbbe427c) "' name='RPMH_BCM_SEQ_CFG_BRANCH_ADDR_CD3_BR15'/>"
WRITE #1 "        <register address='0xbbe4280' value='0x" DATA.LONG(A:0xbbe4280) "' name='RPMH_BCM_SEQ_CFG_BRANCH_ADDR_CD4_BR0'/>"
WRITE #1 "        <register address='0xbbe4284' value='0x" DATA.LONG(A:0xbbe4284) "' name='RPMH_BCM_SEQ_CFG_BRANCH_ADDR_CD4_BR1'/>"
WRITE #1 "        <register address='0xbbe4288' value='0x" DATA.LONG(A:0xbbe4288) "' name='RPMH_BCM_SEQ_CFG_BRANCH_ADDR_CD4_BR2'/>"
WRITE #1 "        <register address='0xbbe428c' value='0x" DATA.LONG(A:0xbbe428c) "' name='RPMH_BCM_SEQ_CFG_BRANCH_ADDR_CD4_BR3'/>"
WRITE #1 "        <register address='0xbbe4290' value='0x" DATA.LONG(A:0xbbe4290) "' name='RPMH_BCM_SEQ_CFG_BRANCH_ADDR_CD4_BR4'/>"
WRITE #1 "        <register address='0xbbe4294' value='0x" DATA.LONG(A:0xbbe4294) "' name='RPMH_BCM_SEQ_CFG_BRANCH_ADDR_CD4_BR5'/>"
WRITE #1 "        <register address='0xbbe4298' value='0x" DATA.LONG(A:0xbbe4298) "' name='RPMH_BCM_SEQ_CFG_BRANCH_ADDR_CD4_BR6'/>"
WRITE #1 "        <register address='0xbbe429c' value='0x" DATA.LONG(A:0xbbe429c) "' name='RPMH_BCM_SEQ_CFG_BRANCH_ADDR_CD4_BR7'/>"
WRITE #1 "        <register address='0xbbe42a0' value='0x" DATA.LONG(A:0xbbe42a0) "' name='RPMH_BCM_SEQ_CFG_BRANCH_ADDR_CD4_BR8'/>"
WRITE #1 "        <register address='0xbbe42a4' value='0x" DATA.LONG(A:0xbbe42a4) "' name='RPMH_BCM_SEQ_CFG_BRANCH_ADDR_CD4_BR9'/>"
WRITE #1 "        <register address='0xbbe42a8' value='0x" DATA.LONG(A:0xbbe42a8) "' name='RPMH_BCM_SEQ_CFG_BRANCH_ADDR_CD4_BR10'/>"
WRITE #1 "        <register address='0xbbe42ac' value='0x" DATA.LONG(A:0xbbe42ac) "' name='RPMH_BCM_SEQ_CFG_BRANCH_ADDR_CD4_BR11'/>"
WRITE #1 "        <register address='0xbbe42b0' value='0x" DATA.LONG(A:0xbbe42b0) "' name='RPMH_BCM_SEQ_CFG_BRANCH_ADDR_CD4_BR12'/>"
WRITE #1 "        <register address='0xbbe42b4' value='0x" DATA.LONG(A:0xbbe42b4) "' name='RPMH_BCM_SEQ_CFG_BRANCH_ADDR_CD4_BR13'/>"
WRITE #1 "        <register address='0xbbe42b8' value='0x" DATA.LONG(A:0xbbe42b8) "' name='RPMH_BCM_SEQ_CFG_BRANCH_ADDR_CD4_BR14'/>"
WRITE #1 "        <register address='0xbbe42bc' value='0x" DATA.LONG(A:0xbbe42bc) "' name='RPMH_BCM_SEQ_CFG_BRANCH_ADDR_CD4_BR15'/>"
WRITE #1 "        <register address='0xbbe42c0' value='0x" DATA.LONG(A:0xbbe42c0) "' name='RPMH_BCM_SEQ_CFG_BRANCH_ADDR_CD5_BR0'/>"
WRITE #1 "        <register address='0xbbe42c4' value='0x" DATA.LONG(A:0xbbe42c4) "' name='RPMH_BCM_SEQ_CFG_BRANCH_ADDR_CD5_BR1'/>"
WRITE #1 "        <register address='0xbbe42c8' value='0x" DATA.LONG(A:0xbbe42c8) "' name='RPMH_BCM_SEQ_CFG_BRANCH_ADDR_CD5_BR2'/>"
WRITE #1 "        <register address='0xbbe42cc' value='0x" DATA.LONG(A:0xbbe42cc) "' name='RPMH_BCM_SEQ_CFG_BRANCH_ADDR_CD5_BR3'/>"
WRITE #1 "        <register address='0xbbe42d0' value='0x" DATA.LONG(A:0xbbe42d0) "' name='RPMH_BCM_SEQ_CFG_BRANCH_ADDR_CD5_BR4'/>"
WRITE #1 "        <register address='0xbbe42d4' value='0x" DATA.LONG(A:0xbbe42d4) "' name='RPMH_BCM_SEQ_CFG_BRANCH_ADDR_CD5_BR5'/>"
WRITE #1 "        <register address='0xbbe42d8' value='0x" DATA.LONG(A:0xbbe42d8) "' name='RPMH_BCM_SEQ_CFG_BRANCH_ADDR_CD5_BR6'/>"
WRITE #1 "        <register address='0xbbe42dc' value='0x" DATA.LONG(A:0xbbe42dc) "' name='RPMH_BCM_SEQ_CFG_BRANCH_ADDR_CD5_BR7'/>"
WRITE #1 "        <register address='0xbbe42e0' value='0x" DATA.LONG(A:0xbbe42e0) "' name='RPMH_BCM_SEQ_CFG_BRANCH_ADDR_CD5_BR8'/>"
WRITE #1 "        <register address='0xbbe42e4' value='0x" DATA.LONG(A:0xbbe42e4) "' name='RPMH_BCM_SEQ_CFG_BRANCH_ADDR_CD5_BR9'/>"
WRITE #1 "        <register address='0xbbe42e8' value='0x" DATA.LONG(A:0xbbe42e8) "' name='RPMH_BCM_SEQ_CFG_BRANCH_ADDR_CD5_BR10'/>"
WRITE #1 "        <register address='0xbbe42ec' value='0x" DATA.LONG(A:0xbbe42ec) "' name='RPMH_BCM_SEQ_CFG_BRANCH_ADDR_CD5_BR11'/>"
WRITE #1 "        <register address='0xbbe42f0' value='0x" DATA.LONG(A:0xbbe42f0) "' name='RPMH_BCM_SEQ_CFG_BRANCH_ADDR_CD5_BR12'/>"
WRITE #1 "        <register address='0xbbe42f4' value='0x" DATA.LONG(A:0xbbe42f4) "' name='RPMH_BCM_SEQ_CFG_BRANCH_ADDR_CD5_BR13'/>"
WRITE #1 "        <register address='0xbbe42f8' value='0x" DATA.LONG(A:0xbbe42f8) "' name='RPMH_BCM_SEQ_CFG_BRANCH_ADDR_CD5_BR14'/>"
WRITE #1 "        <register address='0xbbe42fc' value='0x" DATA.LONG(A:0xbbe42fc) "' name='RPMH_BCM_SEQ_CFG_BRANCH_ADDR_CD5_BR15'/>"
WRITE #1 "        <register address='0xbbe4300' value='0x" DATA.LONG(A:0xbbe4300) "' name='RPMH_BCM_SEQ_CFG_BRANCH_ADDR_CD6_BR0'/>"
WRITE #1 "        <register address='0xbbe4304' value='0x" DATA.LONG(A:0xbbe4304) "' name='RPMH_BCM_SEQ_CFG_BRANCH_ADDR_CD6_BR1'/>"
WRITE #1 "        <register address='0xbbe4308' value='0x" DATA.LONG(A:0xbbe4308) "' name='RPMH_BCM_SEQ_CFG_BRANCH_ADDR_CD6_BR2'/>"
WRITE #1 "        <register address='0xbbe430c' value='0x" DATA.LONG(A:0xbbe430c) "' name='RPMH_BCM_SEQ_CFG_BRANCH_ADDR_CD6_BR3'/>"
WRITE #1 "        <register address='0xbbe4310' value='0x" DATA.LONG(A:0xbbe4310) "' name='RPMH_BCM_SEQ_CFG_BRANCH_ADDR_CD6_BR4'/>"
WRITE #1 "        <register address='0xbbe4314' value='0x" DATA.LONG(A:0xbbe4314) "' name='RPMH_BCM_SEQ_CFG_BRANCH_ADDR_CD6_BR5'/>"
WRITE #1 "        <register address='0xbbe4318' value='0x" DATA.LONG(A:0xbbe4318) "' name='RPMH_BCM_SEQ_CFG_BRANCH_ADDR_CD6_BR6'/>"
WRITE #1 "        <register address='0xbbe431c' value='0x" DATA.LONG(A:0xbbe431c) "' name='RPMH_BCM_SEQ_CFG_BRANCH_ADDR_CD6_BR7'/>"
WRITE #1 "        <register address='0xbbe4320' value='0x" DATA.LONG(A:0xbbe4320) "' name='RPMH_BCM_SEQ_CFG_BRANCH_ADDR_CD6_BR8'/>"
WRITE #1 "        <register address='0xbbe4324' value='0x" DATA.LONG(A:0xbbe4324) "' name='RPMH_BCM_SEQ_CFG_BRANCH_ADDR_CD6_BR9'/>"
WRITE #1 "        <register address='0xbbe4328' value='0x" DATA.LONG(A:0xbbe4328) "' name='RPMH_BCM_SEQ_CFG_BRANCH_ADDR_CD6_BR10'/>"
WRITE #1 "        <register address='0xbbe432c' value='0x" DATA.LONG(A:0xbbe432c) "' name='RPMH_BCM_SEQ_CFG_BRANCH_ADDR_CD6_BR11'/>"
WRITE #1 "        <register address='0xbbe4330' value='0x" DATA.LONG(A:0xbbe4330) "' name='RPMH_BCM_SEQ_CFG_BRANCH_ADDR_CD6_BR12'/>"
WRITE #1 "        <register address='0xbbe4334' value='0x" DATA.LONG(A:0xbbe4334) "' name='RPMH_BCM_SEQ_CFG_BRANCH_ADDR_CD6_BR13'/>"
WRITE #1 "        <register address='0xbbe4338' value='0x" DATA.LONG(A:0xbbe4338) "' name='RPMH_BCM_SEQ_CFG_BRANCH_ADDR_CD6_BR14'/>"
WRITE #1 "        <register address='0xbbe433c' value='0x" DATA.LONG(A:0xbbe433c) "' name='RPMH_BCM_SEQ_CFG_BRANCH_ADDR_CD6_BR15'/>"
WRITE #1 "        <register address='0xbbe4340' value='0x" DATA.LONG(A:0xbbe4340) "' name='RPMH_BCM_SEQ_CFG_BRANCH_ADDR_CD7_BR0'/>"
WRITE #1 "        <register address='0xbbe4344' value='0x" DATA.LONG(A:0xbbe4344) "' name='RPMH_BCM_SEQ_CFG_BRANCH_ADDR_CD7_BR1'/>"
WRITE #1 "        <register address='0xbbe4348' value='0x" DATA.LONG(A:0xbbe4348) "' name='RPMH_BCM_SEQ_CFG_BRANCH_ADDR_CD7_BR2'/>"
WRITE #1 "        <register address='0xbbe434c' value='0x" DATA.LONG(A:0xbbe434c) "' name='RPMH_BCM_SEQ_CFG_BRANCH_ADDR_CD7_BR3'/>"
WRITE #1 "        <register address='0xbbe4350' value='0x" DATA.LONG(A:0xbbe4350) "' name='RPMH_BCM_SEQ_CFG_BRANCH_ADDR_CD7_BR4'/>"
WRITE #1 "        <register address='0xbbe4354' value='0x" DATA.LONG(A:0xbbe4354) "' name='RPMH_BCM_SEQ_CFG_BRANCH_ADDR_CD7_BR5'/>"
WRITE #1 "        <register address='0xbbe4358' value='0x" DATA.LONG(A:0xbbe4358) "' name='RPMH_BCM_SEQ_CFG_BRANCH_ADDR_CD7_BR6'/>"
WRITE #1 "        <register address='0xbbe435c' value='0x" DATA.LONG(A:0xbbe435c) "' name='RPMH_BCM_SEQ_CFG_BRANCH_ADDR_CD7_BR7'/>"
WRITE #1 "        <register address='0xbbe4360' value='0x" DATA.LONG(A:0xbbe4360) "' name='RPMH_BCM_SEQ_CFG_BRANCH_ADDR_CD7_BR8'/>"
WRITE #1 "        <register address='0xbbe4364' value='0x" DATA.LONG(A:0xbbe4364) "' name='RPMH_BCM_SEQ_CFG_BRANCH_ADDR_CD7_BR9'/>"
WRITE #1 "        <register address='0xbbe4368' value='0x" DATA.LONG(A:0xbbe4368) "' name='RPMH_BCM_SEQ_CFG_BRANCH_ADDR_CD7_BR10'/>"
WRITE #1 "        <register address='0xbbe436c' value='0x" DATA.LONG(A:0xbbe436c) "' name='RPMH_BCM_SEQ_CFG_BRANCH_ADDR_CD7_BR11'/>"
WRITE #1 "        <register address='0xbbe4370' value='0x" DATA.LONG(A:0xbbe4370) "' name='RPMH_BCM_SEQ_CFG_BRANCH_ADDR_CD7_BR12'/>"
WRITE #1 "        <register address='0xbbe4374' value='0x" DATA.LONG(A:0xbbe4374) "' name='RPMH_BCM_SEQ_CFG_BRANCH_ADDR_CD7_BR13'/>"
WRITE #1 "        <register address='0xbbe4378' value='0x" DATA.LONG(A:0xbbe4378) "' name='RPMH_BCM_SEQ_CFG_BRANCH_ADDR_CD7_BR14'/>"
WRITE #1 "        <register address='0xbbe437c' value='0x" DATA.LONG(A:0xbbe437c) "' name='RPMH_BCM_SEQ_CFG_BRANCH_ADDR_CD7_BR15'/>"
WRITE #1 "        <register address='0xbbe4380' value='0x" DATA.LONG(A:0xbbe4380) "' name='RPMH_BCM_SEQ_CFG_BRANCH_ADDR_CD8_BR0'/>"
WRITE #1 "        <register address='0xbbe4384' value='0x" DATA.LONG(A:0xbbe4384) "' name='RPMH_BCM_SEQ_CFG_BRANCH_ADDR_CD8_BR1'/>"
WRITE #1 "        <register address='0xbbe4388' value='0x" DATA.LONG(A:0xbbe4388) "' name='RPMH_BCM_SEQ_CFG_BRANCH_ADDR_CD8_BR2'/>"
WRITE #1 "        <register address='0xbbe438c' value='0x" DATA.LONG(A:0xbbe438c) "' name='RPMH_BCM_SEQ_CFG_BRANCH_ADDR_CD8_BR3'/>"
WRITE #1 "        <register address='0xbbe4390' value='0x" DATA.LONG(A:0xbbe4390) "' name='RPMH_BCM_SEQ_CFG_BRANCH_ADDR_CD8_BR4'/>"
WRITE #1 "        <register address='0xbbe4394' value='0x" DATA.LONG(A:0xbbe4394) "' name='RPMH_BCM_SEQ_CFG_BRANCH_ADDR_CD8_BR5'/>"
WRITE #1 "        <register address='0xbbe4398' value='0x" DATA.LONG(A:0xbbe4398) "' name='RPMH_BCM_SEQ_CFG_BRANCH_ADDR_CD8_BR6'/>"
WRITE #1 "        <register address='0xbbe439c' value='0x" DATA.LONG(A:0xbbe439c) "' name='RPMH_BCM_SEQ_CFG_BRANCH_ADDR_CD8_BR7'/>"
WRITE #1 "        <register address='0xbbe43a0' value='0x" DATA.LONG(A:0xbbe43a0) "' name='RPMH_BCM_SEQ_CFG_BRANCH_ADDR_CD8_BR8'/>"
WRITE #1 "        <register address='0xbbe43a4' value='0x" DATA.LONG(A:0xbbe43a4) "' name='RPMH_BCM_SEQ_CFG_BRANCH_ADDR_CD8_BR9'/>"
WRITE #1 "        <register address='0xbbe43a8' value='0x" DATA.LONG(A:0xbbe43a8) "' name='RPMH_BCM_SEQ_CFG_BRANCH_ADDR_CD8_BR10'/>"
WRITE #1 "        <register address='0xbbe43ac' value='0x" DATA.LONG(A:0xbbe43ac) "' name='RPMH_BCM_SEQ_CFG_BRANCH_ADDR_CD8_BR11'/>"
WRITE #1 "        <register address='0xbbe43b0' value='0x" DATA.LONG(A:0xbbe43b0) "' name='RPMH_BCM_SEQ_CFG_BRANCH_ADDR_CD8_BR12'/>"
WRITE #1 "        <register address='0xbbe43b4' value='0x" DATA.LONG(A:0xbbe43b4) "' name='RPMH_BCM_SEQ_CFG_BRANCH_ADDR_CD8_BR13'/>"
WRITE #1 "        <register address='0xbbe43b8' value='0x" DATA.LONG(A:0xbbe43b8) "' name='RPMH_BCM_SEQ_CFG_BRANCH_ADDR_CD8_BR14'/>"
WRITE #1 "        <register address='0xbbe43bc' value='0x" DATA.LONG(A:0xbbe43bc) "' name='RPMH_BCM_SEQ_CFG_BRANCH_ADDR_CD8_BR15'/>"
WRITE #1 "        <register address='0xbbe43c0' value='0x" DATA.LONG(A:0xbbe43c0) "' name='RPMH_BCM_SEQ_CFG_BRANCH_ADDR_CD9_BR0'/>"
WRITE #1 "        <register address='0xbbe43c4' value='0x" DATA.LONG(A:0xbbe43c4) "' name='RPMH_BCM_SEQ_CFG_BRANCH_ADDR_CD9_BR1'/>"
WRITE #1 "        <register address='0xbbe43c8' value='0x" DATA.LONG(A:0xbbe43c8) "' name='RPMH_BCM_SEQ_CFG_BRANCH_ADDR_CD9_BR2'/>"
WRITE #1 "        <register address='0xbbe43cc' value='0x" DATA.LONG(A:0xbbe43cc) "' name='RPMH_BCM_SEQ_CFG_BRANCH_ADDR_CD9_BR3'/>"
WRITE #1 "        <register address='0xbbe43d0' value='0x" DATA.LONG(A:0xbbe43d0) "' name='RPMH_BCM_SEQ_CFG_BRANCH_ADDR_CD9_BR4'/>"
WRITE #1 "        <register address='0xbbe43d4' value='0x" DATA.LONG(A:0xbbe43d4) "' name='RPMH_BCM_SEQ_CFG_BRANCH_ADDR_CD9_BR5'/>"
WRITE #1 "        <register address='0xbbe43d8' value='0x" DATA.LONG(A:0xbbe43d8) "' name='RPMH_BCM_SEQ_CFG_BRANCH_ADDR_CD9_BR6'/>"
WRITE #1 "        <register address='0xbbe43dc' value='0x" DATA.LONG(A:0xbbe43dc) "' name='RPMH_BCM_SEQ_CFG_BRANCH_ADDR_CD9_BR7'/>"
WRITE #1 "        <register address='0xbbe43e0' value='0x" DATA.LONG(A:0xbbe43e0) "' name='RPMH_BCM_SEQ_CFG_BRANCH_ADDR_CD9_BR8'/>"
WRITE #1 "        <register address='0xbbe43e4' value='0x" DATA.LONG(A:0xbbe43e4) "' name='RPMH_BCM_SEQ_CFG_BRANCH_ADDR_CD9_BR9'/>"
WRITE #1 "        <register address='0xbbe43e8' value='0x" DATA.LONG(A:0xbbe43e8) "' name='RPMH_BCM_SEQ_CFG_BRANCH_ADDR_CD9_BR10'/>"
WRITE #1 "        <register address='0xbbe43ec' value='0x" DATA.LONG(A:0xbbe43ec) "' name='RPMH_BCM_SEQ_CFG_BRANCH_ADDR_CD9_BR11'/>"
WRITE #1 "        <register address='0xbbe43f0' value='0x" DATA.LONG(A:0xbbe43f0) "' name='RPMH_BCM_SEQ_CFG_BRANCH_ADDR_CD9_BR12'/>"
WRITE #1 "        <register address='0xbbe43f4' value='0x" DATA.LONG(A:0xbbe43f4) "' name='RPMH_BCM_SEQ_CFG_BRANCH_ADDR_CD9_BR13'/>"
WRITE #1 "        <register address='0xbbe43f8' value='0x" DATA.LONG(A:0xbbe43f8) "' name='RPMH_BCM_SEQ_CFG_BRANCH_ADDR_CD9_BR14'/>"
WRITE #1 "        <register address='0xbbe43fc' value='0x" DATA.LONG(A:0xbbe43fc) "' name='RPMH_BCM_SEQ_CFG_BRANCH_ADDR_CD9_BR15'/>"
WRITE #1 "        <register address='0xbbe4400' value='0x" DATA.LONG(A:0xbbe4400) "' name='RPMH_BCM_SEQ_CFG_BRANCH_ADDR_CD10_BR0'/>"
WRITE #1 "        <register address='0xbbe4404' value='0x" DATA.LONG(A:0xbbe4404) "' name='RPMH_BCM_SEQ_CFG_BRANCH_ADDR_CD10_BR1'/>"
WRITE #1 "        <register address='0xbbe4408' value='0x" DATA.LONG(A:0xbbe4408) "' name='RPMH_BCM_SEQ_CFG_BRANCH_ADDR_CD10_BR2'/>"
WRITE #1 "        <register address='0xbbe440c' value='0x" DATA.LONG(A:0xbbe440c) "' name='RPMH_BCM_SEQ_CFG_BRANCH_ADDR_CD10_BR3'/>"
WRITE #1 "        <register address='0xbbe4410' value='0x" DATA.LONG(A:0xbbe4410) "' name='RPMH_BCM_SEQ_CFG_BRANCH_ADDR_CD10_BR4'/>"
WRITE #1 "        <register address='0xbbe4414' value='0x" DATA.LONG(A:0xbbe4414) "' name='RPMH_BCM_SEQ_CFG_BRANCH_ADDR_CD10_BR5'/>"
WRITE #1 "        <register address='0xbbe4418' value='0x" DATA.LONG(A:0xbbe4418) "' name='RPMH_BCM_SEQ_CFG_BRANCH_ADDR_CD10_BR6'/>"
WRITE #1 "        <register address='0xbbe441c' value='0x" DATA.LONG(A:0xbbe441c) "' name='RPMH_BCM_SEQ_CFG_BRANCH_ADDR_CD10_BR7'/>"
WRITE #1 "        <register address='0xbbe4420' value='0x" DATA.LONG(A:0xbbe4420) "' name='RPMH_BCM_SEQ_CFG_BRANCH_ADDR_CD10_BR8'/>"
WRITE #1 "        <register address='0xbbe4424' value='0x" DATA.LONG(A:0xbbe4424) "' name='RPMH_BCM_SEQ_CFG_BRANCH_ADDR_CD10_BR9'/>"
WRITE #1 "        <register address='0xbbe4428' value='0x" DATA.LONG(A:0xbbe4428) "' name='RPMH_BCM_SEQ_CFG_BRANCH_ADDR_CD10_BR10'/>"
WRITE #1 "        <register address='0xbbe442c' value='0x" DATA.LONG(A:0xbbe442c) "' name='RPMH_BCM_SEQ_CFG_BRANCH_ADDR_CD10_BR11'/>"
WRITE #1 "        <register address='0xbbe4430' value='0x" DATA.LONG(A:0xbbe4430) "' name='RPMH_BCM_SEQ_CFG_BRANCH_ADDR_CD10_BR12'/>"
WRITE #1 "        <register address='0xbbe4434' value='0x" DATA.LONG(A:0xbbe4434) "' name='RPMH_BCM_SEQ_CFG_BRANCH_ADDR_CD10_BR13'/>"
WRITE #1 "        <register address='0xbbe4438' value='0x" DATA.LONG(A:0xbbe4438) "' name='RPMH_BCM_SEQ_CFG_BRANCH_ADDR_CD10_BR14'/>"
WRITE #1 "        <register address='0xbbe443c' value='0x" DATA.LONG(A:0xbbe443c) "' name='RPMH_BCM_SEQ_CFG_BRANCH_ADDR_CD10_BR15'/>"
WRITE #1 "        <register address='0xbbe4440' value='0x" DATA.LONG(A:0xbbe4440) "' name='RPMH_BCM_SEQ_CFG_BRANCH_ADDR_CD11_BR0'/>"
WRITE #1 "        <register address='0xbbe4444' value='0x" DATA.LONG(A:0xbbe4444) "' name='RPMH_BCM_SEQ_CFG_BRANCH_ADDR_CD11_BR1'/>"
WRITE #1 "        <register address='0xbbe4448' value='0x" DATA.LONG(A:0xbbe4448) "' name='RPMH_BCM_SEQ_CFG_BRANCH_ADDR_CD11_BR2'/>"
WRITE #1 "        <register address='0xbbe444c' value='0x" DATA.LONG(A:0xbbe444c) "' name='RPMH_BCM_SEQ_CFG_BRANCH_ADDR_CD11_BR3'/>"
WRITE #1 "        <register address='0xbbe4450' value='0x" DATA.LONG(A:0xbbe4450) "' name='RPMH_BCM_SEQ_CFG_BRANCH_ADDR_CD11_BR4'/>"
WRITE #1 "        <register address='0xbbe4454' value='0x" DATA.LONG(A:0xbbe4454) "' name='RPMH_BCM_SEQ_CFG_BRANCH_ADDR_CD11_BR5'/>"
WRITE #1 "        <register address='0xbbe4458' value='0x" DATA.LONG(A:0xbbe4458) "' name='RPMH_BCM_SEQ_CFG_BRANCH_ADDR_CD11_BR6'/>"
WRITE #1 "        <register address='0xbbe445c' value='0x" DATA.LONG(A:0xbbe445c) "' name='RPMH_BCM_SEQ_CFG_BRANCH_ADDR_CD11_BR7'/>"
WRITE #1 "        <register address='0xbbe4460' value='0x" DATA.LONG(A:0xbbe4460) "' name='RPMH_BCM_SEQ_CFG_BRANCH_ADDR_CD11_BR8'/>"
WRITE #1 "        <register address='0xbbe4464' value='0x" DATA.LONG(A:0xbbe4464) "' name='RPMH_BCM_SEQ_CFG_BRANCH_ADDR_CD11_BR9'/>"
WRITE #1 "        <register address='0xbbe4468' value='0x" DATA.LONG(A:0xbbe4468) "' name='RPMH_BCM_SEQ_CFG_BRANCH_ADDR_CD11_BR10'/>"
WRITE #1 "        <register address='0xbbe446c' value='0x" DATA.LONG(A:0xbbe446c) "' name='RPMH_BCM_SEQ_CFG_BRANCH_ADDR_CD11_BR11'/>"
WRITE #1 "        <register address='0xbbe4470' value='0x" DATA.LONG(A:0xbbe4470) "' name='RPMH_BCM_SEQ_CFG_BRANCH_ADDR_CD11_BR12'/>"
WRITE #1 "        <register address='0xbbe4474' value='0x" DATA.LONG(A:0xbbe4474) "' name='RPMH_BCM_SEQ_CFG_BRANCH_ADDR_CD11_BR13'/>"
WRITE #1 "        <register address='0xbbe4478' value='0x" DATA.LONG(A:0xbbe4478) "' name='RPMH_BCM_SEQ_CFG_BRANCH_ADDR_CD11_BR14'/>"
WRITE #1 "        <register address='0xbbe447c' value='0x" DATA.LONG(A:0xbbe447c) "' name='RPMH_BCM_SEQ_CFG_BRANCH_ADDR_CD11_BR15'/>"
WRITE #1 "        <register address='0xbbe4980' value='0x" DATA.LONG(A:0xbbe4980) "' name='RPMH_BCM_SEQ_CFG_DELAY_CD0_DLY0'/>"
WRITE #1 "        <register address='0xbbe4984' value='0x" DATA.LONG(A:0xbbe4984) "' name='RPMH_BCM_SEQ_CFG_DELAY_CD0_DLY1'/>"
WRITE #1 "        <register address='0xbbe4988' value='0x" DATA.LONG(A:0xbbe4988) "' name='RPMH_BCM_SEQ_CFG_DELAY_CD0_DLY2'/>"
WRITE #1 "        <register address='0xbbe498c' value='0x" DATA.LONG(A:0xbbe498c) "' name='RPMH_BCM_SEQ_CFG_DELAY_CD0_DLY3'/>"
WRITE #1 "        <register address='0xbbe4990' value='0x" DATA.LONG(A:0xbbe4990) "' name='RPMH_BCM_SEQ_CFG_DELAY_CD1_DLY0'/>"
WRITE #1 "        <register address='0xbbe4994' value='0x" DATA.LONG(A:0xbbe4994) "' name='RPMH_BCM_SEQ_CFG_DELAY_CD1_DLY1'/>"
WRITE #1 "        <register address='0xbbe4998' value='0x" DATA.LONG(A:0xbbe4998) "' name='RPMH_BCM_SEQ_CFG_DELAY_CD1_DLY2'/>"
WRITE #1 "        <register address='0xbbe499c' value='0x" DATA.LONG(A:0xbbe499c) "' name='RPMH_BCM_SEQ_CFG_DELAY_CD1_DLY3'/>"
WRITE #1 "        <register address='0xbbe49a0' value='0x" DATA.LONG(A:0xbbe49a0) "' name='RPMH_BCM_SEQ_CFG_DELAY_CD2_DLY0'/>"
WRITE #1 "        <register address='0xbbe49a4' value='0x" DATA.LONG(A:0xbbe49a4) "' name='RPMH_BCM_SEQ_CFG_DELAY_CD2_DLY1'/>"
WRITE #1 "        <register address='0xbbe49a8' value='0x" DATA.LONG(A:0xbbe49a8) "' name='RPMH_BCM_SEQ_CFG_DELAY_CD2_DLY2'/>"
WRITE #1 "        <register address='0xbbe49ac' value='0x" DATA.LONG(A:0xbbe49ac) "' name='RPMH_BCM_SEQ_CFG_DELAY_CD2_DLY3'/>"
WRITE #1 "        <register address='0xbbe49b0' value='0x" DATA.LONG(A:0xbbe49b0) "' name='RPMH_BCM_SEQ_CFG_DELAY_CD3_DLY0'/>"
WRITE #1 "        <register address='0xbbe49b4' value='0x" DATA.LONG(A:0xbbe49b4) "' name='RPMH_BCM_SEQ_CFG_DELAY_CD3_DLY1'/>"
WRITE #1 "        <register address='0xbbe49b8' value='0x" DATA.LONG(A:0xbbe49b8) "' name='RPMH_BCM_SEQ_CFG_DELAY_CD3_DLY2'/>"
WRITE #1 "        <register address='0xbbe49bc' value='0x" DATA.LONG(A:0xbbe49bc) "' name='RPMH_BCM_SEQ_CFG_DELAY_CD3_DLY3'/>"
WRITE #1 "        <register address='0xbbe49c0' value='0x" DATA.LONG(A:0xbbe49c0) "' name='RPMH_BCM_SEQ_CFG_DELAY_CD4_DLY0'/>"
WRITE #1 "        <register address='0xbbe49c4' value='0x" DATA.LONG(A:0xbbe49c4) "' name='RPMH_BCM_SEQ_CFG_DELAY_CD4_DLY1'/>"
WRITE #1 "        <register address='0xbbe49c8' value='0x" DATA.LONG(A:0xbbe49c8) "' name='RPMH_BCM_SEQ_CFG_DELAY_CD4_DLY2'/>"
WRITE #1 "        <register address='0xbbe49cc' value='0x" DATA.LONG(A:0xbbe49cc) "' name='RPMH_BCM_SEQ_CFG_DELAY_CD4_DLY3'/>"
WRITE #1 "        <register address='0xbbe49d0' value='0x" DATA.LONG(A:0xbbe49d0) "' name='RPMH_BCM_SEQ_CFG_DELAY_CD5_DLY0'/>"
WRITE #1 "        <register address='0xbbe49d4' value='0x" DATA.LONG(A:0xbbe49d4) "' name='RPMH_BCM_SEQ_CFG_DELAY_CD5_DLY1'/>"
WRITE #1 "        <register address='0xbbe49d8' value='0x" DATA.LONG(A:0xbbe49d8) "' name='RPMH_BCM_SEQ_CFG_DELAY_CD5_DLY2'/>"
WRITE #1 "        <register address='0xbbe49dc' value='0x" DATA.LONG(A:0xbbe49dc) "' name='RPMH_BCM_SEQ_CFG_DELAY_CD5_DLY3'/>"
WRITE #1 "        <register address='0xbbe49e0' value='0x" DATA.LONG(A:0xbbe49e0) "' name='RPMH_BCM_SEQ_CFG_DELAY_CD6_DLY0'/>"
WRITE #1 "        <register address='0xbbe49e4' value='0x" DATA.LONG(A:0xbbe49e4) "' name='RPMH_BCM_SEQ_CFG_DELAY_CD6_DLY1'/>"
WRITE #1 "        <register address='0xbbe49e8' value='0x" DATA.LONG(A:0xbbe49e8) "' name='RPMH_BCM_SEQ_CFG_DELAY_CD6_DLY2'/>"
WRITE #1 "        <register address='0xbbe49ec' value='0x" DATA.LONG(A:0xbbe49ec) "' name='RPMH_BCM_SEQ_CFG_DELAY_CD6_DLY3'/>"
WRITE #1 "        <register address='0xbbe49f0' value='0x" DATA.LONG(A:0xbbe49f0) "' name='RPMH_BCM_SEQ_CFG_DELAY_CD7_DLY0'/>"
WRITE #1 "        <register address='0xbbe49f4' value='0x" DATA.LONG(A:0xbbe49f4) "' name='RPMH_BCM_SEQ_CFG_DELAY_CD7_DLY1'/>"
WRITE #1 "        <register address='0xbbe49f8' value='0x" DATA.LONG(A:0xbbe49f8) "' name='RPMH_BCM_SEQ_CFG_DELAY_CD7_DLY2'/>"
WRITE #1 "        <register address='0xbbe49fc' value='0x" DATA.LONG(A:0xbbe49fc) "' name='RPMH_BCM_SEQ_CFG_DELAY_CD7_DLY3'/>"
WRITE #1 "        <register address='0xbbe4a00' value='0x" DATA.LONG(A:0xbbe4a00) "' name='RPMH_BCM_SEQ_CFG_DELAY_CD8_DLY0'/>"
WRITE #1 "        <register address='0xbbe4a04' value='0x" DATA.LONG(A:0xbbe4a04) "' name='RPMH_BCM_SEQ_CFG_DELAY_CD8_DLY1'/>"
WRITE #1 "        <register address='0xbbe4a08' value='0x" DATA.LONG(A:0xbbe4a08) "' name='RPMH_BCM_SEQ_CFG_DELAY_CD8_DLY2'/>"
WRITE #1 "        <register address='0xbbe4a0c' value='0x" DATA.LONG(A:0xbbe4a0c) "' name='RPMH_BCM_SEQ_CFG_DELAY_CD8_DLY3'/>"
WRITE #1 "        <register address='0xbbe4a10' value='0x" DATA.LONG(A:0xbbe4a10) "' name='RPMH_BCM_SEQ_CFG_DELAY_CD9_DLY0'/>"
WRITE #1 "        <register address='0xbbe4a14' value='0x" DATA.LONG(A:0xbbe4a14) "' name='RPMH_BCM_SEQ_CFG_DELAY_CD9_DLY1'/>"
WRITE #1 "        <register address='0xbbe4a18' value='0x" DATA.LONG(A:0xbbe4a18) "' name='RPMH_BCM_SEQ_CFG_DELAY_CD9_DLY2'/>"
WRITE #1 "        <register address='0xbbe4a1c' value='0x" DATA.LONG(A:0xbbe4a1c) "' name='RPMH_BCM_SEQ_CFG_DELAY_CD9_DLY3'/>"
WRITE #1 "        <register address='0xbbe4a20' value='0x" DATA.LONG(A:0xbbe4a20) "' name='RPMH_BCM_SEQ_CFG_DELAY_CD10_DLY0'/>"
WRITE #1 "        <register address='0xbbe4a24' value='0x" DATA.LONG(A:0xbbe4a24) "' name='RPMH_BCM_SEQ_CFG_DELAY_CD10_DLY1'/>"
WRITE #1 "        <register address='0xbbe4a28' value='0x" DATA.LONG(A:0xbbe4a28) "' name='RPMH_BCM_SEQ_CFG_DELAY_CD10_DLY2'/>"
WRITE #1 "        <register address='0xbbe4a2c' value='0x" DATA.LONG(A:0xbbe4a2c) "' name='RPMH_BCM_SEQ_CFG_DELAY_CD10_DLY3'/>"
WRITE #1 "        <register address='0xbbe4a30' value='0x" DATA.LONG(A:0xbbe4a30) "' name='RPMH_BCM_SEQ_CFG_DELAY_CD11_DLY0'/>"
WRITE #1 "        <register address='0xbbe4a34' value='0x" DATA.LONG(A:0xbbe4a34) "' name='RPMH_BCM_SEQ_CFG_DELAY_CD11_DLY1'/>"
WRITE #1 "        <register address='0xbbe4a38' value='0x" DATA.LONG(A:0xbbe4a38) "' name='RPMH_BCM_SEQ_CFG_DELAY_CD11_DLY2'/>"
WRITE #1 "        <register address='0xbbe4a3c' value='0x" DATA.LONG(A:0xbbe4a3c) "' name='RPMH_BCM_SEQ_CFG_DELAY_CD11_DLY3'/>"
WRITE #1 "        <register address='0xbbe5400' value='0x" DATA.LONG(A:0xbbe5400) "' name='RPMH_BCM_TCS_CFG_CD0'/>"
WRITE #1 "        <register address='0xbbe5404' value='0x" DATA.LONG(A:0xbbe5404) "' name='RPMH_BCM_TCS_CFG_CD1'/>"
WRITE #1 "        <register address='0xbbe5408' value='0x" DATA.LONG(A:0xbbe5408) "' name='RPMH_BCM_TCS_CFG_CD2'/>"
WRITE #1 "        <register address='0xbbe540c' value='0x" DATA.LONG(A:0xbbe540c) "' name='RPMH_BCM_TCS_CFG_CD3'/>"
WRITE #1 "        <register address='0xbbe5410' value='0x" DATA.LONG(A:0xbbe5410) "' name='RPMH_BCM_TCS_CFG_CD4'/>"
WRITE #1 "        <register address='0xbbe5414' value='0x" DATA.LONG(A:0xbbe5414) "' name='RPMH_BCM_TCS_CFG_CD5'/>"
WRITE #1 "        <register address='0xbbe5418' value='0x" DATA.LONG(A:0xbbe5418) "' name='RPMH_BCM_TCS_CFG_CD6'/>"
WRITE #1 "        <register address='0xbbe541c' value='0x" DATA.LONG(A:0xbbe541c) "' name='RPMH_BCM_TCS_CFG_CD7'/>"
WRITE #1 "        <register address='0xbbe5420' value='0x" DATA.LONG(A:0xbbe5420) "' name='RPMH_BCM_TCS_CFG_CD8'/>"
WRITE #1 "        <register address='0xbbe5424' value='0x" DATA.LONG(A:0xbbe5424) "' name='RPMH_BCM_TCS_CFG_CD9'/>"
WRITE #1 "        <register address='0xbbe5428' value='0x" DATA.LONG(A:0xbbe5428) "' name='RPMH_BCM_TCS_CFG_CD10'/>"
WRITE #1 "        <register address='0xbbe542c' value='0x" DATA.LONG(A:0xbbe542c) "' name='RPMH_BCM_TCS_CFG_CD11'/>"
WRITE #1 "        <register address='0xbbe5480' value='0x" DATA.LONG(A:0xbbe5480) "' name='RPMH_BCM_TCS_CFG_VOTE_ADDR_CD0_CMD0'/>"
WRITE #1 "        <register address='0xbbe5484' value='0x" DATA.LONG(A:0xbbe5484) "' name='RPMH_BCM_TCS_CFG_VOTE_ADDR_CD0_CMD1'/>"
WRITE #1 "        <register address='0xbbe5488' value='0x" DATA.LONG(A:0xbbe5488) "' name='RPMH_BCM_TCS_CFG_VOTE_ADDR_CD0_CMD2'/>"
WRITE #1 "        <register address='0xbbe548c' value='0x" DATA.LONG(A:0xbbe548c) "' name='RPMH_BCM_TCS_CFG_VOTE_ADDR_CD1_CMD0'/>"
WRITE #1 "        <register address='0xbbe5490' value='0x" DATA.LONG(A:0xbbe5490) "' name='RPMH_BCM_TCS_CFG_VOTE_ADDR_CD1_CMD1'/>"
WRITE #1 "        <register address='0xbbe5494' value='0x" DATA.LONG(A:0xbbe5494) "' name='RPMH_BCM_TCS_CFG_VOTE_ADDR_CD1_CMD2'/>"
WRITE #1 "        <register address='0xbbe5498' value='0x" DATA.LONG(A:0xbbe5498) "' name='RPMH_BCM_TCS_CFG_VOTE_ADDR_CD2_CMD0'/>"
WRITE #1 "        <register address='0xbbe549c' value='0x" DATA.LONG(A:0xbbe549c) "' name='RPMH_BCM_TCS_CFG_VOTE_ADDR_CD2_CMD1'/>"
WRITE #1 "        <register address='0xbbe54a0' value='0x" DATA.LONG(A:0xbbe54a0) "' name='RPMH_BCM_TCS_CFG_VOTE_ADDR_CD2_CMD2'/>"
WRITE #1 "        <register address='0xbbe54a4' value='0x" DATA.LONG(A:0xbbe54a4) "' name='RPMH_BCM_TCS_CFG_VOTE_ADDR_CD3_CMD0'/>"
WRITE #1 "        <register address='0xbbe54a8' value='0x" DATA.LONG(A:0xbbe54a8) "' name='RPMH_BCM_TCS_CFG_VOTE_ADDR_CD3_CMD1'/>"
WRITE #1 "        <register address='0xbbe54ac' value='0x" DATA.LONG(A:0xbbe54ac) "' name='RPMH_BCM_TCS_CFG_VOTE_ADDR_CD3_CMD2'/>"
WRITE #1 "        <register address='0xbbe54b0' value='0x" DATA.LONG(A:0xbbe54b0) "' name='RPMH_BCM_TCS_CFG_VOTE_ADDR_CD4_CMD0'/>"
WRITE #1 "        <register address='0xbbe54b4' value='0x" DATA.LONG(A:0xbbe54b4) "' name='RPMH_BCM_TCS_CFG_VOTE_ADDR_CD4_CMD1'/>"
WRITE #1 "        <register address='0xbbe54b8' value='0x" DATA.LONG(A:0xbbe54b8) "' name='RPMH_BCM_TCS_CFG_VOTE_ADDR_CD4_CMD2'/>"
WRITE #1 "        <register address='0xbbe54bc' value='0x" DATA.LONG(A:0xbbe54bc) "' name='RPMH_BCM_TCS_CFG_VOTE_ADDR_CD5_CMD0'/>"
WRITE #1 "        <register address='0xbbe54c0' value='0x" DATA.LONG(A:0xbbe54c0) "' name='RPMH_BCM_TCS_CFG_VOTE_ADDR_CD5_CMD1'/>"
WRITE #1 "        <register address='0xbbe54c4' value='0x" DATA.LONG(A:0xbbe54c4) "' name='RPMH_BCM_TCS_CFG_VOTE_ADDR_CD5_CMD2'/>"
WRITE #1 "        <register address='0xbbe54c8' value='0x" DATA.LONG(A:0xbbe54c8) "' name='RPMH_BCM_TCS_CFG_VOTE_ADDR_CD6_CMD0'/>"
WRITE #1 "        <register address='0xbbe54cc' value='0x" DATA.LONG(A:0xbbe54cc) "' name='RPMH_BCM_TCS_CFG_VOTE_ADDR_CD6_CMD1'/>"
WRITE #1 "        <register address='0xbbe54d0' value='0x" DATA.LONG(A:0xbbe54d0) "' name='RPMH_BCM_TCS_CFG_VOTE_ADDR_CD6_CMD2'/>"
WRITE #1 "        <register address='0xbbe54d4' value='0x" DATA.LONG(A:0xbbe54d4) "' name='RPMH_BCM_TCS_CFG_VOTE_ADDR_CD7_CMD0'/>"
WRITE #1 "        <register address='0xbbe54d8' value='0x" DATA.LONG(A:0xbbe54d8) "' name='RPMH_BCM_TCS_CFG_VOTE_ADDR_CD7_CMD1'/>"
WRITE #1 "        <register address='0xbbe54dc' value='0x" DATA.LONG(A:0xbbe54dc) "' name='RPMH_BCM_TCS_CFG_VOTE_ADDR_CD7_CMD2'/>"
WRITE #1 "        <register address='0xbbe54e0' value='0x" DATA.LONG(A:0xbbe54e0) "' name='RPMH_BCM_TCS_CFG_VOTE_ADDR_CD8_CMD0'/>"
WRITE #1 "        <register address='0xbbe54e4' value='0x" DATA.LONG(A:0xbbe54e4) "' name='RPMH_BCM_TCS_CFG_VOTE_ADDR_CD8_CMD1'/>"
WRITE #1 "        <register address='0xbbe54e8' value='0x" DATA.LONG(A:0xbbe54e8) "' name='RPMH_BCM_TCS_CFG_VOTE_ADDR_CD8_CMD2'/>"
WRITE #1 "        <register address='0xbbe54ec' value='0x" DATA.LONG(A:0xbbe54ec) "' name='RPMH_BCM_TCS_CFG_VOTE_ADDR_CD9_CMD0'/>"
WRITE #1 "        <register address='0xbbe54f0' value='0x" DATA.LONG(A:0xbbe54f0) "' name='RPMH_BCM_TCS_CFG_VOTE_ADDR_CD9_CMD1'/>"
WRITE #1 "        <register address='0xbbe54f4' value='0x" DATA.LONG(A:0xbbe54f4) "' name='RPMH_BCM_TCS_CFG_VOTE_ADDR_CD9_CMD2'/>"
WRITE #1 "        <register address='0xbbe54f8' value='0x" DATA.LONG(A:0xbbe54f8) "' name='RPMH_BCM_TCS_CFG_VOTE_ADDR_CD10_CMD0'/>"
WRITE #1 "        <register address='0xbbe54fc' value='0x" DATA.LONG(A:0xbbe54fc) "' name='RPMH_BCM_TCS_CFG_VOTE_ADDR_CD10_CMD1'/>"
WRITE #1 "        <register address='0xbbe5500' value='0x" DATA.LONG(A:0xbbe5500) "' name='RPMH_BCM_TCS_CFG_VOTE_ADDR_CD10_CMD2'/>"
WRITE #1 "        <register address='0xbbe5504' value='0x" DATA.LONG(A:0xbbe5504) "' name='RPMH_BCM_TCS_CFG_VOTE_ADDR_CD11_CMD0'/>"
WRITE #1 "        <register address='0xbbe5508' value='0x" DATA.LONG(A:0xbbe5508) "' name='RPMH_BCM_TCS_CFG_VOTE_ADDR_CD11_CMD1'/>"
WRITE #1 "        <register address='0xbbe550c' value='0x" DATA.LONG(A:0xbbe550c) "' name='RPMH_BCM_TCS_CFG_VOTE_ADDR_CD11_CMD2'/>"
WRITE #1 "        <register address='0xbbe5680' value='0x" DATA.LONG(A:0xbbe5680) "' name='RPMH_BCM_TCS_CFG_VOTE_DATA_CD0_CP0'/>"
WRITE #1 "        <register address='0xbbe5684' value='0x" DATA.LONG(A:0xbbe5684) "' name='RPMH_BCM_TCS_CFG_VOTE_DATA_CD0_CP1'/>"
WRITE #1 "        <register address='0xbbe5688' value='0x" DATA.LONG(A:0xbbe5688) "' name='RPMH_BCM_TCS_CFG_VOTE_DATA_CD0_CP2'/>"
WRITE #1 "        <register address='0xbbe568c' value='0x" DATA.LONG(A:0xbbe568c) "' name='RPMH_BCM_TCS_CFG_VOTE_DATA_CD0_CP3'/>"
WRITE #1 "        <register address='0xbbe5690' value='0x" DATA.LONG(A:0xbbe5690) "' name='RPMH_BCM_TCS_CFG_VOTE_DATA_CD0_CP4'/>"
WRITE #1 "        <register address='0xbbe5694' value='0x" DATA.LONG(A:0xbbe5694) "' name='RPMH_BCM_TCS_CFG_VOTE_DATA_CD0_CP5'/>"
WRITE #1 "        <register address='0xbbe5698' value='0x" DATA.LONG(A:0xbbe5698) "' name='RPMH_BCM_TCS_CFG_VOTE_DATA_CD0_CP6'/>"
WRITE #1 "        <register address='0xbbe569c' value='0x" DATA.LONG(A:0xbbe569c) "' name='RPMH_BCM_TCS_CFG_VOTE_DATA_CD0_CP7'/>"
WRITE #1 "        <register address='0xbbe56a0' value='0x" DATA.LONG(A:0xbbe56a0) "' name='RPMH_BCM_TCS_CFG_VOTE_DATA_CD0_CP8'/>"
WRITE #1 "        <register address='0xbbe56a4' value='0x" DATA.LONG(A:0xbbe56a4) "' name='RPMH_BCM_TCS_CFG_VOTE_DATA_CD0_CP9'/>"
WRITE #1 "        <register address='0xbbe56a8' value='0x" DATA.LONG(A:0xbbe56a8) "' name='RPMH_BCM_TCS_CFG_VOTE_DATA_CD0_CP10'/>"
WRITE #1 "        <register address='0xbbe56ac' value='0x" DATA.LONG(A:0xbbe56ac) "' name='RPMH_BCM_TCS_CFG_VOTE_DATA_CD0_CP11'/>"
WRITE #1 "        <register address='0xbbe56b0' value='0x" DATA.LONG(A:0xbbe56b0) "' name='RPMH_BCM_TCS_CFG_VOTE_DATA_CD0_CP12'/>"
WRITE #1 "        <register address='0xbbe56b4' value='0x" DATA.LONG(A:0xbbe56b4) "' name='RPMH_BCM_TCS_CFG_VOTE_DATA_CD0_CP13'/>"
WRITE #1 "        <register address='0xbbe56b8' value='0x" DATA.LONG(A:0xbbe56b8) "' name='RPMH_BCM_TCS_CFG_VOTE_DATA_CD0_CP14'/>"
WRITE #1 "        <register address='0xbbe56bc' value='0x" DATA.LONG(A:0xbbe56bc) "' name='RPMH_BCM_TCS_CFG_VOTE_DATA_CD0_CP15'/>"
WRITE #1 "        <register address='0xbbe56c0' value='0x" DATA.LONG(A:0xbbe56c0) "' name='RPMH_BCM_TCS_CFG_VOTE_DATA_CD1_CP0'/>"
WRITE #1 "        <register address='0xbbe56c4' value='0x" DATA.LONG(A:0xbbe56c4) "' name='RPMH_BCM_TCS_CFG_VOTE_DATA_CD1_CP1'/>"
WRITE #1 "        <register address='0xbbe56c8' value='0x" DATA.LONG(A:0xbbe56c8) "' name='RPMH_BCM_TCS_CFG_VOTE_DATA_CD1_CP2'/>"
WRITE #1 "        <register address='0xbbe56cc' value='0x" DATA.LONG(A:0xbbe56cc) "' name='RPMH_BCM_TCS_CFG_VOTE_DATA_CD1_CP3'/>"
WRITE #1 "        <register address='0xbbe56d0' value='0x" DATA.LONG(A:0xbbe56d0) "' name='RPMH_BCM_TCS_CFG_VOTE_DATA_CD1_CP4'/>"
WRITE #1 "        <register address='0xbbe56d4' value='0x" DATA.LONG(A:0xbbe56d4) "' name='RPMH_BCM_TCS_CFG_VOTE_DATA_CD1_CP5'/>"
WRITE #1 "        <register address='0xbbe56d8' value='0x" DATA.LONG(A:0xbbe56d8) "' name='RPMH_BCM_TCS_CFG_VOTE_DATA_CD1_CP6'/>"
WRITE #1 "        <register address='0xbbe56dc' value='0x" DATA.LONG(A:0xbbe56dc) "' name='RPMH_BCM_TCS_CFG_VOTE_DATA_CD1_CP7'/>"
WRITE #1 "        <register address='0xbbe56e0' value='0x" DATA.LONG(A:0xbbe56e0) "' name='RPMH_BCM_TCS_CFG_VOTE_DATA_CD1_CP8'/>"
WRITE #1 "        <register address='0xbbe56e4' value='0x" DATA.LONG(A:0xbbe56e4) "' name='RPMH_BCM_TCS_CFG_VOTE_DATA_CD1_CP9'/>"
WRITE #1 "        <register address='0xbbe56e8' value='0x" DATA.LONG(A:0xbbe56e8) "' name='RPMH_BCM_TCS_CFG_VOTE_DATA_CD1_CP10'/>"
WRITE #1 "        <register address='0xbbe56ec' value='0x" DATA.LONG(A:0xbbe56ec) "' name='RPMH_BCM_TCS_CFG_VOTE_DATA_CD1_CP11'/>"
WRITE #1 "        <register address='0xbbe56f0' value='0x" DATA.LONG(A:0xbbe56f0) "' name='RPMH_BCM_TCS_CFG_VOTE_DATA_CD1_CP12'/>"
WRITE #1 "        <register address='0xbbe56f4' value='0x" DATA.LONG(A:0xbbe56f4) "' name='RPMH_BCM_TCS_CFG_VOTE_DATA_CD1_CP13'/>"
WRITE #1 "        <register address='0xbbe56f8' value='0x" DATA.LONG(A:0xbbe56f8) "' name='RPMH_BCM_TCS_CFG_VOTE_DATA_CD1_CP14'/>"
WRITE #1 "        <register address='0xbbe56fc' value='0x" DATA.LONG(A:0xbbe56fc) "' name='RPMH_BCM_TCS_CFG_VOTE_DATA_CD1_CP15'/>"
WRITE #1 "        <register address='0xbbe5700' value='0x" DATA.LONG(A:0xbbe5700) "' name='RPMH_BCM_TCS_CFG_VOTE_DATA_CD2_CP0'/>"
WRITE #1 "        <register address='0xbbe5704' value='0x" DATA.LONG(A:0xbbe5704) "' name='RPMH_BCM_TCS_CFG_VOTE_DATA_CD2_CP1'/>"
WRITE #1 "        <register address='0xbbe5708' value='0x" DATA.LONG(A:0xbbe5708) "' name='RPMH_BCM_TCS_CFG_VOTE_DATA_CD2_CP2'/>"
WRITE #1 "        <register address='0xbbe570c' value='0x" DATA.LONG(A:0xbbe570c) "' name='RPMH_BCM_TCS_CFG_VOTE_DATA_CD2_CP3'/>"
WRITE #1 "        <register address='0xbbe5710' value='0x" DATA.LONG(A:0xbbe5710) "' name='RPMH_BCM_TCS_CFG_VOTE_DATA_CD2_CP4'/>"
WRITE #1 "        <register address='0xbbe5714' value='0x" DATA.LONG(A:0xbbe5714) "' name='RPMH_BCM_TCS_CFG_VOTE_DATA_CD2_CP5'/>"
WRITE #1 "        <register address='0xbbe5718' value='0x" DATA.LONG(A:0xbbe5718) "' name='RPMH_BCM_TCS_CFG_VOTE_DATA_CD2_CP6'/>"
WRITE #1 "        <register address='0xbbe571c' value='0x" DATA.LONG(A:0xbbe571c) "' name='RPMH_BCM_TCS_CFG_VOTE_DATA_CD2_CP7'/>"
WRITE #1 "        <register address='0xbbe5740' value='0x" DATA.LONG(A:0xbbe5740) "' name='RPMH_BCM_TCS_CFG_VOTE_DATA_CD3_CP0'/>"
WRITE #1 "        <register address='0xbbe5744' value='0x" DATA.LONG(A:0xbbe5744) "' name='RPMH_BCM_TCS_CFG_VOTE_DATA_CD3_CP1'/>"
WRITE #1 "        <register address='0xbbe5748' value='0x" DATA.LONG(A:0xbbe5748) "' name='RPMH_BCM_TCS_CFG_VOTE_DATA_CD3_CP2'/>"
WRITE #1 "        <register address='0xbbe574c' value='0x" DATA.LONG(A:0xbbe574c) "' name='RPMH_BCM_TCS_CFG_VOTE_DATA_CD3_CP3'/>"
WRITE #1 "        <register address='0xbbe5750' value='0x" DATA.LONG(A:0xbbe5750) "' name='RPMH_BCM_TCS_CFG_VOTE_DATA_CD3_CP4'/>"
WRITE #1 "        <register address='0xbbe5754' value='0x" DATA.LONG(A:0xbbe5754) "' name='RPMH_BCM_TCS_CFG_VOTE_DATA_CD3_CP5'/>"
WRITE #1 "        <register address='0xbbe5758' value='0x" DATA.LONG(A:0xbbe5758) "' name='RPMH_BCM_TCS_CFG_VOTE_DATA_CD3_CP6'/>"
WRITE #1 "        <register address='0xbbe575c' value='0x" DATA.LONG(A:0xbbe575c) "' name='RPMH_BCM_TCS_CFG_VOTE_DATA_CD3_CP7'/>"
WRITE #1 "        <register address='0xbbe5780' value='0x" DATA.LONG(A:0xbbe5780) "' name='RPMH_BCM_TCS_CFG_VOTE_DATA_CD4_CP0'/>"
WRITE #1 "        <register address='0xbbe5784' value='0x" DATA.LONG(A:0xbbe5784) "' name='RPMH_BCM_TCS_CFG_VOTE_DATA_CD4_CP1'/>"
WRITE #1 "        <register address='0xbbe5788' value='0x" DATA.LONG(A:0xbbe5788) "' name='RPMH_BCM_TCS_CFG_VOTE_DATA_CD4_CP2'/>"
WRITE #1 "        <register address='0xbbe578c' value='0x" DATA.LONG(A:0xbbe578c) "' name='RPMH_BCM_TCS_CFG_VOTE_DATA_CD4_CP3'/>"
WRITE #1 "        <register address='0xbbe5790' value='0x" DATA.LONG(A:0xbbe5790) "' name='RPMH_BCM_TCS_CFG_VOTE_DATA_CD4_CP4'/>"
WRITE #1 "        <register address='0xbbe5794' value='0x" DATA.LONG(A:0xbbe5794) "' name='RPMH_BCM_TCS_CFG_VOTE_DATA_CD4_CP5'/>"
WRITE #1 "        <register address='0xbbe5798' value='0x" DATA.LONG(A:0xbbe5798) "' name='RPMH_BCM_TCS_CFG_VOTE_DATA_CD4_CP6'/>"
WRITE #1 "        <register address='0xbbe579c' value='0x" DATA.LONG(A:0xbbe579c) "' name='RPMH_BCM_TCS_CFG_VOTE_DATA_CD4_CP7'/>"
WRITE #1 "        <register address='0xbbe57c0' value='0x" DATA.LONG(A:0xbbe57c0) "' name='RPMH_BCM_TCS_CFG_VOTE_DATA_CD5_CP0'/>"
WRITE #1 "        <register address='0xbbe57c4' value='0x" DATA.LONG(A:0xbbe57c4) "' name='RPMH_BCM_TCS_CFG_VOTE_DATA_CD5_CP1'/>"
WRITE #1 "        <register address='0xbbe57c8' value='0x" DATA.LONG(A:0xbbe57c8) "' name='RPMH_BCM_TCS_CFG_VOTE_DATA_CD5_CP2'/>"
WRITE #1 "        <register address='0xbbe57cc' value='0x" DATA.LONG(A:0xbbe57cc) "' name='RPMH_BCM_TCS_CFG_VOTE_DATA_CD5_CP3'/>"
WRITE #1 "        <register address='0xbbe57d0' value='0x" DATA.LONG(A:0xbbe57d0) "' name='RPMH_BCM_TCS_CFG_VOTE_DATA_CD5_CP4'/>"
WRITE #1 "        <register address='0xbbe57d4' value='0x" DATA.LONG(A:0xbbe57d4) "' name='RPMH_BCM_TCS_CFG_VOTE_DATA_CD5_CP5'/>"
WRITE #1 "        <register address='0xbbe57d8' value='0x" DATA.LONG(A:0xbbe57d8) "' name='RPMH_BCM_TCS_CFG_VOTE_DATA_CD5_CP6'/>"
WRITE #1 "        <register address='0xbbe57dc' value='0x" DATA.LONG(A:0xbbe57dc) "' name='RPMH_BCM_TCS_CFG_VOTE_DATA_CD5_CP7'/>"
WRITE #1 "        <register address='0xbbe5800' value='0x" DATA.LONG(A:0xbbe5800) "' name='RPMH_BCM_TCS_CFG_VOTE_DATA_CD6_CP0'/>"
WRITE #1 "        <register address='0xbbe5804' value='0x" DATA.LONG(A:0xbbe5804) "' name='RPMH_BCM_TCS_CFG_VOTE_DATA_CD6_CP1'/>"
WRITE #1 "        <register address='0xbbe5808' value='0x" DATA.LONG(A:0xbbe5808) "' name='RPMH_BCM_TCS_CFG_VOTE_DATA_CD6_CP2'/>"
WRITE #1 "        <register address='0xbbe580c' value='0x" DATA.LONG(A:0xbbe580c) "' name='RPMH_BCM_TCS_CFG_VOTE_DATA_CD6_CP3'/>"
WRITE #1 "        <register address='0xbbe5810' value='0x" DATA.LONG(A:0xbbe5810) "' name='RPMH_BCM_TCS_CFG_VOTE_DATA_CD6_CP4'/>"
WRITE #1 "        <register address='0xbbe5814' value='0x" DATA.LONG(A:0xbbe5814) "' name='RPMH_BCM_TCS_CFG_VOTE_DATA_CD6_CP5'/>"
WRITE #1 "        <register address='0xbbe5818' value='0x" DATA.LONG(A:0xbbe5818) "' name='RPMH_BCM_TCS_CFG_VOTE_DATA_CD6_CP6'/>"
WRITE #1 "        <register address='0xbbe581c' value='0x" DATA.LONG(A:0xbbe581c) "' name='RPMH_BCM_TCS_CFG_VOTE_DATA_CD6_CP7'/>"
WRITE #1 "        <register address='0xbbe5820' value='0x" DATA.LONG(A:0xbbe5820) "' name='RPMH_BCM_TCS_CFG_VOTE_DATA_CD6_CP8'/>"
WRITE #1 "        <register address='0xbbe5824' value='0x" DATA.LONG(A:0xbbe5824) "' name='RPMH_BCM_TCS_CFG_VOTE_DATA_CD6_CP9'/>"
WRITE #1 "        <register address='0xbbe5828' value='0x" DATA.LONG(A:0xbbe5828) "' name='RPMH_BCM_TCS_CFG_VOTE_DATA_CD6_CP10'/>"
WRITE #1 "        <register address='0xbbe582c' value='0x" DATA.LONG(A:0xbbe582c) "' name='RPMH_BCM_TCS_CFG_VOTE_DATA_CD6_CP11'/>"
WRITE #1 "        <register address='0xbbe5830' value='0x" DATA.LONG(A:0xbbe5830) "' name='RPMH_BCM_TCS_CFG_VOTE_DATA_CD6_CP12'/>"
WRITE #1 "        <register address='0xbbe5834' value='0x" DATA.LONG(A:0xbbe5834) "' name='RPMH_BCM_TCS_CFG_VOTE_DATA_CD6_CP13'/>"
WRITE #1 "        <register address='0xbbe5838' value='0x" DATA.LONG(A:0xbbe5838) "' name='RPMH_BCM_TCS_CFG_VOTE_DATA_CD6_CP14'/>"
WRITE #1 "        <register address='0xbbe583c' value='0x" DATA.LONG(A:0xbbe583c) "' name='RPMH_BCM_TCS_CFG_VOTE_DATA_CD6_CP15'/>"
WRITE #1 "        <register address='0xbbe5840' value='0x" DATA.LONG(A:0xbbe5840) "' name='RPMH_BCM_TCS_CFG_VOTE_DATA_CD7_CP0'/>"
WRITE #1 "        <register address='0xbbe5844' value='0x" DATA.LONG(A:0xbbe5844) "' name='RPMH_BCM_TCS_CFG_VOTE_DATA_CD7_CP1'/>"
WRITE #1 "        <register address='0xbbe5848' value='0x" DATA.LONG(A:0xbbe5848) "' name='RPMH_BCM_TCS_CFG_VOTE_DATA_CD7_CP2'/>"
WRITE #1 "        <register address='0xbbe584c' value='0x" DATA.LONG(A:0xbbe584c) "' name='RPMH_BCM_TCS_CFG_VOTE_DATA_CD7_CP3'/>"
WRITE #1 "        <register address='0xbbe5850' value='0x" DATA.LONG(A:0xbbe5850) "' name='RPMH_BCM_TCS_CFG_VOTE_DATA_CD7_CP4'/>"
WRITE #1 "        <register address='0xbbe5854' value='0x" DATA.LONG(A:0xbbe5854) "' name='RPMH_BCM_TCS_CFG_VOTE_DATA_CD7_CP5'/>"
WRITE #1 "        <register address='0xbbe5858' value='0x" DATA.LONG(A:0xbbe5858) "' name='RPMH_BCM_TCS_CFG_VOTE_DATA_CD7_CP6'/>"
WRITE #1 "        <register address='0xbbe585c' value='0x" DATA.LONG(A:0xbbe585c) "' name='RPMH_BCM_TCS_CFG_VOTE_DATA_CD7_CP7'/>"
WRITE #1 "        <register address='0xbbe5860' value='0x" DATA.LONG(A:0xbbe5860) "' name='RPMH_BCM_TCS_CFG_VOTE_DATA_CD7_CP8'/>"
WRITE #1 "        <register address='0xbbe5864' value='0x" DATA.LONG(A:0xbbe5864) "' name='RPMH_BCM_TCS_CFG_VOTE_DATA_CD7_CP9'/>"
WRITE #1 "        <register address='0xbbe5868' value='0x" DATA.LONG(A:0xbbe5868) "' name='RPMH_BCM_TCS_CFG_VOTE_DATA_CD7_CP10'/>"
WRITE #1 "        <register address='0xbbe586c' value='0x" DATA.LONG(A:0xbbe586c) "' name='RPMH_BCM_TCS_CFG_VOTE_DATA_CD7_CP11'/>"
WRITE #1 "        <register address='0xbbe5870' value='0x" DATA.LONG(A:0xbbe5870) "' name='RPMH_BCM_TCS_CFG_VOTE_DATA_CD7_CP12'/>"
WRITE #1 "        <register address='0xbbe5874' value='0x" DATA.LONG(A:0xbbe5874) "' name='RPMH_BCM_TCS_CFG_VOTE_DATA_CD7_CP13'/>"
WRITE #1 "        <register address='0xbbe5878' value='0x" DATA.LONG(A:0xbbe5878) "' name='RPMH_BCM_TCS_CFG_VOTE_DATA_CD7_CP14'/>"
WRITE #1 "        <register address='0xbbe587c' value='0x" DATA.LONG(A:0xbbe587c) "' name='RPMH_BCM_TCS_CFG_VOTE_DATA_CD7_CP15'/>"
WRITE #1 "        <register address='0xbbe5880' value='0x" DATA.LONG(A:0xbbe5880) "' name='RPMH_BCM_TCS_CFG_VOTE_DATA_CD8_CP0'/>"
WRITE #1 "        <register address='0xbbe5884' value='0x" DATA.LONG(A:0xbbe5884) "' name='RPMH_BCM_TCS_CFG_VOTE_DATA_CD8_CP1'/>"
WRITE #1 "        <register address='0xbbe5888' value='0x" DATA.LONG(A:0xbbe5888) "' name='RPMH_BCM_TCS_CFG_VOTE_DATA_CD8_CP2'/>"
WRITE #1 "        <register address='0xbbe588c' value='0x" DATA.LONG(A:0xbbe588c) "' name='RPMH_BCM_TCS_CFG_VOTE_DATA_CD8_CP3'/>"
WRITE #1 "        <register address='0xbbe5890' value='0x" DATA.LONG(A:0xbbe5890) "' name='RPMH_BCM_TCS_CFG_VOTE_DATA_CD8_CP4'/>"
WRITE #1 "        <register address='0xbbe5894' value='0x" DATA.LONG(A:0xbbe5894) "' name='RPMH_BCM_TCS_CFG_VOTE_DATA_CD8_CP5'/>"
WRITE #1 "        <register address='0xbbe5898' value='0x" DATA.LONG(A:0xbbe5898) "' name='RPMH_BCM_TCS_CFG_VOTE_DATA_CD8_CP6'/>"
WRITE #1 "        <register address='0xbbe589c' value='0x" DATA.LONG(A:0xbbe589c) "' name='RPMH_BCM_TCS_CFG_VOTE_DATA_CD8_CP7'/>"
WRITE #1 "        <register address='0xbbe58a0' value='0x" DATA.LONG(A:0xbbe58a0) "' name='RPMH_BCM_TCS_CFG_VOTE_DATA_CD8_CP8'/>"
WRITE #1 "        <register address='0xbbe58a4' value='0x" DATA.LONG(A:0xbbe58a4) "' name='RPMH_BCM_TCS_CFG_VOTE_DATA_CD8_CP9'/>"
WRITE #1 "        <register address='0xbbe58a8' value='0x" DATA.LONG(A:0xbbe58a8) "' name='RPMH_BCM_TCS_CFG_VOTE_DATA_CD8_CP10'/>"
WRITE #1 "        <register address='0xbbe58ac' value='0x" DATA.LONG(A:0xbbe58ac) "' name='RPMH_BCM_TCS_CFG_VOTE_DATA_CD8_CP11'/>"
WRITE #1 "        <register address='0xbbe58b0' value='0x" DATA.LONG(A:0xbbe58b0) "' name='RPMH_BCM_TCS_CFG_VOTE_DATA_CD8_CP12'/>"
WRITE #1 "        <register address='0xbbe58b4' value='0x" DATA.LONG(A:0xbbe58b4) "' name='RPMH_BCM_TCS_CFG_VOTE_DATA_CD8_CP13'/>"
WRITE #1 "        <register address='0xbbe58b8' value='0x" DATA.LONG(A:0xbbe58b8) "' name='RPMH_BCM_TCS_CFG_VOTE_DATA_CD8_CP14'/>"
WRITE #1 "        <register address='0xbbe58bc' value='0x" DATA.LONG(A:0xbbe58bc) "' name='RPMH_BCM_TCS_CFG_VOTE_DATA_CD8_CP15'/>"
WRITE #1 "        <register address='0xbbe58c0' value='0x" DATA.LONG(A:0xbbe58c0) "' name='RPMH_BCM_TCS_CFG_VOTE_DATA_CD9_CP0'/>"
WRITE #1 "        <register address='0xbbe58c4' value='0x" DATA.LONG(A:0xbbe58c4) "' name='RPMH_BCM_TCS_CFG_VOTE_DATA_CD9_CP1'/>"
WRITE #1 "        <register address='0xbbe58c8' value='0x" DATA.LONG(A:0xbbe58c8) "' name='RPMH_BCM_TCS_CFG_VOTE_DATA_CD9_CP2'/>"
WRITE #1 "        <register address='0xbbe58cc' value='0x" DATA.LONG(A:0xbbe58cc) "' name='RPMH_BCM_TCS_CFG_VOTE_DATA_CD9_CP3'/>"
WRITE #1 "        <register address='0xbbe58d0' value='0x" DATA.LONG(A:0xbbe58d0) "' name='RPMH_BCM_TCS_CFG_VOTE_DATA_CD9_CP4'/>"
WRITE #1 "        <register address='0xbbe58d4' value='0x" DATA.LONG(A:0xbbe58d4) "' name='RPMH_BCM_TCS_CFG_VOTE_DATA_CD9_CP5'/>"
WRITE #1 "        <register address='0xbbe58d8' value='0x" DATA.LONG(A:0xbbe58d8) "' name='RPMH_BCM_TCS_CFG_VOTE_DATA_CD9_CP6'/>"
WRITE #1 "        <register address='0xbbe58dc' value='0x" DATA.LONG(A:0xbbe58dc) "' name='RPMH_BCM_TCS_CFG_VOTE_DATA_CD9_CP7'/>"
WRITE #1 "        <register address='0xbbe5900' value='0x" DATA.LONG(A:0xbbe5900) "' name='RPMH_BCM_TCS_CFG_VOTE_DATA_CD10_CP0'/>"
WRITE #1 "        <register address='0xbbe5904' value='0x" DATA.LONG(A:0xbbe5904) "' name='RPMH_BCM_TCS_CFG_VOTE_DATA_CD10_CP1'/>"
WRITE #1 "        <register address='0xbbe5908' value='0x" DATA.LONG(A:0xbbe5908) "' name='RPMH_BCM_TCS_CFG_VOTE_DATA_CD10_CP2'/>"
WRITE #1 "        <register address='0xbbe590c' value='0x" DATA.LONG(A:0xbbe590c) "' name='RPMH_BCM_TCS_CFG_VOTE_DATA_CD10_CP3'/>"
WRITE #1 "        <register address='0xbbe5910' value='0x" DATA.LONG(A:0xbbe5910) "' name='RPMH_BCM_TCS_CFG_VOTE_DATA_CD10_CP4'/>"
WRITE #1 "        <register address='0xbbe5914' value='0x" DATA.LONG(A:0xbbe5914) "' name='RPMH_BCM_TCS_CFG_VOTE_DATA_CD10_CP5'/>"
WRITE #1 "        <register address='0xbbe5918' value='0x" DATA.LONG(A:0xbbe5918) "' name='RPMH_BCM_TCS_CFG_VOTE_DATA_CD10_CP6'/>"
WRITE #1 "        <register address='0xbbe591c' value='0x" DATA.LONG(A:0xbbe591c) "' name='RPMH_BCM_TCS_CFG_VOTE_DATA_CD10_CP7'/>"
WRITE #1 "        <register address='0xbbe5940' value='0x" DATA.LONG(A:0xbbe5940) "' name='RPMH_BCM_TCS_CFG_VOTE_DATA_CD11_CP0'/>"
WRITE #1 "        <register address='0xbbe5944' value='0x" DATA.LONG(A:0xbbe5944) "' name='RPMH_BCM_TCS_CFG_VOTE_DATA_CD11_CP1'/>"
WRITE #1 "        <register address='0xbbe5948' value='0x" DATA.LONG(A:0xbbe5948) "' name='RPMH_BCM_TCS_CFG_VOTE_DATA_CD11_CP2'/>"
WRITE #1 "        <register address='0xbbe594c' value='0x" DATA.LONG(A:0xbbe594c) "' name='RPMH_BCM_TCS_CFG_VOTE_DATA_CD11_CP3'/>"
WRITE #1 "        <register address='0xbbe5950' value='0x" DATA.LONG(A:0xbbe5950) "' name='RPMH_BCM_TCS_CFG_VOTE_DATA_CD11_CP4'/>"
WRITE #1 "        <register address='0xbbe5954' value='0x" DATA.LONG(A:0xbbe5954) "' name='RPMH_BCM_TCS_CFG_VOTE_DATA_CD11_CP5'/>"
WRITE #1 "        <register address='0xbbe5958' value='0x" DATA.LONG(A:0xbbe5958) "' name='RPMH_BCM_TCS_CFG_VOTE_DATA_CD11_CP6'/>"
WRITE #1 "        <register address='0xbbe595c' value='0x" DATA.LONG(A:0xbbe595c) "' name='RPMH_BCM_TCS_CFG_VOTE_DATA_CD11_CP7'/>"
WRITE #1 "        <register address='0xbbe5960' value='0x" DATA.LONG(A:0xbbe5960) "' name='RPMH_BCM_TCS_CFG_VOTE_DATA_CD11_CP8'/>"
WRITE #1 "        <register address='0xbbe5964' value='0x" DATA.LONG(A:0xbbe5964) "' name='RPMH_BCM_TCS_CFG_VOTE_DATA_CD11_CP9'/>"
WRITE #1 "        <register address='0xbbe5968' value='0x" DATA.LONG(A:0xbbe5968) "' name='RPMH_BCM_TCS_CFG_VOTE_DATA_CD11_CP10'/>"
WRITE #1 "        <register address='0xbbe596c' value='0x" DATA.LONG(A:0xbbe596c) "' name='RPMH_BCM_TCS_CFG_VOTE_DATA_CD11_CP11'/>"
WRITE #1 "        <register address='0xbbe5970' value='0x" DATA.LONG(A:0xbbe5970) "' name='RPMH_BCM_TCS_CFG_VOTE_DATA_CD11_CP12'/>"
WRITE #1 "        <register address='0xbbe5974' value='0x" DATA.LONG(A:0xbbe5974) "' name='RPMH_BCM_TCS_CFG_VOTE_DATA_CD11_CP13'/>"
WRITE #1 "        <register address='0xbbe5978' value='0x" DATA.LONG(A:0xbbe5978) "' name='RPMH_BCM_TCS_CFG_VOTE_DATA_CD11_CP14'/>"
WRITE #1 "        <register address='0xbbe597c' value='0x" DATA.LONG(A:0xbbe597c) "' name='RPMH_BCM_TCS_CFG_VOTE_DATA_CD11_CP15'/>"
WRITE #1 "        <register address='0xbbe5e80' value='0x" DATA.LONG(A:0xbbe5e80) "' name='RPMH_BCM_TCS_VOTE_RESP_BACK'/>"
WRITE #1 "        <register address='0xbbe6800' value='0x" DATA.LONG(A:0xbbe6800) "' name='RPMH_BCM_ALGO_ADDR0'/>"
WRITE #1 "        <register address='0xbbe6804' value='0x" DATA.LONG(A:0xbbe6804) "' name='RPMH_BCM_ALGO_ADDR1'/>"
WRITE #1 "        <register address='0xbbe6808' value='0x" DATA.LONG(A:0xbbe6808) "' name='RPMH_BCM_ALGO_ADDR2'/>"
WRITE #1 "        <register address='0xbbe680c' value='0x" DATA.LONG(A:0xbbe680c) "' name='RPMH_BCM_ALGO_ADDR3'/>"
WRITE #1 "        <register address='0xbbe6810' value='0x" DATA.LONG(A:0xbbe6810) "' name='RPMH_BCM_ALGO_ADDR4'/>"
WRITE #1 "        <register address='0xbbe6814' value='0x" DATA.LONG(A:0xbbe6814) "' name='RPMH_BCM_ALGO_ADDR5'/>"
WRITE #1 "        <register address='0xbbe6818' value='0x" DATA.LONG(A:0xbbe6818) "' name='RPMH_BCM_ALGO_ADDR6'/>"
WRITE #1 "        <register address='0xbbe681c' value='0x" DATA.LONG(A:0xbbe681c) "' name='RPMH_BCM_ALGO_ADDR7'/>"
WRITE #1 "        <register address='0xbbe6820' value='0x" DATA.LONG(A:0xbbe6820) "' name='RPMH_BCM_ALGO_ADDR8'/>"
WRITE #1 "        <register address='0xbbe6824' value='0x" DATA.LONG(A:0xbbe6824) "' name='RPMH_BCM_ALGO_ADDR9'/>"
WRITE #1 "        <register address='0xbbe6828' value='0x" DATA.LONG(A:0xbbe6828) "' name='RPMH_BCM_ALGO_ADDR10'/>"
WRITE #1 "        <register address='0xbbe682c' value='0x" DATA.LONG(A:0xbbe682c) "' name='RPMH_BCM_ALGO_ADDR11'/>"
WRITE #1 "        <register address='0xbbe6830' value='0x" DATA.LONG(A:0xbbe6830) "' name='RPMH_BCM_ALGO_ADDR12'/>"
WRITE #1 "        <register address='0xbbe6834' value='0x" DATA.LONG(A:0xbbe6834) "' name='RPMH_BCM_ALGO_ADDR13'/>"
WRITE #1 "        <register address='0xbbe6838' value='0x" DATA.LONG(A:0xbbe6838) "' name='RPMH_BCM_ALGO_ADDR14'/>"
WRITE #1 "        <register address='0xbbe683c' value='0x" DATA.LONG(A:0xbbe683c) "' name='RPMH_BCM_ALGO_ADDR15'/>"
WRITE #1 "        <register address='0xbbe6840' value='0x" DATA.LONG(A:0xbbe6840) "' name='RPMH_BCM_ALGO_ADDR16'/>"
WRITE #1 "        <register address='0xbbe6844' value='0x" DATA.LONG(A:0xbbe6844) "' name='RPMH_BCM_ALGO_ADDR17'/>"
WRITE #1 "        <register address='0xbbe6848' value='0x" DATA.LONG(A:0xbbe6848) "' name='RPMH_BCM_ALGO_ADDR18'/>"
WRITE #1 "        <register address='0xbbe684c' value='0x" DATA.LONG(A:0xbbe684c) "' name='RPMH_BCM_ALGO_ADDR19'/>"
WRITE #1 "        <register address='0xbbe6850' value='0x" DATA.LONG(A:0xbbe6850) "' name='RPMH_BCM_ALGO_ADDR20'/>"
WRITE #1 "        <register address='0xbbe6854' value='0x" DATA.LONG(A:0xbbe6854) "' name='RPMH_BCM_ALGO_ADDR21'/>"
WRITE #1 "        <register address='0xbbe6858' value='0x" DATA.LONG(A:0xbbe6858) "' name='RPMH_BCM_ALGO_ADDR22'/>"
WRITE #1 "        <register address='0xbbe685c' value='0x" DATA.LONG(A:0xbbe685c) "' name='RPMH_BCM_ALGO_ADDR23'/>"
WRITE #1 "        <register address='0xbbe6860' value='0x" DATA.LONG(A:0xbbe6860) "' name='RPMH_BCM_ALGO_ADDR24'/>"
WRITE #1 "        <register address='0xbbe6864' value='0x" DATA.LONG(A:0xbbe6864) "' name='RPMH_BCM_ALGO_ADDR25'/>"
WRITE #1 "        <register address='0xbbe6868' value='0x" DATA.LONG(A:0xbbe6868) "' name='RPMH_BCM_ALGO_ADDR26'/>"
WRITE #1 "        <register address='0xbbe686c' value='0x" DATA.LONG(A:0xbbe686c) "' name='RPMH_BCM_ALGO_ADDR27'/>"
WRITE #1 "        <register address='0xbbe6870' value='0x" DATA.LONG(A:0xbbe6870) "' name='RPMH_BCM_ALGO_ADDR28'/>"
WRITE #1 "        <register address='0xbbe6874' value='0x" DATA.LONG(A:0xbbe6874) "' name='RPMH_BCM_ALGO_ADDR29'/>"
WRITE #1 "        <register address='0xbbe6878' value='0x" DATA.LONG(A:0xbbe6878) "' name='RPMH_BCM_ALGO_ADDR30'/>"
WRITE #1 "        <register address='0xbbe687c' value='0x" DATA.LONG(A:0xbbe687c) "' name='RPMH_BCM_ALGO_ADDR31'/>"
WRITE #1 "        <register address='0xbbe6900' value='0x" DATA.LONG(A:0xbbe6900) "' name='RPMH_BCM_AU_CFG_SCALAR0'/>"
WRITE #1 "        <register address='0xbbe6904' value='0x" DATA.LONG(A:0xbbe6904) "' name='RPMH_BCM_AU_CFG_SCALAR1'/>"
WRITE #1 "        <register address='0xbbe6908' value='0x" DATA.LONG(A:0xbbe6908) "' name='RPMH_BCM_AU_CFG_SCALAR2'/>"
WRITE #1 "        <register address='0xbbe690c' value='0x" DATA.LONG(A:0xbbe690c) "' name='RPMH_BCM_AU_CFG_SCALAR3'/>"
WRITE #1 "        <register address='0xbbe6910' value='0x" DATA.LONG(A:0xbbe6910) "' name='RPMH_BCM_AU_CFG_SCALAR4'/>"
WRITE #1 "        <register address='0xbbe6914' value='0x" DATA.LONG(A:0xbbe6914) "' name='RPMH_BCM_AU_CFG_SCALAR5'/>"
WRITE #1 "        <register address='0xbbe6918' value='0x" DATA.LONG(A:0xbbe6918) "' name='RPMH_BCM_AU_CFG_SCALAR6'/>"
WRITE #1 "        <register address='0xbbe691c' value='0x" DATA.LONG(A:0xbbe691c) "' name='RPMH_BCM_AU_CFG_SCALAR7'/>"
WRITE #1 "        <register address='0xbbe6920' value='0x" DATA.LONG(A:0xbbe6920) "' name='RPMH_BCM_AU_CFG_SCALAR8'/>"
WRITE #1 "        <register address='0xbbe6924' value='0x" DATA.LONG(A:0xbbe6924) "' name='RPMH_BCM_AU_CFG_SCALAR9'/>"
WRITE #1 "        <register address='0xbbe6928' value='0x" DATA.LONG(A:0xbbe6928) "' name='RPMH_BCM_AU_CFG_SCALAR10'/>"
WRITE #1 "        <register address='0xbbe692c' value='0x" DATA.LONG(A:0xbbe692c) "' name='RPMH_BCM_AU_CFG_SCALAR11'/>"
WRITE #1 "        <register address='0xbbe6930' value='0x" DATA.LONG(A:0xbbe6930) "' name='RPMH_BCM_AU_CFG_SCALAR12'/>"
WRITE #1 "        <register address='0xbbe6934' value='0x" DATA.LONG(A:0xbbe6934) "' name='RPMH_BCM_AU_CFG_SCALAR13'/>"
WRITE #1 "        <register address='0xbbe6938' value='0x" DATA.LONG(A:0xbbe6938) "' name='RPMH_BCM_AU_CFG_SCALAR14'/>"
WRITE #1 "        <register address='0xbbe693c' value='0x" DATA.LONG(A:0xbbe693c) "' name='RPMH_BCM_AU_CFG_SCALAR15'/>"
WRITE #1 "        <register address='0xbbe6940' value='0x" DATA.LONG(A:0xbbe6940) "' name='RPMH_BCM_AU_CFG_SCALAR16'/>"
WRITE #1 "        <register address='0xbbe6944' value='0x" DATA.LONG(A:0xbbe6944) "' name='RPMH_BCM_AU_CFG_SCALAR17'/>"
WRITE #1 "        <register address='0xbbe6948' value='0x" DATA.LONG(A:0xbbe6948) "' name='RPMH_BCM_AU_CFG_SCALAR18'/>"
WRITE #1 "        <register address='0xbbe694c' value='0x" DATA.LONG(A:0xbbe694c) "' name='RPMH_BCM_AU_CFG_SCALAR19'/>"
WRITE #1 "        <register address='0xbbe6950' value='0x" DATA.LONG(A:0xbbe6950) "' name='RPMH_BCM_AU_CFG_SCALAR20'/>"
WRITE #1 "        <register address='0xbbe6954' value='0x" DATA.LONG(A:0xbbe6954) "' name='RPMH_BCM_AU_CFG_SCALAR21'/>"
WRITE #1 "        <register address='0xbbe6958' value='0x" DATA.LONG(A:0xbbe6958) "' name='RPMH_BCM_AU_CFG_SCALAR22'/>"
WRITE #1 "        <register address='0xbbe695c' value='0x" DATA.LONG(A:0xbbe695c) "' name='RPMH_BCM_AU_CFG_SCALAR23'/>"
WRITE #1 "        <register address='0xbbe6960' value='0x" DATA.LONG(A:0xbbe6960) "' name='RPMH_BCM_AU_CFG_SCALAR24'/>"
WRITE #1 "        <register address='0xbbe6964' value='0x" DATA.LONG(A:0xbbe6964) "' name='RPMH_BCM_AU_CFG_SCALAR25'/>"
WRITE #1 "        <register address='0xbbe6968' value='0x" DATA.LONG(A:0xbbe6968) "' name='RPMH_BCM_AU_CFG_SCALAR26'/>"
WRITE #1 "        <register address='0xbbe696c' value='0x" DATA.LONG(A:0xbbe696c) "' name='RPMH_BCM_AU_CFG_SCALAR27'/>"
WRITE #1 "        <register address='0xbbe6970' value='0x" DATA.LONG(A:0xbbe6970) "' name='RPMH_BCM_AU_CFG_SCALAR28'/>"
WRITE #1 "        <register address='0xbbe6974' value='0x" DATA.LONG(A:0xbbe6974) "' name='RPMH_BCM_AU_CFG_SCALAR29'/>"
WRITE #1 "        <register address='0xbbe6978' value='0x" DATA.LONG(A:0xbbe6978) "' name='RPMH_BCM_AU_CFG_SCALAR30'/>"
WRITE #1 "        <register address='0xbbe697c' value='0x" DATA.LONG(A:0xbbe697c) "' name='RPMH_BCM_AU_CFG_SCALAR31'/>"
WRITE #1 "        <register address='0xbbe6980' value='0x" DATA.LONG(A:0xbbe6980) "' name='RPMH_BCM_AU_CFG_SCALAR_FORMAT'/>"
WRITE #1 "        <register address='0xbbe7000' value='0x" DATA.LONG(A:0xbbe7000) "' name='RPMH_BCM_BCM_CFG_BCM_EN'/>"
WRITE #1 "        <register address='0xbbe7004' value='0x" DATA.LONG(A:0xbbe7004) "' name='RPMH_BCM_BCM_CFG_SLV_ID_FOR_RESP'/>"
WRITE #1 "        <register address='0xbbe7008' value='0x" DATA.LONG(A:0xbbe7008) "' name='RPMH_BCM_BCM_CFG_DRV_ID_FOR_ARC_VOTE'/>"
WRITE #1 "        <register address='0xbbe7088' value='0x" DATA.LONG(A:0xbbe7088) "' name='RPMH_BCM_BCM_CFG_DRV_ID_FOR_VRM_VOTE'/>"
WRITE #1 "        <register address='0xbbe708c' value='0x" DATA.LONG(A:0xbbe708c) "' name='RPMH_BCM_BCM_CFG_DRV0'/>"
WRITE #1 "        <register address='0xbbe7090' value='0x" DATA.LONG(A:0xbbe7090) "' name='RPMH_BCM_BCM_CFG_DRV1'/>"
WRITE #1 "        <register address='0xbbe7094' value='0x" DATA.LONG(A:0xbbe7094) "' name='RPMH_BCM_BCM_CFG_DRV2'/>"
WRITE #1 "        <register address='0xbbe7098' value='0x" DATA.LONG(A:0xbbe7098) "' name='RPMH_BCM_BCM_CFG_DRV3'/>"
WRITE #1 "        <register address='0xbbe709c' value='0x" DATA.LONG(A:0xbbe709c) "' name='RPMH_BCM_BCM_CFG_DRV4'/>"
WRITE #1 "        <register address='0xbbe7110' value='0x" DATA.LONG(A:0xbbe7110) "' name='RPMH_BCM_BCM_CFG_ARCH_CG_DISABLE'/>"
WRITE #1 "        <register address='0xbbf0000' value='0x" DATA.LONG(A:0xbbf0000) "' name='RPMH_BCM_STATUS_FE_AGG_FSM'/>"
WRITE #1 "        <register address='0xbbf0004' value='0x" DATA.LONG(A:0xbbf0004) "' name='RPMH_BCM_STATUS_FE_CD0'/>"
WRITE #1 "        <register address='0xbbf0008' value='0x" DATA.LONG(A:0xbbf0008) "' name='RPMH_BCM_STATUS_FE_CD1'/>"
WRITE #1 "        <register address='0xbbf000c' value='0x" DATA.LONG(A:0xbbf000c) "' name='RPMH_BCM_STATUS_FE_CD2'/>"
WRITE #1 "        <register address='0xbbf0010' value='0x" DATA.LONG(A:0xbbf0010) "' name='RPMH_BCM_STATUS_FE_CD3'/>"
WRITE #1 "        <register address='0xbbf0014' value='0x" DATA.LONG(A:0xbbf0014) "' name='RPMH_BCM_STATUS_FE_CD4'/>"
WRITE #1 "        <register address='0xbbf0018' value='0x" DATA.LONG(A:0xbbf0018) "' name='RPMH_BCM_STATUS_FE_CD5'/>"
WRITE #1 "        <register address='0xbbf001c' value='0x" DATA.LONG(A:0xbbf001c) "' name='RPMH_BCM_STATUS_FE_CD6'/>"
WRITE #1 "        <register address='0xbbf0020' value='0x" DATA.LONG(A:0xbbf0020) "' name='RPMH_BCM_STATUS_FE_CD7'/>"
WRITE #1 "        <register address='0xbbf0024' value='0x" DATA.LONG(A:0xbbf0024) "' name='RPMH_BCM_STATUS_FE_CD8'/>"
WRITE #1 "        <register address='0xbbf0028' value='0x" DATA.LONG(A:0xbbf0028) "' name='RPMH_BCM_STATUS_FE_CD9'/>"
WRITE #1 "        <register address='0xbbf002c' value='0x" DATA.LONG(A:0xbbf002c) "' name='RPMH_BCM_STATUS_FE_CD10'/>"
WRITE #1 "        <register address='0xbbf0030' value='0x" DATA.LONG(A:0xbbf0030) "' name='RPMH_BCM_STATUS_FE_CD11'/>"
WRITE #1 "        <register address='0xbbf0084' value='0x" DATA.LONG(A:0xbbf0084) "' name='RPMH_BCM_STATUS_DIRTY_ND_0'/>"
WRITE #1 "        <register address='0xbbf0088' value='0x" DATA.LONG(A:0xbbf0088) "' name='RPMH_BCM_STATUS_DIRTY_ND_1'/>"
WRITE #1 "        <register address='0xbbf008c' value='0x" DATA.LONG(A:0xbbf008c) "' name='RPMH_BCM_STATUS_SND0'/>"
WRITE #1 "        <register address='0xbbf0090' value='0x" DATA.LONG(A:0xbbf0090) "' name='RPMH_BCM_STATUS_SND1'/>"
WRITE #1 "        <register address='0xbbf0094' value='0x" DATA.LONG(A:0xbbf0094) "' name='RPMH_BCM_STATUS_SND2'/>"
WRITE #1 "        <register address='0xbbf0098' value='0x" DATA.LONG(A:0xbbf0098) "' name='RPMH_BCM_STATUS_SND3'/>"
WRITE #1 "        <register address='0xbbf010c' value='0x" DATA.LONG(A:0xbbf010c) "' name='RPMH_BCM_STATUS_AGG_BW_ND0'/>"
WRITE #1 "        <register address='0xbbf0110' value='0x" DATA.LONG(A:0xbbf0110) "' name='RPMH_BCM_STATUS_AGG_BW_ND1'/>"
WRITE #1 "        <register address='0xbbf0114' value='0x" DATA.LONG(A:0xbbf0114) "' name='RPMH_BCM_STATUS_AGG_BW_ND2'/>"
WRITE #1 "        <register address='0xbbf0118' value='0x" DATA.LONG(A:0xbbf0118) "' name='RPMH_BCM_STATUS_AGG_BW_ND3'/>"
WRITE #1 "        <register address='0xbbf011c' value='0x" DATA.LONG(A:0xbbf011c) "' name='RPMH_BCM_STATUS_AGG_BW_ND4'/>"
WRITE #1 "        <register address='0xbbf0120' value='0x" DATA.LONG(A:0xbbf0120) "' name='RPMH_BCM_STATUS_AGG_BW_ND5'/>"
WRITE #1 "        <register address='0xbbf0124' value='0x" DATA.LONG(A:0xbbf0124) "' name='RPMH_BCM_STATUS_AGG_BW_ND6'/>"
WRITE #1 "        <register address='0xbbf0128' value='0x" DATA.LONG(A:0xbbf0128) "' name='RPMH_BCM_STATUS_AGG_BW_ND7'/>"
WRITE #1 "        <register address='0xbbf012c' value='0x" DATA.LONG(A:0xbbf012c) "' name='RPMH_BCM_STATUS_AGG_BW_ND8'/>"
WRITE #1 "        <register address='0xbbf0130' value='0x" DATA.LONG(A:0xbbf0130) "' name='RPMH_BCM_STATUS_AGG_BW_ND9'/>"
WRITE #1 "        <register address='0xbbf0134' value='0x" DATA.LONG(A:0xbbf0134) "' name='RPMH_BCM_STATUS_AGG_BW_ND10'/>"
WRITE #1 "        <register address='0xbbf0138' value='0x" DATA.LONG(A:0xbbf0138) "' name='RPMH_BCM_STATUS_AGG_BW_ND11'/>"
WRITE #1 "        <register address='0xbbf013c' value='0x" DATA.LONG(A:0xbbf013c) "' name='RPMH_BCM_STATUS_AGG_BW_ND12'/>"
WRITE #1 "        <register address='0xbbf0140' value='0x" DATA.LONG(A:0xbbf0140) "' name='RPMH_BCM_STATUS_AGG_BW_ND13'/>"
WRITE #1 "        <register address='0xbbf0144' value='0x" DATA.LONG(A:0xbbf0144) "' name='RPMH_BCM_STATUS_AGG_BW_ND14'/>"
WRITE #1 "        <register address='0xbbf0148' value='0x" DATA.LONG(A:0xbbf0148) "' name='RPMH_BCM_STATUS_AGG_BW_ND15'/>"
WRITE #1 "        <register address='0xbbf014c' value='0x" DATA.LONG(A:0xbbf014c) "' name='RPMH_BCM_STATUS_AGG_BW_ND16'/>"
WRITE #1 "        <register address='0xbbf0150' value='0x" DATA.LONG(A:0xbbf0150) "' name='RPMH_BCM_STATUS_AGG_BW_ND17'/>"
WRITE #1 "        <register address='0xbbf0154' value='0x" DATA.LONG(A:0xbbf0154) "' name='RPMH_BCM_STATUS_AGG_BW_ND18'/>"
WRITE #1 "        <register address='0xbbf0158' value='0x" DATA.LONG(A:0xbbf0158) "' name='RPMH_BCM_STATUS_AGG_BW_ND19'/>"
WRITE #1 "        <register address='0xbbf015c' value='0x" DATA.LONG(A:0xbbf015c) "' name='RPMH_BCM_STATUS_AGG_BW_ND20'/>"
WRITE #1 "        <register address='0xbbf0160' value='0x" DATA.LONG(A:0xbbf0160) "' name='RPMH_BCM_STATUS_AGG_BW_ND21'/>"
WRITE #1 "        <register address='0xbbf0164' value='0x" DATA.LONG(A:0xbbf0164) "' name='RPMH_BCM_STATUS_AGG_BW_ND22'/>"
WRITE #1 "        <register address='0xbbf0168' value='0x" DATA.LONG(A:0xbbf0168) "' name='RPMH_BCM_STATUS_AGG_BW_ND23'/>"
WRITE #1 "        <register address='0xbbf016c' value='0x" DATA.LONG(A:0xbbf016c) "' name='RPMH_BCM_STATUS_AGG_BW_ND24'/>"
WRITE #1 "        <register address='0xbbf0170' value='0x" DATA.LONG(A:0xbbf0170) "' name='RPMH_BCM_STATUS_AGG_BW_ND25'/>"
WRITE #1 "        <register address='0xbbf0174' value='0x" DATA.LONG(A:0xbbf0174) "' name='RPMH_BCM_STATUS_AGG_BW_ND26'/>"
WRITE #1 "        <register address='0xbbf0178' value='0x" DATA.LONG(A:0xbbf0178) "' name='RPMH_BCM_STATUS_AGG_BW_ND27'/>"
WRITE #1 "        <register address='0xbbf017c' value='0x" DATA.LONG(A:0xbbf017c) "' name='RPMH_BCM_STATUS_AGG_BW_ND28'/>"
WRITE #1 "        <register address='0xbbf0180' value='0x" DATA.LONG(A:0xbbf0180) "' name='RPMH_BCM_STATUS_AGG_BW_ND29'/>"
WRITE #1 "        <register address='0xbbf0184' value='0x" DATA.LONG(A:0xbbf0184) "' name='RPMH_BCM_STATUS_AGG_BW_ND30'/>"
WRITE #1 "        <register address='0xbbf0188' value='0x" DATA.LONG(A:0xbbf0188) "' name='RPMH_BCM_STATUS_AGG_BW_ND31'/>"
WRITE #1 "        <register address='0xbbf018c' value='0x" DATA.LONG(A:0xbbf018c) "' name='RPMH_BCM_STATUS_AGG_BW_ND32'/>"
WRITE #1 "        <register address='0xbbf0190' value='0x" DATA.LONG(A:0xbbf0190) "' name='RPMH_BCM_STATUS_AGG_BW_ND33'/>"
WRITE #1 "        <register address='0xbbf0194' value='0x" DATA.LONG(A:0xbbf0194) "' name='RPMH_BCM_STATUS_AGG_BW_ND34'/>"
WRITE #1 "        <register address='0xbbf0198' value='0x" DATA.LONG(A:0xbbf0198) "' name='RPMH_BCM_STATUS_AGG_BW_ND35'/>"
WRITE #1 "        <register address='0xbbf019c' value='0x" DATA.LONG(A:0xbbf019c) "' name='RPMH_BCM_STATUS_AGG_BW_ND36'/>"
WRITE #1 "        <register address='0xbbf01a0' value='0x" DATA.LONG(A:0xbbf01a0) "' name='RPMH_BCM_STATUS_AGG_BW_ND37'/>"
WRITE #1 "        <register address='0xbbf01a4' value='0x" DATA.LONG(A:0xbbf01a4) "' name='RPMH_BCM_STATUS_AGG_BW_ND38'/>"
WRITE #1 "        <register address='0xbbf01a8' value='0x" DATA.LONG(A:0xbbf01a8) "' name='RPMH_BCM_STATUS_AGG_BW_ND39'/>"
WRITE #1 "        <register address='0xbbf01ac' value='0x" DATA.LONG(A:0xbbf01ac) "' name='RPMH_BCM_STATUS_AGG_BW_ND40'/>"
WRITE #1 "        <register address='0xbbf01b0' value='0x" DATA.LONG(A:0xbbf01b0) "' name='RPMH_BCM_STATUS_AGG_BW_ND41'/>"
WRITE #1 "        <register address='0xbbf01b4' value='0x" DATA.LONG(A:0xbbf01b4) "' name='RPMH_BCM_STATUS_AGG_BW_ND42'/>"
WRITE #1 "        <register address='0xbbf01b8' value='0x" DATA.LONG(A:0xbbf01b8) "' name='RPMH_BCM_STATUS_AGG_BW_ND43'/>"
WRITE #1 "        <register address='0xbbf030c' value='0x" DATA.LONG(A:0xbbf030c) "' name='RPMH_BCM_STATUS_AGG_BW_Z_ND0'/>"
WRITE #1 "        <register address='0xbbf0310' value='0x" DATA.LONG(A:0xbbf0310) "' name='RPMH_BCM_STATUS_AGG_BW_Z_ND1'/>"
WRITE #1 "        <register address='0xbbf0314' value='0x" DATA.LONG(A:0xbbf0314) "' name='RPMH_BCM_STATUS_AGG_BW_Z_ND2'/>"
WRITE #1 "        <register address='0xbbf0318' value='0x" DATA.LONG(A:0xbbf0318) "' name='RPMH_BCM_STATUS_AGG_BW_Z_ND3'/>"
WRITE #1 "        <register address='0xbbf0800' value='0x" DATA.LONG(A:0xbbf0800) "' name='RPMH_BCM_STATUS_BE_CD0'/>"
WRITE #1 "        <register address='0xbbf0804' value='0x" DATA.LONG(A:0xbbf0804) "' name='RPMH_BCM_STATUS_BE_CD1'/>"
WRITE #1 "        <register address='0xbbf0808' value='0x" DATA.LONG(A:0xbbf0808) "' name='RPMH_BCM_STATUS_BE_CD2'/>"
WRITE #1 "        <register address='0xbbf080c' value='0x" DATA.LONG(A:0xbbf080c) "' name='RPMH_BCM_STATUS_BE_CD3'/>"
WRITE #1 "        <register address='0xbbf0810' value='0x" DATA.LONG(A:0xbbf0810) "' name='RPMH_BCM_STATUS_BE_CD4'/>"
WRITE #1 "        <register address='0xbbf0814' value='0x" DATA.LONG(A:0xbbf0814) "' name='RPMH_BCM_STATUS_BE_CD5'/>"
WRITE #1 "        <register address='0xbbf0818' value='0x" DATA.LONG(A:0xbbf0818) "' name='RPMH_BCM_STATUS_BE_CD6'/>"
WRITE #1 "        <register address='0xbbf081c' value='0x" DATA.LONG(A:0xbbf081c) "' name='RPMH_BCM_STATUS_BE_CD7'/>"
WRITE #1 "        <register address='0xbbf0820' value='0x" DATA.LONG(A:0xbbf0820) "' name='RPMH_BCM_STATUS_BE_CD8'/>"
WRITE #1 "        <register address='0xbbf0824' value='0x" DATA.LONG(A:0xbbf0824) "' name='RPMH_BCM_STATUS_BE_CD9'/>"
WRITE #1 "        <register address='0xbbf0828' value='0x" DATA.LONG(A:0xbbf0828) "' name='RPMH_BCM_STATUS_BE_CD10'/>"
WRITE #1 "        <register address='0xbbf082c' value='0x" DATA.LONG(A:0xbbf082c) "' name='RPMH_BCM_STATUS_BE_CD11'/>"
WRITE #1 "        <register address='0xbbf0880' value='0x" DATA.LONG(A:0xbbf0880) "' name='RPMH_BCM_STATUS_BE_SEQ_CD0'/>"
WRITE #1 "        <register address='0xbbf0884' value='0x" DATA.LONG(A:0xbbf0884) "' name='RPMH_BCM_STATUS_BE_SEQ_CD1'/>"
WRITE #1 "        <register address='0xbbf0888' value='0x" DATA.LONG(A:0xbbf0888) "' name='RPMH_BCM_STATUS_BE_SEQ_CD2'/>"
WRITE #1 "        <register address='0xbbf088c' value='0x" DATA.LONG(A:0xbbf088c) "' name='RPMH_BCM_STATUS_BE_SEQ_CD3'/>"
WRITE #1 "        <register address='0xbbf0890' value='0x" DATA.LONG(A:0xbbf0890) "' name='RPMH_BCM_STATUS_BE_SEQ_CD4'/>"
WRITE #1 "        <register address='0xbbf0894' value='0x" DATA.LONG(A:0xbbf0894) "' name='RPMH_BCM_STATUS_BE_SEQ_CD5'/>"
WRITE #1 "        <register address='0xbbf0898' value='0x" DATA.LONG(A:0xbbf0898) "' name='RPMH_BCM_STATUS_BE_SEQ_CD6'/>"
WRITE #1 "        <register address='0xbbf089c' value='0x" DATA.LONG(A:0xbbf089c) "' name='RPMH_BCM_STATUS_BE_SEQ_CD7'/>"
WRITE #1 "        <register address='0xbbf08a0' value='0x" DATA.LONG(A:0xbbf08a0) "' name='RPMH_BCM_STATUS_BE_SEQ_CD8'/>"
WRITE #1 "        <register address='0xbbf08a4' value='0x" DATA.LONG(A:0xbbf08a4) "' name='RPMH_BCM_STATUS_BE_SEQ_CD9'/>"
WRITE #1 "        <register address='0xbbf08a8' value='0x" DATA.LONG(A:0xbbf08a8) "' name='RPMH_BCM_STATUS_BE_SEQ_CD10'/>"
WRITE #1 "        <register address='0xbbf08ac' value='0x" DATA.LONG(A:0xbbf08ac) "' name='RPMH_BCM_STATUS_BE_SEQ_CD11'/>"
WRITE #1 "        <register address='0xbbf0900' value='0x" DATA.LONG(A:0xbbf0900) "' name='RPMH_BCM_STATUS_BE_CMD_ISSUE_STATUS_CD0'/>"
WRITE #1 "        <register address='0xbbf0904' value='0x" DATA.LONG(A:0xbbf0904) "' name='RPMH_BCM_STATUS_BE_CMD_ISSUE_STATUS_CD1'/>"
WRITE #1 "        <register address='0xbbf0908' value='0x" DATA.LONG(A:0xbbf0908) "' name='RPMH_BCM_STATUS_BE_CMD_ISSUE_STATUS_CD2'/>"
WRITE #1 "        <register address='0xbbf090c' value='0x" DATA.LONG(A:0xbbf090c) "' name='RPMH_BCM_STATUS_BE_CMD_ISSUE_STATUS_CD3'/>"
WRITE #1 "        <register address='0xbbf0910' value='0x" DATA.LONG(A:0xbbf0910) "' name='RPMH_BCM_STATUS_BE_CMD_ISSUE_STATUS_CD4'/>"
WRITE #1 "        <register address='0xbbf0914' value='0x" DATA.LONG(A:0xbbf0914) "' name='RPMH_BCM_STATUS_BE_CMD_ISSUE_STATUS_CD5'/>"
WRITE #1 "        <register address='0xbbf0918' value='0x" DATA.LONG(A:0xbbf0918) "' name='RPMH_BCM_STATUS_BE_CMD_ISSUE_STATUS_CD6'/>"
WRITE #1 "        <register address='0xbbf091c' value='0x" DATA.LONG(A:0xbbf091c) "' name='RPMH_BCM_STATUS_BE_CMD_ISSUE_STATUS_CD7'/>"
WRITE #1 "        <register address='0xbbf0920' value='0x" DATA.LONG(A:0xbbf0920) "' name='RPMH_BCM_STATUS_BE_CMD_ISSUE_STATUS_CD8'/>"
WRITE #1 "        <register address='0xbbf0924' value='0x" DATA.LONG(A:0xbbf0924) "' name='RPMH_BCM_STATUS_BE_CMD_ISSUE_STATUS_CD9'/>"
WRITE #1 "        <register address='0xbbf0928' value='0x" DATA.LONG(A:0xbbf0928) "' name='RPMH_BCM_STATUS_BE_CMD_ISSUE_STATUS_CD10'/>"
WRITE #1 "        <register address='0xbbf092c' value='0x" DATA.LONG(A:0xbbf092c) "' name='RPMH_BCM_STATUS_BE_CMD_ISSUE_STATUS_CD11'/>"
WRITE #1 "        <register address='0xbbf0980' value='0x" DATA.LONG(A:0xbbf0980) "' name='RPMH_BCM_STATUS_BE_CMD_SENT_STATUS_CD0'/>"
WRITE #1 "        <register address='0xbbf0984' value='0x" DATA.LONG(A:0xbbf0984) "' name='RPMH_BCM_STATUS_BE_CMD_SENT_STATUS_CD1'/>"
WRITE #1 "        <register address='0xbbf0988' value='0x" DATA.LONG(A:0xbbf0988) "' name='RPMH_BCM_STATUS_BE_CMD_SENT_STATUS_CD2'/>"
WRITE #1 "        <register address='0xbbf098c' value='0x" DATA.LONG(A:0xbbf098c) "' name='RPMH_BCM_STATUS_BE_CMD_SENT_STATUS_CD3'/>"
WRITE #1 "        <register address='0xbbf0990' value='0x" DATA.LONG(A:0xbbf0990) "' name='RPMH_BCM_STATUS_BE_CMD_SENT_STATUS_CD4'/>"
WRITE #1 "        <register address='0xbbf0994' value='0x" DATA.LONG(A:0xbbf0994) "' name='RPMH_BCM_STATUS_BE_CMD_SENT_STATUS_CD5'/>"
WRITE #1 "        <register address='0xbbf0998' value='0x" DATA.LONG(A:0xbbf0998) "' name='RPMH_BCM_STATUS_BE_CMD_SENT_STATUS_CD6'/>"
WRITE #1 "        <register address='0xbbf099c' value='0x" DATA.LONG(A:0xbbf099c) "' name='RPMH_BCM_STATUS_BE_CMD_SENT_STATUS_CD7'/>"
WRITE #1 "        <register address='0xbbf09a0' value='0x" DATA.LONG(A:0xbbf09a0) "' name='RPMH_BCM_STATUS_BE_CMD_SENT_STATUS_CD8'/>"
WRITE #1 "        <register address='0xbbf09a4' value='0x" DATA.LONG(A:0xbbf09a4) "' name='RPMH_BCM_STATUS_BE_CMD_SENT_STATUS_CD9'/>"
WRITE #1 "        <register address='0xbbf09a8' value='0x" DATA.LONG(A:0xbbf09a8) "' name='RPMH_BCM_STATUS_BE_CMD_SENT_STATUS_CD10'/>"
WRITE #1 "        <register address='0xbbf09ac' value='0x" DATA.LONG(A:0xbbf09ac) "' name='RPMH_BCM_STATUS_BE_CMD_SENT_STATUS_CD11'/>"
WRITE #1 "        <register address='0xbbf0a00' value='0x" DATA.LONG(A:0xbbf0a00) "' name='RPMH_BCM_STATUS_BE_CMD_CMPL_STATUS_CD0'/>"
WRITE #1 "        <register address='0xbbf0a04' value='0x" DATA.LONG(A:0xbbf0a04) "' name='RPMH_BCM_STATUS_BE_CMD_CMPL_STATUS_CD1'/>"
WRITE #1 "        <register address='0xbbf0a08' value='0x" DATA.LONG(A:0xbbf0a08) "' name='RPMH_BCM_STATUS_BE_CMD_CMPL_STATUS_CD2'/>"
WRITE #1 "        <register address='0xbbf0a0c' value='0x" DATA.LONG(A:0xbbf0a0c) "' name='RPMH_BCM_STATUS_BE_CMD_CMPL_STATUS_CD3'/>"
WRITE #1 "        <register address='0xbbf0a10' value='0x" DATA.LONG(A:0xbbf0a10) "' name='RPMH_BCM_STATUS_BE_CMD_CMPL_STATUS_CD4'/>"
WRITE #1 "        <register address='0xbbf0a14' value='0x" DATA.LONG(A:0xbbf0a14) "' name='RPMH_BCM_STATUS_BE_CMD_CMPL_STATUS_CD5'/>"
WRITE #1 "        <register address='0xbbf0a18' value='0x" DATA.LONG(A:0xbbf0a18) "' name='RPMH_BCM_STATUS_BE_CMD_CMPL_STATUS_CD6'/>"
WRITE #1 "        <register address='0xbbf0a1c' value='0x" DATA.LONG(A:0xbbf0a1c) "' name='RPMH_BCM_STATUS_BE_CMD_CMPL_STATUS_CD7'/>"
WRITE #1 "        <register address='0xbbf0a20' value='0x" DATA.LONG(A:0xbbf0a20) "' name='RPMH_BCM_STATUS_BE_CMD_CMPL_STATUS_CD8'/>"
WRITE #1 "        <register address='0xbbf0a24' value='0x" DATA.LONG(A:0xbbf0a24) "' name='RPMH_BCM_STATUS_BE_CMD_CMPL_STATUS_CD9'/>"
WRITE #1 "        <register address='0xbbf0a28' value='0x" DATA.LONG(A:0xbbf0a28) "' name='RPMH_BCM_STATUS_BE_CMD_CMPL_STATUS_CD10'/>"
WRITE #1 "        <register address='0xbbf0a2c' value='0x" DATA.LONG(A:0xbbf0a2c) "' name='RPMH_BCM_STATUS_BE_CMD_CMPL_STATUS_CD11'/>"
WRITE #1 "        <register address='0xbbf0a80' value='0x" DATA.LONG(A:0xbbf0a80) "' name='RPMH_BCM_STATUS_BE_TCS_STATUS_CD0'/>"
WRITE #1 "        <register address='0xbbf0a84' value='0x" DATA.LONG(A:0xbbf0a84) "' name='RPMH_BCM_STATUS_BE_TCS_STATUS_CD1'/>"
WRITE #1 "        <register address='0xbbf0a88' value='0x" DATA.LONG(A:0xbbf0a88) "' name='RPMH_BCM_STATUS_BE_TCS_STATUS_CD2'/>"
WRITE #1 "        <register address='0xbbf0a8c' value='0x" DATA.LONG(A:0xbbf0a8c) "' name='RPMH_BCM_STATUS_BE_TCS_STATUS_CD3'/>"
WRITE #1 "        <register address='0xbbf0a90' value='0x" DATA.LONG(A:0xbbf0a90) "' name='RPMH_BCM_STATUS_BE_TCS_STATUS_CD4'/>"
WRITE #1 "        <register address='0xbbf0a94' value='0x" DATA.LONG(A:0xbbf0a94) "' name='RPMH_BCM_STATUS_BE_TCS_STATUS_CD5'/>"
WRITE #1 "        <register address='0xbbf0a98' value='0x" DATA.LONG(A:0xbbf0a98) "' name='RPMH_BCM_STATUS_BE_TCS_STATUS_CD6'/>"
WRITE #1 "        <register address='0xbbf0a9c' value='0x" DATA.LONG(A:0xbbf0a9c) "' name='RPMH_BCM_STATUS_BE_TCS_STATUS_CD7'/>"
WRITE #1 "        <register address='0xbbf0aa0' value='0x" DATA.LONG(A:0xbbf0aa0) "' name='RPMH_BCM_STATUS_BE_TCS_STATUS_CD8'/>"
WRITE #1 "        <register address='0xbbf0aa4' value='0x" DATA.LONG(A:0xbbf0aa4) "' name='RPMH_BCM_STATUS_BE_TCS_STATUS_CD9'/>"
WRITE #1 "        <register address='0xbbf0aa8' value='0x" DATA.LONG(A:0xbbf0aa8) "' name='RPMH_BCM_STATUS_BE_TCS_STATUS_CD10'/>"
WRITE #1 "        <register address='0xbbf0aac' value='0x" DATA.LONG(A:0xbbf0aac) "' name='RPMH_BCM_STATUS_BE_TCS_STATUS_CD11'/>"
WRITE #1 "        <register address='0xbbf0f00' value='0x" DATA.LONG(A:0xbbf0f00) "' name='RPMH_BCM_STATUS_CE_DRV0_CTT0'/>"
WRITE #1 "        <register address='0xbbf0f04' value='0x" DATA.LONG(A:0xbbf0f04) "' name='RPMH_BCM_STATUS_CE_DRV0_CTT1'/>"
WRITE #1 "        <register address='0xbbf0f08' value='0x" DATA.LONG(A:0xbbf0f08) "' name='RPMH_BCM_STATUS_CE_DRV0_CTT2'/>"
WRITE #1 "        <register address='0xbbf0f0c' value='0x" DATA.LONG(A:0xbbf0f0c) "' name='RPMH_BCM_STATUS_CE_DRV0_CTT3'/>"
WRITE #1 "        <register address='0xbbf0f10' value='0x" DATA.LONG(A:0xbbf0f10) "' name='RPMH_BCM_STATUS_CE_DRV0_CTT4'/>"
WRITE #1 "        <register address='0xbbf0f14' value='0x" DATA.LONG(A:0xbbf0f14) "' name='RPMH_BCM_STATUS_CE_DRV0_CTT5'/>"
WRITE #1 "        <register address='0xbbf0f18' value='0x" DATA.LONG(A:0xbbf0f18) "' name='RPMH_BCM_STATUS_CE_DRV0_CTT6'/>"
WRITE #1 "        <register address='0xbbf0f1c' value='0x" DATA.LONG(A:0xbbf0f1c) "' name='RPMH_BCM_STATUS_CE_DRV0_CTT7'/>"
WRITE #1 "        <register address='0xbbf0f20' value='0x" DATA.LONG(A:0xbbf0f20) "' name='RPMH_BCM_STATUS_CE_DRV0_CTT8'/>"
WRITE #1 "        <register address='0xbbf0f24' value='0x" DATA.LONG(A:0xbbf0f24) "' name='RPMH_BCM_STATUS_CE_DRV0_CTT9'/>"
WRITE #1 "        <register address='0xbbf0f28' value='0x" DATA.LONG(A:0xbbf0f28) "' name='RPMH_BCM_STATUS_CE_DRV0_CTT10'/>"
WRITE #1 "        <register address='0xbbf0f2c' value='0x" DATA.LONG(A:0xbbf0f2c) "' name='RPMH_BCM_STATUS_CE_DRV0_CTT11'/>"
WRITE #1 "        <register address='0xbbf0f30' value='0x" DATA.LONG(A:0xbbf0f30) "' name='RPMH_BCM_STATUS_CE_DRV0_CTT12'/>"
WRITE #1 "        <register address='0xbbf0f34' value='0x" DATA.LONG(A:0xbbf0f34) "' name='RPMH_BCM_STATUS_CE_DRV0_CTT13'/>"
WRITE #1 "        <register address='0xbbf0f38' value='0x" DATA.LONG(A:0xbbf0f38) "' name='RPMH_BCM_STATUS_CE_DRV0_CTT14'/>"
WRITE #1 "        <register address='0xbbf0f3c' value='0x" DATA.LONG(A:0xbbf0f3c) "' name='RPMH_BCM_STATUS_CE_DRV0_CTT15'/>"
WRITE #1 "        <register address='0xbbf0f40' value='0x" DATA.LONG(A:0xbbf0f40) "' name='RPMH_BCM_STATUS_CE_DRV0_CTT16'/>"
WRITE #1 "        <register address='0xbbf0f44' value='0x" DATA.LONG(A:0xbbf0f44) "' name='RPMH_BCM_STATUS_CE_DRV0_CTT17'/>"
WRITE #1 "        <register address='0xbbf0f48' value='0x" DATA.LONG(A:0xbbf0f48) "' name='RPMH_BCM_STATUS_CE_DRV0_CTT18'/>"
WRITE #1 "        <register address='0xbbf0f4c' value='0x" DATA.LONG(A:0xbbf0f4c) "' name='RPMH_BCM_STATUS_CE_DRV0_CTT19'/>"
WRITE #1 "        <register address='0xbbf0f50' value='0x" DATA.LONG(A:0xbbf0f50) "' name='RPMH_BCM_STATUS_CE_DRV0_CTT20'/>"
WRITE #1 "        <register address='0xbbf0f54' value='0x" DATA.LONG(A:0xbbf0f54) "' name='RPMH_BCM_STATUS_CE_DRV0_CTT21'/>"
WRITE #1 "        <register address='0xbbf0f58' value='0x" DATA.LONG(A:0xbbf0f58) "' name='RPMH_BCM_STATUS_CE_DRV0_CTT22'/>"
WRITE #1 "        <register address='0xbbf0f5c' value='0x" DATA.LONG(A:0xbbf0f5c) "' name='RPMH_BCM_STATUS_CE_DRV0_CTT23'/>"
WRITE #1 "        <register address='0xbbf0f60' value='0x" DATA.LONG(A:0xbbf0f60) "' name='RPMH_BCM_STATUS_CE_DRV1_CTT0'/>"
WRITE #1 "        <register address='0xbbf0f64' value='0x" DATA.LONG(A:0xbbf0f64) "' name='RPMH_BCM_STATUS_CE_DRV1_CTT1'/>"
WRITE #1 "        <register address='0xbbf0f68' value='0x" DATA.LONG(A:0xbbf0f68) "' name='RPMH_BCM_STATUS_CE_DRV1_CTT2'/>"
WRITE #1 "        <register address='0xbbf0f6c' value='0x" DATA.LONG(A:0xbbf0f6c) "' name='RPMH_BCM_STATUS_CE_DRV1_CTT3'/>"
WRITE #1 "        <register address='0xbbf0f70' value='0x" DATA.LONG(A:0xbbf0f70) "' name='RPMH_BCM_STATUS_CE_DRV1_CTT4'/>"
WRITE #1 "        <register address='0xbbf0f74' value='0x" DATA.LONG(A:0xbbf0f74) "' name='RPMH_BCM_STATUS_CE_DRV1_CTT5'/>"
WRITE #1 "        <register address='0xbbf0f78' value='0x" DATA.LONG(A:0xbbf0f78) "' name='RPMH_BCM_STATUS_CE_DRV1_CTT6'/>"
WRITE #1 "        <register address='0xbbf0f7c' value='0x" DATA.LONG(A:0xbbf0f7c) "' name='RPMH_BCM_STATUS_CE_DRV1_CTT7'/>"
WRITE #1 "        <register address='0xbbf0f80' value='0x" DATA.LONG(A:0xbbf0f80) "' name='RPMH_BCM_STATUS_CE_DRV1_CTT8'/>"
WRITE #1 "        <register address='0xbbf0f84' value='0x" DATA.LONG(A:0xbbf0f84) "' name='RPMH_BCM_STATUS_CE_DRV1_CTT9'/>"
WRITE #1 "        <register address='0xbbf0f88' value='0x" DATA.LONG(A:0xbbf0f88) "' name='RPMH_BCM_STATUS_CE_DRV1_CTT10'/>"
WRITE #1 "        <register address='0xbbf0f8c' value='0x" DATA.LONG(A:0xbbf0f8c) "' name='RPMH_BCM_STATUS_CE_DRV1_CTT11'/>"
WRITE #1 "        <register address='0xbbf0f90' value='0x" DATA.LONG(A:0xbbf0f90) "' name='RPMH_BCM_STATUS_CE_DRV1_CTT12'/>"
WRITE #1 "        <register address='0xbbf0f94' value='0x" DATA.LONG(A:0xbbf0f94) "' name='RPMH_BCM_STATUS_CE_DRV1_CTT13'/>"
WRITE #1 "        <register address='0xbbf0f98' value='0x" DATA.LONG(A:0xbbf0f98) "' name='RPMH_BCM_STATUS_CE_DRV1_CTT14'/>"
WRITE #1 "        <register address='0xbbf0f9c' value='0x" DATA.LONG(A:0xbbf0f9c) "' name='RPMH_BCM_STATUS_CE_DRV1_CTT15'/>"
WRITE #1 "        <register address='0xbbf0fa0' value='0x" DATA.LONG(A:0xbbf0fa0) "' name='RPMH_BCM_STATUS_CE_DRV1_CTT16'/>"
WRITE #1 "        <register address='0xbbf0fa4' value='0x" DATA.LONG(A:0xbbf0fa4) "' name='RPMH_BCM_STATUS_CE_DRV1_CTT17'/>"
WRITE #1 "        <register address='0xbbf0fa8' value='0x" DATA.LONG(A:0xbbf0fa8) "' name='RPMH_BCM_STATUS_CE_DRV1_CTT18'/>"
WRITE #1 "        <register address='0xbbf0fac' value='0x" DATA.LONG(A:0xbbf0fac) "' name='RPMH_BCM_STATUS_CE_DRV1_CTT19'/>"
WRITE #1 "        <register address='0xbbf0fb0' value='0x" DATA.LONG(A:0xbbf0fb0) "' name='RPMH_BCM_STATUS_CE_DRV1_CTT20'/>"
WRITE #1 "        <register address='0xbbf0fb4' value='0x" DATA.LONG(A:0xbbf0fb4) "' name='RPMH_BCM_STATUS_CE_DRV1_CTT21'/>"
WRITE #1 "        <register address='0xbbf0fb8' value='0x" DATA.LONG(A:0xbbf0fb8) "' name='RPMH_BCM_STATUS_CE_DRV1_CTT22'/>"
WRITE #1 "        <register address='0xbbf0fbc' value='0x" DATA.LONG(A:0xbbf0fbc) "' name='RPMH_BCM_STATUS_CE_DRV1_CTT23'/>"
WRITE #1 "        <register address='0xbbf0fc0' value='0x" DATA.LONG(A:0xbbf0fc0) "' name='RPMH_BCM_STATUS_CE_DRV2_CTT0'/>"
WRITE #1 "        <register address='0xbbf0fc4' value='0x" DATA.LONG(A:0xbbf0fc4) "' name='RPMH_BCM_STATUS_CE_DRV2_CTT1'/>"
WRITE #1 "        <register address='0xbbf0fc8' value='0x" DATA.LONG(A:0xbbf0fc8) "' name='RPMH_BCM_STATUS_CE_DRV2_CTT2'/>"
WRITE #1 "        <register address='0xbbf0fcc' value='0x" DATA.LONG(A:0xbbf0fcc) "' name='RPMH_BCM_STATUS_CE_DRV2_CTT3'/>"
WRITE #1 "        <register address='0xbbf0fd0' value='0x" DATA.LONG(A:0xbbf0fd0) "' name='RPMH_BCM_STATUS_CE_DRV2_CTT4'/>"
WRITE #1 "        <register address='0xbbf0fd4' value='0x" DATA.LONG(A:0xbbf0fd4) "' name='RPMH_BCM_STATUS_CE_DRV2_CTT5'/>"
WRITE #1 "        <register address='0xbbf0fd8' value='0x" DATA.LONG(A:0xbbf0fd8) "' name='RPMH_BCM_STATUS_CE_DRV2_CTT6'/>"
WRITE #1 "        <register address='0xbbf0fdc' value='0x" DATA.LONG(A:0xbbf0fdc) "' name='RPMH_BCM_STATUS_CE_DRV2_CTT7'/>"
WRITE #1 "        <register address='0xbbf0fe0' value='0x" DATA.LONG(A:0xbbf0fe0) "' name='RPMH_BCM_STATUS_CE_DRV2_CTT8'/>"
WRITE #1 "        <register address='0xbbf0fe4' value='0x" DATA.LONG(A:0xbbf0fe4) "' name='RPMH_BCM_STATUS_CE_DRV2_CTT9'/>"
WRITE #1 "        <register address='0xbbf0fe8' value='0x" DATA.LONG(A:0xbbf0fe8) "' name='RPMH_BCM_STATUS_CE_DRV2_CTT10'/>"
WRITE #1 "        <register address='0xbbf0fec' value='0x" DATA.LONG(A:0xbbf0fec) "' name='RPMH_BCM_STATUS_CE_DRV2_CTT11'/>"
WRITE #1 "        <register address='0xbbf0ff0' value='0x" DATA.LONG(A:0xbbf0ff0) "' name='RPMH_BCM_STATUS_CE_DRV2_CTT12'/>"
WRITE #1 "        <register address='0xbbf0ff4' value='0x" DATA.LONG(A:0xbbf0ff4) "' name='RPMH_BCM_STATUS_CE_DRV2_CTT13'/>"
WRITE #1 "        <register address='0xbbf0ff8' value='0x" DATA.LONG(A:0xbbf0ff8) "' name='RPMH_BCM_STATUS_CE_DRV2_CTT14'/>"
WRITE #1 "        <register address='0xbbf0ffc' value='0x" DATA.LONG(A:0xbbf0ffc) "' name='RPMH_BCM_STATUS_CE_DRV2_CTT15'/>"
WRITE #1 "        <register address='0xbbf1000' value='0x" DATA.LONG(A:0xbbf1000) "' name='RPMH_BCM_STATUS_CE_DRV2_CTT16'/>"
WRITE #1 "        <register address='0xbbf1004' value='0x" DATA.LONG(A:0xbbf1004) "' name='RPMH_BCM_STATUS_CE_DRV2_CTT17'/>"
WRITE #1 "        <register address='0xbbf1008' value='0x" DATA.LONG(A:0xbbf1008) "' name='RPMH_BCM_STATUS_CE_DRV2_CTT18'/>"
WRITE #1 "        <register address='0xbbf100c' value='0x" DATA.LONG(A:0xbbf100c) "' name='RPMH_BCM_STATUS_CE_DRV2_CTT19'/>"
WRITE #1 "        <register address='0xbbf1010' value='0x" DATA.LONG(A:0xbbf1010) "' name='RPMH_BCM_STATUS_CE_DRV2_CTT20'/>"
WRITE #1 "        <register address='0xbbf1014' value='0x" DATA.LONG(A:0xbbf1014) "' name='RPMH_BCM_STATUS_CE_DRV2_CTT21'/>"
WRITE #1 "        <register address='0xbbf1018' value='0x" DATA.LONG(A:0xbbf1018) "' name='RPMH_BCM_STATUS_CE_DRV2_CTT22'/>"
WRITE #1 "        <register address='0xbbf101c' value='0x" DATA.LONG(A:0xbbf101c) "' name='RPMH_BCM_STATUS_CE_DRV2_CTT23'/>"
WRITE #1 "        <register address='0xbbf1020' value='0x" DATA.LONG(A:0xbbf1020) "' name='RPMH_BCM_STATUS_CE_DRV3_CTT0'/>"
WRITE #1 "        <register address='0xbbf1024' value='0x" DATA.LONG(A:0xbbf1024) "' name='RPMH_BCM_STATUS_CE_DRV3_CTT1'/>"
WRITE #1 "        <register address='0xbbf1028' value='0x" DATA.LONG(A:0xbbf1028) "' name='RPMH_BCM_STATUS_CE_DRV3_CTT2'/>"
WRITE #1 "        <register address='0xbbf102c' value='0x" DATA.LONG(A:0xbbf102c) "' name='RPMH_BCM_STATUS_CE_DRV3_CTT3'/>"
WRITE #1 "        <register address='0xbbf1030' value='0x" DATA.LONG(A:0xbbf1030) "' name='RPMH_BCM_STATUS_CE_DRV3_CTT4'/>"
WRITE #1 "        <register address='0xbbf1034' value='0x" DATA.LONG(A:0xbbf1034) "' name='RPMH_BCM_STATUS_CE_DRV3_CTT5'/>"
WRITE #1 "        <register address='0xbbf1038' value='0x" DATA.LONG(A:0xbbf1038) "' name='RPMH_BCM_STATUS_CE_DRV3_CTT6'/>"
WRITE #1 "        <register address='0xbbf103c' value='0x" DATA.LONG(A:0xbbf103c) "' name='RPMH_BCM_STATUS_CE_DRV3_CTT7'/>"
WRITE #1 "        <register address='0xbbf1040' value='0x" DATA.LONG(A:0xbbf1040) "' name='RPMH_BCM_STATUS_CE_DRV3_CTT8'/>"
WRITE #1 "        <register address='0xbbf1044' value='0x" DATA.LONG(A:0xbbf1044) "' name='RPMH_BCM_STATUS_CE_DRV3_CTT9'/>"
WRITE #1 "        <register address='0xbbf1048' value='0x" DATA.LONG(A:0xbbf1048) "' name='RPMH_BCM_STATUS_CE_DRV3_CTT10'/>"
WRITE #1 "        <register address='0xbbf104c' value='0x" DATA.LONG(A:0xbbf104c) "' name='RPMH_BCM_STATUS_CE_DRV3_CTT11'/>"
WRITE #1 "        <register address='0xbbf1050' value='0x" DATA.LONG(A:0xbbf1050) "' name='RPMH_BCM_STATUS_CE_DRV3_CTT12'/>"
WRITE #1 "        <register address='0xbbf1054' value='0x" DATA.LONG(A:0xbbf1054) "' name='RPMH_BCM_STATUS_CE_DRV3_CTT13'/>"
WRITE #1 "        <register address='0xbbf1058' value='0x" DATA.LONG(A:0xbbf1058) "' name='RPMH_BCM_STATUS_CE_DRV3_CTT14'/>"
WRITE #1 "        <register address='0xbbf105c' value='0x" DATA.LONG(A:0xbbf105c) "' name='RPMH_BCM_STATUS_CE_DRV3_CTT15'/>"
WRITE #1 "        <register address='0xbbf1060' value='0x" DATA.LONG(A:0xbbf1060) "' name='RPMH_BCM_STATUS_CE_DRV3_CTT16'/>"
WRITE #1 "        <register address='0xbbf1064' value='0x" DATA.LONG(A:0xbbf1064) "' name='RPMH_BCM_STATUS_CE_DRV3_CTT17'/>"
WRITE #1 "        <register address='0xbbf1068' value='0x" DATA.LONG(A:0xbbf1068) "' name='RPMH_BCM_STATUS_CE_DRV3_CTT18'/>"
WRITE #1 "        <register address='0xbbf106c' value='0x" DATA.LONG(A:0xbbf106c) "' name='RPMH_BCM_STATUS_CE_DRV3_CTT19'/>"
WRITE #1 "        <register address='0xbbf1070' value='0x" DATA.LONG(A:0xbbf1070) "' name='RPMH_BCM_STATUS_CE_DRV3_CTT20'/>"
WRITE #1 "        <register address='0xbbf1074' value='0x" DATA.LONG(A:0xbbf1074) "' name='RPMH_BCM_STATUS_CE_DRV3_CTT21'/>"
WRITE #1 "        <register address='0xbbf1078' value='0x" DATA.LONG(A:0xbbf1078) "' name='RPMH_BCM_STATUS_CE_DRV3_CTT22'/>"
WRITE #1 "        <register address='0xbbf107c' value='0x" DATA.LONG(A:0xbbf107c) "' name='RPMH_BCM_STATUS_CE_DRV3_CTT23'/>"
WRITE #1 "        <register address='0xbbf1080' value='0x" DATA.LONG(A:0xbbf1080) "' name='RPMH_BCM_STATUS_CE_DRV4_CTT0'/>"
WRITE #1 "        <register address='0xbbf1084' value='0x" DATA.LONG(A:0xbbf1084) "' name='RPMH_BCM_STATUS_CE_DRV4_CTT1'/>"
WRITE #1 "        <register address='0xbbf1088' value='0x" DATA.LONG(A:0xbbf1088) "' name='RPMH_BCM_STATUS_CE_DRV4_CTT2'/>"
WRITE #1 "        <register address='0xbbf108c' value='0x" DATA.LONG(A:0xbbf108c) "' name='RPMH_BCM_STATUS_CE_DRV4_CTT3'/>"
WRITE #1 "        <register address='0xbbf1090' value='0x" DATA.LONG(A:0xbbf1090) "' name='RPMH_BCM_STATUS_CE_DRV4_CTT4'/>"
WRITE #1 "        <register address='0xbbf1094' value='0x" DATA.LONG(A:0xbbf1094) "' name='RPMH_BCM_STATUS_CE_DRV4_CTT5'/>"
WRITE #1 "        <register address='0xbbf1098' value='0x" DATA.LONG(A:0xbbf1098) "' name='RPMH_BCM_STATUS_CE_DRV4_CTT6'/>"
WRITE #1 "        <register address='0xbbf109c' value='0x" DATA.LONG(A:0xbbf109c) "' name='RPMH_BCM_STATUS_CE_DRV4_CTT7'/>"
WRITE #1 "        <register address='0xbbf10a0' value='0x" DATA.LONG(A:0xbbf10a0) "' name='RPMH_BCM_STATUS_CE_DRV4_CTT8'/>"
WRITE #1 "        <register address='0xbbf10a4' value='0x" DATA.LONG(A:0xbbf10a4) "' name='RPMH_BCM_STATUS_CE_DRV4_CTT9'/>"
WRITE #1 "        <register address='0xbbf10a8' value='0x" DATA.LONG(A:0xbbf10a8) "' name='RPMH_BCM_STATUS_CE_DRV4_CTT10'/>"
WRITE #1 "        <register address='0xbbf10ac' value='0x" DATA.LONG(A:0xbbf10ac) "' name='RPMH_BCM_STATUS_CE_DRV4_CTT11'/>"
WRITE #1 "        <register address='0xbbf10b0' value='0x" DATA.LONG(A:0xbbf10b0) "' name='RPMH_BCM_STATUS_CE_DRV4_CTT12'/>"
WRITE #1 "        <register address='0xbbf10b4' value='0x" DATA.LONG(A:0xbbf10b4) "' name='RPMH_BCM_STATUS_CE_DRV4_CTT13'/>"
WRITE #1 "        <register address='0xbbf10b8' value='0x" DATA.LONG(A:0xbbf10b8) "' name='RPMH_BCM_STATUS_CE_DRV4_CTT14'/>"
WRITE #1 "        <register address='0xbbf10bc' value='0x" DATA.LONG(A:0xbbf10bc) "' name='RPMH_BCM_STATUS_CE_DRV4_CTT15'/>"
WRITE #1 "        <register address='0xbbf10c0' value='0x" DATA.LONG(A:0xbbf10c0) "' name='RPMH_BCM_STATUS_CE_DRV4_CTT16'/>"
WRITE #1 "        <register address='0xbbf10c4' value='0x" DATA.LONG(A:0xbbf10c4) "' name='RPMH_BCM_STATUS_CE_DRV4_CTT17'/>"
WRITE #1 "        <register address='0xbbf10c8' value='0x" DATA.LONG(A:0xbbf10c8) "' name='RPMH_BCM_STATUS_CE_DRV4_CTT18'/>"
WRITE #1 "        <register address='0xbbf10cc' value='0x" DATA.LONG(A:0xbbf10cc) "' name='RPMH_BCM_STATUS_CE_DRV4_CTT19'/>"
WRITE #1 "        <register address='0xbbf10d0' value='0x" DATA.LONG(A:0xbbf10d0) "' name='RPMH_BCM_STATUS_CE_DRV4_CTT20'/>"
WRITE #1 "        <register address='0xbbf10d4' value='0x" DATA.LONG(A:0xbbf10d4) "' name='RPMH_BCM_STATUS_CE_DRV4_CTT21'/>"
WRITE #1 "        <register address='0xbbf10d8' value='0x" DATA.LONG(A:0xbbf10d8) "' name='RPMH_BCM_STATUS_CE_DRV4_CTT22'/>"
WRITE #1 "        <register address='0xbbf10dc' value='0x" DATA.LONG(A:0xbbf10dc) "' name='RPMH_BCM_STATUS_CE_DRV4_CTT23'/>"
WRITE #1 "        <register address='0xbbf1700' value='0x" DATA.LONG(A:0xbbf1700) "' name='RPMH_BCM_STATUS_CE'/>"
WRITE #1 "        <register address='0xbbf1704' value='0x" DATA.LONG(A:0xbbf1704) "' name='RPMH_BCM_STATUS_BCM'/>"
WRITE #1 "        <register address='0xbbf1708' value='0x" DATA.LONG(A:0xbbf1708) "' name='RPMH_BCM_HW_VERSION'/>"
WRITE #1 "        <register address='0xbbf1f00' value='0x" DATA.LONG(A:0xbbf1f00) "' name='RPMH_BCM_INTERRUPT_AGG_DONE_INT_EN'/>"
WRITE #1 "        <register address='0xbbf1f04' value='0x" DATA.LONG(A:0xbbf1f04) "' name='RPMH_BCM_INTERRUPT_CP_CHANGE_DONE_INT_EN'/>"
WRITE #1 "        <register address='0xbbf1f08' value='0x" DATA.LONG(A:0xbbf1f08) "' name='RPMH_BCM_INTERRUPT_CTT_FULL_INT_EN'/>"
WRITE #1 "        <register address='0xbbf1f0c' value='0x" DATA.LONG(A:0xbbf1f0c) "' name='RPMH_BCM_INTERRUPT_SEQ_GENERIC_INT_0_EN'/>"
WRITE #1 "        <register address='0xbbf1f10' value='0x" DATA.LONG(A:0xbbf1f10) "' name='RPMH_BCM_INTERRUPT_SEQ_GENERIC_INT_1_EN'/>"
WRITE #1 "        <register address='0xbbf1f14' value='0x" DATA.LONG(A:0xbbf1f14) "' name='RPMH_BCM_INTERRUPT_STOP_AGG_ACK_INT_EN'/>"
WRITE #1 "        <register address='0xbbf1f40' value='0x" DATA.LONG(A:0xbbf1f40) "' name='RPMH_BCM_INTERRUPT_AGG_DONE_INT_STATUS'/>"
WRITE #1 "        <register address='0xbbf1f44' value='0x" DATA.LONG(A:0xbbf1f44) "' name='RPMH_BCM_INTERRUPT_CP_CHANGE_DONE_INT_STATUS'/>"
WRITE #1 "        <register address='0xbbf1f48' value='0x" DATA.LONG(A:0xbbf1f48) "' name='RPMH_BCM_INTERRUPT_CTT_FULL_INT_STATUS'/>"
WRITE #1 "        <register address='0xbbf1f4c' value='0x" DATA.LONG(A:0xbbf1f4c) "' name='RPMH_BCM_INTERRUPT_SEQ_GENERIC_INT_0_STATUS'/>"
WRITE #1 "        <register address='0xbbf1f50' value='0x" DATA.LONG(A:0xbbf1f50) "' name='RPMH_BCM_INTERRUPT_SEQ_GENERIC_INT_1_STATUS'/>"
WRITE #1 "        <register address='0xbbf1f54' value='0x" DATA.LONG(A:0xbbf1f54) "' name='RPMH_BCM_INTERRUPT_STOP_AGG_ACK_INT_STATUS'/>"
WRITE #1 "        <register address='0xbbf2000' value='0x" DATA.LONG(A:0xbbf2000) "' name='RPMH_BCM_AU_INST_MEM0'/>"
WRITE #1 "        <register address='0xbbf2004' value='0x" DATA.LONG(A:0xbbf2004) "' name='RPMH_BCM_AU_INST_MEM1'/>"
WRITE #1 "        <register address='0xbbf2008' value='0x" DATA.LONG(A:0xbbf2008) "' name='RPMH_BCM_AU_INST_MEM2'/>"
WRITE #1 "        <register address='0xbbf200c' value='0x" DATA.LONG(A:0xbbf200c) "' name='RPMH_BCM_AU_INST_MEM3'/>"
WRITE #1 "        <register address='0xbbf2010' value='0x" DATA.LONG(A:0xbbf2010) "' name='RPMH_BCM_AU_INST_MEM4'/>"
WRITE #1 "        <register address='0xbbf2014' value='0x" DATA.LONG(A:0xbbf2014) "' name='RPMH_BCM_AU_INST_MEM5'/>"
WRITE #1 "        <register address='0xbbf2018' value='0x" DATA.LONG(A:0xbbf2018) "' name='RPMH_BCM_AU_INST_MEM6'/>"
WRITE #1 "        <register address='0xbbf201c' value='0x" DATA.LONG(A:0xbbf201c) "' name='RPMH_BCM_AU_INST_MEM7'/>"
WRITE #1 "        <register address='0xbbf2020' value='0x" DATA.LONG(A:0xbbf2020) "' name='RPMH_BCM_AU_INST_MEM8'/>"
WRITE #1 "        <register address='0xbbf2024' value='0x" DATA.LONG(A:0xbbf2024) "' name='RPMH_BCM_AU_INST_MEM9'/>"
WRITE #1 "        <register address='0xbbf2028' value='0x" DATA.LONG(A:0xbbf2028) "' name='RPMH_BCM_AU_INST_MEM10'/>"
WRITE #1 "        <register address='0xbbf202c' value='0x" DATA.LONG(A:0xbbf202c) "' name='RPMH_BCM_AU_INST_MEM11'/>"
WRITE #1 "        <register address='0xbbf2030' value='0x" DATA.LONG(A:0xbbf2030) "' name='RPMH_BCM_AU_INST_MEM12'/>"
WRITE #1 "        <register address='0xbbf2034' value='0x" DATA.LONG(A:0xbbf2034) "' name='RPMH_BCM_AU_INST_MEM13'/>"
WRITE #1 "        <register address='0xbbf2038' value='0x" DATA.LONG(A:0xbbf2038) "' name='RPMH_BCM_AU_INST_MEM14'/>"
WRITE #1 "        <register address='0xbbf203c' value='0x" DATA.LONG(A:0xbbf203c) "' name='RPMH_BCM_AU_INST_MEM15'/>"
WRITE #1 "        <register address='0xbbf2040' value='0x" DATA.LONG(A:0xbbf2040) "' name='RPMH_BCM_AU_INST_MEM16'/>"
WRITE #1 "        <register address='0xbbf2044' value='0x" DATA.LONG(A:0xbbf2044) "' name='RPMH_BCM_AU_INST_MEM17'/>"
WRITE #1 "        <register address='0xbbf2048' value='0x" DATA.LONG(A:0xbbf2048) "' name='RPMH_BCM_AU_INST_MEM18'/>"
WRITE #1 "        <register address='0xbbf204c' value='0x" DATA.LONG(A:0xbbf204c) "' name='RPMH_BCM_AU_INST_MEM19'/>"
WRITE #1 "        <register address='0xbbf2050' value='0x" DATA.LONG(A:0xbbf2050) "' name='RPMH_BCM_AU_INST_MEM20'/>"
WRITE #1 "        <register address='0xbbf2054' value='0x" DATA.LONG(A:0xbbf2054) "' name='RPMH_BCM_AU_INST_MEM21'/>"
WRITE #1 "        <register address='0xbbf2058' value='0x" DATA.LONG(A:0xbbf2058) "' name='RPMH_BCM_AU_INST_MEM22'/>"
WRITE #1 "        <register address='0xbbf205c' value='0x" DATA.LONG(A:0xbbf205c) "' name='RPMH_BCM_AU_INST_MEM23'/>"
WRITE #1 "        <register address='0xbbf2060' value='0x" DATA.LONG(A:0xbbf2060) "' name='RPMH_BCM_AU_INST_MEM24'/>"
WRITE #1 "        <register address='0xbbf2064' value='0x" DATA.LONG(A:0xbbf2064) "' name='RPMH_BCM_AU_INST_MEM25'/>"
WRITE #1 "        <register address='0xbbf2068' value='0x" DATA.LONG(A:0xbbf2068) "' name='RPMH_BCM_AU_INST_MEM26'/>"
WRITE #1 "        <register address='0xbbf206c' value='0x" DATA.LONG(A:0xbbf206c) "' name='RPMH_BCM_AU_INST_MEM27'/>"
WRITE #1 "        <register address='0xbbf2070' value='0x" DATA.LONG(A:0xbbf2070) "' name='RPMH_BCM_AU_INST_MEM28'/>"
WRITE #1 "        <register address='0xbbf2074' value='0x" DATA.LONG(A:0xbbf2074) "' name='RPMH_BCM_AU_INST_MEM29'/>"
WRITE #1 "        <register address='0xbbf2078' value='0x" DATA.LONG(A:0xbbf2078) "' name='RPMH_BCM_AU_INST_MEM30'/>"
WRITE #1 "        <register address='0xbbf207c' value='0x" DATA.LONG(A:0xbbf207c) "' name='RPMH_BCM_AU_INST_MEM31'/>"
WRITE #1 "        <register address='0xbbf2080' value='0x" DATA.LONG(A:0xbbf2080) "' name='RPMH_BCM_AU_INST_MEM32'/>"
WRITE #1 "        <register address='0xbbf2084' value='0x" DATA.LONG(A:0xbbf2084) "' name='RPMH_BCM_AU_INST_MEM33'/>"
WRITE #1 "        <register address='0xbbf2088' value='0x" DATA.LONG(A:0xbbf2088) "' name='RPMH_BCM_AU_INST_MEM34'/>"
WRITE #1 "        <register address='0xbbf208c' value='0x" DATA.LONG(A:0xbbf208c) "' name='RPMH_BCM_AU_INST_MEM35'/>"
WRITE #1 "        <register address='0xbbf2090' value='0x" DATA.LONG(A:0xbbf2090) "' name='RPMH_BCM_AU_INST_MEM36'/>"
WRITE #1 "        <register address='0xbbf2094' value='0x" DATA.LONG(A:0xbbf2094) "' name='RPMH_BCM_AU_INST_MEM37'/>"
WRITE #1 "        <register address='0xbbf2098' value='0x" DATA.LONG(A:0xbbf2098) "' name='RPMH_BCM_AU_INST_MEM38'/>"
WRITE #1 "        <register address='0xbbf209c' value='0x" DATA.LONG(A:0xbbf209c) "' name='RPMH_BCM_AU_INST_MEM39'/>"
WRITE #1 "        <register address='0xbbf20a0' value='0x" DATA.LONG(A:0xbbf20a0) "' name='RPMH_BCM_AU_INST_MEM40'/>"
WRITE #1 "        <register address='0xbbf20a4' value='0x" DATA.LONG(A:0xbbf20a4) "' name='RPMH_BCM_AU_INST_MEM41'/>"
WRITE #1 "        <register address='0xbbf20a8' value='0x" DATA.LONG(A:0xbbf20a8) "' name='RPMH_BCM_AU_INST_MEM42'/>"
WRITE #1 "        <register address='0xbbf20ac' value='0x" DATA.LONG(A:0xbbf20ac) "' name='RPMH_BCM_AU_INST_MEM43'/>"
WRITE #1 "        <register address='0xbbf20b0' value='0x" DATA.LONG(A:0xbbf20b0) "' name='RPMH_BCM_AU_INST_MEM44'/>"
WRITE #1 "        <register address='0xbbf20b4' value='0x" DATA.LONG(A:0xbbf20b4) "' name='RPMH_BCM_AU_INST_MEM45'/>"
WRITE #1 "        <register address='0xbbf20b8' value='0x" DATA.LONG(A:0xbbf20b8) "' name='RPMH_BCM_AU_INST_MEM46'/>"
WRITE #1 "        <register address='0xbbf20bc' value='0x" DATA.LONG(A:0xbbf20bc) "' name='RPMH_BCM_AU_INST_MEM47'/>"
WRITE #1 "        <register address='0xbbf20c0' value='0x" DATA.LONG(A:0xbbf20c0) "' name='RPMH_BCM_AU_INST_MEM48'/>"
WRITE #1 "        <register address='0xbbf20c4' value='0x" DATA.LONG(A:0xbbf20c4) "' name='RPMH_BCM_AU_INST_MEM49'/>"
WRITE #1 "        <register address='0xbbf20c8' value='0x" DATA.LONG(A:0xbbf20c8) "' name='RPMH_BCM_AU_INST_MEM50'/>"
WRITE #1 "        <register address='0xbbf20cc' value='0x" DATA.LONG(A:0xbbf20cc) "' name='RPMH_BCM_AU_INST_MEM51'/>"
WRITE #1 "        <register address='0xbbf20d0' value='0x" DATA.LONG(A:0xbbf20d0) "' name='RPMH_BCM_AU_INST_MEM52'/>"
WRITE #1 "        <register address='0xbbf20d4' value='0x" DATA.LONG(A:0xbbf20d4) "' name='RPMH_BCM_AU_INST_MEM53'/>"
WRITE #1 "        <register address='0xbbf20d8' value='0x" DATA.LONG(A:0xbbf20d8) "' name='RPMH_BCM_AU_INST_MEM54'/>"
WRITE #1 "        <register address='0xbbf20dc' value='0x" DATA.LONG(A:0xbbf20dc) "' name='RPMH_BCM_AU_INST_MEM55'/>"
WRITE #1 "        <register address='0xbbf20e0' value='0x" DATA.LONG(A:0xbbf20e0) "' name='RPMH_BCM_AU_INST_MEM56'/>"
WRITE #1 "        <register address='0xbbf20e4' value='0x" DATA.LONG(A:0xbbf20e4) "' name='RPMH_BCM_AU_INST_MEM57'/>"
WRITE #1 "        <register address='0xbbf20e8' value='0x" DATA.LONG(A:0xbbf20e8) "' name='RPMH_BCM_AU_INST_MEM58'/>"
WRITE #1 "        <register address='0xbbf20ec' value='0x" DATA.LONG(A:0xbbf20ec) "' name='RPMH_BCM_AU_INST_MEM59'/>"
WRITE #1 "        <register address='0xbbf20f0' value='0x" DATA.LONG(A:0xbbf20f0) "' name='RPMH_BCM_AU_INST_MEM60'/>"
WRITE #1 "        <register address='0xbbf20f4' value='0x" DATA.LONG(A:0xbbf20f4) "' name='RPMH_BCM_AU_INST_MEM61'/>"
WRITE #1 "        <register address='0xbbf20f8' value='0x" DATA.LONG(A:0xbbf20f8) "' name='RPMH_BCM_AU_INST_MEM62'/>"
WRITE #1 "        <register address='0xbbf20fc' value='0x" DATA.LONG(A:0xbbf20fc) "' name='RPMH_BCM_AU_INST_MEM63'/>"
WRITE #1 "        <register address='0xbbf2100' value='0x" DATA.LONG(A:0xbbf2100) "' name='RPMH_BCM_AU_INST_MEM64'/>"
WRITE #1 "        <register address='0xbbf2104' value='0x" DATA.LONG(A:0xbbf2104) "' name='RPMH_BCM_AU_INST_MEM65'/>"
WRITE #1 "        <register address='0xbbf2108' value='0x" DATA.LONG(A:0xbbf2108) "' name='RPMH_BCM_AU_INST_MEM66'/>"
WRITE #1 "        <register address='0xbbf210c' value='0x" DATA.LONG(A:0xbbf210c) "' name='RPMH_BCM_AU_INST_MEM67'/>"
WRITE #1 "        <register address='0xbbf2110' value='0x" DATA.LONG(A:0xbbf2110) "' name='RPMH_BCM_AU_INST_MEM68'/>"
WRITE #1 "        <register address='0xbbf2114' value='0x" DATA.LONG(A:0xbbf2114) "' name='RPMH_BCM_AU_INST_MEM69'/>"
WRITE #1 "        <register address='0xbbf2118' value='0x" DATA.LONG(A:0xbbf2118) "' name='RPMH_BCM_AU_INST_MEM70'/>"
WRITE #1 "        <register address='0xbbf211c' value='0x" DATA.LONG(A:0xbbf211c) "' name='RPMH_BCM_AU_INST_MEM71'/>"
WRITE #1 "        <register address='0xbbf2120' value='0x" DATA.LONG(A:0xbbf2120) "' name='RPMH_BCM_AU_INST_MEM72'/>"
WRITE #1 "        <register address='0xbbf2124' value='0x" DATA.LONG(A:0xbbf2124) "' name='RPMH_BCM_AU_INST_MEM73'/>"
WRITE #1 "        <register address='0xbbf2128' value='0x" DATA.LONG(A:0xbbf2128) "' name='RPMH_BCM_AU_INST_MEM74'/>"
WRITE #1 "        <register address='0xbbf212c' value='0x" DATA.LONG(A:0xbbf212c) "' name='RPMH_BCM_AU_INST_MEM75'/>"
WRITE #1 "        <register address='0xbbf2130' value='0x" DATA.LONG(A:0xbbf2130) "' name='RPMH_BCM_AU_INST_MEM76'/>"
WRITE #1 "        <register address='0xbbf2134' value='0x" DATA.LONG(A:0xbbf2134) "' name='RPMH_BCM_AU_INST_MEM77'/>"
WRITE #1 "        <register address='0xbbf2138' value='0x" DATA.LONG(A:0xbbf2138) "' name='RPMH_BCM_AU_INST_MEM78'/>"
WRITE #1 "        <register address='0xbbf213c' value='0x" DATA.LONG(A:0xbbf213c) "' name='RPMH_BCM_AU_INST_MEM79'/>"
WRITE #1 "        <register address='0xbbf2140' value='0x" DATA.LONG(A:0xbbf2140) "' name='RPMH_BCM_AU_INST_MEM80'/>"
WRITE #1 "        <register address='0xbbf2144' value='0x" DATA.LONG(A:0xbbf2144) "' name='RPMH_BCM_AU_INST_MEM81'/>"
WRITE #1 "        <register address='0xbbf2148' value='0x" DATA.LONG(A:0xbbf2148) "' name='RPMH_BCM_AU_INST_MEM82'/>"
WRITE #1 "        <register address='0xbbf214c' value='0x" DATA.LONG(A:0xbbf214c) "' name='RPMH_BCM_AU_INST_MEM83'/>"
WRITE #1 "        <register address='0xbbf2150' value='0x" DATA.LONG(A:0xbbf2150) "' name='RPMH_BCM_AU_INST_MEM84'/>"
WRITE #1 "        <register address='0xbbf2154' value='0x" DATA.LONG(A:0xbbf2154) "' name='RPMH_BCM_AU_INST_MEM85'/>"
WRITE #1 "        <register address='0xbbf2158' value='0x" DATA.LONG(A:0xbbf2158) "' name='RPMH_BCM_AU_INST_MEM86'/>"
WRITE #1 "        <register address='0xbbf215c' value='0x" DATA.LONG(A:0xbbf215c) "' name='RPMH_BCM_AU_INST_MEM87'/>"
WRITE #1 "        <register address='0xbbf2160' value='0x" DATA.LONG(A:0xbbf2160) "' name='RPMH_BCM_AU_INST_MEM88'/>"
WRITE #1 "        <register address='0xbbf2164' value='0x" DATA.LONG(A:0xbbf2164) "' name='RPMH_BCM_AU_INST_MEM89'/>"
WRITE #1 "        <register address='0xbbf2168' value='0x" DATA.LONG(A:0xbbf2168) "' name='RPMH_BCM_AU_INST_MEM90'/>"
WRITE #1 "        <register address='0xbbf216c' value='0x" DATA.LONG(A:0xbbf216c) "' name='RPMH_BCM_AU_INST_MEM91'/>"
WRITE #1 "        <register address='0xbbf2170' value='0x" DATA.LONG(A:0xbbf2170) "' name='RPMH_BCM_AU_INST_MEM92'/>"
WRITE #1 "        <register address='0xbbf2174' value='0x" DATA.LONG(A:0xbbf2174) "' name='RPMH_BCM_AU_INST_MEM93'/>"
WRITE #1 "        <register address='0xbbf2178' value='0x" DATA.LONG(A:0xbbf2178) "' name='RPMH_BCM_AU_INST_MEM94'/>"
WRITE #1 "        <register address='0xbbf217c' value='0x" DATA.LONG(A:0xbbf217c) "' name='RPMH_BCM_AU_INST_MEM95'/>"
WRITE #1 "        <register address='0xbbf2180' value='0x" DATA.LONG(A:0xbbf2180) "' name='RPMH_BCM_AU_INST_MEM96'/>"
WRITE #1 "        <register address='0xbbf2184' value='0x" DATA.LONG(A:0xbbf2184) "' name='RPMH_BCM_AU_INST_MEM97'/>"
WRITE #1 "        <register address='0xbbf2188' value='0x" DATA.LONG(A:0xbbf2188) "' name='RPMH_BCM_AU_INST_MEM98'/>"
WRITE #1 "        <register address='0xbbf218c' value='0x" DATA.LONG(A:0xbbf218c) "' name='RPMH_BCM_AU_INST_MEM99'/>"
WRITE #1 "        <register address='0xbbf2190' value='0x" DATA.LONG(A:0xbbf2190) "' name='RPMH_BCM_AU_INST_MEM100'/>"
WRITE #1 "        <register address='0xbbf2194' value='0x" DATA.LONG(A:0xbbf2194) "' name='RPMH_BCM_AU_INST_MEM101'/>"
WRITE #1 "        <register address='0xbbf2198' value='0x" DATA.LONG(A:0xbbf2198) "' name='RPMH_BCM_AU_INST_MEM102'/>"
WRITE #1 "        <register address='0xbbf219c' value='0x" DATA.LONG(A:0xbbf219c) "' name='RPMH_BCM_AU_INST_MEM103'/>"
WRITE #1 "        <register address='0xbbf21a0' value='0x" DATA.LONG(A:0xbbf21a0) "' name='RPMH_BCM_AU_INST_MEM104'/>"
WRITE #1 "        <register address='0xbbf21a4' value='0x" DATA.LONG(A:0xbbf21a4) "' name='RPMH_BCM_AU_INST_MEM105'/>"
WRITE #1 "        <register address='0xbbf21a8' value='0x" DATA.LONG(A:0xbbf21a8) "' name='RPMH_BCM_AU_INST_MEM106'/>"
WRITE #1 "        <register address='0xbbf21ac' value='0x" DATA.LONG(A:0xbbf21ac) "' name='RPMH_BCM_AU_INST_MEM107'/>"
WRITE #1 "        <register address='0xbbf21b0' value='0x" DATA.LONG(A:0xbbf21b0) "' name='RPMH_BCM_AU_INST_MEM108'/>"
WRITE #1 "        <register address='0xbbf21b4' value='0x" DATA.LONG(A:0xbbf21b4) "' name='RPMH_BCM_AU_INST_MEM109'/>"
WRITE #1 "        <register address='0xbbf21b8' value='0x" DATA.LONG(A:0xbbf21b8) "' name='RPMH_BCM_AU_INST_MEM110'/>"
WRITE #1 "        <register address='0xbbf21bc' value='0x" DATA.LONG(A:0xbbf21bc) "' name='RPMH_BCM_AU_INST_MEM111'/>"
WRITE #1 "        <register address='0xbbf21c0' value='0x" DATA.LONG(A:0xbbf21c0) "' name='RPMH_BCM_AU_INST_MEM112'/>"
WRITE #1 "        <register address='0xbbf21c4' value='0x" DATA.LONG(A:0xbbf21c4) "' name='RPMH_BCM_AU_INST_MEM113'/>"
WRITE #1 "        <register address='0xbbf21c8' value='0x" DATA.LONG(A:0xbbf21c8) "' name='RPMH_BCM_AU_INST_MEM114'/>"
WRITE #1 "        <register address='0xbbf21cc' value='0x" DATA.LONG(A:0xbbf21cc) "' name='RPMH_BCM_AU_INST_MEM115'/>"
WRITE #1 "        <register address='0xbbf21d0' value='0x" DATA.LONG(A:0xbbf21d0) "' name='RPMH_BCM_AU_INST_MEM116'/>"
WRITE #1 "        <register address='0xbbf21d4' value='0x" DATA.LONG(A:0xbbf21d4) "' name='RPMH_BCM_AU_INST_MEM117'/>"
WRITE #1 "        <register address='0xbbf21d8' value='0x" DATA.LONG(A:0xbbf21d8) "' name='RPMH_BCM_AU_INST_MEM118'/>"
WRITE #1 "        <register address='0xbbf21dc' value='0x" DATA.LONG(A:0xbbf21dc) "' name='RPMH_BCM_AU_INST_MEM119'/>"
WRITE #1 "        <register address='0xbbf21e0' value='0x" DATA.LONG(A:0xbbf21e0) "' name='RPMH_BCM_AU_INST_MEM120'/>"
WRITE #1 "        <register address='0xbbf21e4' value='0x" DATA.LONG(A:0xbbf21e4) "' name='RPMH_BCM_AU_INST_MEM121'/>"
WRITE #1 "        <register address='0xbbf21e8' value='0x" DATA.LONG(A:0xbbf21e8) "' name='RPMH_BCM_AU_INST_MEM122'/>"
WRITE #1 "        <register address='0xbbf21ec' value='0x" DATA.LONG(A:0xbbf21ec) "' name='RPMH_BCM_AU_INST_MEM123'/>"
WRITE #1 "        <register address='0xbbf21f0' value='0x" DATA.LONG(A:0xbbf21f0) "' name='RPMH_BCM_AU_INST_MEM124'/>"
WRITE #1 "        <register address='0xbbf21f4' value='0x" DATA.LONG(A:0xbbf21f4) "' name='RPMH_BCM_AU_INST_MEM125'/>"
WRITE #1 "        <register address='0xbbf21f8' value='0x" DATA.LONG(A:0xbbf21f8) "' name='RPMH_BCM_AU_INST_MEM126'/>"
WRITE #1 "        <register address='0xbbf21fc' value='0x" DATA.LONG(A:0xbbf21fc) "' name='RPMH_BCM_AU_INST_MEM127'/>"
WRITE #1 "        <register address='0xbbf2200' value='0x" DATA.LONG(A:0xbbf2200) "' name='RPMH_BCM_AU_INST_MEM128'/>"
WRITE #1 "        <register address='0xbbf2204' value='0x" DATA.LONG(A:0xbbf2204) "' name='RPMH_BCM_AU_INST_MEM129'/>"
WRITE #1 "        <register address='0xbbf2208' value='0x" DATA.LONG(A:0xbbf2208) "' name='RPMH_BCM_AU_INST_MEM130'/>"
WRITE #1 "        <register address='0xbbf220c' value='0x" DATA.LONG(A:0xbbf220c) "' name='RPMH_BCM_AU_INST_MEM131'/>"
WRITE #1 "        <register address='0xbbf2210' value='0x" DATA.LONG(A:0xbbf2210) "' name='RPMH_BCM_AU_INST_MEM132'/>"
WRITE #1 "        <register address='0xbbf2214' value='0x" DATA.LONG(A:0xbbf2214) "' name='RPMH_BCM_AU_INST_MEM133'/>"
WRITE #1 "        <register address='0xbbf2218' value='0x" DATA.LONG(A:0xbbf2218) "' name='RPMH_BCM_AU_INST_MEM134'/>"
WRITE #1 "        <register address='0xbbf221c' value='0x" DATA.LONG(A:0xbbf221c) "' name='RPMH_BCM_AU_INST_MEM135'/>"
WRITE #1 "        <register address='0xbbf2220' value='0x" DATA.LONG(A:0xbbf2220) "' name='RPMH_BCM_AU_INST_MEM136'/>"
WRITE #1 "        <register address='0xbbf2224' value='0x" DATA.LONG(A:0xbbf2224) "' name='RPMH_BCM_AU_INST_MEM137'/>"
WRITE #1 "        <register address='0xbbf2228' value='0x" DATA.LONG(A:0xbbf2228) "' name='RPMH_BCM_AU_INST_MEM138'/>"
WRITE #1 "        <register address='0xbbf222c' value='0x" DATA.LONG(A:0xbbf222c) "' name='RPMH_BCM_AU_INST_MEM139'/>"
WRITE #1 "        <register address='0xbbf2230' value='0x" DATA.LONG(A:0xbbf2230) "' name='RPMH_BCM_AU_INST_MEM140'/>"
WRITE #1 "        <register address='0xbbf2234' value='0x" DATA.LONG(A:0xbbf2234) "' name='RPMH_BCM_AU_INST_MEM141'/>"
WRITE #1 "        <register address='0xbbf2238' value='0x" DATA.LONG(A:0xbbf2238) "' name='RPMH_BCM_AU_INST_MEM142'/>"
WRITE #1 "        <register address='0xbbf223c' value='0x" DATA.LONG(A:0xbbf223c) "' name='RPMH_BCM_AU_INST_MEM143'/>"
WRITE #1 "        <register address='0xbbf2240' value='0x" DATA.LONG(A:0xbbf2240) "' name='RPMH_BCM_AU_INST_MEM144'/>"
WRITE #1 "        <register address='0xbbf2244' value='0x" DATA.LONG(A:0xbbf2244) "' name='RPMH_BCM_AU_INST_MEM145'/>"
WRITE #1 "        <register address='0xbbf2248' value='0x" DATA.LONG(A:0xbbf2248) "' name='RPMH_BCM_AU_INST_MEM146'/>"
WRITE #1 "        <register address='0xbbf224c' value='0x" DATA.LONG(A:0xbbf224c) "' name='RPMH_BCM_AU_INST_MEM147'/>"
WRITE #1 "        <register address='0xbbf2250' value='0x" DATA.LONG(A:0xbbf2250) "' name='RPMH_BCM_AU_INST_MEM148'/>"
WRITE #1 "        <register address='0xbbf2254' value='0x" DATA.LONG(A:0xbbf2254) "' name='RPMH_BCM_AU_INST_MEM149'/>"
WRITE #1 "        <register address='0xbbf2258' value='0x" DATA.LONG(A:0xbbf2258) "' name='RPMH_BCM_AU_INST_MEM150'/>"
WRITE #1 "        <register address='0xbbf225c' value='0x" DATA.LONG(A:0xbbf225c) "' name='RPMH_BCM_AU_INST_MEM151'/>"
WRITE #1 "        <register address='0xbbf2260' value='0x" DATA.LONG(A:0xbbf2260) "' name='RPMH_BCM_AU_INST_MEM152'/>"
WRITE #1 "        <register address='0xbbf2264' value='0x" DATA.LONG(A:0xbbf2264) "' name='RPMH_BCM_AU_INST_MEM153'/>"
WRITE #1 "        <register address='0xbbf2268' value='0x" DATA.LONG(A:0xbbf2268) "' name='RPMH_BCM_AU_INST_MEM154'/>"
WRITE #1 "        <register address='0xbbf226c' value='0x" DATA.LONG(A:0xbbf226c) "' name='RPMH_BCM_AU_INST_MEM155'/>"
WRITE #1 "        <register address='0xbbf2270' value='0x" DATA.LONG(A:0xbbf2270) "' name='RPMH_BCM_AU_INST_MEM156'/>"
WRITE #1 "        <register address='0xbbf2274' value='0x" DATA.LONG(A:0xbbf2274) "' name='RPMH_BCM_AU_INST_MEM157'/>"
WRITE #1 "        <register address='0xbbf2278' value='0x" DATA.LONG(A:0xbbf2278) "' name='RPMH_BCM_AU_INST_MEM158'/>"
WRITE #1 "        <register address='0xbbf227c' value='0x" DATA.LONG(A:0xbbf227c) "' name='RPMH_BCM_AU_INST_MEM159'/>"
WRITE #1 "        <register address='0xbbf2280' value='0x" DATA.LONG(A:0xbbf2280) "' name='RPMH_BCM_AU_INST_MEM160'/>"
WRITE #1 "        <register address='0xbbf2284' value='0x" DATA.LONG(A:0xbbf2284) "' name='RPMH_BCM_AU_INST_MEM161'/>"
WRITE #1 "        <register address='0xbbf2288' value='0x" DATA.LONG(A:0xbbf2288) "' name='RPMH_BCM_AU_INST_MEM162'/>"
WRITE #1 "        <register address='0xbbf228c' value='0x" DATA.LONG(A:0xbbf228c) "' name='RPMH_BCM_AU_INST_MEM163'/>"
WRITE #1 "        <register address='0xbbf2290' value='0x" DATA.LONG(A:0xbbf2290) "' name='RPMH_BCM_AU_INST_MEM164'/>"
WRITE #1 "        <register address='0xbbf2294' value='0x" DATA.LONG(A:0xbbf2294) "' name='RPMH_BCM_AU_INST_MEM165'/>"
WRITE #1 "        <register address='0xbbf2298' value='0x" DATA.LONG(A:0xbbf2298) "' name='RPMH_BCM_AU_INST_MEM166'/>"
WRITE #1 "        <register address='0xbbf229c' value='0x" DATA.LONG(A:0xbbf229c) "' name='RPMH_BCM_AU_INST_MEM167'/>"
WRITE #1 "        <register address='0xbbf22a0' value='0x" DATA.LONG(A:0xbbf22a0) "' name='RPMH_BCM_AU_INST_MEM168'/>"
WRITE #1 "        <register address='0xbbf22a4' value='0x" DATA.LONG(A:0xbbf22a4) "' name='RPMH_BCM_AU_INST_MEM169'/>"
WRITE #1 "        <register address='0xbbf22a8' value='0x" DATA.LONG(A:0xbbf22a8) "' name='RPMH_BCM_AU_INST_MEM170'/>"
WRITE #1 "        <register address='0xbbf22ac' value='0x" DATA.LONG(A:0xbbf22ac) "' name='RPMH_BCM_AU_INST_MEM171'/>"
WRITE #1 "        <register address='0xbbf22b0' value='0x" DATA.LONG(A:0xbbf22b0) "' name='RPMH_BCM_AU_INST_MEM172'/>"
WRITE #1 "        <register address='0xbbf22b4' value='0x" DATA.LONG(A:0xbbf22b4) "' name='RPMH_BCM_AU_INST_MEM173'/>"
WRITE #1 "        <register address='0xbbf22b8' value='0x" DATA.LONG(A:0xbbf22b8) "' name='RPMH_BCM_AU_INST_MEM174'/>"
WRITE #1 "        <register address='0xbbf22bc' value='0x" DATA.LONG(A:0xbbf22bc) "' name='RPMH_BCM_AU_INST_MEM175'/>"
WRITE #1 "        <register address='0xbbf22c0' value='0x" DATA.LONG(A:0xbbf22c0) "' name='RPMH_BCM_AU_INST_MEM176'/>"
WRITE #1 "        <register address='0xbbf22c4' value='0x" DATA.LONG(A:0xbbf22c4) "' name='RPMH_BCM_AU_INST_MEM177'/>"
WRITE #1 "        <register address='0xbbf22c8' value='0x" DATA.LONG(A:0xbbf22c8) "' name='RPMH_BCM_AU_INST_MEM178'/>"
WRITE #1 "        <register address='0xbbf22cc' value='0x" DATA.LONG(A:0xbbf22cc) "' name='RPMH_BCM_AU_INST_MEM179'/>"
WRITE #1 "        <register address='0xbbf22d0' value='0x" DATA.LONG(A:0xbbf22d0) "' name='RPMH_BCM_AU_INST_MEM180'/>"
WRITE #1 "        <register address='0xbbf22d4' value='0x" DATA.LONG(A:0xbbf22d4) "' name='RPMH_BCM_AU_INST_MEM181'/>"
WRITE #1 "        <register address='0xbbf22d8' value='0x" DATA.LONG(A:0xbbf22d8) "' name='RPMH_BCM_AU_INST_MEM182'/>"
WRITE #1 "        <register address='0xbbf22dc' value='0x" DATA.LONG(A:0xbbf22dc) "' name='RPMH_BCM_AU_INST_MEM183'/>"
WRITE #1 "        <register address='0xbbf22e0' value='0x" DATA.LONG(A:0xbbf22e0) "' name='RPMH_BCM_AU_INST_MEM184'/>"
WRITE #1 "        <register address='0xbbf22e4' value='0x" DATA.LONG(A:0xbbf22e4) "' name='RPMH_BCM_AU_INST_MEM185'/>"
WRITE #1 "        <register address='0xbbf22e8' value='0x" DATA.LONG(A:0xbbf22e8) "' name='RPMH_BCM_AU_INST_MEM186'/>"
WRITE #1 "        <register address='0xbbf22ec' value='0x" DATA.LONG(A:0xbbf22ec) "' name='RPMH_BCM_AU_INST_MEM187'/>"
WRITE #1 "        <register address='0xbbf22f0' value='0x" DATA.LONG(A:0xbbf22f0) "' name='RPMH_BCM_AU_INST_MEM188'/>"
WRITE #1 "        <register address='0xbbf22f4' value='0x" DATA.LONG(A:0xbbf22f4) "' name='RPMH_BCM_AU_INST_MEM189'/>"
WRITE #1 "        <register address='0xbbf22f8' value='0x" DATA.LONG(A:0xbbf22f8) "' name='RPMH_BCM_AU_INST_MEM190'/>"
WRITE #1 "        <register address='0xbbf22fc' value='0x" DATA.LONG(A:0xbbf22fc) "' name='RPMH_BCM_AU_INST_MEM191'/>"
WRITE #1 "        <register address='0xbbf2300' value='0x" DATA.LONG(A:0xbbf2300) "' name='RPMH_BCM_AU_INST_MEM192'/>"
WRITE #1 "        <register address='0xbbf2304' value='0x" DATA.LONG(A:0xbbf2304) "' name='RPMH_BCM_AU_INST_MEM193'/>"
WRITE #1 "        <register address='0xbbf2308' value='0x" DATA.LONG(A:0xbbf2308) "' name='RPMH_BCM_AU_INST_MEM194'/>"
WRITE #1 "        <register address='0xbbf230c' value='0x" DATA.LONG(A:0xbbf230c) "' name='RPMH_BCM_AU_INST_MEM195'/>"
WRITE #1 "        <register address='0xbbf2310' value='0x" DATA.LONG(A:0xbbf2310) "' name='RPMH_BCM_AU_INST_MEM196'/>"
WRITE #1 "        <register address='0xbbf2314' value='0x" DATA.LONG(A:0xbbf2314) "' name='RPMH_BCM_AU_INST_MEM197'/>"
WRITE #1 "        <register address='0xbbf2318' value='0x" DATA.LONG(A:0xbbf2318) "' name='RPMH_BCM_AU_INST_MEM198'/>"
WRITE #1 "        <register address='0xbbf231c' value='0x" DATA.LONG(A:0xbbf231c) "' name='RPMH_BCM_AU_INST_MEM199'/>"
WRITE #1 "        <register address='0xbbf2320' value='0x" DATA.LONG(A:0xbbf2320) "' name='RPMH_BCM_AU_INST_MEM200'/>"
WRITE #1 "        <register address='0xbbf2324' value='0x" DATA.LONG(A:0xbbf2324) "' name='RPMH_BCM_AU_INST_MEM201'/>"
WRITE #1 "        <register address='0xbbf2328' value='0x" DATA.LONG(A:0xbbf2328) "' name='RPMH_BCM_AU_INST_MEM202'/>"
WRITE #1 "        <register address='0xbbf232c' value='0x" DATA.LONG(A:0xbbf232c) "' name='RPMH_BCM_AU_INST_MEM203'/>"
WRITE #1 "        <register address='0xbbf2330' value='0x" DATA.LONG(A:0xbbf2330) "' name='RPMH_BCM_AU_INST_MEM204'/>"
WRITE #1 "        <register address='0xbbf2334' value='0x" DATA.LONG(A:0xbbf2334) "' name='RPMH_BCM_AU_INST_MEM205'/>"
WRITE #1 "        <register address='0xbbf2338' value='0x" DATA.LONG(A:0xbbf2338) "' name='RPMH_BCM_AU_INST_MEM206'/>"
WRITE #1 "        <register address='0xbbf233c' value='0x" DATA.LONG(A:0xbbf233c) "' name='RPMH_BCM_AU_INST_MEM207'/>"
WRITE #1 "        <register address='0xbbf2340' value='0x" DATA.LONG(A:0xbbf2340) "' name='RPMH_BCM_AU_INST_MEM208'/>"
WRITE #1 "        <register address='0xbbf2344' value='0x" DATA.LONG(A:0xbbf2344) "' name='RPMH_BCM_AU_INST_MEM209'/>"
WRITE #1 "        <register address='0xbbf2348' value='0x" DATA.LONG(A:0xbbf2348) "' name='RPMH_BCM_AU_INST_MEM210'/>"
WRITE #1 "        <register address='0xbbf234c' value='0x" DATA.LONG(A:0xbbf234c) "' name='RPMH_BCM_AU_INST_MEM211'/>"
WRITE #1 "        <register address='0xbbf2350' value='0x" DATA.LONG(A:0xbbf2350) "' name='RPMH_BCM_AU_INST_MEM212'/>"
WRITE #1 "        <register address='0xbbf2354' value='0x" DATA.LONG(A:0xbbf2354) "' name='RPMH_BCM_AU_INST_MEM213'/>"
WRITE #1 "        <register address='0xbbf2358' value='0x" DATA.LONG(A:0xbbf2358) "' name='RPMH_BCM_AU_INST_MEM214'/>"
WRITE #1 "        <register address='0xbbf235c' value='0x" DATA.LONG(A:0xbbf235c) "' name='RPMH_BCM_AU_INST_MEM215'/>"
WRITE #1 "        <register address='0xbbf2360' value='0x" DATA.LONG(A:0xbbf2360) "' name='RPMH_BCM_AU_INST_MEM216'/>"
WRITE #1 "        <register address='0xbbf2364' value='0x" DATA.LONG(A:0xbbf2364) "' name='RPMH_BCM_AU_INST_MEM217'/>"
WRITE #1 "        <register address='0xbbf2368' value='0x" DATA.LONG(A:0xbbf2368) "' name='RPMH_BCM_AU_INST_MEM218'/>"
WRITE #1 "        <register address='0xbbf236c' value='0x" DATA.LONG(A:0xbbf236c) "' name='RPMH_BCM_AU_INST_MEM219'/>"
WRITE #1 "        <register address='0xbbf2370' value='0x" DATA.LONG(A:0xbbf2370) "' name='RPMH_BCM_AU_INST_MEM220'/>"
WRITE #1 "        <register address='0xbbf2374' value='0x" DATA.LONG(A:0xbbf2374) "' name='RPMH_BCM_AU_INST_MEM221'/>"
WRITE #1 "        <register address='0xbbf2378' value='0x" DATA.LONG(A:0xbbf2378) "' name='RPMH_BCM_AU_INST_MEM222'/>"
WRITE #1 "        <register address='0xbbf237c' value='0x" DATA.LONG(A:0xbbf237c) "' name='RPMH_BCM_AU_INST_MEM223'/>"
WRITE #1 "        <register address='0xbbf2380' value='0x" DATA.LONG(A:0xbbf2380) "' name='RPMH_BCM_AU_INST_MEM224'/>"
WRITE #1 "        <register address='0xbbf2384' value='0x" DATA.LONG(A:0xbbf2384) "' name='RPMH_BCM_AU_INST_MEM225'/>"
WRITE #1 "        <register address='0xbbf2388' value='0x" DATA.LONG(A:0xbbf2388) "' name='RPMH_BCM_AU_INST_MEM226'/>"
WRITE #1 "        <register address='0xbbf238c' value='0x" DATA.LONG(A:0xbbf238c) "' name='RPMH_BCM_AU_INST_MEM227'/>"
WRITE #1 "        <register address='0xbbf2390' value='0x" DATA.LONG(A:0xbbf2390) "' name='RPMH_BCM_AU_INST_MEM228'/>"
WRITE #1 "        <register address='0xbbf2394' value='0x" DATA.LONG(A:0xbbf2394) "' name='RPMH_BCM_AU_INST_MEM229'/>"
WRITE #1 "        <register address='0xbbf2398' value='0x" DATA.LONG(A:0xbbf2398) "' name='RPMH_BCM_AU_INST_MEM230'/>"
WRITE #1 "        <register address='0xbbf239c' value='0x" DATA.LONG(A:0xbbf239c) "' name='RPMH_BCM_AU_INST_MEM231'/>"
WRITE #1 "        <register address='0xbbf23a0' value='0x" DATA.LONG(A:0xbbf23a0) "' name='RPMH_BCM_AU_INST_MEM232'/>"
WRITE #1 "        <register address='0xbbf23a4' value='0x" DATA.LONG(A:0xbbf23a4) "' name='RPMH_BCM_AU_INST_MEM233'/>"
WRITE #1 "        <register address='0xbbf23a8' value='0x" DATA.LONG(A:0xbbf23a8) "' name='RPMH_BCM_AU_INST_MEM234'/>"
WRITE #1 "        <register address='0xbbf23ac' value='0x" DATA.LONG(A:0xbbf23ac) "' name='RPMH_BCM_AU_INST_MEM235'/>"
WRITE #1 "        <register address='0xbbf23b0' value='0x" DATA.LONG(A:0xbbf23b0) "' name='RPMH_BCM_AU_INST_MEM236'/>"
WRITE #1 "        <register address='0xbbf23b4' value='0x" DATA.LONG(A:0xbbf23b4) "' name='RPMH_BCM_AU_INST_MEM237'/>"
WRITE #1 "        <register address='0xbbf23b8' value='0x" DATA.LONG(A:0xbbf23b8) "' name='RPMH_BCM_AU_INST_MEM238'/>"
WRITE #1 "        <register address='0xbbf23bc' value='0x" DATA.LONG(A:0xbbf23bc) "' name='RPMH_BCM_AU_INST_MEM239'/>"
WRITE #1 "        <register address='0xbbf23c0' value='0x" DATA.LONG(A:0xbbf23c0) "' name='RPMH_BCM_AU_INST_MEM240'/>"
WRITE #1 "        <register address='0xbbf23c4' value='0x" DATA.LONG(A:0xbbf23c4) "' name='RPMH_BCM_AU_INST_MEM241'/>"
WRITE #1 "        <register address='0xbbf23c8' value='0x" DATA.LONG(A:0xbbf23c8) "' name='RPMH_BCM_AU_INST_MEM242'/>"
WRITE #1 "        <register address='0xbbf23cc' value='0x" DATA.LONG(A:0xbbf23cc) "' name='RPMH_BCM_AU_INST_MEM243'/>"
WRITE #1 "        <register address='0xbbf23d0' value='0x" DATA.LONG(A:0xbbf23d0) "' name='RPMH_BCM_AU_INST_MEM244'/>"
WRITE #1 "        <register address='0xbbf23d4' value='0x" DATA.LONG(A:0xbbf23d4) "' name='RPMH_BCM_AU_INST_MEM245'/>"
WRITE #1 "        <register address='0xbbf23d8' value='0x" DATA.LONG(A:0xbbf23d8) "' name='RPMH_BCM_AU_INST_MEM246'/>"
WRITE #1 "        <register address='0xbbf23dc' value='0x" DATA.LONG(A:0xbbf23dc) "' name='RPMH_BCM_AU_INST_MEM247'/>"
WRITE #1 "        <register address='0xbbf23e0' value='0x" DATA.LONG(A:0xbbf23e0) "' name='RPMH_BCM_AU_INST_MEM248'/>"
WRITE #1 "        <register address='0xbbf23e4' value='0x" DATA.LONG(A:0xbbf23e4) "' name='RPMH_BCM_AU_INST_MEM249'/>"
WRITE #1 "        <register address='0xbbf23e8' value='0x" DATA.LONG(A:0xbbf23e8) "' name='RPMH_BCM_AU_INST_MEM250'/>"
WRITE #1 "        <register address='0xbbf23ec' value='0x" DATA.LONG(A:0xbbf23ec) "' name='RPMH_BCM_AU_INST_MEM251'/>"
WRITE #1 "        <register address='0xbbf23f0' value='0x" DATA.LONG(A:0xbbf23f0) "' name='RPMH_BCM_AU_INST_MEM252'/>"
WRITE #1 "        <register address='0xbbf23f4' value='0x" DATA.LONG(A:0xbbf23f4) "' name='RPMH_BCM_AU_INST_MEM253'/>"
WRITE #1 "        <register address='0xbbf23f8' value='0x" DATA.LONG(A:0xbbf23f8) "' name='RPMH_BCM_AU_INST_MEM254'/>"
WRITE #1 "        <register address='0xbbf23fc' value='0x" DATA.LONG(A:0xbbf23fc) "' name='RPMH_BCM_AU_INST_MEM255'/>"
WRITE #1 "        <register address='0xbbf2400' value='0x" DATA.LONG(A:0xbbf2400) "' name='RPMH_BCM_SEQ_MEM0'/>"
WRITE #1 "        <register address='0xbbf2404' value='0x" DATA.LONG(A:0xbbf2404) "' name='RPMH_BCM_SEQ_MEM1'/>"
WRITE #1 "        <register address='0xbbf2408' value='0x" DATA.LONG(A:0xbbf2408) "' name='RPMH_BCM_SEQ_MEM2'/>"
WRITE #1 "        <register address='0xbbf240c' value='0x" DATA.LONG(A:0xbbf240c) "' name='RPMH_BCM_SEQ_MEM3'/>"
WRITE #1 "        <register address='0xbbf2410' value='0x" DATA.LONG(A:0xbbf2410) "' name='RPMH_BCM_SEQ_MEM4'/>"
WRITE #1 "        <register address='0xbbf2414' value='0x" DATA.LONG(A:0xbbf2414) "' name='RPMH_BCM_SEQ_MEM5'/>"
WRITE #1 "        <register address='0xbbf2418' value='0x" DATA.LONG(A:0xbbf2418) "' name='RPMH_BCM_SEQ_MEM6'/>"
WRITE #1 "        <register address='0xbbf241c' value='0x" DATA.LONG(A:0xbbf241c) "' name='RPMH_BCM_SEQ_MEM7'/>"
WRITE #1 "        <register address='0xbbf2420' value='0x" DATA.LONG(A:0xbbf2420) "' name='RPMH_BCM_SEQ_MEM8'/>"
WRITE #1 "        <register address='0xbbf2424' value='0x" DATA.LONG(A:0xbbf2424) "' name='RPMH_BCM_SEQ_MEM9'/>"
WRITE #1 "        <register address='0xbbf2428' value='0x" DATA.LONG(A:0xbbf2428) "' name='RPMH_BCM_SEQ_MEM10'/>"
WRITE #1 "        <register address='0xbbf242c' value='0x" DATA.LONG(A:0xbbf242c) "' name='RPMH_BCM_SEQ_MEM11'/>"
WRITE #1 "        <register address='0xbbf2430' value='0x" DATA.LONG(A:0xbbf2430) "' name='RPMH_BCM_SEQ_MEM12'/>"
WRITE #1 "        <register address='0xbbf2434' value='0x" DATA.LONG(A:0xbbf2434) "' name='RPMH_BCM_SEQ_MEM13'/>"
WRITE #1 "        <register address='0xbbf2438' value='0x" DATA.LONG(A:0xbbf2438) "' name='RPMH_BCM_SEQ_MEM14'/>"
WRITE #1 "        <register address='0xbbf243c' value='0x" DATA.LONG(A:0xbbf243c) "' name='RPMH_BCM_SEQ_MEM15'/>"
WRITE #1 "        <register address='0xbbf2440' value='0x" DATA.LONG(A:0xbbf2440) "' name='RPMH_BCM_SEQ_MEM16'/>"
WRITE #1 "        <register address='0xbbf2444' value='0x" DATA.LONG(A:0xbbf2444) "' name='RPMH_BCM_SEQ_MEM17'/>"
WRITE #1 "        <register address='0xbbf2448' value='0x" DATA.LONG(A:0xbbf2448) "' name='RPMH_BCM_SEQ_MEM18'/>"
WRITE #1 "        <register address='0xbbf244c' value='0x" DATA.LONG(A:0xbbf244c) "' name='RPMH_BCM_SEQ_MEM19'/>"
WRITE #1 "        <register address='0xbbf2450' value='0x" DATA.LONG(A:0xbbf2450) "' name='RPMH_BCM_SEQ_MEM20'/>"
WRITE #1 "        <register address='0xbbf2454' value='0x" DATA.LONG(A:0xbbf2454) "' name='RPMH_BCM_SEQ_MEM21'/>"
WRITE #1 "        <register address='0xbbf2458' value='0x" DATA.LONG(A:0xbbf2458) "' name='RPMH_BCM_SEQ_MEM22'/>"
WRITE #1 "        <register address='0xbbf245c' value='0x" DATA.LONG(A:0xbbf245c) "' name='RPMH_BCM_SEQ_MEM23'/>"
WRITE #1 "        <register address='0xbbf2460' value='0x" DATA.LONG(A:0xbbf2460) "' name='RPMH_BCM_SEQ_MEM24'/>"
WRITE #1 "        <register address='0xbbf2464' value='0x" DATA.LONG(A:0xbbf2464) "' name='RPMH_BCM_SEQ_MEM25'/>"
WRITE #1 "        <register address='0xbbf2468' value='0x" DATA.LONG(A:0xbbf2468) "' name='RPMH_BCM_SEQ_MEM26'/>"
WRITE #1 "        <register address='0xbbf246c' value='0x" DATA.LONG(A:0xbbf246c) "' name='RPMH_BCM_SEQ_MEM27'/>"
WRITE #1 "        <register address='0xbbf2470' value='0x" DATA.LONG(A:0xbbf2470) "' name='RPMH_BCM_SEQ_MEM28'/>"
WRITE #1 "        <register address='0xbbf2474' value='0x" DATA.LONG(A:0xbbf2474) "' name='RPMH_BCM_SEQ_MEM29'/>"
WRITE #1 "        <register address='0xbbf2478' value='0x" DATA.LONG(A:0xbbf2478) "' name='RPMH_BCM_SEQ_MEM30'/>"
WRITE #1 "        <register address='0xbbf247c' value='0x" DATA.LONG(A:0xbbf247c) "' name='RPMH_BCM_SEQ_MEM31'/>"
WRITE #1 "        <register address='0xbbf2600' value='0x" DATA.LONG(A:0xbbf2600) "' name='RPMH_BCM_SW_CP_CD0'/>"
WRITE #1 "        <register address='0xbbf2604' value='0x" DATA.LONG(A:0xbbf2604) "' name='RPMH_BCM_SW_CP_CD1'/>"
WRITE #1 "        <register address='0xbbf2608' value='0x" DATA.LONG(A:0xbbf2608) "' name='RPMH_BCM_SW_CP_CD2'/>"
WRITE #1 "        <register address='0xbbf260c' value='0x" DATA.LONG(A:0xbbf260c) "' name='RPMH_BCM_SW_CP_CD3'/>"
WRITE #1 "        <register address='0xbbf2610' value='0x" DATA.LONG(A:0xbbf2610) "' name='RPMH_BCM_SW_CP_CD4'/>"
WRITE #1 "        <register address='0xbbf2614' value='0x" DATA.LONG(A:0xbbf2614) "' name='RPMH_BCM_SW_CP_CD5'/>"
WRITE #1 "        <register address='0xbbf2618' value='0x" DATA.LONG(A:0xbbf2618) "' name='RPMH_BCM_SW_CP_CD6'/>"
WRITE #1 "        <register address='0xbbf261c' value='0x" DATA.LONG(A:0xbbf261c) "' name='RPMH_BCM_SW_CP_CD7'/>"
WRITE #1 "        <register address='0xbbf2620' value='0x" DATA.LONG(A:0xbbf2620) "' name='RPMH_BCM_SW_CP_CD8'/>"
WRITE #1 "        <register address='0xbbf2624' value='0x" DATA.LONG(A:0xbbf2624) "' name='RPMH_BCM_SW_CP_CD9'/>"
WRITE #1 "        <register address='0xbbf2628' value='0x" DATA.LONG(A:0xbbf2628) "' name='RPMH_BCM_SW_CP_CD10'/>"
WRITE #1 "        <register address='0xbbf262c' value='0x" DATA.LONG(A:0xbbf262c) "' name='RPMH_BCM_SW_CP_CD11'/>"
WRITE #1 "        <register address='0xbbf2680' value='0x" DATA.LONG(A:0xbbf2680) "' name='RPMH_BCM_SW_MASK_FE_BE_TRIG_CD0'/>"
WRITE #1 "        <register address='0xbbf2684' value='0x" DATA.LONG(A:0xbbf2684) "' name='RPMH_BCM_SW_MASK_FE_BE_TRIG_CD1'/>"
WRITE #1 "        <register address='0xbbf2688' value='0x" DATA.LONG(A:0xbbf2688) "' name='RPMH_BCM_SW_MASK_FE_BE_TRIG_CD2'/>"
WRITE #1 "        <register address='0xbbf268c' value='0x" DATA.LONG(A:0xbbf268c) "' name='RPMH_BCM_SW_MASK_FE_BE_TRIG_CD3'/>"
WRITE #1 "        <register address='0xbbf2690' value='0x" DATA.LONG(A:0xbbf2690) "' name='RPMH_BCM_SW_MASK_FE_BE_TRIG_CD4'/>"
WRITE #1 "        <register address='0xbbf2694' value='0x" DATA.LONG(A:0xbbf2694) "' name='RPMH_BCM_SW_MASK_FE_BE_TRIG_CD5'/>"
WRITE #1 "        <register address='0xbbf2698' value='0x" DATA.LONG(A:0xbbf2698) "' name='RPMH_BCM_SW_MASK_FE_BE_TRIG_CD6'/>"
WRITE #1 "        <register address='0xbbf269c' value='0x" DATA.LONG(A:0xbbf269c) "' name='RPMH_BCM_SW_MASK_FE_BE_TRIG_CD7'/>"
WRITE #1 "        <register address='0xbbf26a0' value='0x" DATA.LONG(A:0xbbf26a0) "' name='RPMH_BCM_SW_MASK_FE_BE_TRIG_CD8'/>"
WRITE #1 "        <register address='0xbbf26a4' value='0x" DATA.LONG(A:0xbbf26a4) "' name='RPMH_BCM_SW_MASK_FE_BE_TRIG_CD9'/>"
WRITE #1 "        <register address='0xbbf26a8' value='0x" DATA.LONG(A:0xbbf26a8) "' name='RPMH_BCM_SW_MASK_FE_BE_TRIG_CD10'/>"
WRITE #1 "        <register address='0xbbf26ac' value='0x" DATA.LONG(A:0xbbf26ac) "' name='RPMH_BCM_SW_MASK_FE_BE_TRIG_CD11'/>"
WRITE #1 "        <register address='0xbbf2700' value='0x" DATA.LONG(A:0xbbf2700) "' name='RPMH_BCM_SW_OVERRIDE_STOP_AGG_CD0'/>"
WRITE #1 "        <register address='0xbbf2704' value='0x" DATA.LONG(A:0xbbf2704) "' name='RPMH_BCM_SW_OVERRIDE_STOP_AGG_CD1'/>"
WRITE #1 "        <register address='0xbbf2708' value='0x" DATA.LONG(A:0xbbf2708) "' name='RPMH_BCM_SW_OVERRIDE_STOP_AGG_CD2'/>"
WRITE #1 "        <register address='0xbbf270c' value='0x" DATA.LONG(A:0xbbf270c) "' name='RPMH_BCM_SW_OVERRIDE_STOP_AGG_CD3'/>"
WRITE #1 "        <register address='0xbbf2710' value='0x" DATA.LONG(A:0xbbf2710) "' name='RPMH_BCM_SW_OVERRIDE_STOP_AGG_CD4'/>"
WRITE #1 "        <register address='0xbbf2714' value='0x" DATA.LONG(A:0xbbf2714) "' name='RPMH_BCM_SW_OVERRIDE_STOP_AGG_CD5'/>"
WRITE #1 "        <register address='0xbbf2718' value='0x" DATA.LONG(A:0xbbf2718) "' name='RPMH_BCM_SW_OVERRIDE_STOP_AGG_CD6'/>"
WRITE #1 "        <register address='0xbbf271c' value='0x" DATA.LONG(A:0xbbf271c) "' name='RPMH_BCM_SW_OVERRIDE_STOP_AGG_CD7'/>"
WRITE #1 "        <register address='0xbbf2720' value='0x" DATA.LONG(A:0xbbf2720) "' name='RPMH_BCM_SW_OVERRIDE_STOP_AGG_CD8'/>"
WRITE #1 "        <register address='0xbbf2724' value='0x" DATA.LONG(A:0xbbf2724) "' name='RPMH_BCM_SW_OVERRIDE_STOP_AGG_CD9'/>"
WRITE #1 "        <register address='0xbbf2728' value='0x" DATA.LONG(A:0xbbf2728) "' name='RPMH_BCM_SW_OVERRIDE_STOP_AGG_CD10'/>"
WRITE #1 "        <register address='0xbbf272c' value='0x" DATA.LONG(A:0xbbf272c) "' name='RPMH_BCM_SW_OVERRIDE_STOP_AGG_CD11'/>"
WRITE #1 "        <register address='0xbbf2800' value='0x" DATA.LONG(A:0xbbf2800) "' name='RPMH_BCM_SW_OVERWRITE_FINAL_CP_CD0'/>"
WRITE #1 "        <register address='0xbbf2804' value='0x" DATA.LONG(A:0xbbf2804) "' name='RPMH_BCM_SW_OVERWRITE_FINAL_CP_CD1'/>"
WRITE #1 "        <register address='0xbbf2808' value='0x" DATA.LONG(A:0xbbf2808) "' name='RPMH_BCM_SW_OVERWRITE_FINAL_CP_CD2'/>"
WRITE #1 "        <register address='0xbbf280c' value='0x" DATA.LONG(A:0xbbf280c) "' name='RPMH_BCM_SW_OVERWRITE_FINAL_CP_CD3'/>"
WRITE #1 "        <register address='0xbbf2810' value='0x" DATA.LONG(A:0xbbf2810) "' name='RPMH_BCM_SW_OVERWRITE_FINAL_CP_CD4'/>"
WRITE #1 "        <register address='0xbbf2814' value='0x" DATA.LONG(A:0xbbf2814) "' name='RPMH_BCM_SW_OVERWRITE_FINAL_CP_CD5'/>"
WRITE #1 "        <register address='0xbbf2818' value='0x" DATA.LONG(A:0xbbf2818) "' name='RPMH_BCM_SW_OVERWRITE_FINAL_CP_CD6'/>"
WRITE #1 "        <register address='0xbbf281c' value='0x" DATA.LONG(A:0xbbf281c) "' name='RPMH_BCM_SW_OVERWRITE_FINAL_CP_CD7'/>"
WRITE #1 "        <register address='0xbbf2820' value='0x" DATA.LONG(A:0xbbf2820) "' name='RPMH_BCM_SW_OVERWRITE_FINAL_CP_CD8'/>"
WRITE #1 "        <register address='0xbbf2824' value='0x" DATA.LONG(A:0xbbf2824) "' name='RPMH_BCM_SW_OVERWRITE_FINAL_CP_CD9'/>"
WRITE #1 "        <register address='0xbbf2828' value='0x" DATA.LONG(A:0xbbf2828) "' name='RPMH_BCM_SW_OVERWRITE_FINAL_CP_CD10'/>"
WRITE #1 "        <register address='0xbbf282c' value='0x" DATA.LONG(A:0xbbf282c) "' name='RPMH_BCM_SW_OVERWRITE_FINAL_CP_CD11'/>"
WRITE #1 "        <register address='0xbbf2880' value='0x" DATA.LONG(A:0xbbf2880) "' name='RPMH_BCM_SW_BLOCK_FINAL_CP_CD0'/>"
WRITE #1 "        <register address='0xbbf2884' value='0x" DATA.LONG(A:0xbbf2884) "' name='RPMH_BCM_SW_BLOCK_FINAL_CP_CD1'/>"
WRITE #1 "        <register address='0xbbf2888' value='0x" DATA.LONG(A:0xbbf2888) "' name='RPMH_BCM_SW_BLOCK_FINAL_CP_CD2'/>"
WRITE #1 "        <register address='0xbbf288c' value='0x" DATA.LONG(A:0xbbf288c) "' name='RPMH_BCM_SW_BLOCK_FINAL_CP_CD3'/>"
WRITE #1 "        <register address='0xbbf2890' value='0x" DATA.LONG(A:0xbbf2890) "' name='RPMH_BCM_SW_BLOCK_FINAL_CP_CD4'/>"
WRITE #1 "        <register address='0xbbf2894' value='0x" DATA.LONG(A:0xbbf2894) "' name='RPMH_BCM_SW_BLOCK_FINAL_CP_CD5'/>"
WRITE #1 "        <register address='0xbbf2898' value='0x" DATA.LONG(A:0xbbf2898) "' name='RPMH_BCM_SW_BLOCK_FINAL_CP_CD6'/>"
WRITE #1 "        <register address='0xbbf289c' value='0x" DATA.LONG(A:0xbbf289c) "' name='RPMH_BCM_SW_BLOCK_FINAL_CP_CD7'/>"
WRITE #1 "        <register address='0xbbf28a0' value='0x" DATA.LONG(A:0xbbf28a0) "' name='RPMH_BCM_SW_BLOCK_FINAL_CP_CD8'/>"
WRITE #1 "        <register address='0xbbf28a4' value='0x" DATA.LONG(A:0xbbf28a4) "' name='RPMH_BCM_SW_BLOCK_FINAL_CP_CD9'/>"
WRITE #1 "        <register address='0xbbf28a8' value='0x" DATA.LONG(A:0xbbf28a8) "' name='RPMH_BCM_SW_BLOCK_FINAL_CP_CD10'/>"
WRITE #1 "        <register address='0xbbf28ac' value='0x" DATA.LONG(A:0xbbf28ac) "' name='RPMH_BCM_SW_BLOCK_FINAL_CP_CD11'/>"
WRITE #1 "        <register address='0xbbf2900' value='0x" DATA.LONG(A:0xbbf2900) "' name='RPMH_BCM_SW_OVERWRITE_WRITTEN_CP_CD0'/>"
WRITE #1 "        <register address='0xbbf2904' value='0x" DATA.LONG(A:0xbbf2904) "' name='RPMH_BCM_SW_OVERWRITE_WRITTEN_CP_CD1'/>"
WRITE #1 "        <register address='0xbbf2908' value='0x" DATA.LONG(A:0xbbf2908) "' name='RPMH_BCM_SW_OVERWRITE_WRITTEN_CP_CD2'/>"
WRITE #1 "        <register address='0xbbf290c' value='0x" DATA.LONG(A:0xbbf290c) "' name='RPMH_BCM_SW_OVERWRITE_WRITTEN_CP_CD3'/>"
WRITE #1 "        <register address='0xbbf2910' value='0x" DATA.LONG(A:0xbbf2910) "' name='RPMH_BCM_SW_OVERWRITE_WRITTEN_CP_CD4'/>"
WRITE #1 "        <register address='0xbbf2914' value='0x" DATA.LONG(A:0xbbf2914) "' name='RPMH_BCM_SW_OVERWRITE_WRITTEN_CP_CD5'/>"
WRITE #1 "        <register address='0xbbf2918' value='0x" DATA.LONG(A:0xbbf2918) "' name='RPMH_BCM_SW_OVERWRITE_WRITTEN_CP_CD6'/>"
WRITE #1 "        <register address='0xbbf291c' value='0x" DATA.LONG(A:0xbbf291c) "' name='RPMH_BCM_SW_OVERWRITE_WRITTEN_CP_CD7'/>"
WRITE #1 "        <register address='0xbbf2920' value='0x" DATA.LONG(A:0xbbf2920) "' name='RPMH_BCM_SW_OVERWRITE_WRITTEN_CP_CD8'/>"
WRITE #1 "        <register address='0xbbf2924' value='0x" DATA.LONG(A:0xbbf2924) "' name='RPMH_BCM_SW_OVERWRITE_WRITTEN_CP_CD9'/>"
WRITE #1 "        <register address='0xbbf2928' value='0x" DATA.LONG(A:0xbbf2928) "' name='RPMH_BCM_SW_OVERWRITE_WRITTEN_CP_CD10'/>"
WRITE #1 "        <register address='0xbbf292c' value='0x" DATA.LONG(A:0xbbf292c) "' name='RPMH_BCM_SW_OVERWRITE_WRITTEN_CP_CD11'/>"
WRITE #1 "        <register address='0xbbf2980' value='0x" DATA.LONG(A:0xbbf2980) "' name='RPMH_BCM_SW_OVERWRITE_CURRENT_CP_CD0'/>"
WRITE #1 "        <register address='0xbbf2984' value='0x" DATA.LONG(A:0xbbf2984) "' name='RPMH_BCM_SW_OVERWRITE_CURRENT_CP_CD1'/>"
WRITE #1 "        <register address='0xbbf2988' value='0x" DATA.LONG(A:0xbbf2988) "' name='RPMH_BCM_SW_OVERWRITE_CURRENT_CP_CD2'/>"
WRITE #1 "        <register address='0xbbf298c' value='0x" DATA.LONG(A:0xbbf298c) "' name='RPMH_BCM_SW_OVERWRITE_CURRENT_CP_CD3'/>"
WRITE #1 "        <register address='0xbbf2990' value='0x" DATA.LONG(A:0xbbf2990) "' name='RPMH_BCM_SW_OVERWRITE_CURRENT_CP_CD4'/>"
WRITE #1 "        <register address='0xbbf2994' value='0x" DATA.LONG(A:0xbbf2994) "' name='RPMH_BCM_SW_OVERWRITE_CURRENT_CP_CD5'/>"
WRITE #1 "        <register address='0xbbf2998' value='0x" DATA.LONG(A:0xbbf2998) "' name='RPMH_BCM_SW_OVERWRITE_CURRENT_CP_CD6'/>"
WRITE #1 "        <register address='0xbbf299c' value='0x" DATA.LONG(A:0xbbf299c) "' name='RPMH_BCM_SW_OVERWRITE_CURRENT_CP_CD7'/>"
WRITE #1 "        <register address='0xbbf29a0' value='0x" DATA.LONG(A:0xbbf29a0) "' name='RPMH_BCM_SW_OVERWRITE_CURRENT_CP_CD8'/>"
WRITE #1 "        <register address='0xbbf29a4' value='0x" DATA.LONG(A:0xbbf29a4) "' name='RPMH_BCM_SW_OVERWRITE_CURRENT_CP_CD9'/>"
WRITE #1 "        <register address='0xbbf29a8' value='0x" DATA.LONG(A:0xbbf29a8) "' name='RPMH_BCM_SW_OVERWRITE_CURRENT_CP_CD10'/>"
WRITE #1 "        <register address='0xbbf29ac' value='0x" DATA.LONG(A:0xbbf29ac) "' name='RPMH_BCM_SW_OVERWRITE_CURRENT_CP_CD11'/>"
WRITE #1 "        <register address='0xbbf2a00' value='0x" DATA.LONG(A:0xbbf2a00) "' name='RPMH_BCM_SW_OVERRIDE_TCS_CP_SEL_CD0'/>"
WRITE #1 "        <register address='0xbbf2a04' value='0x" DATA.LONG(A:0xbbf2a04) "' name='RPMH_BCM_SW_OVERRIDE_TCS_CP_SEL_CD1'/>"
WRITE #1 "        <register address='0xbbf2a08' value='0x" DATA.LONG(A:0xbbf2a08) "' name='RPMH_BCM_SW_OVERRIDE_TCS_CP_SEL_CD2'/>"
WRITE #1 "        <register address='0xbbf2a0c' value='0x" DATA.LONG(A:0xbbf2a0c) "' name='RPMH_BCM_SW_OVERRIDE_TCS_CP_SEL_CD3'/>"
WRITE #1 "        <register address='0xbbf2a10' value='0x" DATA.LONG(A:0xbbf2a10) "' name='RPMH_BCM_SW_OVERRIDE_TCS_CP_SEL_CD4'/>"
WRITE #1 "        <register address='0xbbf2a14' value='0x" DATA.LONG(A:0xbbf2a14) "' name='RPMH_BCM_SW_OVERRIDE_TCS_CP_SEL_CD5'/>"
WRITE #1 "        <register address='0xbbf2a18' value='0x" DATA.LONG(A:0xbbf2a18) "' name='RPMH_BCM_SW_OVERRIDE_TCS_CP_SEL_CD6'/>"
WRITE #1 "        <register address='0xbbf2a1c' value='0x" DATA.LONG(A:0xbbf2a1c) "' name='RPMH_BCM_SW_OVERRIDE_TCS_CP_SEL_CD7'/>"
WRITE #1 "        <register address='0xbbf2a20' value='0x" DATA.LONG(A:0xbbf2a20) "' name='RPMH_BCM_SW_OVERRIDE_TCS_CP_SEL_CD8'/>"
WRITE #1 "        <register address='0xbbf2a24' value='0x" DATA.LONG(A:0xbbf2a24) "' name='RPMH_BCM_SW_OVERRIDE_TCS_CP_SEL_CD9'/>"
WRITE #1 "        <register address='0xbbf2a28' value='0x" DATA.LONG(A:0xbbf2a28) "' name='RPMH_BCM_SW_OVERRIDE_TCS_CP_SEL_CD10'/>"
WRITE #1 "        <register address='0xbbf2a2c' value='0x" DATA.LONG(A:0xbbf2a2c) "' name='RPMH_BCM_SW_OVERRIDE_TCS_CP_SEL_CD11'/>"
WRITE #1 "        <register address='0xbbf2a80' value='0x" DATA.LONG(A:0xbbf2a80) "' name='RPMH_BCM_SW_OVERRIDE_TCS_ENABLE_CD0'/>"
WRITE #1 "        <register address='0xbbf2a84' value='0x" DATA.LONG(A:0xbbf2a84) "' name='RPMH_BCM_SW_OVERRIDE_TCS_ENABLE_CD1'/>"
WRITE #1 "        <register address='0xbbf2a88' value='0x" DATA.LONG(A:0xbbf2a88) "' name='RPMH_BCM_SW_OVERRIDE_TCS_ENABLE_CD2'/>"
WRITE #1 "        <register address='0xbbf2a8c' value='0x" DATA.LONG(A:0xbbf2a8c) "' name='RPMH_BCM_SW_OVERRIDE_TCS_ENABLE_CD3'/>"
WRITE #1 "        <register address='0xbbf2a90' value='0x" DATA.LONG(A:0xbbf2a90) "' name='RPMH_BCM_SW_OVERRIDE_TCS_ENABLE_CD4'/>"
WRITE #1 "        <register address='0xbbf2a94' value='0x" DATA.LONG(A:0xbbf2a94) "' name='RPMH_BCM_SW_OVERRIDE_TCS_ENABLE_CD5'/>"
WRITE #1 "        <register address='0xbbf2a98' value='0x" DATA.LONG(A:0xbbf2a98) "' name='RPMH_BCM_SW_OVERRIDE_TCS_ENABLE_CD6'/>"
WRITE #1 "        <register address='0xbbf2a9c' value='0x" DATA.LONG(A:0xbbf2a9c) "' name='RPMH_BCM_SW_OVERRIDE_TCS_ENABLE_CD7'/>"
WRITE #1 "        <register address='0xbbf2aa0' value='0x" DATA.LONG(A:0xbbf2aa0) "' name='RPMH_BCM_SW_OVERRIDE_TCS_ENABLE_CD8'/>"
WRITE #1 "        <register address='0xbbf2aa4' value='0x" DATA.LONG(A:0xbbf2aa4) "' name='RPMH_BCM_SW_OVERRIDE_TCS_ENABLE_CD9'/>"
WRITE #1 "        <register address='0xbbf2aa8' value='0x" DATA.LONG(A:0xbbf2aa8) "' name='RPMH_BCM_SW_OVERRIDE_TCS_ENABLE_CD10'/>"
WRITE #1 "        <register address='0xbbf2aac' value='0x" DATA.LONG(A:0xbbf2aac) "' name='RPMH_BCM_SW_OVERRIDE_TCS_ENABLE_CD11'/>"
WRITE #1 "        <register address='0xbbf2b00' value='0x" DATA.LONG(A:0xbbf2b00) "' name='RPMH_BCM_SW_OVERRIDE_TCS_FLUSH_CD0'/>"
WRITE #1 "        <register address='0xbbf2b04' value='0x" DATA.LONG(A:0xbbf2b04) "' name='RPMH_BCM_SW_OVERRIDE_TCS_FLUSH_CD1'/>"
WRITE #1 "        <register address='0xbbf2b08' value='0x" DATA.LONG(A:0xbbf2b08) "' name='RPMH_BCM_SW_OVERRIDE_TCS_FLUSH_CD2'/>"
WRITE #1 "        <register address='0xbbf2b0c' value='0x" DATA.LONG(A:0xbbf2b0c) "' name='RPMH_BCM_SW_OVERRIDE_TCS_FLUSH_CD3'/>"
WRITE #1 "        <register address='0xbbf2b10' value='0x" DATA.LONG(A:0xbbf2b10) "' name='RPMH_BCM_SW_OVERRIDE_TCS_FLUSH_CD4'/>"
WRITE #1 "        <register address='0xbbf2b14' value='0x" DATA.LONG(A:0xbbf2b14) "' name='RPMH_BCM_SW_OVERRIDE_TCS_FLUSH_CD5'/>"
WRITE #1 "        <register address='0xbbf2b18' value='0x" DATA.LONG(A:0xbbf2b18) "' name='RPMH_BCM_SW_OVERRIDE_TCS_FLUSH_CD6'/>"
WRITE #1 "        <register address='0xbbf2b1c' value='0x" DATA.LONG(A:0xbbf2b1c) "' name='RPMH_BCM_SW_OVERRIDE_TCS_FLUSH_CD7'/>"
WRITE #1 "        <register address='0xbbf2b20' value='0x" DATA.LONG(A:0xbbf2b20) "' name='RPMH_BCM_SW_OVERRIDE_TCS_FLUSH_CD8'/>"
WRITE #1 "        <register address='0xbbf2b24' value='0x" DATA.LONG(A:0xbbf2b24) "' name='RPMH_BCM_SW_OVERRIDE_TCS_FLUSH_CD9'/>"
WRITE #1 "        <register address='0xbbf2b28' value='0x" DATA.LONG(A:0xbbf2b28) "' name='RPMH_BCM_SW_OVERRIDE_TCS_FLUSH_CD10'/>"
WRITE #1 "        <register address='0xbbf2b2c' value='0x" DATA.LONG(A:0xbbf2b2c) "' name='RPMH_BCM_SW_OVERRIDE_TCS_FLUSH_CD11'/>"
WRITE #1 "        <register address='0xbbf2b80' value='0x" DATA.LONG(A:0xbbf2b80) "' name='RPMH_BCM_SW_OVERRIDE_SEQ_UNBLOCK_STICKY_CD0'/>"
WRITE #1 "        <register address='0xbbf2b84' value='0x" DATA.LONG(A:0xbbf2b84) "' name='RPMH_BCM_SW_OVERRIDE_SEQ_UNBLOCK_STICKY_CD1'/>"
WRITE #1 "        <register address='0xbbf2b88' value='0x" DATA.LONG(A:0xbbf2b88) "' name='RPMH_BCM_SW_OVERRIDE_SEQ_UNBLOCK_STICKY_CD2'/>"
WRITE #1 "        <register address='0xbbf2b8c' value='0x" DATA.LONG(A:0xbbf2b8c) "' name='RPMH_BCM_SW_OVERRIDE_SEQ_UNBLOCK_STICKY_CD3'/>"
WRITE #1 "        <register address='0xbbf2b90' value='0x" DATA.LONG(A:0xbbf2b90) "' name='RPMH_BCM_SW_OVERRIDE_SEQ_UNBLOCK_STICKY_CD4'/>"
WRITE #1 "        <register address='0xbbf2b94' value='0x" DATA.LONG(A:0xbbf2b94) "' name='RPMH_BCM_SW_OVERRIDE_SEQ_UNBLOCK_STICKY_CD5'/>"
WRITE #1 "        <register address='0xbbf2b98' value='0x" DATA.LONG(A:0xbbf2b98) "' name='RPMH_BCM_SW_OVERRIDE_SEQ_UNBLOCK_STICKY_CD6'/>"
WRITE #1 "        <register address='0xbbf2b9c' value='0x" DATA.LONG(A:0xbbf2b9c) "' name='RPMH_BCM_SW_OVERRIDE_SEQ_UNBLOCK_STICKY_CD7'/>"
WRITE #1 "        <register address='0xbbf2ba0' value='0x" DATA.LONG(A:0xbbf2ba0) "' name='RPMH_BCM_SW_OVERRIDE_SEQ_UNBLOCK_STICKY_CD8'/>"
WRITE #1 "        <register address='0xbbf2ba4' value='0x" DATA.LONG(A:0xbbf2ba4) "' name='RPMH_BCM_SW_OVERRIDE_SEQ_UNBLOCK_STICKY_CD9'/>"
WRITE #1 "        <register address='0xbbf2ba8' value='0x" DATA.LONG(A:0xbbf2ba8) "' name='RPMH_BCM_SW_OVERRIDE_SEQ_UNBLOCK_STICKY_CD10'/>"
WRITE #1 "        <register address='0xbbf2bac' value='0x" DATA.LONG(A:0xbbf2bac) "' name='RPMH_BCM_SW_OVERRIDE_SEQ_UNBLOCK_STICKY_CD11'/>"
WRITE #1 "        <register address='0xbbf2d00' value='0x" DATA.LONG(A:0xbbf2d00) "' name='RPMH_BCM_SW_OVERRIDE_CE_INPUT_CD0'/>"
WRITE #1 "        <register address='0xbbf2d04' value='0x" DATA.LONG(A:0xbbf2d04) "' name='RPMH_BCM_SW_OVERRIDE_CE_INPUT_CD1'/>"
WRITE #1 "        <register address='0xbbf2d08' value='0x" DATA.LONG(A:0xbbf2d08) "' name='RPMH_BCM_SW_OVERRIDE_CE_INPUT_CD2'/>"
WRITE #1 "        <register address='0xbbf2d0c' value='0x" DATA.LONG(A:0xbbf2d0c) "' name='RPMH_BCM_SW_OVERRIDE_CE_INPUT_CD3'/>"
WRITE #1 "        <register address='0xbbf2d10' value='0x" DATA.LONG(A:0xbbf2d10) "' name='RPMH_BCM_SW_OVERRIDE_CE_INPUT_CD4'/>"
WRITE #1 "        <register address='0xbbf2d14' value='0x" DATA.LONG(A:0xbbf2d14) "' name='RPMH_BCM_SW_OVERRIDE_CE_INPUT_CD5'/>"
WRITE #1 "        <register address='0xbbf2d18' value='0x" DATA.LONG(A:0xbbf2d18) "' name='RPMH_BCM_SW_OVERRIDE_CE_INPUT_CD6'/>"
WRITE #1 "        <register address='0xbbf2d1c' value='0x" DATA.LONG(A:0xbbf2d1c) "' name='RPMH_BCM_SW_OVERRIDE_CE_INPUT_CD7'/>"
WRITE #1 "        <register address='0xbbf2d20' value='0x" DATA.LONG(A:0xbbf2d20) "' name='RPMH_BCM_SW_OVERRIDE_CE_INPUT_CD8'/>"
WRITE #1 "        <register address='0xbbf2d24' value='0x" DATA.LONG(A:0xbbf2d24) "' name='RPMH_BCM_SW_OVERRIDE_CE_INPUT_CD9'/>"
WRITE #1 "        <register address='0xbbf2d28' value='0x" DATA.LONG(A:0xbbf2d28) "' name='RPMH_BCM_SW_OVERRIDE_CE_INPUT_CD10'/>"
WRITE #1 "        <register address='0xbbf2d2c' value='0x" DATA.LONG(A:0xbbf2d2c) "' name='RPMH_BCM_SW_OVERRIDE_CE_INPUT_CD11'/>"
WRITE #1 "        <register address='0xbbf2d80' value='0x" DATA.LONG(A:0xbbf2d80) "' name='RPMH_BCM_SW_OVERRIDE_BE_SEQ_TCS_CLK_ON_CD0'/>"
WRITE #1 "        <register address='0xbbf2d84' value='0x" DATA.LONG(A:0xbbf2d84) "' name='RPMH_BCM_SW_OVERRIDE_BE_SEQ_TCS_CLK_ON_CD1'/>"
WRITE #1 "        <register address='0xbbf2d88' value='0x" DATA.LONG(A:0xbbf2d88) "' name='RPMH_BCM_SW_OVERRIDE_BE_SEQ_TCS_CLK_ON_CD2'/>"
WRITE #1 "        <register address='0xbbf2d8c' value='0x" DATA.LONG(A:0xbbf2d8c) "' name='RPMH_BCM_SW_OVERRIDE_BE_SEQ_TCS_CLK_ON_CD3'/>"
WRITE #1 "        <register address='0xbbf2d90' value='0x" DATA.LONG(A:0xbbf2d90) "' name='RPMH_BCM_SW_OVERRIDE_BE_SEQ_TCS_CLK_ON_CD4'/>"
WRITE #1 "        <register address='0xbbf2d94' value='0x" DATA.LONG(A:0xbbf2d94) "' name='RPMH_BCM_SW_OVERRIDE_BE_SEQ_TCS_CLK_ON_CD5'/>"
WRITE #1 "        <register address='0xbbf2d98' value='0x" DATA.LONG(A:0xbbf2d98) "' name='RPMH_BCM_SW_OVERRIDE_BE_SEQ_TCS_CLK_ON_CD6'/>"
WRITE #1 "        <register address='0xbbf2d9c' value='0x" DATA.LONG(A:0xbbf2d9c) "' name='RPMH_BCM_SW_OVERRIDE_BE_SEQ_TCS_CLK_ON_CD7'/>"
WRITE #1 "        <register address='0xbbf2da0' value='0x" DATA.LONG(A:0xbbf2da0) "' name='RPMH_BCM_SW_OVERRIDE_BE_SEQ_TCS_CLK_ON_CD8'/>"
WRITE #1 "        <register address='0xbbf2da4' value='0x" DATA.LONG(A:0xbbf2da4) "' name='RPMH_BCM_SW_OVERRIDE_BE_SEQ_TCS_CLK_ON_CD9'/>"
WRITE #1 "        <register address='0xbbf2da8' value='0x" DATA.LONG(A:0xbbf2da8) "' name='RPMH_BCM_SW_OVERRIDE_BE_SEQ_TCS_CLK_ON_CD10'/>"
WRITE #1 "        <register address='0xbbf2dac' value='0x" DATA.LONG(A:0xbbf2dac) "' name='RPMH_BCM_SW_OVERRIDE_BE_SEQ_TCS_CLK_ON_CD11'/>"
WRITE #1 "        <register address='0xbc00000' value='0x" DATA.LONG(A:0xbc00000) "' name='RPMH_DDRAUX_RSI_TCS0_CFG'/>"
WRITE #1 "        <register address='0xbc00004' value='0x" DATA.LONG(A:0xbc00004) "' name='RPMH_DDRAUX_RSI_TCS1_CFG'/>"
WRITE #1 "        <register address='0xbc00008' value='0x" DATA.LONG(A:0xbc00008) "' name='RPMH_DDRAUX_RSI_TCS2_CFG'/>"
WRITE #1 "        <register address='0xbc0000c' value='0x" DATA.LONG(A:0xbc0000c) "' name='RPMH_DDRAUX_RSI_TCS3_CFG'/>"
WRITE #1 "        <register address='0xbc00010' value='0x" DATA.LONG(A:0xbc00010) "' name='RPMH_DDRAUX_RSI_TCS4_CFG'/>"
WRITE #1 "        <register address='0xbc00014' value='0x" DATA.LONG(A:0xbc00014) "' name='RPMH_DDRAUX_RSI_TCS5_CFG'/>"
WRITE #1 "        <register address='0xbc00018' value='0x" DATA.LONG(A:0xbc00018) "' name='RPMH_DDRAUX_RSI_TCS6_CFG'/>"
WRITE #1 "        <register address='0xbc0001c' value='0x" DATA.LONG(A:0xbc0001c) "' name='RPMH_DDRAUX_RSI_TCS7_CFG'/>"
WRITE #1 "        <register address='0xbc00020' value='0x" DATA.LONG(A:0xbc00020) "' name='RPMH_DDRAUX_RSI_TCS8_CFG'/>"
WRITE #1 "        <register address='0xbc00024' value='0x" DATA.LONG(A:0xbc00024) "' name='RPMH_DDRAUX_RSI_TCS9_CFG'/>"
WRITE #1 "        <register address='0xbc00028' value='0x" DATA.LONG(A:0xbc00028) "' name='RPMH_DDRAUX_RSI_TCS10_CFG'/>"
WRITE #1 "        <register address='0xbc0002c' value='0x" DATA.LONG(A:0xbc0002c) "' name='RPMH_DDRAUX_RSI_TCS11_CFG'/>"
WRITE #1 "        <register address='0xbc00030' value='0x" DATA.LONG(A:0xbc00030) "' name='RPMH_DDRAUX_RSI_TCS12_CFG'/>"
WRITE #1 "        <register address='0xbc00034' value='0x" DATA.LONG(A:0xbc00034) "' name='RPMH_DDRAUX_RSI_TCS13_CFG'/>"
WRITE #1 "        <register address='0xbc00040' value='0x" DATA.LONG(A:0xbc00040) "' name='RPMH_DDRAUX_RSI_TCS0_STAT'/>"
WRITE #1 "        <register address='0xbc00044' value='0x" DATA.LONG(A:0xbc00044) "' name='RPMH_DDRAUX_RSI_TCS1_STAT'/>"
WRITE #1 "        <register address='0xbc00048' value='0x" DATA.LONG(A:0xbc00048) "' name='RPMH_DDRAUX_RSI_TCS2_STAT'/>"
WRITE #1 "        <register address='0xbc0004c' value='0x" DATA.LONG(A:0xbc0004c) "' name='RPMH_DDRAUX_RSI_TCS3_STAT'/>"
WRITE #1 "        <register address='0xbc00050' value='0x" DATA.LONG(A:0xbc00050) "' name='RPMH_DDRAUX_RSI_TCS4_STAT'/>"
WRITE #1 "        <register address='0xbc00054' value='0x" DATA.LONG(A:0xbc00054) "' name='RPMH_DDRAUX_RSI_TCS5_STAT'/>"
WRITE #1 "        <register address='0xbc00058' value='0x" DATA.LONG(A:0xbc00058) "' name='RPMH_DDRAUX_RSI_TCS6_STAT'/>"
WRITE #1 "        <register address='0xbc0005c' value='0x" DATA.LONG(A:0xbc0005c) "' name='RPMH_DDRAUX_RSI_TCS7_STAT'/>"
WRITE #1 "        <register address='0xbc00060' value='0x" DATA.LONG(A:0xbc00060) "' name='RPMH_DDRAUX_RSI_TCS8_STAT'/>"
WRITE #1 "        <register address='0xbc00064' value='0x" DATA.LONG(A:0xbc00064) "' name='RPMH_DDRAUX_RSI_TCS9_STAT'/>"
WRITE #1 "        <register address='0xbc00068' value='0x" DATA.LONG(A:0xbc00068) "' name='RPMH_DDRAUX_RSI_TCS10_STAT'/>"
WRITE #1 "        <register address='0xbc0006c' value='0x" DATA.LONG(A:0xbc0006c) "' name='RPMH_DDRAUX_RSI_TCS11_STAT'/>"
WRITE #1 "        <register address='0xbc00070' value='0x" DATA.LONG(A:0xbc00070) "' name='RPMH_DDRAUX_RSI_TCS12_STAT'/>"
WRITE #1 "        <register address='0xbc00074' value='0x" DATA.LONG(A:0xbc00074) "' name='RPMH_DDRAUX_RSI_TCS13_STAT'/>"
WRITE #1 "        <register address='0xbc00080' value='0x" DATA.LONG(A:0xbc00080) "' name='RPMH_DDRAUX_RSI_TCS0_CMD0'/>"
WRITE #1 "        <register address='0xbc00084' value='0x" DATA.LONG(A:0xbc00084) "' name='RPMH_DDRAUX_RSI_TCS0_CMD1'/>"
WRITE #1 "        <register address='0xbc00088' value='0x" DATA.LONG(A:0xbc00088) "' name='RPMH_DDRAUX_RSI_TCS0_CMD2'/>"
WRITE #1 "        <register address='0xbc0008c' value='0x" DATA.LONG(A:0xbc0008c) "' name='RPMH_DDRAUX_RSI_TCS0_CMD3'/>"
WRITE #1 "        <register address='0xbc00090' value='0x" DATA.LONG(A:0xbc00090) "' name='RPMH_DDRAUX_RSI_TCS1_CMD0'/>"
WRITE #1 "        <register address='0xbc00094' value='0x" DATA.LONG(A:0xbc00094) "' name='RPMH_DDRAUX_RSI_TCS1_CMD1'/>"
WRITE #1 "        <register address='0xbc00098' value='0x" DATA.LONG(A:0xbc00098) "' name='RPMH_DDRAUX_RSI_TCS1_CMD2'/>"
WRITE #1 "        <register address='0xbc0009c' value='0x" DATA.LONG(A:0xbc0009c) "' name='RPMH_DDRAUX_RSI_TCS1_CMD3'/>"
WRITE #1 "        <register address='0xbc000a0' value='0x" DATA.LONG(A:0xbc000a0) "' name='RPMH_DDRAUX_RSI_TCS2_CMD0'/>"
WRITE #1 "        <register address='0xbc000a4' value='0x" DATA.LONG(A:0xbc000a4) "' name='RPMH_DDRAUX_RSI_TCS2_CMD1'/>"
WRITE #1 "        <register address='0xbc000a8' value='0x" DATA.LONG(A:0xbc000a8) "' name='RPMH_DDRAUX_RSI_TCS2_CMD2'/>"
WRITE #1 "        <register address='0xbc000ac' value='0x" DATA.LONG(A:0xbc000ac) "' name='RPMH_DDRAUX_RSI_TCS2_CMD3'/>"
WRITE #1 "        <register address='0xbc000b0' value='0x" DATA.LONG(A:0xbc000b0) "' name='RPMH_DDRAUX_RSI_TCS3_CMD0'/>"
WRITE #1 "        <register address='0xbc000b4' value='0x" DATA.LONG(A:0xbc000b4) "' name='RPMH_DDRAUX_RSI_TCS3_CMD1'/>"
WRITE #1 "        <register address='0xbc000b8' value='0x" DATA.LONG(A:0xbc000b8) "' name='RPMH_DDRAUX_RSI_TCS3_CMD2'/>"
WRITE #1 "        <register address='0xbc000bc' value='0x" DATA.LONG(A:0xbc000bc) "' name='RPMH_DDRAUX_RSI_TCS3_CMD3'/>"
WRITE #1 "        <register address='0xbc000c0' value='0x" DATA.LONG(A:0xbc000c0) "' name='RPMH_DDRAUX_RSI_TCS4_CMD0'/>"
WRITE #1 "        <register address='0xbc000c4' value='0x" DATA.LONG(A:0xbc000c4) "' name='RPMH_DDRAUX_RSI_TCS4_CMD1'/>"
WRITE #1 "        <register address='0xbc000c8' value='0x" DATA.LONG(A:0xbc000c8) "' name='RPMH_DDRAUX_RSI_TCS4_CMD2'/>"
WRITE #1 "        <register address='0xbc000cc' value='0x" DATA.LONG(A:0xbc000cc) "' name='RPMH_DDRAUX_RSI_TCS4_CMD3'/>"
WRITE #1 "        <register address='0xbc000d0' value='0x" DATA.LONG(A:0xbc000d0) "' name='RPMH_DDRAUX_RSI_TCS5_CMD0'/>"
WRITE #1 "        <register address='0xbc000d4' value='0x" DATA.LONG(A:0xbc000d4) "' name='RPMH_DDRAUX_RSI_TCS5_CMD1'/>"
WRITE #1 "        <register address='0xbc000d8' value='0x" DATA.LONG(A:0xbc000d8) "' name='RPMH_DDRAUX_RSI_TCS5_CMD2'/>"
WRITE #1 "        <register address='0xbc000dc' value='0x" DATA.LONG(A:0xbc000dc) "' name='RPMH_DDRAUX_RSI_TCS5_CMD3'/>"
WRITE #1 "        <register address='0xbc000e0' value='0x" DATA.LONG(A:0xbc000e0) "' name='RPMH_DDRAUX_RSI_TCS6_CMD0'/>"
WRITE #1 "        <register address='0xbc000e4' value='0x" DATA.LONG(A:0xbc000e4) "' name='RPMH_DDRAUX_RSI_TCS6_CMD1'/>"
WRITE #1 "        <register address='0xbc000e8' value='0x" DATA.LONG(A:0xbc000e8) "' name='RPMH_DDRAUX_RSI_TCS6_CMD2'/>"
WRITE #1 "        <register address='0xbc000ec' value='0x" DATA.LONG(A:0xbc000ec) "' name='RPMH_DDRAUX_RSI_TCS6_CMD3'/>"
WRITE #1 "        <register address='0xbc000f0' value='0x" DATA.LONG(A:0xbc000f0) "' name='RPMH_DDRAUX_RSI_TCS7_CMD0'/>"
WRITE #1 "        <register address='0xbc000f4' value='0x" DATA.LONG(A:0xbc000f4) "' name='RPMH_DDRAUX_RSI_TCS7_CMD1'/>"
WRITE #1 "        <register address='0xbc000f8' value='0x" DATA.LONG(A:0xbc000f8) "' name='RPMH_DDRAUX_RSI_TCS7_CMD2'/>"
WRITE #1 "        <register address='0xbc000fc' value='0x" DATA.LONG(A:0xbc000fc) "' name='RPMH_DDRAUX_RSI_TCS7_CMD3'/>"
WRITE #1 "        <register address='0xbc00100' value='0x" DATA.LONG(A:0xbc00100) "' name='RPMH_DDRAUX_RSI_TCS8_CMD0'/>"
WRITE #1 "        <register address='0xbc00104' value='0x" DATA.LONG(A:0xbc00104) "' name='RPMH_DDRAUX_RSI_TCS8_CMD1'/>"
WRITE #1 "        <register address='0xbc00108' value='0x" DATA.LONG(A:0xbc00108) "' name='RPMH_DDRAUX_RSI_TCS8_CMD2'/>"
WRITE #1 "        <register address='0xbc0010c' value='0x" DATA.LONG(A:0xbc0010c) "' name='RPMH_DDRAUX_RSI_TCS8_CMD3'/>"
WRITE #1 "        <register address='0xbc00110' value='0x" DATA.LONG(A:0xbc00110) "' name='RPMH_DDRAUX_RSI_TCS9_CMD0'/>"
WRITE #1 "        <register address='0xbc00114' value='0x" DATA.LONG(A:0xbc00114) "' name='RPMH_DDRAUX_RSI_TCS9_CMD1'/>"
WRITE #1 "        <register address='0xbc00118' value='0x" DATA.LONG(A:0xbc00118) "' name='RPMH_DDRAUX_RSI_TCS9_CMD2'/>"
WRITE #1 "        <register address='0xbc0011c' value='0x" DATA.LONG(A:0xbc0011c) "' name='RPMH_DDRAUX_RSI_TCS9_CMD3'/>"
WRITE #1 "        <register address='0xbc00120' value='0x" DATA.LONG(A:0xbc00120) "' name='RPMH_DDRAUX_RSI_TCS10_CMD0'/>"
WRITE #1 "        <register address='0xbc00124' value='0x" DATA.LONG(A:0xbc00124) "' name='RPMH_DDRAUX_RSI_TCS10_CMD1'/>"
WRITE #1 "        <register address='0xbc00128' value='0x" DATA.LONG(A:0xbc00128) "' name='RPMH_DDRAUX_RSI_TCS10_CMD2'/>"
WRITE #1 "        <register address='0xbc0012c' value='0x" DATA.LONG(A:0xbc0012c) "' name='RPMH_DDRAUX_RSI_TCS10_CMD3'/>"
WRITE #1 "        <register address='0xbc00130' value='0x" DATA.LONG(A:0xbc00130) "' name='RPMH_DDRAUX_RSI_TCS11_CMD0'/>"
WRITE #1 "        <register address='0xbc00134' value='0x" DATA.LONG(A:0xbc00134) "' name='RPMH_DDRAUX_RSI_TCS11_CMD1'/>"
WRITE #1 "        <register address='0xbc00138' value='0x" DATA.LONG(A:0xbc00138) "' name='RPMH_DDRAUX_RSI_TCS11_CMD2'/>"
WRITE #1 "        <register address='0xbc0013c' value='0x" DATA.LONG(A:0xbc0013c) "' name='RPMH_DDRAUX_RSI_TCS11_CMD3'/>"
WRITE #1 "        <register address='0xbc00140' value='0x" DATA.LONG(A:0xbc00140) "' name='RPMH_DDRAUX_RSI_TCS12_CMD0'/>"
WRITE #1 "        <register address='0xbc00144' value='0x" DATA.LONG(A:0xbc00144) "' name='RPMH_DDRAUX_RSI_TCS12_CMD1'/>"
WRITE #1 "        <register address='0xbc00148' value='0x" DATA.LONG(A:0xbc00148) "' name='RPMH_DDRAUX_RSI_TCS12_CMD2'/>"
WRITE #1 "        <register address='0xbc0014c' value='0x" DATA.LONG(A:0xbc0014c) "' name='RPMH_DDRAUX_RSI_TCS12_CMD3'/>"
WRITE #1 "        <register address='0xbc00150' value='0x" DATA.LONG(A:0xbc00150) "' name='RPMH_DDRAUX_RSI_TCS13_CMD0'/>"
WRITE #1 "        <register address='0xbc00154' value='0x" DATA.LONG(A:0xbc00154) "' name='RPMH_DDRAUX_RSI_TCS13_CMD1'/>"
WRITE #1 "        <register address='0xbc00158' value='0x" DATA.LONG(A:0xbc00158) "' name='RPMH_DDRAUX_RSI_TCS13_CMD2'/>"
WRITE #1 "        <register address='0xbc0015c' value='0x" DATA.LONG(A:0xbc0015c) "' name='RPMH_DDRAUX_RSI_TCS13_CMD3'/>"
WRITE #1 "        <register address='0xbc00180' value='0x" DATA.LONG(A:0xbc00180) "' name='RPMH_DDRAUX_RSI_TCS0_AMC_MODE'/>"
WRITE #1 "        <register address='0xbc00184' value='0x" DATA.LONG(A:0xbc00184) "' name='RPMH_DDRAUX_RSI_TCS1_AMC_MODE'/>"
WRITE #1 "        <register address='0xbc00188' value='0x" DATA.LONG(A:0xbc00188) "' name='RPMH_DDRAUX_RSI_TCS2_AMC_MODE'/>"
WRITE #1 "        <register address='0xbc0018c' value='0x" DATA.LONG(A:0xbc0018c) "' name='RPMH_DDRAUX_RSI_TCS3_AMC_MODE'/>"
WRITE #1 "        <register address='0xbc00190' value='0x" DATA.LONG(A:0xbc00190) "' name='RPMH_DDRAUX_RSI_TCS4_AMC_MODE'/>"
WRITE #1 "        <register address='0xbc00194' value='0x" DATA.LONG(A:0xbc00194) "' name='RPMH_DDRAUX_RSI_TCS5_AMC_MODE'/>"
WRITE #1 "        <register address='0xbc00198' value='0x" DATA.LONG(A:0xbc00198) "' name='RPMH_DDRAUX_RSI_TCS6_AMC_MODE'/>"
WRITE #1 "        <register address='0xbc0019c' value='0x" DATA.LONG(A:0xbc0019c) "' name='RPMH_DDRAUX_RSI_TCS7_AMC_MODE'/>"
WRITE #1 "        <register address='0xbc001a0' value='0x" DATA.LONG(A:0xbc001a0) "' name='RPMH_DDRAUX_RSI_TCS8_AMC_MODE'/>"
WRITE #1 "        <register address='0xbc001a4' value='0x" DATA.LONG(A:0xbc001a4) "' name='RPMH_DDRAUX_RSI_TCS9_AMC_MODE'/>"
WRITE #1 "        <register address='0xbc001a8' value='0x" DATA.LONG(A:0xbc001a8) "' name='RPMH_DDRAUX_RSI_TCS10_AMC_MODE'/>"
WRITE #1 "        <register address='0xbc001ac' value='0x" DATA.LONG(A:0xbc001ac) "' name='RPMH_DDRAUX_RSI_TCS11_AMC_MODE'/>"
WRITE #1 "        <register address='0xbc001b0' value='0x" DATA.LONG(A:0xbc001b0) "' name='RPMH_DDRAUX_RSI_TCS12_AMC_MODE'/>"
WRITE #1 "        <register address='0xbc001b4' value='0x" DATA.LONG(A:0xbc001b4) "' name='RPMH_DDRAUX_RSI_TCS13_AMC_MODE'/>"
WRITE #1 "        <register address='0xbc001c0' value='0x" DATA.LONG(A:0xbc001c0) "' name='RPMH_DDRAUX_RSI_TCS0_RESP_DATA0'/>"
WRITE #1 "        <register address='0xbc001c4' value='0x" DATA.LONG(A:0xbc001c4) "' name='RPMH_DDRAUX_RSI_TCS0_RESP_DATA1'/>"
WRITE #1 "        <register address='0xbc001c8' value='0x" DATA.LONG(A:0xbc001c8) "' name='RPMH_DDRAUX_RSI_TCS0_RESP_DATA2'/>"
WRITE #1 "        <register address='0xbc001cc' value='0x" DATA.LONG(A:0xbc001cc) "' name='RPMH_DDRAUX_RSI_TCS0_RESP_DATA3'/>"
WRITE #1 "        <register address='0xbc001d0' value='0x" DATA.LONG(A:0xbc001d0) "' name='RPMH_DDRAUX_RSI_TCS_BUSY_SUMMARY'/>"
WRITE #1 "        <register address='0xbc00200' value='0x" DATA.LONG(A:0xbc00200) "' name='RPMH_DDRAUX_SEQ_BRANCH_EVENT'/>"
WRITE #1 "        <register address='0xbc00208' value='0x" DATA.LONG(A:0xbc00208) "' name='RPMH_DDRAUX_SEQ_GCC_CLKPLAN'/>"
WRITE #1 "        <register address='0xbc0022c' value='0x" DATA.LONG(A:0xbc0022c) "' name='RPMH_DDRAUX_SEQ0_CFG'/>"
WRITE #1 "        <register address='0xbc00230' value='0x" DATA.LONG(A:0xbc00230) "' name='RPMH_DDRAUX_SEQ1_CFG'/>"
WRITE #1 "        <register address='0xbc00234' value='0x" DATA.LONG(A:0xbc00234) "' name='RPMH_DDRAUX_SEQ0_STAT'/>"
WRITE #1 "        <register address='0xbc00238' value='0x" DATA.LONG(A:0xbc00238) "' name='RPMH_DDRAUX_SEQ1_STAT'/>"
WRITE #1 "        <register address='0xbc0023c' value='0x" DATA.LONG(A:0xbc0023c) "' name='RPMH_DDRAUX_SEQ_VCD_SEL'/>"
WRITE #1 "        <register address='0xbc00244' value='0x" DATA.LONG(A:0xbc00244) "' name='RPMH_DDRAUX_SEQ0_PWR_CTRL_OVRD_BIT_31_TO_0_MASK'/>"
WRITE #1 "        <register address='0xbc00248' value='0x" DATA.LONG(A:0xbc00248) "' name='RPMH_DDRAUX_SEQ1_PWR_CTRL_OVRD_BIT_31_TO_0_MASK'/>"
WRITE #1 "        <register address='0xbc0024c' value='0x" DATA.LONG(A:0xbc0024c) "' name='RPMH_DDRAUX_SEQ0_PWR_CTRL_OVRD_BIT_63_TO_32_MASK'/>"
WRITE #1 "        <register address='0xbc00250' value='0x" DATA.LONG(A:0xbc00250) "' name='RPMH_DDRAUX_SEQ1_PWR_CTRL_OVRD_BIT_63_TO_32_MASK'/>"
WRITE #1 "        <register address='0xbc00254' value='0x" DATA.LONG(A:0xbc00254) "' name='RPMH_DDRAUX_SEQ0_PWR_CTRL_OVRD_BIT_31_TO_0_VAL'/>"
WRITE #1 "        <register address='0xbc00258' value='0x" DATA.LONG(A:0xbc00258) "' name='RPMH_DDRAUX_SEQ1_PWR_CTRL_OVRD_BIT_31_TO_0_VAL'/>"
WRITE #1 "        <register address='0xbc0025c' value='0x" DATA.LONG(A:0xbc0025c) "' name='RPMH_DDRAUX_SEQ0_PWR_CTRL_OVRD_BIT_63_TO_32_VAL'/>"
WRITE #1 "        <register address='0xbc00260' value='0x" DATA.LONG(A:0xbc00260) "' name='RPMH_DDRAUX_SEQ1_PWR_CTRL_OVRD_BIT_63_TO_32_VAL'/>"
WRITE #1 "        <register address='0xbc00264' value='0x" DATA.LONG(A:0xbc00264) "' name='RPMH_DDRAUX_SEQ0_WAIT_EVENT_BIT_31_TO_0_OVRD_MASK'/>"
WRITE #1 "        <register address='0xbc00268' value='0x" DATA.LONG(A:0xbc00268) "' name='RPMH_DDRAUX_SEQ1_WAIT_EVENT_BIT_31_TO_0_OVRD_MASK'/>"
WRITE #1 "        <register address='0xbc0026c' value='0x" DATA.LONG(A:0xbc0026c) "' name='RPMH_DDRAUX_SEQ0_WAIT_EVENT_BIT_63_TO_32_OVRD_MASK'/>"
WRITE #1 "        <register address='0xbc00270' value='0x" DATA.LONG(A:0xbc00270) "' name='RPMH_DDRAUX_SEQ1_WAIT_EVENT_BIT_63_TO_32_OVRD_MASK'/>"
WRITE #1 "        <register address='0xbc00274' value='0x" DATA.LONG(A:0xbc00274) "' name='RPMH_DDRAUX_SEQ0_WAIT_EVENT_BIT_31_TO_0_OVRD_VAL'/>"
WRITE #1 "        <register address='0xbc00278' value='0x" DATA.LONG(A:0xbc00278) "' name='RPMH_DDRAUX_SEQ1_WAIT_EVENT_BIT_31_TO_0_OVRD_VAL'/>"
WRITE #1 "        <register address='0xbc0027c' value='0x" DATA.LONG(A:0xbc0027c) "' name='RPMH_DDRAUX_SEQ0_WAIT_EVENT_BIT_63_TO_32_OVRD_VAL'/>"
WRITE #1 "        <register address='0xbc00280' value='0x" DATA.LONG(A:0xbc00280) "' name='RPMH_DDRAUX_SEQ1_WAIT_EVENT_BIT_63_TO_32_OVRD_VAL'/>"
WRITE #1 "        <register address='0xbc00284' value='0x" DATA.LONG(A:0xbc00284) "' name='RPMH_DDRAUX_SEQ0_BRANCH_EVENT_OVRD_MASK'/>"
WRITE #1 "        <register address='0xbc00288' value='0x" DATA.LONG(A:0xbc00288) "' name='RPMH_DDRAUX_SEQ1_BRANCH_EVENT_OVRD_MASK'/>"
WRITE #1 "        <register address='0xbc0028c' value='0x" DATA.LONG(A:0xbc0028c) "' name='RPMH_DDRAUX_SEQ0_BRANCH_EVENT_OVRD_VAL'/>"
WRITE #1 "        <register address='0xbc00290' value='0x" DATA.LONG(A:0xbc00290) "' name='RPMH_DDRAUX_SEQ1_BRANCH_EVENT_OVRD_VAL'/>"
WRITE #1 "        <register address='0xbc00298' value='0x" DATA.LONG(A:0xbc00298) "' name='RPMH_DDRAUX_SEQ_CFG_DELAY_VAL_0'/>"
WRITE #1 "        <register address='0xbc0029c' value='0x" DATA.LONG(A:0xbc0029c) "' name='RPMH_DDRAUX_SEQ_CFG_DELAY_VAL_1'/>"
WRITE #1 "        <register address='0xbc002a0' value='0x" DATA.LONG(A:0xbc002a0) "' name='RPMH_DDRAUX_SEQ_CFG_DELAY_VAL_2'/>"
WRITE #1 "        <register address='0xbc002a4' value='0x" DATA.LONG(A:0xbc002a4) "' name='RPMH_DDRAUX_SEQ_CFG_DELAY_VAL_3'/>"
WRITE #1 "        <register address='0xbc00308' value='0x" DATA.LONG(A:0xbc00308) "' name='RPMH_DDRAUX_BRANCH_ADDR0'/>"
WRITE #1 "        <register address='0xbc0030c' value='0x" DATA.LONG(A:0xbc0030c) "' name='RPMH_DDRAUX_BRANCH_ADDR1'/>"
WRITE #1 "        <register address='0xbc00310' value='0x" DATA.LONG(A:0xbc00310) "' name='RPMH_DDRAUX_BRANCH_ADDR2'/>"
WRITE #1 "        <register address='0xbc00314' value='0x" DATA.LONG(A:0xbc00314) "' name='RPMH_DDRAUX_BRANCH_ADDR3'/>"
WRITE #1 "        <register address='0xbc00318' value='0x" DATA.LONG(A:0xbc00318) "' name='RPMH_DDRAUX_BRANCH_ADDR4'/>"
WRITE #1 "        <register address='0xbc0031c' value='0x" DATA.LONG(A:0xbc0031c) "' name='RPMH_DDRAUX_BRANCH_ADDR5'/>"
WRITE #1 "        <register address='0xbc00320' value='0x" DATA.LONG(A:0xbc00320) "' name='RPMH_DDRAUX_BRANCH_ADDR6'/>"
WRITE #1 "        <register address='0xbc00324' value='0x" DATA.LONG(A:0xbc00324) "' name='RPMH_DDRAUX_BRANCH_ADDR7'/>"
WRITE #1 "        <register address='0xbc00328' value='0x" DATA.LONG(A:0xbc00328) "' name='RPMH_DDRAUX_BRANCH_ADDR8'/>"
WRITE #1 "        <register address='0xbc0032c' value='0x" DATA.LONG(A:0xbc0032c) "' name='RPMH_DDRAUX_BRANCH_ADDR9'/>"
WRITE #1 "        <register address='0xbc00330' value='0x" DATA.LONG(A:0xbc00330) "' name='RPMH_DDRAUX_BRANCH_ADDR10'/>"
WRITE #1 "        <register address='0xbc00334' value='0x" DATA.LONG(A:0xbc00334) "' name='RPMH_DDRAUX_BRANCH_ADDR11'/>"
WRITE #1 "        <register address='0xbc00338' value='0x" DATA.LONG(A:0xbc00338) "' name='RPMH_DDRAUX_BRANCH_ADDR12'/>"
WRITE #1 "        <register address='0xbc0033c' value='0x" DATA.LONG(A:0xbc0033c) "' name='RPMH_DDRAUX_BRANCH_ADDR13'/>"
WRITE #1 "        <register address='0xbc00340' value='0x" DATA.LONG(A:0xbc00340) "' name='RPMH_DDRAUX_BRANCH_ADDR14'/>"
WRITE #1 "        <register address='0xbc00344' value='0x" DATA.LONG(A:0xbc00344) "' name='RPMH_DDRAUX_BRANCH_ADDR15'/>"
WRITE #1 "        <register address='0xbc00348' value='0x" DATA.LONG(A:0xbc00348) "' name='RPMH_DDRAUX_BRANCH_ADDR16'/>"
WRITE #1 "        <register address='0xbc0034c' value='0x" DATA.LONG(A:0xbc0034c) "' name='RPMH_DDRAUX_BRANCH_ADDR17'/>"
WRITE #1 "        <register address='0xbc00350' value='0x" DATA.LONG(A:0xbc00350) "' name='RPMH_DDRAUX_BRANCH_ADDR18'/>"
WRITE #1 "        <register address='0xbc00354' value='0x" DATA.LONG(A:0xbc00354) "' name='RPMH_DDRAUX_BRANCH_ADDR19'/>"
WRITE #1 "        <register address='0xbc00358' value='0x" DATA.LONG(A:0xbc00358) "' name='RPMH_DDRAUX_BRANCH_ADDR20'/>"
WRITE #1 "        <register address='0xbc0035c' value='0x" DATA.LONG(A:0xbc0035c) "' name='RPMH_DDRAUX_BRANCH_ADDR21'/>"
WRITE #1 "        <register address='0xbc00360' value='0x" DATA.LONG(A:0xbc00360) "' name='RPMH_DDRAUX_BRANCH_ADDR22'/>"
WRITE #1 "        <register address='0xbc00364' value='0x" DATA.LONG(A:0xbc00364) "' name='RPMH_DDRAUX_BRANCH_ADDR23'/>"
WRITE #1 "        <register address='0xbc00368' value='0x" DATA.LONG(A:0xbc00368) "' name='RPMH_DDRAUX_BRANCH_ADDR24'/>"
WRITE #1 "        <register address='0xbc0036c' value='0x" DATA.LONG(A:0xbc0036c) "' name='RPMH_DDRAUX_BRANCH_ADDR25'/>"
WRITE #1 "        <register address='0xbc00370' value='0x" DATA.LONG(A:0xbc00370) "' name='RPMH_DDRAUX_BRANCH_ADDR26'/>"
WRITE #1 "        <register address='0xbc00374' value='0x" DATA.LONG(A:0xbc00374) "' name='RPMH_DDRAUX_BRANCH_ADDR27'/>"
WRITE #1 "        <register address='0xbc00378' value='0x" DATA.LONG(A:0xbc00378) "' name='RPMH_DDRAUX_BRANCH_ADDR28'/>"
WRITE #1 "        <register address='0xbc0037c' value='0x" DATA.LONG(A:0xbc0037c) "' name='RPMH_DDRAUX_BRANCH_ADDR29'/>"
WRITE #1 "        <register address='0xbc00380' value='0x" DATA.LONG(A:0xbc00380) "' name='RPMH_DDRAUX_BRANCH_ADDR30'/>"
WRITE #1 "        <register address='0xbc00384' value='0x" DATA.LONG(A:0xbc00384) "' name='RPMH_DDRAUX_BRANCH_ADDR31'/>"
WRITE #1 "        <register address='0xbc00388' value='0x" DATA.LONG(A:0xbc00388) "' name='RPMH_DDRAUX_BRANCH_ADDR32'/>"
WRITE #1 "        <register address='0xbc0038c' value='0x" DATA.LONG(A:0xbc0038c) "' name='RPMH_DDRAUX_BRANCH_ADDR33'/>"
WRITE #1 "        <register address='0xbc00390' value='0x" DATA.LONG(A:0xbc00390) "' name='RPMH_DDRAUX_BRANCH_ADDR34'/>"
WRITE #1 "        <register address='0xbc00394' value='0x" DATA.LONG(A:0xbc00394) "' name='RPMH_DDRAUX_BRANCH_ADDR35'/>"
WRITE #1 "        <register address='0xbc00398' value='0x" DATA.LONG(A:0xbc00398) "' name='RPMH_DDRAUX_BRANCH_ADDR36'/>"
WRITE #1 "        <register address='0xbc0039c' value='0x" DATA.LONG(A:0xbc0039c) "' name='RPMH_DDRAUX_BRANCH_ADDR37'/>"
WRITE #1 "        <register address='0xbc003a0' value='0x" DATA.LONG(A:0xbc003a0) "' name='RPMH_DDRAUX_BRANCH_ADDR38'/>"
WRITE #1 "        <register address='0xbc003a4' value='0x" DATA.LONG(A:0xbc003a4) "' name='RPMH_DDRAUX_BRANCH_ADDR39'/>"
WRITE #1 "        <register address='0xbc003a8' value='0x" DATA.LONG(A:0xbc003a8) "' name='RPMH_DDRAUX_BRANCH_ADDR40'/>"
WRITE #1 "        <register address='0xbc003ac' value='0x" DATA.LONG(A:0xbc003ac) "' name='RPMH_DDRAUX_BRANCH_ADDR41'/>"
WRITE #1 "        <register address='0xbc003b0' value='0x" DATA.LONG(A:0xbc003b0) "' name='RPMH_DDRAUX_BRANCH_ADDR42'/>"
WRITE #1 "        <register address='0xbc003b4' value='0x" DATA.LONG(A:0xbc003b4) "' name='RPMH_DDRAUX_BRANCH_ADDR43'/>"
WRITE #1 "        <register address='0xbc003b8' value='0x" DATA.LONG(A:0xbc003b8) "' name='RPMH_DDRAUX_BRANCH_ADDR44'/>"
WRITE #1 "        <register address='0xbc003bc' value='0x" DATA.LONG(A:0xbc003bc) "' name='RPMH_DDRAUX_BRANCH_ADDR45'/>"
WRITE #1 "        <register address='0xbc003c0' value='0x" DATA.LONG(A:0xbc003c0) "' name='RPMH_DDRAUX_BRANCH_ADDR46'/>"
WRITE #1 "        <register address='0xbc003c4' value='0x" DATA.LONG(A:0xbc003c4) "' name='RPMH_DDRAUX_BRANCH_ADDR47'/>"
WRITE #1 "        <register address='0xbc003c8' value='0x" DATA.LONG(A:0xbc003c8) "' name='RPMH_DDRAUX_BRANCH_ADDR48'/>"
WRITE #1 "        <register address='0xbc003cc' value='0x" DATA.LONG(A:0xbc003cc) "' name='RPMH_DDRAUX_BRANCH_ADDR49'/>"
WRITE #1 "        <register address='0xbc003d0' value='0x" DATA.LONG(A:0xbc003d0) "' name='RPMH_DDRAUX_BRANCH_ADDR50'/>"
WRITE #1 "        <register address='0xbc003d4' value='0x" DATA.LONG(A:0xbc003d4) "' name='RPMH_DDRAUX_BRANCH_ADDR51'/>"
WRITE #1 "        <register address='0xbc003d8' value='0x" DATA.LONG(A:0xbc003d8) "' name='RPMH_DDRAUX_BRANCH_ADDR52'/>"
WRITE #1 "        <register address='0xbc003dc' value='0x" DATA.LONG(A:0xbc003dc) "' name='RPMH_DDRAUX_BRANCH_ADDR53'/>"
WRITE #1 "        <register address='0xbc003e0' value='0x" DATA.LONG(A:0xbc003e0) "' name='RPMH_DDRAUX_BRANCH_ADDR54'/>"
WRITE #1 "        <register address='0xbc003e4' value='0x" DATA.LONG(A:0xbc003e4) "' name='RPMH_DDRAUX_BRANCH_ADDR55'/>"
WRITE #1 "        <register address='0xbc003e8' value='0x" DATA.LONG(A:0xbc003e8) "' name='RPMH_DDRAUX_BRANCH_ADDR56'/>"
WRITE #1 "        <register address='0xbc003ec' value='0x" DATA.LONG(A:0xbc003ec) "' name='RPMH_DDRAUX_BRANCH_ADDR57'/>"
WRITE #1 "        <register address='0xbc003f0' value='0x" DATA.LONG(A:0xbc003f0) "' name='RPMH_DDRAUX_BRANCH_ADDR58'/>"
WRITE #1 "        <register address='0xbc003f4' value='0x" DATA.LONG(A:0xbc003f4) "' name='RPMH_DDRAUX_BRANCH_ADDR59'/>"
WRITE #1 "        <register address='0xbc003f8' value='0x" DATA.LONG(A:0xbc003f8) "' name='RPMH_DDRAUX_BRANCH_ADDR60'/>"
WRITE #1 "        <register address='0xbc003fc' value='0x" DATA.LONG(A:0xbc003fc) "' name='RPMH_DDRAUX_BRANCH_ADDR61'/>"
WRITE #1 "        <register address='0xbc00400' value='0x" DATA.LONG(A:0xbc00400) "' name='RPMH_DDRAUX_BRANCH_ADDR62'/>"
WRITE #1 "        <register address='0xbc00404' value='0x" DATA.LONG(A:0xbc00404) "' name='RPMH_DDRAUX_BRANCH_ADDR63'/>"
WRITE #1 "        <register address='0xbc00408' value='0x" DATA.LONG(A:0xbc00408) "' name='RPMH_DDRAUX_SEQ0_PWR_CTRL_STAT_BIT_31_TO_0'/>"
WRITE #1 "        <register address='0xbc0040c' value='0x" DATA.LONG(A:0xbc0040c) "' name='RPMH_DDRAUX_SEQ1_PWR_CTRL_STAT_BIT_31_TO_0'/>"
WRITE #1 "        <register address='0xbc00410' value='0x" DATA.LONG(A:0xbc00410) "' name='RPMH_DDRAUX_SEQ0_PWR_CTRL_STAT_BIT_63_TO_32'/>"
WRITE #1 "        <register address='0xbc00414' value='0x" DATA.LONG(A:0xbc00414) "' name='RPMH_DDRAUX_SEQ1_PWR_CTRL_STAT_BIT_63_TO_32'/>"
WRITE #1 "        <register address='0xbc00418' value='0x" DATA.LONG(A:0xbc00418) "' name='RPMH_DDRAUX_SEQ_MEM0'/>"
WRITE #1 "        <register address='0xbc0041c' value='0x" DATA.LONG(A:0xbc0041c) "' name='RPMH_DDRAUX_SEQ_MEM1'/>"
WRITE #1 "        <register address='0xbc00420' value='0x" DATA.LONG(A:0xbc00420) "' name='RPMH_DDRAUX_SEQ_MEM2'/>"
WRITE #1 "        <register address='0xbc00424' value='0x" DATA.LONG(A:0xbc00424) "' name='RPMH_DDRAUX_SEQ_MEM3'/>"
WRITE #1 "        <register address='0xbc00428' value='0x" DATA.LONG(A:0xbc00428) "' name='RPMH_DDRAUX_SEQ_MEM4'/>"
WRITE #1 "        <register address='0xbc0042c' value='0x" DATA.LONG(A:0xbc0042c) "' name='RPMH_DDRAUX_SEQ_MEM5'/>"
WRITE #1 "        <register address='0xbc00430' value='0x" DATA.LONG(A:0xbc00430) "' name='RPMH_DDRAUX_SEQ_MEM6'/>"
WRITE #1 "        <register address='0xbc00434' value='0x" DATA.LONG(A:0xbc00434) "' name='RPMH_DDRAUX_SEQ_MEM7'/>"
WRITE #1 "        <register address='0xbc00438' value='0x" DATA.LONG(A:0xbc00438) "' name='RPMH_DDRAUX_SEQ_MEM8'/>"
WRITE #1 "        <register address='0xbc0043c' value='0x" DATA.LONG(A:0xbc0043c) "' name='RPMH_DDRAUX_SEQ_MEM9'/>"
WRITE #1 "        <register address='0xbc00440' value='0x" DATA.LONG(A:0xbc00440) "' name='RPMH_DDRAUX_SEQ_MEM10'/>"
WRITE #1 "        <register address='0xbc00444' value='0x" DATA.LONG(A:0xbc00444) "' name='RPMH_DDRAUX_SEQ_MEM11'/>"
WRITE #1 "        <register address='0xbc00448' value='0x" DATA.LONG(A:0xbc00448) "' name='RPMH_DDRAUX_SEQ_MEM12'/>"
WRITE #1 "        <register address='0xbc0044c' value='0x" DATA.LONG(A:0xbc0044c) "' name='RPMH_DDRAUX_SEQ_MEM13'/>"
WRITE #1 "        <register address='0xbc00450' value='0x" DATA.LONG(A:0xbc00450) "' name='RPMH_DDRAUX_SEQ_MEM14'/>"
WRITE #1 "        <register address='0xbc00454' value='0x" DATA.LONG(A:0xbc00454) "' name='RPMH_DDRAUX_SEQ_MEM15'/>"
WRITE #1 "        <register address='0xbc00458' value='0x" DATA.LONG(A:0xbc00458) "' name='RPMH_DDRAUX_SEQ_MEM16'/>"
WRITE #1 "        <register address='0xbc0045c' value='0x" DATA.LONG(A:0xbc0045c) "' name='RPMH_DDRAUX_SEQ_MEM17'/>"
WRITE #1 "        <register address='0xbc00460' value='0x" DATA.LONG(A:0xbc00460) "' name='RPMH_DDRAUX_SEQ_MEM18'/>"
WRITE #1 "        <register address='0xbc00464' value='0x" DATA.LONG(A:0xbc00464) "' name='RPMH_DDRAUX_SEQ_MEM19'/>"
WRITE #1 "        <register address='0xbc00468' value='0x" DATA.LONG(A:0xbc00468) "' name='RPMH_DDRAUX_SEQ_MEM20'/>"
WRITE #1 "        <register address='0xbc0046c' value='0x" DATA.LONG(A:0xbc0046c) "' name='RPMH_DDRAUX_SEQ_MEM21'/>"
WRITE #1 "        <register address='0xbc00470' value='0x" DATA.LONG(A:0xbc00470) "' name='RPMH_DDRAUX_SEQ_MEM22'/>"
WRITE #1 "        <register address='0xbc00474' value='0x" DATA.LONG(A:0xbc00474) "' name='RPMH_DDRAUX_SEQ_MEM23'/>"
WRITE #1 "        <register address='0xbc00478' value='0x" DATA.LONG(A:0xbc00478) "' name='RPMH_DDRAUX_SEQ_MEM24'/>"
WRITE #1 "        <register address='0xbc0047c' value='0x" DATA.LONG(A:0xbc0047c) "' name='RPMH_DDRAUX_SEQ_MEM25'/>"
WRITE #1 "        <register address='0xbc00480' value='0x" DATA.LONG(A:0xbc00480) "' name='RPMH_DDRAUX_SEQ_MEM26'/>"
WRITE #1 "        <register address='0xbc00484' value='0x" DATA.LONG(A:0xbc00484) "' name='RPMH_DDRAUX_SEQ_MEM27'/>"
WRITE #1 "        <register address='0xbc00488' value='0x" DATA.LONG(A:0xbc00488) "' name='RPMH_DDRAUX_SEQ_MEM28'/>"
WRITE #1 "        <register address='0xbc0048c' value='0x" DATA.LONG(A:0xbc0048c) "' name='RPMH_DDRAUX_SEQ_MEM29'/>"
WRITE #1 "        <register address='0xbc00490' value='0x" DATA.LONG(A:0xbc00490) "' name='RPMH_DDRAUX_SEQ_MEM30'/>"
WRITE #1 "        <register address='0xbc00494' value='0x" DATA.LONG(A:0xbc00494) "' name='RPMH_DDRAUX_SEQ_MEM31'/>"
WRITE #1 "        <register address='0xbc00498' value='0x" DATA.LONG(A:0xbc00498) "' name='RPMH_DDRAUX_SEQ_MEM32'/>"
WRITE #1 "        <register address='0xbc0049c' value='0x" DATA.LONG(A:0xbc0049c) "' name='RPMH_DDRAUX_SEQ_MEM33'/>"
WRITE #1 "        <register address='0xbc004a0' value='0x" DATA.LONG(A:0xbc004a0) "' name='RPMH_DDRAUX_SEQ_MEM34'/>"
WRITE #1 "        <register address='0xbc004a4' value='0x" DATA.LONG(A:0xbc004a4) "' name='RPMH_DDRAUX_SEQ_MEM35'/>"
WRITE #1 "        <register address='0xbc004a8' value='0x" DATA.LONG(A:0xbc004a8) "' name='RPMH_DDRAUX_SEQ_MEM36'/>"
WRITE #1 "        <register address='0xbc004ac' value='0x" DATA.LONG(A:0xbc004ac) "' name='RPMH_DDRAUX_SEQ_MEM37'/>"
WRITE #1 "        <register address='0xbc004b0' value='0x" DATA.LONG(A:0xbc004b0) "' name='RPMH_DDRAUX_SEQ_MEM38'/>"
WRITE #1 "        <register address='0xbc004b4' value='0x" DATA.LONG(A:0xbc004b4) "' name='RPMH_DDRAUX_SEQ_MEM39'/>"
WRITE #1 "        <register address='0xbc004b8' value='0x" DATA.LONG(A:0xbc004b8) "' name='RPMH_DDRAUX_SEQ_MEM40'/>"
WRITE #1 "        <register address='0xbc004bc' value='0x" DATA.LONG(A:0xbc004bc) "' name='RPMH_DDRAUX_SEQ_MEM41'/>"
WRITE #1 "        <register address='0xbc004c0' value='0x" DATA.LONG(A:0xbc004c0) "' name='RPMH_DDRAUX_SEQ_MEM42'/>"
WRITE #1 "        <register address='0xbc004c4' value='0x" DATA.LONG(A:0xbc004c4) "' name='RPMH_DDRAUX_SEQ_MEM43'/>"
WRITE #1 "        <register address='0xbc004c8' value='0x" DATA.LONG(A:0xbc004c8) "' name='RPMH_DDRAUX_SEQ_MEM44'/>"
WRITE #1 "        <register address='0xbc004cc' value='0x" DATA.LONG(A:0xbc004cc) "' name='RPMH_DDRAUX_SEQ_MEM45'/>"
WRITE #1 "        <register address='0xbc004d0' value='0x" DATA.LONG(A:0xbc004d0) "' name='RPMH_DDRAUX_SEQ_MEM46'/>"
WRITE #1 "        <register address='0xbc004d4' value='0x" DATA.LONG(A:0xbc004d4) "' name='RPMH_DDRAUX_SEQ_MEM47'/>"
WRITE #1 "        <register address='0xbc004d8' value='0x" DATA.LONG(A:0xbc004d8) "' name='RPMH_DDRAUX_SEQ_MEM48'/>"
WRITE #1 "        <register address='0xbc004dc' value='0x" DATA.LONG(A:0xbc004dc) "' name='RPMH_DDRAUX_SEQ_MEM49'/>"
WRITE #1 "        <register address='0xbc004e0' value='0x" DATA.LONG(A:0xbc004e0) "' name='RPMH_DDRAUX_SEQ_MEM50'/>"
WRITE #1 "        <register address='0xbc004e4' value='0x" DATA.LONG(A:0xbc004e4) "' name='RPMH_DDRAUX_SEQ_MEM51'/>"
WRITE #1 "        <register address='0xbc004e8' value='0x" DATA.LONG(A:0xbc004e8) "' name='RPMH_DDRAUX_SEQ_MEM52'/>"
WRITE #1 "        <register address='0xbc004ec' value='0x" DATA.LONG(A:0xbc004ec) "' name='RPMH_DDRAUX_SEQ_MEM53'/>"
WRITE #1 "        <register address='0xbc004f0' value='0x" DATA.LONG(A:0xbc004f0) "' name='RPMH_DDRAUX_SEQ_MEM54'/>"
WRITE #1 "        <register address='0xbc004f4' value='0x" DATA.LONG(A:0xbc004f4) "' name='RPMH_DDRAUX_SEQ_MEM55'/>"
WRITE #1 "        <register address='0xbc004f8' value='0x" DATA.LONG(A:0xbc004f8) "' name='RPMH_DDRAUX_SEQ_MEM56'/>"
WRITE #1 "        <register address='0xbc004fc' value='0x" DATA.LONG(A:0xbc004fc) "' name='RPMH_DDRAUX_SEQ_MEM57'/>"
WRITE #1 "        <register address='0xbc00500' value='0x" DATA.LONG(A:0xbc00500) "' name='RPMH_DDRAUX_SEQ_MEM58'/>"
WRITE #1 "        <register address='0xbc00504' value='0x" DATA.LONG(A:0xbc00504) "' name='RPMH_DDRAUX_SEQ_MEM59'/>"
WRITE #1 "        <register address='0xbc00508' value='0x" DATA.LONG(A:0xbc00508) "' name='RPMH_DDRAUX_SEQ_MEM60'/>"
WRITE #1 "        <register address='0xbc0050c' value='0x" DATA.LONG(A:0xbc0050c) "' name='RPMH_DDRAUX_SEQ_MEM61'/>"
WRITE #1 "        <register address='0xbc00510' value='0x" DATA.LONG(A:0xbc00510) "' name='RPMH_DDRAUX_SEQ_MEM62'/>"
WRITE #1 "        <register address='0xbc00514' value='0x" DATA.LONG(A:0xbc00514) "' name='RPMH_DDRAUX_SEQ_MEM63'/>"
WRITE #1 "        <register address='0xbc00518' value='0x" DATA.LONG(A:0xbc00518) "' name='RPMH_DDRAUX_SEQ_MEM64'/>"
WRITE #1 "        <register address='0xbc0051c' value='0x" DATA.LONG(A:0xbc0051c) "' name='RPMH_DDRAUX_SEQ_MEM65'/>"
WRITE #1 "        <register address='0xbc00520' value='0x" DATA.LONG(A:0xbc00520) "' name='RPMH_DDRAUX_SEQ_MEM66'/>"
WRITE #1 "        <register address='0xbc00524' value='0x" DATA.LONG(A:0xbc00524) "' name='RPMH_DDRAUX_SEQ_MEM67'/>"
WRITE #1 "        <register address='0xbc00528' value='0x" DATA.LONG(A:0xbc00528) "' name='RPMH_DDRAUX_SEQ_MEM68'/>"
WRITE #1 "        <register address='0xbc0052c' value='0x" DATA.LONG(A:0xbc0052c) "' name='RPMH_DDRAUX_SEQ_MEM69'/>"
WRITE #1 "        <register address='0xbc00530' value='0x" DATA.LONG(A:0xbc00530) "' name='RPMH_DDRAUX_SEQ_MEM70'/>"
WRITE #1 "        <register address='0xbc00534' value='0x" DATA.LONG(A:0xbc00534) "' name='RPMH_DDRAUX_SEQ_MEM71'/>"
WRITE #1 "        <register address='0xbc00538' value='0x" DATA.LONG(A:0xbc00538) "' name='RPMH_DDRAUX_SEQ_MEM72'/>"
WRITE #1 "        <register address='0xbc0053c' value='0x" DATA.LONG(A:0xbc0053c) "' name='RPMH_DDRAUX_SEQ_MEM73'/>"
WRITE #1 "        <register address='0xbc00540' value='0x" DATA.LONG(A:0xbc00540) "' name='RPMH_DDRAUX_SEQ_MEM74'/>"
WRITE #1 "        <register address='0xbc00544' value='0x" DATA.LONG(A:0xbc00544) "' name='RPMH_DDRAUX_SEQ_MEM75'/>"
WRITE #1 "        <register address='0xbc00548' value='0x" DATA.LONG(A:0xbc00548) "' name='RPMH_DDRAUX_SEQ_MEM76'/>"
WRITE #1 "        <register address='0xbc0054c' value='0x" DATA.LONG(A:0xbc0054c) "' name='RPMH_DDRAUX_SEQ_MEM77'/>"
WRITE #1 "        <register address='0xbc00550' value='0x" DATA.LONG(A:0xbc00550) "' name='RPMH_DDRAUX_SEQ_MEM78'/>"
WRITE #1 "        <register address='0xbc00554' value='0x" DATA.LONG(A:0xbc00554) "' name='RPMH_DDRAUX_SEQ_MEM79'/>"
WRITE #1 "        <register address='0xbc00558' value='0x" DATA.LONG(A:0xbc00558) "' name='RPMH_DDRAUX_SEQ_MEM80'/>"
WRITE #1 "        <register address='0xbc0055c' value='0x" DATA.LONG(A:0xbc0055c) "' name='RPMH_DDRAUX_SEQ_MEM81'/>"
WRITE #1 "        <register address='0xbc00560' value='0x" DATA.LONG(A:0xbc00560) "' name='RPMH_DDRAUX_SEQ_MEM82'/>"
WRITE #1 "        <register address='0xbc00564' value='0x" DATA.LONG(A:0xbc00564) "' name='RPMH_DDRAUX_SEQ_MEM83'/>"
WRITE #1 "        <register address='0xbc00568' value='0x" DATA.LONG(A:0xbc00568) "' name='RPMH_DDRAUX_SEQ_MEM84'/>"
WRITE #1 "        <register address='0xbc0056c' value='0x" DATA.LONG(A:0xbc0056c) "' name='RPMH_DDRAUX_SEQ_MEM85'/>"
WRITE #1 "        <register address='0xbc00570' value='0x" DATA.LONG(A:0xbc00570) "' name='RPMH_DDRAUX_SEQ_MEM86'/>"
WRITE #1 "        <register address='0xbc00574' value='0x" DATA.LONG(A:0xbc00574) "' name='RPMH_DDRAUX_SEQ_MEM87'/>"
WRITE #1 "        <register address='0xbc00578' value='0x" DATA.LONG(A:0xbc00578) "' name='RPMH_DDRAUX_SEQ_MEM88'/>"
WRITE #1 "        <register address='0xbc0057c' value='0x" DATA.LONG(A:0xbc0057c) "' name='RPMH_DDRAUX_SEQ_MEM89'/>"
WRITE #1 "        <register address='0xbc00580' value='0x" DATA.LONG(A:0xbc00580) "' name='RPMH_DDRAUX_SEQ_MEM90'/>"
WRITE #1 "        <register address='0xbc00584' value='0x" DATA.LONG(A:0xbc00584) "' name='RPMH_DDRAUX_SEQ_MEM91'/>"
WRITE #1 "        <register address='0xbc00588' value='0x" DATA.LONG(A:0xbc00588) "' name='RPMH_DDRAUX_SEQ_MEM92'/>"
WRITE #1 "        <register address='0xbc0058c' value='0x" DATA.LONG(A:0xbc0058c) "' name='RPMH_DDRAUX_SEQ_MEM93'/>"
WRITE #1 "        <register address='0xbc00590' value='0x" DATA.LONG(A:0xbc00590) "' name='RPMH_DDRAUX_SEQ_MEM94'/>"
WRITE #1 "        <register address='0xbc00594' value='0x" DATA.LONG(A:0xbc00594) "' name='RPMH_DDRAUX_SEQ_MEM95'/>"
WRITE #1 "        <register address='0xbc00598' value='0x" DATA.LONG(A:0xbc00598) "' name='RPMH_DDRAUX_SEQ_MEM96'/>"
WRITE #1 "        <register address='0xbc0059c' value='0x" DATA.LONG(A:0xbc0059c) "' name='RPMH_DDRAUX_SEQ_MEM97'/>"
WRITE #1 "        <register address='0xbc005a0' value='0x" DATA.LONG(A:0xbc005a0) "' name='RPMH_DDRAUX_SEQ_MEM98'/>"
WRITE #1 "        <register address='0xbc005a4' value='0x" DATA.LONG(A:0xbc005a4) "' name='RPMH_DDRAUX_SEQ_MEM99'/>"
WRITE #1 "        <register address='0xbc005a8' value='0x" DATA.LONG(A:0xbc005a8) "' name='RPMH_DDRAUX_SEQ_MEM100'/>"
WRITE #1 "        <register address='0xbc005ac' value='0x" DATA.LONG(A:0xbc005ac) "' name='RPMH_DDRAUX_SEQ_MEM101'/>"
WRITE #1 "        <register address='0xbc005b0' value='0x" DATA.LONG(A:0xbc005b0) "' name='RPMH_DDRAUX_SEQ_MEM102'/>"
WRITE #1 "        <register address='0xbc005b4' value='0x" DATA.LONG(A:0xbc005b4) "' name='RPMH_DDRAUX_SEQ_MEM103'/>"
WRITE #1 "        <register address='0xbc005b8' value='0x" DATA.LONG(A:0xbc005b8) "' name='RPMH_DDRAUX_SEQ_MEM104'/>"
WRITE #1 "        <register address='0xbc005bc' value='0x" DATA.LONG(A:0xbc005bc) "' name='RPMH_DDRAUX_SEQ_MEM105'/>"
WRITE #1 "        <register address='0xbc005c0' value='0x" DATA.LONG(A:0xbc005c0) "' name='RPMH_DDRAUX_SEQ_MEM106'/>"
WRITE #1 "        <register address='0xbc005c4' value='0x" DATA.LONG(A:0xbc005c4) "' name='RPMH_DDRAUX_SEQ_MEM107'/>"
WRITE #1 "        <register address='0xbc005c8' value='0x" DATA.LONG(A:0xbc005c8) "' name='RPMH_DDRAUX_SEQ_MEM108'/>"
WRITE #1 "        <register address='0xbc005cc' value='0x" DATA.LONG(A:0xbc005cc) "' name='RPMH_DDRAUX_SEQ_MEM109'/>"
WRITE #1 "        <register address='0xbc005d0' value='0x" DATA.LONG(A:0xbc005d0) "' name='RPMH_DDRAUX_SEQ_MEM110'/>"
WRITE #1 "        <register address='0xbc005d4' value='0x" DATA.LONG(A:0xbc005d4) "' name='RPMH_DDRAUX_SEQ_MEM111'/>"
WRITE #1 "        <register address='0xbc005d8' value='0x" DATA.LONG(A:0xbc005d8) "' name='RPMH_DDRAUX_SEQ_MEM112'/>"
WRITE #1 "        <register address='0xbc005dc' value='0x" DATA.LONG(A:0xbc005dc) "' name='RPMH_DDRAUX_SEQ_MEM113'/>"
WRITE #1 "        <register address='0xbc005e0' value='0x" DATA.LONG(A:0xbc005e0) "' name='RPMH_DDRAUX_SEQ_MEM114'/>"
WRITE #1 "        <register address='0xbc005e4' value='0x" DATA.LONG(A:0xbc005e4) "' name='RPMH_DDRAUX_SEQ_MEM115'/>"
WRITE #1 "        <register address='0xbc005e8' value='0x" DATA.LONG(A:0xbc005e8) "' name='RPMH_DDRAUX_SEQ_MEM116'/>"
WRITE #1 "        <register address='0xbc005ec' value='0x" DATA.LONG(A:0xbc005ec) "' name='RPMH_DDRAUX_SEQ_MEM117'/>"
WRITE #1 "        <register address='0xbc005f0' value='0x" DATA.LONG(A:0xbc005f0) "' name='RPMH_DDRAUX_SEQ_MEM118'/>"
WRITE #1 "        <register address='0xbc005f4' value='0x" DATA.LONG(A:0xbc005f4) "' name='RPMH_DDRAUX_SEQ_MEM119'/>"
WRITE #1 "        <register address='0xbc005f8' value='0x" DATA.LONG(A:0xbc005f8) "' name='RPMH_DDRAUX_SEQ_MEM120'/>"
WRITE #1 "        <register address='0xbc005fc' value='0x" DATA.LONG(A:0xbc005fc) "' name='RPMH_DDRAUX_SEQ_MEM121'/>"
WRITE #1 "        <register address='0xbc00600' value='0x" DATA.LONG(A:0xbc00600) "' name='RPMH_DDRAUX_SEQ_MEM122'/>"
WRITE #1 "        <register address='0xbc00604' value='0x" DATA.LONG(A:0xbc00604) "' name='RPMH_DDRAUX_SEQ_MEM123'/>"
WRITE #1 "        <register address='0xbc00608' value='0x" DATA.LONG(A:0xbc00608) "' name='RPMH_DDRAUX_SEQ_MEM124'/>"
WRITE #1 "        <register address='0xbc0060c' value='0x" DATA.LONG(A:0xbc0060c) "' name='RPMH_DDRAUX_SEQ_MEM125'/>"
WRITE #1 "        <register address='0xbc00610' value='0x" DATA.LONG(A:0xbc00610) "' name='RPMH_DDRAUX_SEQ_MEM126'/>"
WRITE #1 "        <register address='0xbc00614' value='0x" DATA.LONG(A:0xbc00614) "' name='RPMH_DDRAUX_SEQ_MEM127'/>"
WRITE #1 "        <register address='0xbc00700' value='0x" DATA.LONG(A:0xbc00700) "' name='RPMH_DDRAUX_VERSION'/>"
WRITE #1 "        <register address='0xbc00704' value='0x" DATA.LONG(A:0xbc00704) "' name='RPMH_DDRAUX_DDR_AUX_HW_ENABLE'/>"
WRITE #1 "        <register address='0xbc00708' value='0x" DATA.LONG(A:0xbc00708) "' name='RPMH_DDRAUX_AOP_INTR_STAT'/>"
WRITE #1 "        <register address='0xbc0070c' value='0x" DATA.LONG(A:0xbc0070c) "' name='RPMH_DDRAUX_AOP_INTR_DETAIL'/>"
WRITE #1 "        <register address='0xbc00710' value='0x" DATA.LONG(A:0xbc00710) "' name='RPMH_DDRAUX_AOP_INTR_MASK'/>"
WRITE #1 "        <register address='0xbc00718' value='0x" DATA.LONG(A:0xbc00718) "' name='RPMH_DDRAUX_ARC_INTF_PERF_LVL'/>"
WRITE #1 "        <register address='0xbc0071c' value='0x" DATA.LONG(A:0xbc0071c) "' name='RPMH_DDRAUX_SHRM_RSI_GPW_DATA'/>"
WRITE #1 "        <register address='0xbc00720' value='0x" DATA.LONG(A:0xbc00720) "' name='RPMH_DDRAUX_GCC_INTF_STAT'/>"
WRITE #1 "        <register address='0xbc00724' value='0x" DATA.LONG(A:0xbc00724) "' name='RPMH_DDRAUX_ARC_INTF_STAT'/>"
WRITE #1 "        <register address='0xbc00728' value='0x" DATA.LONG(A:0xbc00728) "' name='RPMH_DDRAUX_BCM_INTF_STAT'/>"
WRITE #1 "        <register address='0xbc0072c' value='0x" DATA.LONG(A:0xbc0072c) "' name='RPMH_DDRAUX_BCM_INTF_CLKPLAN'/>"
WRITE #1 "        <register address='0xbc00730' value='0x" DATA.LONG(A:0xbc00730) "' name='RPMH_DDRAUX_RSI_TIMEOUT'/>"
WRITE #1 "        <register address='0xbc0073c' value='0x" DATA.LONG(A:0xbc0073c) "' name='RPMH_DDRAUX_DDR_AUX_STAT'/>"
WRITE #1 "        <register address='0xbc00740' value='0x" DATA.LONG(A:0xbc00740) "' name='RPMH_DDRAUX_SEQ_TCS_CLK_ON'/>"
WRITE #1 "        <register address='0xc200000' value='0x" DATA.LONG(A:0xc200000) "' name='RPMH_CPRF_HW_VERSION'/>"
WRITE #1 "        <register address='0xc200004' value='0x" DATA.LONG(A:0xc200004) "' name='RPMH_CPRF_AOSS_SETTINGS'/>"
WRITE #1 "        <register address='0xc200008' value='0x" DATA.LONG(A:0xc200008) "' name='RPMH_CPRF_INTERRUPT_STATUS'/>"
WRITE #1 "        <register address='0xc200024' value='0x" DATA.LONG(A:0xc200024) "' name='RPMH_CPRF_CXO_ON_SETTINGS'/>"
WRITE #1 "        <register address='0xc200028' value='0x" DATA.LONG(A:0xc200028) "' name='RPMH_CPRF_CLOCK_MGMT_RESET'/>"
WRITE #1 "        <register address='0xc20002c' value='0x" DATA.LONG(A:0xc20002c) "' name='RPMH_CPRF_CLOCK_MGMT_ENABLE'/>"
WRITE #1 "        <register address='0xc200038' value='0x" DATA.LONG(A:0xc200038) "' name='RPMH_CPRF_MISC_RESET'/>"
WRITE #1 "        <register address='0xc20003c' value='0x" DATA.LONG(A:0xc20003c) "' name='RPMH_CPRF_MISC_CTRL'/>"
WRITE #1 "        <register address='0xc200044' value='0x" DATA.LONG(A:0xc200044) "' name='RPMH_CPRF_CPRF_WRAPPER_DEBUG_BUS'/>"
WRITE #1 "        <register address='0xc200048' value='0x" DATA.LONG(A:0xc200048) "' name='RPMH_CPRF_CPRF_OL_CAPTURE_LOC0'/>"
WRITE #1 "        <register address='0xc20004c' value='0x" DATA.LONG(A:0xc20004c) "' name='RPMH_CPRF_CPRF_OL_CAPTURE_LOC1'/>"
WRITE #1 "        <register address='0xc200050' value='0x" DATA.LONG(A:0xc200050) "' name='RPMH_CPRF_CPRF_OL_CAPTURE_LOC2'/>"
WRITE #1 "        <register address='0xc200054' value='0x" DATA.LONG(A:0xc200054) "' name='RPMH_CPRF_CPRF_OL_CAPTURE_LOC3'/>"
WRITE #1 "        <register address='0xc200058' value='0x" DATA.LONG(A:0xc200058) "' name='RPMH_CPRF_CPRF_OL_CAPTURE_LOC4'/>"
WRITE #1 "        <register address='0xc20005c' value='0x" DATA.LONG(A:0xc20005c) "' name='RPMH_CPRF_CPRF_OL_CAPTURE_LOC5'/>"
WRITE #1 "        <register address='0xc200060' value='0x" DATA.LONG(A:0xc200060) "' name='RPMH_CPRF_CPRF_OL_CAPTURE_LOC6'/>"
WRITE #1 "        <register address='0xc200064' value='0x" DATA.LONG(A:0xc200064) "' name='RPMH_CPRF_CPRF_OL_CAPTURE_LOC7'/>"
WRITE #1 "        <register address='0xc200068' value='0x" DATA.LONG(A:0xc200068) "' name='RPMH_CPRF_CPRF_OL_CAPTURE_LOC8'/>"
WRITE #1 "        <register address='0xc20006c' value='0x" DATA.LONG(A:0xc20006c) "' name='RPMH_CPRF_CPRF_OL_CAPTURE_LOC9'/>"
WRITE #1 "        <register address='0xc200070' value='0x" DATA.LONG(A:0xc200070) "' name='RPMH_CPRF_CPRF_OL_CAPTURE_LOC10'/>"
WRITE #1 "        <register address='0xc200074' value='0x" DATA.LONG(A:0xc200074) "' name='RPMH_CPRF_CPRF_OL_CAPTURE_LOC11'/>"
WRITE #1 "        <register address='0xc200078' value='0x" DATA.LONG(A:0xc200078) "' name='RPMH_CPRF_CPRF_OL_CAPTURE_LOC12'/>"
WRITE #1 "        <register address='0xc20007c' value='0x" DATA.LONG(A:0xc20007c) "' name='RPMH_CPRF_CPRF_OL_CAPTURE_LOC13'/>"
WRITE #1 "        <register address='0xc200080' value='0x" DATA.LONG(A:0xc200080) "' name='RPMH_CPRF_CPRF_OL_CAPTURE_LOC14'/>"
WRITE #1 "        <register address='0xc200084' value='0x" DATA.LONG(A:0xc200084) "' name='RPMH_CPRF_CPRF_OL_CAPTURE_LOC15'/>"
WRITE #1 "        <register address='0xc200088' value='0x" DATA.LONG(A:0xc200088) "' name='RPMH_CPRF_CPRF_OL_CAPTURE_WRPTR'/>"
WRITE #1 "        <register address='0xc201000' value='0x" DATA.LONG(A:0xc201000) "' name='RPMH_CPRF_CPRF0_RESET'/>"
WRITE #1 "        <register address='0xc202000' value='0x" DATA.LONG(A:0xc202000) "' name='RPMH_CPRF_CPRF1_RESET'/>"
WRITE #1 "        <register address='0xc203000' value='0x" DATA.LONG(A:0xc203000) "' name='RPMH_CPRF_CPRF2_RESET'/>"
WRITE #1 "        <register address='0xc204000' value='0x" DATA.LONG(A:0xc204000) "' name='RPMH_CPRF_CPRF3_RESET'/>"
WRITE #1 "        <register address='0xc201004' value='0x" DATA.LONG(A:0xc201004) "' name='RPMH_CPRF_CPRF0_CTRL'/>"
WRITE #1 "        <register address='0xc202004' value='0x" DATA.LONG(A:0xc202004) "' name='RPMH_CPRF_CPRF1_CTRL'/>"
WRITE #1 "        <register address='0xc203004' value='0x" DATA.LONG(A:0xc203004) "' name='RPMH_CPRF_CPRF2_CTRL'/>"
WRITE #1 "        <register address='0xc204004' value='0x" DATA.LONG(A:0xc204004) "' name='RPMH_CPRF_CPRF3_CTRL'/>"
WRITE #1 "        <register address='0xc201008' value='0x" DATA.LONG(A:0xc201008) "' name='RPMH_CPRF_CPRF0_VRM_SETTINGS'/>"
WRITE #1 "        <register address='0xc202008' value='0x" DATA.LONG(A:0xc202008) "' name='RPMH_CPRF_CPRF1_VRM_SETTINGS'/>"
WRITE #1 "        <register address='0xc203008' value='0x" DATA.LONG(A:0xc203008) "' name='RPMH_CPRF_CPRF2_VRM_SETTINGS'/>"
WRITE #1 "        <register address='0xc204008' value='0x" DATA.LONG(A:0xc204008) "' name='RPMH_CPRF_CPRF3_VRM_SETTINGS'/>"
WRITE #1 "        <register address='0xc20100c' value='0x" DATA.LONG(A:0xc20100c) "' name='RPMH_CPRF_CPRF0_VOLTAGE_LIMITS_0'/>"
WRITE #1 "        <register address='0xc201010' value='0x" DATA.LONG(A:0xc201010) "' name='RPMH_CPRF_CPRF0_VOLTAGE_LIMITS_1'/>"
WRITE #1 "        <register address='0xc201014' value='0x" DATA.LONG(A:0xc201014) "' name='RPMH_CPRF_CPRF0_VOLTAGE_LIMITS_2'/>"
WRITE #1 "        <register address='0xc201018' value='0x" DATA.LONG(A:0xc201018) "' name='RPMH_CPRF_CPRF0_VOLTAGE_LIMITS_3'/>"
WRITE #1 "        <register address='0xc20101c' value='0x" DATA.LONG(A:0xc20101c) "' name='RPMH_CPRF_CPRF0_VOLTAGE_LIMITS_4'/>"
WRITE #1 "        <register address='0xc201020' value='0x" DATA.LONG(A:0xc201020) "' name='RPMH_CPRF_CPRF0_VOLTAGE_LIMITS_5'/>"
WRITE #1 "        <register address='0xc201024' value='0x" DATA.LONG(A:0xc201024) "' name='RPMH_CPRF_CPRF0_VOLTAGE_LIMITS_6'/>"
WRITE #1 "        <register address='0xc201028' value='0x" DATA.LONG(A:0xc201028) "' name='RPMH_CPRF_CPRF0_VOLTAGE_LIMITS_7'/>"
WRITE #1 "        <register address='0xc20102c' value='0x" DATA.LONG(A:0xc20102c) "' name='RPMH_CPRF_CPRF0_VOLTAGE_LIMITS_8'/>"
WRITE #1 "        <register address='0xc201030' value='0x" DATA.LONG(A:0xc201030) "' name='RPMH_CPRF_CPRF0_VOLTAGE_LIMITS_9'/>"
WRITE #1 "        <register address='0xc201034' value='0x" DATA.LONG(A:0xc201034) "' name='RPMH_CPRF_CPRF0_VOLTAGE_LIMITS_10'/>"
WRITE #1 "        <register address='0xc201038' value='0x" DATA.LONG(A:0xc201038) "' name='RPMH_CPRF_CPRF0_VOLTAGE_LIMITS_11'/>"
WRITE #1 "        <register address='0xc20103c' value='0x" DATA.LONG(A:0xc20103c) "' name='RPMH_CPRF_CPRF0_VOLTAGE_LIMITS_12'/>"
WRITE #1 "        <register address='0xc201040' value='0x" DATA.LONG(A:0xc201040) "' name='RPMH_CPRF_CPRF0_VOLTAGE_LIMITS_13'/>"
WRITE #1 "        <register address='0xc201044' value='0x" DATA.LONG(A:0xc201044) "' name='RPMH_CPRF_CPRF0_VOLTAGE_LIMITS_14'/>"
WRITE #1 "        <register address='0xc201048' value='0x" DATA.LONG(A:0xc201048) "' name='RPMH_CPRF_CPRF0_VOLTAGE_LIMITS_15'/>"
WRITE #1 "        <register address='0xc20200c' value='0x" DATA.LONG(A:0xc20200c) "' name='RPMH_CPRF_CPRF1_VOLTAGE_LIMITS_0'/>"
WRITE #1 "        <register address='0xc202010' value='0x" DATA.LONG(A:0xc202010) "' name='RPMH_CPRF_CPRF1_VOLTAGE_LIMITS_1'/>"
WRITE #1 "        <register address='0xc202014' value='0x" DATA.LONG(A:0xc202014) "' name='RPMH_CPRF_CPRF1_VOLTAGE_LIMITS_2'/>"
WRITE #1 "        <register address='0xc202018' value='0x" DATA.LONG(A:0xc202018) "' name='RPMH_CPRF_CPRF1_VOLTAGE_LIMITS_3'/>"
WRITE #1 "        <register address='0xc20201c' value='0x" DATA.LONG(A:0xc20201c) "' name='RPMH_CPRF_CPRF1_VOLTAGE_LIMITS_4'/>"
WRITE #1 "        <register address='0xc202020' value='0x" DATA.LONG(A:0xc202020) "' name='RPMH_CPRF_CPRF1_VOLTAGE_LIMITS_5'/>"
WRITE #1 "        <register address='0xc202024' value='0x" DATA.LONG(A:0xc202024) "' name='RPMH_CPRF_CPRF1_VOLTAGE_LIMITS_6'/>"
WRITE #1 "        <register address='0xc202028' value='0x" DATA.LONG(A:0xc202028) "' name='RPMH_CPRF_CPRF1_VOLTAGE_LIMITS_7'/>"
WRITE #1 "        <register address='0xc20202c' value='0x" DATA.LONG(A:0xc20202c) "' name='RPMH_CPRF_CPRF1_VOLTAGE_LIMITS_8'/>"
WRITE #1 "        <register address='0xc202030' value='0x" DATA.LONG(A:0xc202030) "' name='RPMH_CPRF_CPRF1_VOLTAGE_LIMITS_9'/>"
WRITE #1 "        <register address='0xc202034' value='0x" DATA.LONG(A:0xc202034) "' name='RPMH_CPRF_CPRF1_VOLTAGE_LIMITS_10'/>"
WRITE #1 "        <register address='0xc202038' value='0x" DATA.LONG(A:0xc202038) "' name='RPMH_CPRF_CPRF1_VOLTAGE_LIMITS_11'/>"
WRITE #1 "        <register address='0xc20203c' value='0x" DATA.LONG(A:0xc20203c) "' name='RPMH_CPRF_CPRF1_VOLTAGE_LIMITS_12'/>"
WRITE #1 "        <register address='0xc202040' value='0x" DATA.LONG(A:0xc202040) "' name='RPMH_CPRF_CPRF1_VOLTAGE_LIMITS_13'/>"
WRITE #1 "        <register address='0xc202044' value='0x" DATA.LONG(A:0xc202044) "' name='RPMH_CPRF_CPRF1_VOLTAGE_LIMITS_14'/>"
WRITE #1 "        <register address='0xc202048' value='0x" DATA.LONG(A:0xc202048) "' name='RPMH_CPRF_CPRF1_VOLTAGE_LIMITS_15'/>"
WRITE #1 "        <register address='0xc20300c' value='0x" DATA.LONG(A:0xc20300c) "' name='RPMH_CPRF_CPRF2_VOLTAGE_LIMITS_0'/>"
WRITE #1 "        <register address='0xc203010' value='0x" DATA.LONG(A:0xc203010) "' name='RPMH_CPRF_CPRF2_VOLTAGE_LIMITS_1'/>"
WRITE #1 "        <register address='0xc203014' value='0x" DATA.LONG(A:0xc203014) "' name='RPMH_CPRF_CPRF2_VOLTAGE_LIMITS_2'/>"
WRITE #1 "        <register address='0xc203018' value='0x" DATA.LONG(A:0xc203018) "' name='RPMH_CPRF_CPRF2_VOLTAGE_LIMITS_3'/>"
WRITE #1 "        <register address='0xc20301c' value='0x" DATA.LONG(A:0xc20301c) "' name='RPMH_CPRF_CPRF2_VOLTAGE_LIMITS_4'/>"
WRITE #1 "        <register address='0xc203020' value='0x" DATA.LONG(A:0xc203020) "' name='RPMH_CPRF_CPRF2_VOLTAGE_LIMITS_5'/>"
WRITE #1 "        <register address='0xc203024' value='0x" DATA.LONG(A:0xc203024) "' name='RPMH_CPRF_CPRF2_VOLTAGE_LIMITS_6'/>"
WRITE #1 "        <register address='0xc203028' value='0x" DATA.LONG(A:0xc203028) "' name='RPMH_CPRF_CPRF2_VOLTAGE_LIMITS_7'/>"
WRITE #1 "        <register address='0xc20302c' value='0x" DATA.LONG(A:0xc20302c) "' name='RPMH_CPRF_CPRF2_VOLTAGE_LIMITS_8'/>"
WRITE #1 "        <register address='0xc203030' value='0x" DATA.LONG(A:0xc203030) "' name='RPMH_CPRF_CPRF2_VOLTAGE_LIMITS_9'/>"
WRITE #1 "        <register address='0xc203034' value='0x" DATA.LONG(A:0xc203034) "' name='RPMH_CPRF_CPRF2_VOLTAGE_LIMITS_10'/>"
WRITE #1 "        <register address='0xc203038' value='0x" DATA.LONG(A:0xc203038) "' name='RPMH_CPRF_CPRF2_VOLTAGE_LIMITS_11'/>"
WRITE #1 "        <register address='0xc20303c' value='0x" DATA.LONG(A:0xc20303c) "' name='RPMH_CPRF_CPRF2_VOLTAGE_LIMITS_12'/>"
WRITE #1 "        <register address='0xc203040' value='0x" DATA.LONG(A:0xc203040) "' name='RPMH_CPRF_CPRF2_VOLTAGE_LIMITS_13'/>"
WRITE #1 "        <register address='0xc203044' value='0x" DATA.LONG(A:0xc203044) "' name='RPMH_CPRF_CPRF2_VOLTAGE_LIMITS_14'/>"
WRITE #1 "        <register address='0xc203048' value='0x" DATA.LONG(A:0xc203048) "' name='RPMH_CPRF_CPRF2_VOLTAGE_LIMITS_15'/>"
WRITE #1 "        <register address='0xc20400c' value='0x" DATA.LONG(A:0xc20400c) "' name='RPMH_CPRF_CPRF3_VOLTAGE_LIMITS_0'/>"
WRITE #1 "        <register address='0xc204010' value='0x" DATA.LONG(A:0xc204010) "' name='RPMH_CPRF_CPRF3_VOLTAGE_LIMITS_1'/>"
WRITE #1 "        <register address='0xc204014' value='0x" DATA.LONG(A:0xc204014) "' name='RPMH_CPRF_CPRF3_VOLTAGE_LIMITS_2'/>"
WRITE #1 "        <register address='0xc204018' value='0x" DATA.LONG(A:0xc204018) "' name='RPMH_CPRF_CPRF3_VOLTAGE_LIMITS_3'/>"
WRITE #1 "        <register address='0xc20401c' value='0x" DATA.LONG(A:0xc20401c) "' name='RPMH_CPRF_CPRF3_VOLTAGE_LIMITS_4'/>"
WRITE #1 "        <register address='0xc204020' value='0x" DATA.LONG(A:0xc204020) "' name='RPMH_CPRF_CPRF3_VOLTAGE_LIMITS_5'/>"
WRITE #1 "        <register address='0xc204024' value='0x" DATA.LONG(A:0xc204024) "' name='RPMH_CPRF_CPRF3_VOLTAGE_LIMITS_6'/>"
WRITE #1 "        <register address='0xc204028' value='0x" DATA.LONG(A:0xc204028) "' name='RPMH_CPRF_CPRF3_VOLTAGE_LIMITS_7'/>"
WRITE #1 "        <register address='0xc20402c' value='0x" DATA.LONG(A:0xc20402c) "' name='RPMH_CPRF_CPRF3_VOLTAGE_LIMITS_8'/>"
WRITE #1 "        <register address='0xc204030' value='0x" DATA.LONG(A:0xc204030) "' name='RPMH_CPRF_CPRF3_VOLTAGE_LIMITS_9'/>"
WRITE #1 "        <register address='0xc204034' value='0x" DATA.LONG(A:0xc204034) "' name='RPMH_CPRF_CPRF3_VOLTAGE_LIMITS_10'/>"
WRITE #1 "        <register address='0xc204038' value='0x" DATA.LONG(A:0xc204038) "' name='RPMH_CPRF_CPRF3_VOLTAGE_LIMITS_11'/>"
WRITE #1 "        <register address='0xc20403c' value='0x" DATA.LONG(A:0xc20403c) "' name='RPMH_CPRF_CPRF3_VOLTAGE_LIMITS_12'/>"
WRITE #1 "        <register address='0xc204040' value='0x" DATA.LONG(A:0xc204040) "' name='RPMH_CPRF_CPRF3_VOLTAGE_LIMITS_13'/>"
WRITE #1 "        <register address='0xc204044' value='0x" DATA.LONG(A:0xc204044) "' name='RPMH_CPRF_CPRF3_VOLTAGE_LIMITS_14'/>"
WRITE #1 "        <register address='0xc204048' value='0x" DATA.LONG(A:0xc204048) "' name='RPMH_CPRF_CPRF3_VOLTAGE_LIMITS_15'/>"
WRITE #1 "        <register address='0xc20108c' value='0x" DATA.LONG(A:0xc20108c) "' name='RPMH_CPRF_CPRF0_SAFE_VOLTAGE_0'/>"
WRITE #1 "        <register address='0xc201090' value='0x" DATA.LONG(A:0xc201090) "' name='RPMH_CPRF_CPRF0_SAFE_VOLTAGE_1'/>"
WRITE #1 "        <register address='0xc201094' value='0x" DATA.LONG(A:0xc201094) "' name='RPMH_CPRF_CPRF0_SAFE_VOLTAGE_2'/>"
WRITE #1 "        <register address='0xc201098' value='0x" DATA.LONG(A:0xc201098) "' name='RPMH_CPRF_CPRF0_SAFE_VOLTAGE_3'/>"
WRITE #1 "        <register address='0xc20109c' value='0x" DATA.LONG(A:0xc20109c) "' name='RPMH_CPRF_CPRF0_SAFE_VOLTAGE_4'/>"
WRITE #1 "        <register address='0xc2010a0' value='0x" DATA.LONG(A:0xc2010a0) "' name='RPMH_CPRF_CPRF0_SAFE_VOLTAGE_5'/>"
WRITE #1 "        <register address='0xc2010a4' value='0x" DATA.LONG(A:0xc2010a4) "' name='RPMH_CPRF_CPRF0_SAFE_VOLTAGE_6'/>"
WRITE #1 "        <register address='0xc2010a8' value='0x" DATA.LONG(A:0xc2010a8) "' name='RPMH_CPRF_CPRF0_SAFE_VOLTAGE_7'/>"
WRITE #1 "        <register address='0xc2010ac' value='0x" DATA.LONG(A:0xc2010ac) "' name='RPMH_CPRF_CPRF0_SAFE_VOLTAGE_8'/>"
WRITE #1 "        <register address='0xc2010b0' value='0x" DATA.LONG(A:0xc2010b0) "' name='RPMH_CPRF_CPRF0_SAFE_VOLTAGE_9'/>"
WRITE #1 "        <register address='0xc2010b4' value='0x" DATA.LONG(A:0xc2010b4) "' name='RPMH_CPRF_CPRF0_SAFE_VOLTAGE_10'/>"
WRITE #1 "        <register address='0xc2010b8' value='0x" DATA.LONG(A:0xc2010b8) "' name='RPMH_CPRF_CPRF0_SAFE_VOLTAGE_11'/>"
WRITE #1 "        <register address='0xc2010bc' value='0x" DATA.LONG(A:0xc2010bc) "' name='RPMH_CPRF_CPRF0_SAFE_VOLTAGE_12'/>"
WRITE #1 "        <register address='0xc2010c0' value='0x" DATA.LONG(A:0xc2010c0) "' name='RPMH_CPRF_CPRF0_SAFE_VOLTAGE_13'/>"
WRITE #1 "        <register address='0xc2010c4' value='0x" DATA.LONG(A:0xc2010c4) "' name='RPMH_CPRF_CPRF0_SAFE_VOLTAGE_14'/>"
WRITE #1 "        <register address='0xc2010c8' value='0x" DATA.LONG(A:0xc2010c8) "' name='RPMH_CPRF_CPRF0_SAFE_VOLTAGE_15'/>"
WRITE #1 "        <register address='0xc20208c' value='0x" DATA.LONG(A:0xc20208c) "' name='RPMH_CPRF_CPRF1_SAFE_VOLTAGE_0'/>"
WRITE #1 "        <register address='0xc202090' value='0x" DATA.LONG(A:0xc202090) "' name='RPMH_CPRF_CPRF1_SAFE_VOLTAGE_1'/>"
WRITE #1 "        <register address='0xc202094' value='0x" DATA.LONG(A:0xc202094) "' name='RPMH_CPRF_CPRF1_SAFE_VOLTAGE_2'/>"
WRITE #1 "        <register address='0xc202098' value='0x" DATA.LONG(A:0xc202098) "' name='RPMH_CPRF_CPRF1_SAFE_VOLTAGE_3'/>"
WRITE #1 "        <register address='0xc20209c' value='0x" DATA.LONG(A:0xc20209c) "' name='RPMH_CPRF_CPRF1_SAFE_VOLTAGE_4'/>"
WRITE #1 "        <register address='0xc2020a0' value='0x" DATA.LONG(A:0xc2020a0) "' name='RPMH_CPRF_CPRF1_SAFE_VOLTAGE_5'/>"
WRITE #1 "        <register address='0xc2020a4' value='0x" DATA.LONG(A:0xc2020a4) "' name='RPMH_CPRF_CPRF1_SAFE_VOLTAGE_6'/>"
WRITE #1 "        <register address='0xc2020a8' value='0x" DATA.LONG(A:0xc2020a8) "' name='RPMH_CPRF_CPRF1_SAFE_VOLTAGE_7'/>"
WRITE #1 "        <register address='0xc2020ac' value='0x" DATA.LONG(A:0xc2020ac) "' name='RPMH_CPRF_CPRF1_SAFE_VOLTAGE_8'/>"
WRITE #1 "        <register address='0xc2020b0' value='0x" DATA.LONG(A:0xc2020b0) "' name='RPMH_CPRF_CPRF1_SAFE_VOLTAGE_9'/>"
WRITE #1 "        <register address='0xc2020b4' value='0x" DATA.LONG(A:0xc2020b4) "' name='RPMH_CPRF_CPRF1_SAFE_VOLTAGE_10'/>"
WRITE #1 "        <register address='0xc2020b8' value='0x" DATA.LONG(A:0xc2020b8) "' name='RPMH_CPRF_CPRF1_SAFE_VOLTAGE_11'/>"
WRITE #1 "        <register address='0xc2020bc' value='0x" DATA.LONG(A:0xc2020bc) "' name='RPMH_CPRF_CPRF1_SAFE_VOLTAGE_12'/>"
WRITE #1 "        <register address='0xc2020c0' value='0x" DATA.LONG(A:0xc2020c0) "' name='RPMH_CPRF_CPRF1_SAFE_VOLTAGE_13'/>"
WRITE #1 "        <register address='0xc2020c4' value='0x" DATA.LONG(A:0xc2020c4) "' name='RPMH_CPRF_CPRF1_SAFE_VOLTAGE_14'/>"
WRITE #1 "        <register address='0xc2020c8' value='0x" DATA.LONG(A:0xc2020c8) "' name='RPMH_CPRF_CPRF1_SAFE_VOLTAGE_15'/>"
WRITE #1 "        <register address='0xc20308c' value='0x" DATA.LONG(A:0xc20308c) "' name='RPMH_CPRF_CPRF2_SAFE_VOLTAGE_0'/>"
WRITE #1 "        <register address='0xc203090' value='0x" DATA.LONG(A:0xc203090) "' name='RPMH_CPRF_CPRF2_SAFE_VOLTAGE_1'/>"
WRITE #1 "        <register address='0xc203094' value='0x" DATA.LONG(A:0xc203094) "' name='RPMH_CPRF_CPRF2_SAFE_VOLTAGE_2'/>"
WRITE #1 "        <register address='0xc203098' value='0x" DATA.LONG(A:0xc203098) "' name='RPMH_CPRF_CPRF2_SAFE_VOLTAGE_3'/>"
WRITE #1 "        <register address='0xc20309c' value='0x" DATA.LONG(A:0xc20309c) "' name='RPMH_CPRF_CPRF2_SAFE_VOLTAGE_4'/>"
WRITE #1 "        <register address='0xc2030a0' value='0x" DATA.LONG(A:0xc2030a0) "' name='RPMH_CPRF_CPRF2_SAFE_VOLTAGE_5'/>"
WRITE #1 "        <register address='0xc2030a4' value='0x" DATA.LONG(A:0xc2030a4) "' name='RPMH_CPRF_CPRF2_SAFE_VOLTAGE_6'/>"
WRITE #1 "        <register address='0xc2030a8' value='0x" DATA.LONG(A:0xc2030a8) "' name='RPMH_CPRF_CPRF2_SAFE_VOLTAGE_7'/>"
WRITE #1 "        <register address='0xc2030ac' value='0x" DATA.LONG(A:0xc2030ac) "' name='RPMH_CPRF_CPRF2_SAFE_VOLTAGE_8'/>"
WRITE #1 "        <register address='0xc2030b0' value='0x" DATA.LONG(A:0xc2030b0) "' name='RPMH_CPRF_CPRF2_SAFE_VOLTAGE_9'/>"
WRITE #1 "        <register address='0xc2030b4' value='0x" DATA.LONG(A:0xc2030b4) "' name='RPMH_CPRF_CPRF2_SAFE_VOLTAGE_10'/>"
WRITE #1 "        <register address='0xc2030b8' value='0x" DATA.LONG(A:0xc2030b8) "' name='RPMH_CPRF_CPRF2_SAFE_VOLTAGE_11'/>"
WRITE #1 "        <register address='0xc2030bc' value='0x" DATA.LONG(A:0xc2030bc) "' name='RPMH_CPRF_CPRF2_SAFE_VOLTAGE_12'/>"
WRITE #1 "        <register address='0xc2030c0' value='0x" DATA.LONG(A:0xc2030c0) "' name='RPMH_CPRF_CPRF2_SAFE_VOLTAGE_13'/>"
WRITE #1 "        <register address='0xc2030c4' value='0x" DATA.LONG(A:0xc2030c4) "' name='RPMH_CPRF_CPRF2_SAFE_VOLTAGE_14'/>"
WRITE #1 "        <register address='0xc2030c8' value='0x" DATA.LONG(A:0xc2030c8) "' name='RPMH_CPRF_CPRF2_SAFE_VOLTAGE_15'/>"
WRITE #1 "        <register address='0xc20408c' value='0x" DATA.LONG(A:0xc20408c) "' name='RPMH_CPRF_CPRF3_SAFE_VOLTAGE_0'/>"
WRITE #1 "        <register address='0xc204090' value='0x" DATA.LONG(A:0xc204090) "' name='RPMH_CPRF_CPRF3_SAFE_VOLTAGE_1'/>"
WRITE #1 "        <register address='0xc204094' value='0x" DATA.LONG(A:0xc204094) "' name='RPMH_CPRF_CPRF3_SAFE_VOLTAGE_2'/>"
WRITE #1 "        <register address='0xc204098' value='0x" DATA.LONG(A:0xc204098) "' name='RPMH_CPRF_CPRF3_SAFE_VOLTAGE_3'/>"
WRITE #1 "        <register address='0xc20409c' value='0x" DATA.LONG(A:0xc20409c) "' name='RPMH_CPRF_CPRF3_SAFE_VOLTAGE_4'/>"
WRITE #1 "        <register address='0xc2040a0' value='0x" DATA.LONG(A:0xc2040a0) "' name='RPMH_CPRF_CPRF3_SAFE_VOLTAGE_5'/>"
WRITE #1 "        <register address='0xc2040a4' value='0x" DATA.LONG(A:0xc2040a4) "' name='RPMH_CPRF_CPRF3_SAFE_VOLTAGE_6'/>"
WRITE #1 "        <register address='0xc2040a8' value='0x" DATA.LONG(A:0xc2040a8) "' name='RPMH_CPRF_CPRF3_SAFE_VOLTAGE_7'/>"
WRITE #1 "        <register address='0xc2040ac' value='0x" DATA.LONG(A:0xc2040ac) "' name='RPMH_CPRF_CPRF3_SAFE_VOLTAGE_8'/>"
WRITE #1 "        <register address='0xc2040b0' value='0x" DATA.LONG(A:0xc2040b0) "' name='RPMH_CPRF_CPRF3_SAFE_VOLTAGE_9'/>"
WRITE #1 "        <register address='0xc2040b4' value='0x" DATA.LONG(A:0xc2040b4) "' name='RPMH_CPRF_CPRF3_SAFE_VOLTAGE_10'/>"
WRITE #1 "        <register address='0xc2040b8' value='0x" DATA.LONG(A:0xc2040b8) "' name='RPMH_CPRF_CPRF3_SAFE_VOLTAGE_11'/>"
WRITE #1 "        <register address='0xc2040bc' value='0x" DATA.LONG(A:0xc2040bc) "' name='RPMH_CPRF_CPRF3_SAFE_VOLTAGE_12'/>"
WRITE #1 "        <register address='0xc2040c0' value='0x" DATA.LONG(A:0xc2040c0) "' name='RPMH_CPRF_CPRF3_SAFE_VOLTAGE_13'/>"
WRITE #1 "        <register address='0xc2040c4' value='0x" DATA.LONG(A:0xc2040c4) "' name='RPMH_CPRF_CPRF3_SAFE_VOLTAGE_14'/>"
WRITE #1 "        <register address='0xc2040c8' value='0x" DATA.LONG(A:0xc2040c8) "' name='RPMH_CPRF_CPRF3_SAFE_VOLTAGE_15'/>"
WRITE #1 "        <register address='0xc201110' value='0x" DATA.LONG(A:0xc201110) "' name='RPMH_CPRF_CPRF0_DELAY_CPRC'/>"
WRITE #1 "        <register address='0xc202110' value='0x" DATA.LONG(A:0xc202110) "' name='RPMH_CPRF_CPRF1_DELAY_CPRC'/>"
WRITE #1 "        <register address='0xc203110' value='0x" DATA.LONG(A:0xc203110) "' name='RPMH_CPRF_CPRF2_DELAY_CPRC'/>"
WRITE #1 "        <register address='0xc204110' value='0x" DATA.LONG(A:0xc204110) "' name='RPMH_CPRF_CPRF3_DELAY_CPRC'/>"
WRITE #1 "        <register address='0xc201114' value='0x" DATA.LONG(A:0xc201114) "' name='RPMH_CPRF_CPRF0_INITIAL_SETTINGS'/>"
WRITE #1 "        <register address='0xc202114' value='0x" DATA.LONG(A:0xc202114) "' name='RPMH_CPRF_CPRF1_INITIAL_SETTINGS'/>"
WRITE #1 "        <register address='0xc203114' value='0x" DATA.LONG(A:0xc203114) "' name='RPMH_CPRF_CPRF2_INITIAL_SETTINGS'/>"
WRITE #1 "        <register address='0xc204114' value='0x" DATA.LONG(A:0xc204114) "' name='RPMH_CPRF_CPRF3_INITIAL_SETTINGS'/>"
WRITE #1 "        <register address='0xc201118' value='0x" DATA.LONG(A:0xc201118) "' name='RPMH_CPRF_CPRF0_ENABLE'/>"
WRITE #1 "        <register address='0xc202118' value='0x" DATA.LONG(A:0xc202118) "' name='RPMH_CPRF_CPRF1_ENABLE'/>"
WRITE #1 "        <register address='0xc203118' value='0x" DATA.LONG(A:0xc203118) "' name='RPMH_CPRF_CPRF2_ENABLE'/>"
WRITE #1 "        <register address='0xc204118' value='0x" DATA.LONG(A:0xc204118) "' name='RPMH_CPRF_CPRF3_ENABLE'/>"
WRITE #1 "        <register address='0xc20111c' value='0x" DATA.LONG(A:0xc20111c) "' name='RPMH_CPRF_CPRF0_FORCE_SETTINGS'/>"
WRITE #1 "        <register address='0xc20211c' value='0x" DATA.LONG(A:0xc20211c) "' name='RPMH_CPRF_CPRF1_FORCE_SETTINGS'/>"
WRITE #1 "        <register address='0xc20311c' value='0x" DATA.LONG(A:0xc20311c) "' name='RPMH_CPRF_CPRF2_FORCE_SETTINGS'/>"
WRITE #1 "        <register address='0xc20411c' value='0x" DATA.LONG(A:0xc20411c) "' name='RPMH_CPRF_CPRF3_FORCE_SETTINGS'/>"
WRITE #1 "        <register address='0xc201120' value='0x" DATA.LONG(A:0xc201120) "' name='RPMH_CPRF_CPRF0_RECORDING_SETTINGS_0'/>"
WRITE #1 "        <register address='0xc201124' value='0x" DATA.LONG(A:0xc201124) "' name='RPMH_CPRF_CPRF0_RECORDING_SETTINGS_1'/>"
WRITE #1 "        <register address='0xc201128' value='0x" DATA.LONG(A:0xc201128) "' name='RPMH_CPRF_CPRF0_RECORDING_SETTINGS_2'/>"
WRITE #1 "        <register address='0xc20112c' value='0x" DATA.LONG(A:0xc20112c) "' name='RPMH_CPRF_CPRF0_RECORDING_SETTINGS_3'/>"
WRITE #1 "        <register address='0xc201130' value='0x" DATA.LONG(A:0xc201130) "' name='RPMH_CPRF_CPRF0_RECORDING_SETTINGS_4'/>"
WRITE #1 "        <register address='0xc201134' value='0x" DATA.LONG(A:0xc201134) "' name='RPMH_CPRF_CPRF0_RECORDING_SETTINGS_5'/>"
WRITE #1 "        <register address='0xc201138' value='0x" DATA.LONG(A:0xc201138) "' name='RPMH_CPRF_CPRF0_RECORDING_SETTINGS_6'/>"
WRITE #1 "        <register address='0xc20113c' value='0x" DATA.LONG(A:0xc20113c) "' name='RPMH_CPRF_CPRF0_RECORDING_SETTINGS_7'/>"
WRITE #1 "        <register address='0xc201140' value='0x" DATA.LONG(A:0xc201140) "' name='RPMH_CPRF_CPRF0_RECORDING_SETTINGS_8'/>"
WRITE #1 "        <register address='0xc201144' value='0x" DATA.LONG(A:0xc201144) "' name='RPMH_CPRF_CPRF0_RECORDING_SETTINGS_9'/>"
WRITE #1 "        <register address='0xc201148' value='0x" DATA.LONG(A:0xc201148) "' name='RPMH_CPRF_CPRF0_RECORDING_SETTINGS_10'/>"
WRITE #1 "        <register address='0xc20114c' value='0x" DATA.LONG(A:0xc20114c) "' name='RPMH_CPRF_CPRF0_RECORDING_SETTINGS_11'/>"
WRITE #1 "        <register address='0xc201150' value='0x" DATA.LONG(A:0xc201150) "' name='RPMH_CPRF_CPRF0_RECORDING_SETTINGS_12'/>"
WRITE #1 "        <register address='0xc201154' value='0x" DATA.LONG(A:0xc201154) "' name='RPMH_CPRF_CPRF0_RECORDING_SETTINGS_13'/>"
WRITE #1 "        <register address='0xc201158' value='0x" DATA.LONG(A:0xc201158) "' name='RPMH_CPRF_CPRF0_RECORDING_SETTINGS_14'/>"
WRITE #1 "        <register address='0xc20115c' value='0x" DATA.LONG(A:0xc20115c) "' name='RPMH_CPRF_CPRF0_RECORDING_SETTINGS_15'/>"
WRITE #1 "        <register address='0xc202120' value='0x" DATA.LONG(A:0xc202120) "' name='RPMH_CPRF_CPRF1_RECORDING_SETTINGS_0'/>"
WRITE #1 "        <register address='0xc202124' value='0x" DATA.LONG(A:0xc202124) "' name='RPMH_CPRF_CPRF1_RECORDING_SETTINGS_1'/>"
WRITE #1 "        <register address='0xc202128' value='0x" DATA.LONG(A:0xc202128) "' name='RPMH_CPRF_CPRF1_RECORDING_SETTINGS_2'/>"
WRITE #1 "        <register address='0xc20212c' value='0x" DATA.LONG(A:0xc20212c) "' name='RPMH_CPRF_CPRF1_RECORDING_SETTINGS_3'/>"
WRITE #1 "        <register address='0xc202130' value='0x" DATA.LONG(A:0xc202130) "' name='RPMH_CPRF_CPRF1_RECORDING_SETTINGS_4'/>"
WRITE #1 "        <register address='0xc202134' value='0x" DATA.LONG(A:0xc202134) "' name='RPMH_CPRF_CPRF1_RECORDING_SETTINGS_5'/>"
WRITE #1 "        <register address='0xc202138' value='0x" DATA.LONG(A:0xc202138) "' name='RPMH_CPRF_CPRF1_RECORDING_SETTINGS_6'/>"
WRITE #1 "        <register address='0xc20213c' value='0x" DATA.LONG(A:0xc20213c) "' name='RPMH_CPRF_CPRF1_RECORDING_SETTINGS_7'/>"
WRITE #1 "        <register address='0xc202140' value='0x" DATA.LONG(A:0xc202140) "' name='RPMH_CPRF_CPRF1_RECORDING_SETTINGS_8'/>"
WRITE #1 "        <register address='0xc202144' value='0x" DATA.LONG(A:0xc202144) "' name='RPMH_CPRF_CPRF1_RECORDING_SETTINGS_9'/>"
WRITE #1 "        <register address='0xc202148' value='0x" DATA.LONG(A:0xc202148) "' name='RPMH_CPRF_CPRF1_RECORDING_SETTINGS_10'/>"
WRITE #1 "        <register address='0xc20214c' value='0x" DATA.LONG(A:0xc20214c) "' name='RPMH_CPRF_CPRF1_RECORDING_SETTINGS_11'/>"
WRITE #1 "        <register address='0xc202150' value='0x" DATA.LONG(A:0xc202150) "' name='RPMH_CPRF_CPRF1_RECORDING_SETTINGS_12'/>"
WRITE #1 "        <register address='0xc202154' value='0x" DATA.LONG(A:0xc202154) "' name='RPMH_CPRF_CPRF1_RECORDING_SETTINGS_13'/>"
WRITE #1 "        <register address='0xc202158' value='0x" DATA.LONG(A:0xc202158) "' name='RPMH_CPRF_CPRF1_RECORDING_SETTINGS_14'/>"
WRITE #1 "        <register address='0xc20215c' value='0x" DATA.LONG(A:0xc20215c) "' name='RPMH_CPRF_CPRF1_RECORDING_SETTINGS_15'/>"
WRITE #1 "        <register address='0xc203120' value='0x" DATA.LONG(A:0xc203120) "' name='RPMH_CPRF_CPRF2_RECORDING_SETTINGS_0'/>"
WRITE #1 "        <register address='0xc203124' value='0x" DATA.LONG(A:0xc203124) "' name='RPMH_CPRF_CPRF2_RECORDING_SETTINGS_1'/>"
WRITE #1 "        <register address='0xc203128' value='0x" DATA.LONG(A:0xc203128) "' name='RPMH_CPRF_CPRF2_RECORDING_SETTINGS_2'/>"
WRITE #1 "        <register address='0xc20312c' value='0x" DATA.LONG(A:0xc20312c) "' name='RPMH_CPRF_CPRF2_RECORDING_SETTINGS_3'/>"
WRITE #1 "        <register address='0xc203130' value='0x" DATA.LONG(A:0xc203130) "' name='RPMH_CPRF_CPRF2_RECORDING_SETTINGS_4'/>"
WRITE #1 "        <register address='0xc203134' value='0x" DATA.LONG(A:0xc203134) "' name='RPMH_CPRF_CPRF2_RECORDING_SETTINGS_5'/>"
WRITE #1 "        <register address='0xc203138' value='0x" DATA.LONG(A:0xc203138) "' name='RPMH_CPRF_CPRF2_RECORDING_SETTINGS_6'/>"
WRITE #1 "        <register address='0xc20313c' value='0x" DATA.LONG(A:0xc20313c) "' name='RPMH_CPRF_CPRF2_RECORDING_SETTINGS_7'/>"
WRITE #1 "        <register address='0xc203140' value='0x" DATA.LONG(A:0xc203140) "' name='RPMH_CPRF_CPRF2_RECORDING_SETTINGS_8'/>"
WRITE #1 "        <register address='0xc203144' value='0x" DATA.LONG(A:0xc203144) "' name='RPMH_CPRF_CPRF2_RECORDING_SETTINGS_9'/>"
WRITE #1 "        <register address='0xc203148' value='0x" DATA.LONG(A:0xc203148) "' name='RPMH_CPRF_CPRF2_RECORDING_SETTINGS_10'/>"
WRITE #1 "        <register address='0xc20314c' value='0x" DATA.LONG(A:0xc20314c) "' name='RPMH_CPRF_CPRF2_RECORDING_SETTINGS_11'/>"
WRITE #1 "        <register address='0xc203150' value='0x" DATA.LONG(A:0xc203150) "' name='RPMH_CPRF_CPRF2_RECORDING_SETTINGS_12'/>"
WRITE #1 "        <register address='0xc203154' value='0x" DATA.LONG(A:0xc203154) "' name='RPMH_CPRF_CPRF2_RECORDING_SETTINGS_13'/>"
WRITE #1 "        <register address='0xc203158' value='0x" DATA.LONG(A:0xc203158) "' name='RPMH_CPRF_CPRF2_RECORDING_SETTINGS_14'/>"
WRITE #1 "        <register address='0xc20315c' value='0x" DATA.LONG(A:0xc20315c) "' name='RPMH_CPRF_CPRF2_RECORDING_SETTINGS_15'/>"
WRITE #1 "        <register address='0xc204120' value='0x" DATA.LONG(A:0xc204120) "' name='RPMH_CPRF_CPRF3_RECORDING_SETTINGS_0'/>"
WRITE #1 "        <register address='0xc204124' value='0x" DATA.LONG(A:0xc204124) "' name='RPMH_CPRF_CPRF3_RECORDING_SETTINGS_1'/>"
WRITE #1 "        <register address='0xc204128' value='0x" DATA.LONG(A:0xc204128) "' name='RPMH_CPRF_CPRF3_RECORDING_SETTINGS_2'/>"
WRITE #1 "        <register address='0xc20412c' value='0x" DATA.LONG(A:0xc20412c) "' name='RPMH_CPRF_CPRF3_RECORDING_SETTINGS_3'/>"
WRITE #1 "        <register address='0xc204130' value='0x" DATA.LONG(A:0xc204130) "' name='RPMH_CPRF_CPRF3_RECORDING_SETTINGS_4'/>"
WRITE #1 "        <register address='0xc204134' value='0x" DATA.LONG(A:0xc204134) "' name='RPMH_CPRF_CPRF3_RECORDING_SETTINGS_5'/>"
WRITE #1 "        <register address='0xc204138' value='0x" DATA.LONG(A:0xc204138) "' name='RPMH_CPRF_CPRF3_RECORDING_SETTINGS_6'/>"
WRITE #1 "        <register address='0xc20413c' value='0x" DATA.LONG(A:0xc20413c) "' name='RPMH_CPRF_CPRF3_RECORDING_SETTINGS_7'/>"
WRITE #1 "        <register address='0xc204140' value='0x" DATA.LONG(A:0xc204140) "' name='RPMH_CPRF_CPRF3_RECORDING_SETTINGS_8'/>"
WRITE #1 "        <register address='0xc204144' value='0x" DATA.LONG(A:0xc204144) "' name='RPMH_CPRF_CPRF3_RECORDING_SETTINGS_9'/>"
WRITE #1 "        <register address='0xc204148' value='0x" DATA.LONG(A:0xc204148) "' name='RPMH_CPRF_CPRF3_RECORDING_SETTINGS_10'/>"
WRITE #1 "        <register address='0xc20414c' value='0x" DATA.LONG(A:0xc20414c) "' name='RPMH_CPRF_CPRF3_RECORDING_SETTINGS_11'/>"
WRITE #1 "        <register address='0xc204150' value='0x" DATA.LONG(A:0xc204150) "' name='RPMH_CPRF_CPRF3_RECORDING_SETTINGS_12'/>"
WRITE #1 "        <register address='0xc204154' value='0x" DATA.LONG(A:0xc204154) "' name='RPMH_CPRF_CPRF3_RECORDING_SETTINGS_13'/>"
WRITE #1 "        <register address='0xc204158' value='0x" DATA.LONG(A:0xc204158) "' name='RPMH_CPRF_CPRF3_RECORDING_SETTINGS_14'/>"
WRITE #1 "        <register address='0xc20415c' value='0x" DATA.LONG(A:0xc20415c) "' name='RPMH_CPRF_CPRF3_RECORDING_SETTINGS_15'/>"
WRITE #1 "        <register address='0xc2011a0' value='0x" DATA.LONG(A:0xc2011a0) "' name='RPMH_CPRF_CPRF0_CAP_STEP_SETTINGS_0'/>"
WRITE #1 "        <register address='0xc2011a4' value='0x" DATA.LONG(A:0xc2011a4) "' name='RPMH_CPRF_CPRF0_CAP_STEP_SETTINGS_1'/>"
WRITE #1 "        <register address='0xc2011a8' value='0x" DATA.LONG(A:0xc2011a8) "' name='RPMH_CPRF_CPRF0_CAP_STEP_SETTINGS_2'/>"
WRITE #1 "        <register address='0xc2011ac' value='0x" DATA.LONG(A:0xc2011ac) "' name='RPMH_CPRF_CPRF0_CAP_STEP_SETTINGS_3'/>"
WRITE #1 "        <register address='0xc2011b0' value='0x" DATA.LONG(A:0xc2011b0) "' name='RPMH_CPRF_CPRF0_CAP_STEP_SETTINGS_4'/>"
WRITE #1 "        <register address='0xc2011b4' value='0x" DATA.LONG(A:0xc2011b4) "' name='RPMH_CPRF_CPRF0_CAP_STEP_SETTINGS_5'/>"
WRITE #1 "        <register address='0xc2011b8' value='0x" DATA.LONG(A:0xc2011b8) "' name='RPMH_CPRF_CPRF0_CAP_STEP_SETTINGS_6'/>"
WRITE #1 "        <register address='0xc2011bc' value='0x" DATA.LONG(A:0xc2011bc) "' name='RPMH_CPRF_CPRF0_CAP_STEP_SETTINGS_7'/>"
WRITE #1 "        <register address='0xc2011c0' value='0x" DATA.LONG(A:0xc2011c0) "' name='RPMH_CPRF_CPRF0_CAP_STEP_SETTINGS_8'/>"
WRITE #1 "        <register address='0xc2011c4' value='0x" DATA.LONG(A:0xc2011c4) "' name='RPMH_CPRF_CPRF0_CAP_STEP_SETTINGS_9'/>"
WRITE #1 "        <register address='0xc2011c8' value='0x" DATA.LONG(A:0xc2011c8) "' name='RPMH_CPRF_CPRF0_CAP_STEP_SETTINGS_10'/>"
WRITE #1 "        <register address='0xc2011cc' value='0x" DATA.LONG(A:0xc2011cc) "' name='RPMH_CPRF_CPRF0_CAP_STEP_SETTINGS_11'/>"
WRITE #1 "        <register address='0xc2011d0' value='0x" DATA.LONG(A:0xc2011d0) "' name='RPMH_CPRF_CPRF0_CAP_STEP_SETTINGS_12'/>"
WRITE #1 "        <register address='0xc2011d4' value='0x" DATA.LONG(A:0xc2011d4) "' name='RPMH_CPRF_CPRF0_CAP_STEP_SETTINGS_13'/>"
WRITE #1 "        <register address='0xc2011d8' value='0x" DATA.LONG(A:0xc2011d8) "' name='RPMH_CPRF_CPRF0_CAP_STEP_SETTINGS_14'/>"
WRITE #1 "        <register address='0xc2011dc' value='0x" DATA.LONG(A:0xc2011dc) "' name='RPMH_CPRF_CPRF0_CAP_STEP_SETTINGS_15'/>"
WRITE #1 "        <register address='0xc2021a0' value='0x" DATA.LONG(A:0xc2021a0) "' name='RPMH_CPRF_CPRF1_CAP_STEP_SETTINGS_0'/>"
WRITE #1 "        <register address='0xc2021a4' value='0x" DATA.LONG(A:0xc2021a4) "' name='RPMH_CPRF_CPRF1_CAP_STEP_SETTINGS_1'/>"
WRITE #1 "        <register address='0xc2021a8' value='0x" DATA.LONG(A:0xc2021a8) "' name='RPMH_CPRF_CPRF1_CAP_STEP_SETTINGS_2'/>"
WRITE #1 "        <register address='0xc2021ac' value='0x" DATA.LONG(A:0xc2021ac) "' name='RPMH_CPRF_CPRF1_CAP_STEP_SETTINGS_3'/>"
WRITE #1 "        <register address='0xc2021b0' value='0x" DATA.LONG(A:0xc2021b0) "' name='RPMH_CPRF_CPRF1_CAP_STEP_SETTINGS_4'/>"
WRITE #1 "        <register address='0xc2021b4' value='0x" DATA.LONG(A:0xc2021b4) "' name='RPMH_CPRF_CPRF1_CAP_STEP_SETTINGS_5'/>"
WRITE #1 "        <register address='0xc2021b8' value='0x" DATA.LONG(A:0xc2021b8) "' name='RPMH_CPRF_CPRF1_CAP_STEP_SETTINGS_6'/>"
WRITE #1 "        <register address='0xc2021bc' value='0x" DATA.LONG(A:0xc2021bc) "' name='RPMH_CPRF_CPRF1_CAP_STEP_SETTINGS_7'/>"
WRITE #1 "        <register address='0xc2021c0' value='0x" DATA.LONG(A:0xc2021c0) "' name='RPMH_CPRF_CPRF1_CAP_STEP_SETTINGS_8'/>"
WRITE #1 "        <register address='0xc2021c4' value='0x" DATA.LONG(A:0xc2021c4) "' name='RPMH_CPRF_CPRF1_CAP_STEP_SETTINGS_9'/>"
WRITE #1 "        <register address='0xc2021c8' value='0x" DATA.LONG(A:0xc2021c8) "' name='RPMH_CPRF_CPRF1_CAP_STEP_SETTINGS_10'/>"
WRITE #1 "        <register address='0xc2021cc' value='0x" DATA.LONG(A:0xc2021cc) "' name='RPMH_CPRF_CPRF1_CAP_STEP_SETTINGS_11'/>"
WRITE #1 "        <register address='0xc2021d0' value='0x" DATA.LONG(A:0xc2021d0) "' name='RPMH_CPRF_CPRF1_CAP_STEP_SETTINGS_12'/>"
WRITE #1 "        <register address='0xc2021d4' value='0x" DATA.LONG(A:0xc2021d4) "' name='RPMH_CPRF_CPRF1_CAP_STEP_SETTINGS_13'/>"
WRITE #1 "        <register address='0xc2021d8' value='0x" DATA.LONG(A:0xc2021d8) "' name='RPMH_CPRF_CPRF1_CAP_STEP_SETTINGS_14'/>"
WRITE #1 "        <register address='0xc2021dc' value='0x" DATA.LONG(A:0xc2021dc) "' name='RPMH_CPRF_CPRF1_CAP_STEP_SETTINGS_15'/>"
WRITE #1 "        <register address='0xc2031a0' value='0x" DATA.LONG(A:0xc2031a0) "' name='RPMH_CPRF_CPRF2_CAP_STEP_SETTINGS_0'/>"
WRITE #1 "        <register address='0xc2031a4' value='0x" DATA.LONG(A:0xc2031a4) "' name='RPMH_CPRF_CPRF2_CAP_STEP_SETTINGS_1'/>"
WRITE #1 "        <register address='0xc2031a8' value='0x" DATA.LONG(A:0xc2031a8) "' name='RPMH_CPRF_CPRF2_CAP_STEP_SETTINGS_2'/>"
WRITE #1 "        <register address='0xc2031ac' value='0x" DATA.LONG(A:0xc2031ac) "' name='RPMH_CPRF_CPRF2_CAP_STEP_SETTINGS_3'/>"
WRITE #1 "        <register address='0xc2031b0' value='0x" DATA.LONG(A:0xc2031b0) "' name='RPMH_CPRF_CPRF2_CAP_STEP_SETTINGS_4'/>"
WRITE #1 "        <register address='0xc2031b4' value='0x" DATA.LONG(A:0xc2031b4) "' name='RPMH_CPRF_CPRF2_CAP_STEP_SETTINGS_5'/>"
WRITE #1 "        <register address='0xc2031b8' value='0x" DATA.LONG(A:0xc2031b8) "' name='RPMH_CPRF_CPRF2_CAP_STEP_SETTINGS_6'/>"
WRITE #1 "        <register address='0xc2031bc' value='0x" DATA.LONG(A:0xc2031bc) "' name='RPMH_CPRF_CPRF2_CAP_STEP_SETTINGS_7'/>"
WRITE #1 "        <register address='0xc2031c0' value='0x" DATA.LONG(A:0xc2031c0) "' name='RPMH_CPRF_CPRF2_CAP_STEP_SETTINGS_8'/>"
WRITE #1 "        <register address='0xc2031c4' value='0x" DATA.LONG(A:0xc2031c4) "' name='RPMH_CPRF_CPRF2_CAP_STEP_SETTINGS_9'/>"
WRITE #1 "        <register address='0xc2031c8' value='0x" DATA.LONG(A:0xc2031c8) "' name='RPMH_CPRF_CPRF2_CAP_STEP_SETTINGS_10'/>"
WRITE #1 "        <register address='0xc2031cc' value='0x" DATA.LONG(A:0xc2031cc) "' name='RPMH_CPRF_CPRF2_CAP_STEP_SETTINGS_11'/>"
WRITE #1 "        <register address='0xc2031d0' value='0x" DATA.LONG(A:0xc2031d0) "' name='RPMH_CPRF_CPRF2_CAP_STEP_SETTINGS_12'/>"
WRITE #1 "        <register address='0xc2031d4' value='0x" DATA.LONG(A:0xc2031d4) "' name='RPMH_CPRF_CPRF2_CAP_STEP_SETTINGS_13'/>"
WRITE #1 "        <register address='0xc2031d8' value='0x" DATA.LONG(A:0xc2031d8) "' name='RPMH_CPRF_CPRF2_CAP_STEP_SETTINGS_14'/>"
WRITE #1 "        <register address='0xc2031dc' value='0x" DATA.LONG(A:0xc2031dc) "' name='RPMH_CPRF_CPRF2_CAP_STEP_SETTINGS_15'/>"
WRITE #1 "        <register address='0xc2041a0' value='0x" DATA.LONG(A:0xc2041a0) "' name='RPMH_CPRF_CPRF3_CAP_STEP_SETTINGS_0'/>"
WRITE #1 "        <register address='0xc2041a4' value='0x" DATA.LONG(A:0xc2041a4) "' name='RPMH_CPRF_CPRF3_CAP_STEP_SETTINGS_1'/>"
WRITE #1 "        <register address='0xc2041a8' value='0x" DATA.LONG(A:0xc2041a8) "' name='RPMH_CPRF_CPRF3_CAP_STEP_SETTINGS_2'/>"
WRITE #1 "        <register address='0xc2041ac' value='0x" DATA.LONG(A:0xc2041ac) "' name='RPMH_CPRF_CPRF3_CAP_STEP_SETTINGS_3'/>"
WRITE #1 "        <register address='0xc2041b0' value='0x" DATA.LONG(A:0xc2041b0) "' name='RPMH_CPRF_CPRF3_CAP_STEP_SETTINGS_4'/>"
WRITE #1 "        <register address='0xc2041b4' value='0x" DATA.LONG(A:0xc2041b4) "' name='RPMH_CPRF_CPRF3_CAP_STEP_SETTINGS_5'/>"
WRITE #1 "        <register address='0xc2041b8' value='0x" DATA.LONG(A:0xc2041b8) "' name='RPMH_CPRF_CPRF3_CAP_STEP_SETTINGS_6'/>"
WRITE #1 "        <register address='0xc2041bc' value='0x" DATA.LONG(A:0xc2041bc) "' name='RPMH_CPRF_CPRF3_CAP_STEP_SETTINGS_7'/>"
WRITE #1 "        <register address='0xc2041c0' value='0x" DATA.LONG(A:0xc2041c0) "' name='RPMH_CPRF_CPRF3_CAP_STEP_SETTINGS_8'/>"
WRITE #1 "        <register address='0xc2041c4' value='0x" DATA.LONG(A:0xc2041c4) "' name='RPMH_CPRF_CPRF3_CAP_STEP_SETTINGS_9'/>"
WRITE #1 "        <register address='0xc2041c8' value='0x" DATA.LONG(A:0xc2041c8) "' name='RPMH_CPRF_CPRF3_CAP_STEP_SETTINGS_10'/>"
WRITE #1 "        <register address='0xc2041cc' value='0x" DATA.LONG(A:0xc2041cc) "' name='RPMH_CPRF_CPRF3_CAP_STEP_SETTINGS_11'/>"
WRITE #1 "        <register address='0xc2041d0' value='0x" DATA.LONG(A:0xc2041d0) "' name='RPMH_CPRF_CPRF3_CAP_STEP_SETTINGS_12'/>"
WRITE #1 "        <register address='0xc2041d4' value='0x" DATA.LONG(A:0xc2041d4) "' name='RPMH_CPRF_CPRF3_CAP_STEP_SETTINGS_13'/>"
WRITE #1 "        <register address='0xc2041d8' value='0x" DATA.LONG(A:0xc2041d8) "' name='RPMH_CPRF_CPRF3_CAP_STEP_SETTINGS_14'/>"
WRITE #1 "        <register address='0xc2041dc' value='0x" DATA.LONG(A:0xc2041dc) "' name='RPMH_CPRF_CPRF3_CAP_STEP_SETTINGS_15'/>"
WRITE #1 "        <register address='0xc201220' value='0x" DATA.LONG(A:0xc201220) "' name='RPMH_CPRF_CPRF0_INTERRUPT_STATUS'/>"
WRITE #1 "        <register address='0xc202220' value='0x" DATA.LONG(A:0xc202220) "' name='RPMH_CPRF_CPRF1_INTERRUPT_STATUS'/>"
WRITE #1 "        <register address='0xc203220' value='0x" DATA.LONG(A:0xc203220) "' name='RPMH_CPRF_CPRF2_INTERRUPT_STATUS'/>"
WRITE #1 "        <register address='0xc204220' value='0x" DATA.LONG(A:0xc204220) "' name='RPMH_CPRF_CPRF3_INTERRUPT_STATUS'/>"
WRITE #1 "        <register address='0xc201224' value='0x" DATA.LONG(A:0xc201224) "' name='RPMH_CPRF_CPRF0_INTERRUPT_MASK'/>"
WRITE #1 "        <register address='0xc202224' value='0x" DATA.LONG(A:0xc202224) "' name='RPMH_CPRF_CPRF1_INTERRUPT_MASK'/>"
WRITE #1 "        <register address='0xc203224' value='0x" DATA.LONG(A:0xc203224) "' name='RPMH_CPRF_CPRF2_INTERRUPT_MASK'/>"
WRITE #1 "        <register address='0xc204224' value='0x" DATA.LONG(A:0xc204224) "' name='RPMH_CPRF_CPRF3_INTERRUPT_MASK'/>"
WRITE #1 "        <register address='0xc201234' value='0x" DATA.LONG(A:0xc201234) "' name='RPMH_CPRF_CPRF0_STEP_SETTINGS'/>"
WRITE #1 "        <register address='0xc202234' value='0x" DATA.LONG(A:0xc202234) "' name='RPMH_CPRF_CPRF1_STEP_SETTINGS'/>"
WRITE #1 "        <register address='0xc203234' value='0x" DATA.LONG(A:0xc203234) "' name='RPMH_CPRF_CPRF2_STEP_SETTINGS'/>"
WRITE #1 "        <register address='0xc204234' value='0x" DATA.LONG(A:0xc204234) "' name='RPMH_CPRF_CPRF3_STEP_SETTINGS'/>"
WRITE #1 "        <register address='0xc201238' value='0x" DATA.LONG(A:0xc201238) "' name='RPMH_CPRF_CPRF0_FLOOR_SETTINGS'/>"
WRITE #1 "        <register address='0xc202238' value='0x" DATA.LONG(A:0xc202238) "' name='RPMH_CPRF_CPRF1_FLOOR_SETTINGS'/>"
WRITE #1 "        <register address='0xc203238' value='0x" DATA.LONG(A:0xc203238) "' name='RPMH_CPRF_CPRF2_FLOOR_SETTINGS'/>"
WRITE #1 "        <register address='0xc204238' value='0x" DATA.LONG(A:0xc204238) "' name='RPMH_CPRF_CPRF3_FLOOR_SETTINGS'/>"
WRITE #1 "        <register address='0xc20123c' value='0x" DATA.LONG(A:0xc20123c) "' name='RPMH_CPRF_CPRF0_TIMEOUT'/>"
WRITE #1 "        <register address='0xc20223c' value='0x" DATA.LONG(A:0xc20223c) "' name='RPMH_CPRF_CPRF1_TIMEOUT'/>"
WRITE #1 "        <register address='0xc20323c' value='0x" DATA.LONG(A:0xc20323c) "' name='RPMH_CPRF_CPRF2_TIMEOUT'/>"
WRITE #1 "        <register address='0xc20423c' value='0x" DATA.LONG(A:0xc20423c) "' name='RPMH_CPRF_CPRF3_TIMEOUT'/>"
WRITE #1 "        <register address='0xc201240' value='0x" DATA.LONG(A:0xc201240) "' name='RPMH_CPRF_CPRF0_ON_SETTINGS'/>"
WRITE #1 "        <register address='0xc202240' value='0x" DATA.LONG(A:0xc202240) "' name='RPMH_CPRF_CPRF1_ON_SETTINGS'/>"
WRITE #1 "        <register address='0xc203240' value='0x" DATA.LONG(A:0xc203240) "' name='RPMH_CPRF_CPRF2_ON_SETTINGS'/>"
WRITE #1 "        <register address='0xc204240' value='0x" DATA.LONG(A:0xc204240) "' name='RPMH_CPRF_CPRF3_ON_SETTINGS'/>"
WRITE #1 "        <register address='0xc20124c' value='0x" DATA.LONG(A:0xc20124c) "' name='RPMH_CPRF_CPRF0_DELTA_0'/>"
WRITE #1 "        <register address='0xc201250' value='0x" DATA.LONG(A:0xc201250) "' name='RPMH_CPRF_CPRF0_DELTA_1'/>"
WRITE #1 "        <register address='0xc201254' value='0x" DATA.LONG(A:0xc201254) "' name='RPMH_CPRF_CPRF0_DELTA_2'/>"
WRITE #1 "        <register address='0xc201258' value='0x" DATA.LONG(A:0xc201258) "' name='RPMH_CPRF_CPRF0_DELTA_3'/>"
WRITE #1 "        <register address='0xc20125c' value='0x" DATA.LONG(A:0xc20125c) "' name='RPMH_CPRF_CPRF0_DELTA_4'/>"
WRITE #1 "        <register address='0xc201260' value='0x" DATA.LONG(A:0xc201260) "' name='RPMH_CPRF_CPRF0_DELTA_5'/>"
WRITE #1 "        <register address='0xc201264' value='0x" DATA.LONG(A:0xc201264) "' name='RPMH_CPRF_CPRF0_DELTA_6'/>"
WRITE #1 "        <register address='0xc201268' value='0x" DATA.LONG(A:0xc201268) "' name='RPMH_CPRF_CPRF0_DELTA_7'/>"
WRITE #1 "        <register address='0xc20126c' value='0x" DATA.LONG(A:0xc20126c) "' name='RPMH_CPRF_CPRF0_DELTA_8'/>"
WRITE #1 "        <register address='0xc201270' value='0x" DATA.LONG(A:0xc201270) "' name='RPMH_CPRF_CPRF0_DELTA_9'/>"
WRITE #1 "        <register address='0xc201274' value='0x" DATA.LONG(A:0xc201274) "' name='RPMH_CPRF_CPRF0_DELTA_10'/>"
WRITE #1 "        <register address='0xc201278' value='0x" DATA.LONG(A:0xc201278) "' name='RPMH_CPRF_CPRF0_DELTA_11'/>"
WRITE #1 "        <register address='0xc20127c' value='0x" DATA.LONG(A:0xc20127c) "' name='RPMH_CPRF_CPRF0_DELTA_12'/>"
WRITE #1 "        <register address='0xc201280' value='0x" DATA.LONG(A:0xc201280) "' name='RPMH_CPRF_CPRF0_DELTA_13'/>"
WRITE #1 "        <register address='0xc201284' value='0x" DATA.LONG(A:0xc201284) "' name='RPMH_CPRF_CPRF0_DELTA_14'/>"
WRITE #1 "        <register address='0xc201288' value='0x" DATA.LONG(A:0xc201288) "' name='RPMH_CPRF_CPRF0_DELTA_15'/>"
WRITE #1 "        <register address='0xc20224c' value='0x" DATA.LONG(A:0xc20224c) "' name='RPMH_CPRF_CPRF1_DELTA_0'/>"
WRITE #1 "        <register address='0xc202250' value='0x" DATA.LONG(A:0xc202250) "' name='RPMH_CPRF_CPRF1_DELTA_1'/>"
WRITE #1 "        <register address='0xc202254' value='0x" DATA.LONG(A:0xc202254) "' name='RPMH_CPRF_CPRF1_DELTA_2'/>"
WRITE #1 "        <register address='0xc202258' value='0x" DATA.LONG(A:0xc202258) "' name='RPMH_CPRF_CPRF1_DELTA_3'/>"
WRITE #1 "        <register address='0xc20225c' value='0x" DATA.LONG(A:0xc20225c) "' name='RPMH_CPRF_CPRF1_DELTA_4'/>"
WRITE #1 "        <register address='0xc202260' value='0x" DATA.LONG(A:0xc202260) "' name='RPMH_CPRF_CPRF1_DELTA_5'/>"
WRITE #1 "        <register address='0xc202264' value='0x" DATA.LONG(A:0xc202264) "' name='RPMH_CPRF_CPRF1_DELTA_6'/>"
WRITE #1 "        <register address='0xc202268' value='0x" DATA.LONG(A:0xc202268) "' name='RPMH_CPRF_CPRF1_DELTA_7'/>"
WRITE #1 "        <register address='0xc20226c' value='0x" DATA.LONG(A:0xc20226c) "' name='RPMH_CPRF_CPRF1_DELTA_8'/>"
WRITE #1 "        <register address='0xc202270' value='0x" DATA.LONG(A:0xc202270) "' name='RPMH_CPRF_CPRF1_DELTA_9'/>"
WRITE #1 "        <register address='0xc202274' value='0x" DATA.LONG(A:0xc202274) "' name='RPMH_CPRF_CPRF1_DELTA_10'/>"
WRITE #1 "        <register address='0xc202278' value='0x" DATA.LONG(A:0xc202278) "' name='RPMH_CPRF_CPRF1_DELTA_11'/>"
WRITE #1 "        <register address='0xc20227c' value='0x" DATA.LONG(A:0xc20227c) "' name='RPMH_CPRF_CPRF1_DELTA_12'/>"
WRITE #1 "        <register address='0xc202280' value='0x" DATA.LONG(A:0xc202280) "' name='RPMH_CPRF_CPRF1_DELTA_13'/>"
WRITE #1 "        <register address='0xc202284' value='0x" DATA.LONG(A:0xc202284) "' name='RPMH_CPRF_CPRF1_DELTA_14'/>"
WRITE #1 "        <register address='0xc202288' value='0x" DATA.LONG(A:0xc202288) "' name='RPMH_CPRF_CPRF1_DELTA_15'/>"
WRITE #1 "        <register address='0xc20324c' value='0x" DATA.LONG(A:0xc20324c) "' name='RPMH_CPRF_CPRF2_DELTA_0'/>"
WRITE #1 "        <register address='0xc203250' value='0x" DATA.LONG(A:0xc203250) "' name='RPMH_CPRF_CPRF2_DELTA_1'/>"
WRITE #1 "        <register address='0xc203254' value='0x" DATA.LONG(A:0xc203254) "' name='RPMH_CPRF_CPRF2_DELTA_2'/>"
WRITE #1 "        <register address='0xc203258' value='0x" DATA.LONG(A:0xc203258) "' name='RPMH_CPRF_CPRF2_DELTA_3'/>"
WRITE #1 "        <register address='0xc20325c' value='0x" DATA.LONG(A:0xc20325c) "' name='RPMH_CPRF_CPRF2_DELTA_4'/>"
WRITE #1 "        <register address='0xc203260' value='0x" DATA.LONG(A:0xc203260) "' name='RPMH_CPRF_CPRF2_DELTA_5'/>"
WRITE #1 "        <register address='0xc203264' value='0x" DATA.LONG(A:0xc203264) "' name='RPMH_CPRF_CPRF2_DELTA_6'/>"
WRITE #1 "        <register address='0xc203268' value='0x" DATA.LONG(A:0xc203268) "' name='RPMH_CPRF_CPRF2_DELTA_7'/>"
WRITE #1 "        <register address='0xc20326c' value='0x" DATA.LONG(A:0xc20326c) "' name='RPMH_CPRF_CPRF2_DELTA_8'/>"
WRITE #1 "        <register address='0xc203270' value='0x" DATA.LONG(A:0xc203270) "' name='RPMH_CPRF_CPRF2_DELTA_9'/>"
WRITE #1 "        <register address='0xc203274' value='0x" DATA.LONG(A:0xc203274) "' name='RPMH_CPRF_CPRF2_DELTA_10'/>"
WRITE #1 "        <register address='0xc203278' value='0x" DATA.LONG(A:0xc203278) "' name='RPMH_CPRF_CPRF2_DELTA_11'/>"
WRITE #1 "        <register address='0xc20327c' value='0x" DATA.LONG(A:0xc20327c) "' name='RPMH_CPRF_CPRF2_DELTA_12'/>"
WRITE #1 "        <register address='0xc203280' value='0x" DATA.LONG(A:0xc203280) "' name='RPMH_CPRF_CPRF2_DELTA_13'/>"
WRITE #1 "        <register address='0xc203284' value='0x" DATA.LONG(A:0xc203284) "' name='RPMH_CPRF_CPRF2_DELTA_14'/>"
WRITE #1 "        <register address='0xc203288' value='0x" DATA.LONG(A:0xc203288) "' name='RPMH_CPRF_CPRF2_DELTA_15'/>"
WRITE #1 "        <register address='0xc20424c' value='0x" DATA.LONG(A:0xc20424c) "' name='RPMH_CPRF_CPRF3_DELTA_0'/>"
WRITE #1 "        <register address='0xc204250' value='0x" DATA.LONG(A:0xc204250) "' name='RPMH_CPRF_CPRF3_DELTA_1'/>"
WRITE #1 "        <register address='0xc204254' value='0x" DATA.LONG(A:0xc204254) "' name='RPMH_CPRF_CPRF3_DELTA_2'/>"
WRITE #1 "        <register address='0xc204258' value='0x" DATA.LONG(A:0xc204258) "' name='RPMH_CPRF_CPRF3_DELTA_3'/>"
WRITE #1 "        <register address='0xc20425c' value='0x" DATA.LONG(A:0xc20425c) "' name='RPMH_CPRF_CPRF3_DELTA_4'/>"
WRITE #1 "        <register address='0xc204260' value='0x" DATA.LONG(A:0xc204260) "' name='RPMH_CPRF_CPRF3_DELTA_5'/>"
WRITE #1 "        <register address='0xc204264' value='0x" DATA.LONG(A:0xc204264) "' name='RPMH_CPRF_CPRF3_DELTA_6'/>"
WRITE #1 "        <register address='0xc204268' value='0x" DATA.LONG(A:0xc204268) "' name='RPMH_CPRF_CPRF3_DELTA_7'/>"
WRITE #1 "        <register address='0xc20426c' value='0x" DATA.LONG(A:0xc20426c) "' name='RPMH_CPRF_CPRF3_DELTA_8'/>"
WRITE #1 "        <register address='0xc204270' value='0x" DATA.LONG(A:0xc204270) "' name='RPMH_CPRF_CPRF3_DELTA_9'/>"
WRITE #1 "        <register address='0xc204274' value='0x" DATA.LONG(A:0xc204274) "' name='RPMH_CPRF_CPRF3_DELTA_10'/>"
WRITE #1 "        <register address='0xc204278' value='0x" DATA.LONG(A:0xc204278) "' name='RPMH_CPRF_CPRF3_DELTA_11'/>"
WRITE #1 "        <register address='0xc20427c' value='0x" DATA.LONG(A:0xc20427c) "' name='RPMH_CPRF_CPRF3_DELTA_12'/>"
WRITE #1 "        <register address='0xc204280' value='0x" DATA.LONG(A:0xc204280) "' name='RPMH_CPRF_CPRF3_DELTA_13'/>"
WRITE #1 "        <register address='0xc204284' value='0x" DATA.LONG(A:0xc204284) "' name='RPMH_CPRF_CPRF3_DELTA_14'/>"
WRITE #1 "        <register address='0xc204288' value='0x" DATA.LONG(A:0xc204288) "' name='RPMH_CPRF_CPRF3_DELTA_15'/>"
WRITE #1 "        <register address='0xc2013d0' value='0x" DATA.LONG(A:0xc2013d0) "' name='RPMH_CPRF_CPRF0_VALUES_4_0'/>"
WRITE #1 "        <register address='0xc2013d4' value='0x" DATA.LONG(A:0xc2013d4) "' name='RPMH_CPRF_CPRF0_VALUES_4_1'/>"
WRITE #1 "        <register address='0xc2013d8' value='0x" DATA.LONG(A:0xc2013d8) "' name='RPMH_CPRF_CPRF0_VALUES_4_2'/>"
WRITE #1 "        <register address='0xc2013dc' value='0x" DATA.LONG(A:0xc2013dc) "' name='RPMH_CPRF_CPRF0_VALUES_4_3'/>"
WRITE #1 "        <register address='0xc2013e0' value='0x" DATA.LONG(A:0xc2013e0) "' name='RPMH_CPRF_CPRF0_VALUES_4_4'/>"
WRITE #1 "        <register address='0xc2013e4' value='0x" DATA.LONG(A:0xc2013e4) "' name='RPMH_CPRF_CPRF0_VALUES_4_5'/>"
WRITE #1 "        <register address='0xc2013e8' value='0x" DATA.LONG(A:0xc2013e8) "' name='RPMH_CPRF_CPRF0_VALUES_4_6'/>"
WRITE #1 "        <register address='0xc2013ec' value='0x" DATA.LONG(A:0xc2013ec) "' name='RPMH_CPRF_CPRF0_VALUES_4_7'/>"
WRITE #1 "        <register address='0xc2013f0' value='0x" DATA.LONG(A:0xc2013f0) "' name='RPMH_CPRF_CPRF0_VALUES_4_8'/>"
WRITE #1 "        <register address='0xc2013f4' value='0x" DATA.LONG(A:0xc2013f4) "' name='RPMH_CPRF_CPRF0_VALUES_4_9'/>"
WRITE #1 "        <register address='0xc2013f8' value='0x" DATA.LONG(A:0xc2013f8) "' name='RPMH_CPRF_CPRF0_VALUES_4_10'/>"
WRITE #1 "        <register address='0xc2013fc' value='0x" DATA.LONG(A:0xc2013fc) "' name='RPMH_CPRF_CPRF0_VALUES_4_11'/>"
WRITE #1 "        <register address='0xc201400' value='0x" DATA.LONG(A:0xc201400) "' name='RPMH_CPRF_CPRF0_VALUES_4_12'/>"
WRITE #1 "        <register address='0xc201404' value='0x" DATA.LONG(A:0xc201404) "' name='RPMH_CPRF_CPRF0_VALUES_4_13'/>"
WRITE #1 "        <register address='0xc201408' value='0x" DATA.LONG(A:0xc201408) "' name='RPMH_CPRF_CPRF0_VALUES_4_14'/>"
WRITE #1 "        <register address='0xc20140c' value='0x" DATA.LONG(A:0xc20140c) "' name='RPMH_CPRF_CPRF0_VALUES_4_15'/>"
WRITE #1 "        <register address='0xc2023d0' value='0x" DATA.LONG(A:0xc2023d0) "' name='RPMH_CPRF_CPRF1_VALUES_4_0'/>"
WRITE #1 "        <register address='0xc2023d4' value='0x" DATA.LONG(A:0xc2023d4) "' name='RPMH_CPRF_CPRF1_VALUES_4_1'/>"
WRITE #1 "        <register address='0xc2023d8' value='0x" DATA.LONG(A:0xc2023d8) "' name='RPMH_CPRF_CPRF1_VALUES_4_2'/>"
WRITE #1 "        <register address='0xc2023dc' value='0x" DATA.LONG(A:0xc2023dc) "' name='RPMH_CPRF_CPRF1_VALUES_4_3'/>"
WRITE #1 "        <register address='0xc2023e0' value='0x" DATA.LONG(A:0xc2023e0) "' name='RPMH_CPRF_CPRF1_VALUES_4_4'/>"
WRITE #1 "        <register address='0xc2023e4' value='0x" DATA.LONG(A:0xc2023e4) "' name='RPMH_CPRF_CPRF1_VALUES_4_5'/>"
WRITE #1 "        <register address='0xc2023e8' value='0x" DATA.LONG(A:0xc2023e8) "' name='RPMH_CPRF_CPRF1_VALUES_4_6'/>"
WRITE #1 "        <register address='0xc2023ec' value='0x" DATA.LONG(A:0xc2023ec) "' name='RPMH_CPRF_CPRF1_VALUES_4_7'/>"
WRITE #1 "        <register address='0xc2023f0' value='0x" DATA.LONG(A:0xc2023f0) "' name='RPMH_CPRF_CPRF1_VALUES_4_8'/>"
WRITE #1 "        <register address='0xc2023f4' value='0x" DATA.LONG(A:0xc2023f4) "' name='RPMH_CPRF_CPRF1_VALUES_4_9'/>"
WRITE #1 "        <register address='0xc2023f8' value='0x" DATA.LONG(A:0xc2023f8) "' name='RPMH_CPRF_CPRF1_VALUES_4_10'/>"
WRITE #1 "        <register address='0xc2023fc' value='0x" DATA.LONG(A:0xc2023fc) "' name='RPMH_CPRF_CPRF1_VALUES_4_11'/>"
WRITE #1 "        <register address='0xc202400' value='0x" DATA.LONG(A:0xc202400) "' name='RPMH_CPRF_CPRF1_VALUES_4_12'/>"
WRITE #1 "        <register address='0xc202404' value='0x" DATA.LONG(A:0xc202404) "' name='RPMH_CPRF_CPRF1_VALUES_4_13'/>"
WRITE #1 "        <register address='0xc202408' value='0x" DATA.LONG(A:0xc202408) "' name='RPMH_CPRF_CPRF1_VALUES_4_14'/>"
WRITE #1 "        <register address='0xc20240c' value='0x" DATA.LONG(A:0xc20240c) "' name='RPMH_CPRF_CPRF1_VALUES_4_15'/>"
WRITE #1 "        <register address='0xc2033d0' value='0x" DATA.LONG(A:0xc2033d0) "' name='RPMH_CPRF_CPRF2_VALUES_4_0'/>"
WRITE #1 "        <register address='0xc2033d4' value='0x" DATA.LONG(A:0xc2033d4) "' name='RPMH_CPRF_CPRF2_VALUES_4_1'/>"
WRITE #1 "        <register address='0xc2033d8' value='0x" DATA.LONG(A:0xc2033d8) "' name='RPMH_CPRF_CPRF2_VALUES_4_2'/>"
WRITE #1 "        <register address='0xc2033dc' value='0x" DATA.LONG(A:0xc2033dc) "' name='RPMH_CPRF_CPRF2_VALUES_4_3'/>"
WRITE #1 "        <register address='0xc2033e0' value='0x" DATA.LONG(A:0xc2033e0) "' name='RPMH_CPRF_CPRF2_VALUES_4_4'/>"
WRITE #1 "        <register address='0xc2033e4' value='0x" DATA.LONG(A:0xc2033e4) "' name='RPMH_CPRF_CPRF2_VALUES_4_5'/>"
WRITE #1 "        <register address='0xc2033e8' value='0x" DATA.LONG(A:0xc2033e8) "' name='RPMH_CPRF_CPRF2_VALUES_4_6'/>"
WRITE #1 "        <register address='0xc2033ec' value='0x" DATA.LONG(A:0xc2033ec) "' name='RPMH_CPRF_CPRF2_VALUES_4_7'/>"
WRITE #1 "        <register address='0xc2033f0' value='0x" DATA.LONG(A:0xc2033f0) "' name='RPMH_CPRF_CPRF2_VALUES_4_8'/>"
WRITE #1 "        <register address='0xc2033f4' value='0x" DATA.LONG(A:0xc2033f4) "' name='RPMH_CPRF_CPRF2_VALUES_4_9'/>"
WRITE #1 "        <register address='0xc2033f8' value='0x" DATA.LONG(A:0xc2033f8) "' name='RPMH_CPRF_CPRF2_VALUES_4_10'/>"
WRITE #1 "        <register address='0xc2033fc' value='0x" DATA.LONG(A:0xc2033fc) "' name='RPMH_CPRF_CPRF2_VALUES_4_11'/>"
WRITE #1 "        <register address='0xc203400' value='0x" DATA.LONG(A:0xc203400) "' name='RPMH_CPRF_CPRF2_VALUES_4_12'/>"
WRITE #1 "        <register address='0xc203404' value='0x" DATA.LONG(A:0xc203404) "' name='RPMH_CPRF_CPRF2_VALUES_4_13'/>"
WRITE #1 "        <register address='0xc203408' value='0x" DATA.LONG(A:0xc203408) "' name='RPMH_CPRF_CPRF2_VALUES_4_14'/>"
WRITE #1 "        <register address='0xc20340c' value='0x" DATA.LONG(A:0xc20340c) "' name='RPMH_CPRF_CPRF2_VALUES_4_15'/>"
WRITE #1 "        <register address='0xc2043d0' value='0x" DATA.LONG(A:0xc2043d0) "' name='RPMH_CPRF_CPRF3_VALUES_4_0'/>"
WRITE #1 "        <register address='0xc2043d4' value='0x" DATA.LONG(A:0xc2043d4) "' name='RPMH_CPRF_CPRF3_VALUES_4_1'/>"
WRITE #1 "        <register address='0xc2043d8' value='0x" DATA.LONG(A:0xc2043d8) "' name='RPMH_CPRF_CPRF3_VALUES_4_2'/>"
WRITE #1 "        <register address='0xc2043dc' value='0x" DATA.LONG(A:0xc2043dc) "' name='RPMH_CPRF_CPRF3_VALUES_4_3'/>"
WRITE #1 "        <register address='0xc2043e0' value='0x" DATA.LONG(A:0xc2043e0) "' name='RPMH_CPRF_CPRF3_VALUES_4_4'/>"
WRITE #1 "        <register address='0xc2043e4' value='0x" DATA.LONG(A:0xc2043e4) "' name='RPMH_CPRF_CPRF3_VALUES_4_5'/>"
WRITE #1 "        <register address='0xc2043e8' value='0x" DATA.LONG(A:0xc2043e8) "' name='RPMH_CPRF_CPRF3_VALUES_4_6'/>"
WRITE #1 "        <register address='0xc2043ec' value='0x" DATA.LONG(A:0xc2043ec) "' name='RPMH_CPRF_CPRF3_VALUES_4_7'/>"
WRITE #1 "        <register address='0xc2043f0' value='0x" DATA.LONG(A:0xc2043f0) "' name='RPMH_CPRF_CPRF3_VALUES_4_8'/>"
WRITE #1 "        <register address='0xc2043f4' value='0x" DATA.LONG(A:0xc2043f4) "' name='RPMH_CPRF_CPRF3_VALUES_4_9'/>"
WRITE #1 "        <register address='0xc2043f8' value='0x" DATA.LONG(A:0xc2043f8) "' name='RPMH_CPRF_CPRF3_VALUES_4_10'/>"
WRITE #1 "        <register address='0xc2043fc' value='0x" DATA.LONG(A:0xc2043fc) "' name='RPMH_CPRF_CPRF3_VALUES_4_11'/>"
WRITE #1 "        <register address='0xc204400' value='0x" DATA.LONG(A:0xc204400) "' name='RPMH_CPRF_CPRF3_VALUES_4_12'/>"
WRITE #1 "        <register address='0xc204404' value='0x" DATA.LONG(A:0xc204404) "' name='RPMH_CPRF_CPRF3_VALUES_4_13'/>"
WRITE #1 "        <register address='0xc204408' value='0x" DATA.LONG(A:0xc204408) "' name='RPMH_CPRF_CPRF3_VALUES_4_14'/>"
WRITE #1 "        <register address='0xc20440c' value='0x" DATA.LONG(A:0xc20440c) "' name='RPMH_CPRF_CPRF3_VALUES_4_15'/>"
WRITE #1 "        <register address='0xc201450' value='0x" DATA.LONG(A:0xc201450) "' name='RPMH_CPRF_CPRF0_VALUES_5_0'/>"
WRITE #1 "        <register address='0xc201454' value='0x" DATA.LONG(A:0xc201454) "' name='RPMH_CPRF_CPRF0_VALUES_5_1'/>"
WRITE #1 "        <register address='0xc201458' value='0x" DATA.LONG(A:0xc201458) "' name='RPMH_CPRF_CPRF0_VALUES_5_2'/>"
WRITE #1 "        <register address='0xc20145c' value='0x" DATA.LONG(A:0xc20145c) "' name='RPMH_CPRF_CPRF0_VALUES_5_3'/>"
WRITE #1 "        <register address='0xc201460' value='0x" DATA.LONG(A:0xc201460) "' name='RPMH_CPRF_CPRF0_VALUES_5_4'/>"
WRITE #1 "        <register address='0xc201464' value='0x" DATA.LONG(A:0xc201464) "' name='RPMH_CPRF_CPRF0_VALUES_5_5'/>"
WRITE #1 "        <register address='0xc201468' value='0x" DATA.LONG(A:0xc201468) "' name='RPMH_CPRF_CPRF0_VALUES_5_6'/>"
WRITE #1 "        <register address='0xc20146c' value='0x" DATA.LONG(A:0xc20146c) "' name='RPMH_CPRF_CPRF0_VALUES_5_7'/>"
WRITE #1 "        <register address='0xc201470' value='0x" DATA.LONG(A:0xc201470) "' name='RPMH_CPRF_CPRF0_VALUES_5_8'/>"
WRITE #1 "        <register address='0xc201474' value='0x" DATA.LONG(A:0xc201474) "' name='RPMH_CPRF_CPRF0_VALUES_5_9'/>"
WRITE #1 "        <register address='0xc201478' value='0x" DATA.LONG(A:0xc201478) "' name='RPMH_CPRF_CPRF0_VALUES_5_10'/>"
WRITE #1 "        <register address='0xc20147c' value='0x" DATA.LONG(A:0xc20147c) "' name='RPMH_CPRF_CPRF0_VALUES_5_11'/>"
WRITE #1 "        <register address='0xc201480' value='0x" DATA.LONG(A:0xc201480) "' name='RPMH_CPRF_CPRF0_VALUES_5_12'/>"
WRITE #1 "        <register address='0xc201484' value='0x" DATA.LONG(A:0xc201484) "' name='RPMH_CPRF_CPRF0_VALUES_5_13'/>"
WRITE #1 "        <register address='0xc201488' value='0x" DATA.LONG(A:0xc201488) "' name='RPMH_CPRF_CPRF0_VALUES_5_14'/>"
WRITE #1 "        <register address='0xc20148c' value='0x" DATA.LONG(A:0xc20148c) "' name='RPMH_CPRF_CPRF0_VALUES_5_15'/>"
WRITE #1 "        <register address='0xc202450' value='0x" DATA.LONG(A:0xc202450) "' name='RPMH_CPRF_CPRF1_VALUES_5_0'/>"
WRITE #1 "        <register address='0xc202454' value='0x" DATA.LONG(A:0xc202454) "' name='RPMH_CPRF_CPRF1_VALUES_5_1'/>"
WRITE #1 "        <register address='0xc202458' value='0x" DATA.LONG(A:0xc202458) "' name='RPMH_CPRF_CPRF1_VALUES_5_2'/>"
WRITE #1 "        <register address='0xc20245c' value='0x" DATA.LONG(A:0xc20245c) "' name='RPMH_CPRF_CPRF1_VALUES_5_3'/>"
WRITE #1 "        <register address='0xc202460' value='0x" DATA.LONG(A:0xc202460) "' name='RPMH_CPRF_CPRF1_VALUES_5_4'/>"
WRITE #1 "        <register address='0xc202464' value='0x" DATA.LONG(A:0xc202464) "' name='RPMH_CPRF_CPRF1_VALUES_5_5'/>"
WRITE #1 "        <register address='0xc202468' value='0x" DATA.LONG(A:0xc202468) "' name='RPMH_CPRF_CPRF1_VALUES_5_6'/>"
WRITE #1 "        <register address='0xc20246c' value='0x" DATA.LONG(A:0xc20246c) "' name='RPMH_CPRF_CPRF1_VALUES_5_7'/>"
WRITE #1 "        <register address='0xc202470' value='0x" DATA.LONG(A:0xc202470) "' name='RPMH_CPRF_CPRF1_VALUES_5_8'/>"
WRITE #1 "        <register address='0xc202474' value='0x" DATA.LONG(A:0xc202474) "' name='RPMH_CPRF_CPRF1_VALUES_5_9'/>"
WRITE #1 "        <register address='0xc202478' value='0x" DATA.LONG(A:0xc202478) "' name='RPMH_CPRF_CPRF1_VALUES_5_10'/>"
WRITE #1 "        <register address='0xc20247c' value='0x" DATA.LONG(A:0xc20247c) "' name='RPMH_CPRF_CPRF1_VALUES_5_11'/>"
WRITE #1 "        <register address='0xc202480' value='0x" DATA.LONG(A:0xc202480) "' name='RPMH_CPRF_CPRF1_VALUES_5_12'/>"
WRITE #1 "        <register address='0xc202484' value='0x" DATA.LONG(A:0xc202484) "' name='RPMH_CPRF_CPRF1_VALUES_5_13'/>"
WRITE #1 "        <register address='0xc202488' value='0x" DATA.LONG(A:0xc202488) "' name='RPMH_CPRF_CPRF1_VALUES_5_14'/>"
WRITE #1 "        <register address='0xc20248c' value='0x" DATA.LONG(A:0xc20248c) "' name='RPMH_CPRF_CPRF1_VALUES_5_15'/>"
WRITE #1 "        <register address='0xc203450' value='0x" DATA.LONG(A:0xc203450) "' name='RPMH_CPRF_CPRF2_VALUES_5_0'/>"
WRITE #1 "        <register address='0xc203454' value='0x" DATA.LONG(A:0xc203454) "' name='RPMH_CPRF_CPRF2_VALUES_5_1'/>"
WRITE #1 "        <register address='0xc203458' value='0x" DATA.LONG(A:0xc203458) "' name='RPMH_CPRF_CPRF2_VALUES_5_2'/>"
WRITE #1 "        <register address='0xc20345c' value='0x" DATA.LONG(A:0xc20345c) "' name='RPMH_CPRF_CPRF2_VALUES_5_3'/>"
WRITE #1 "        <register address='0xc203460' value='0x" DATA.LONG(A:0xc203460) "' name='RPMH_CPRF_CPRF2_VALUES_5_4'/>"
WRITE #1 "        <register address='0xc203464' value='0x" DATA.LONG(A:0xc203464) "' name='RPMH_CPRF_CPRF2_VALUES_5_5'/>"
WRITE #1 "        <register address='0xc203468' value='0x" DATA.LONG(A:0xc203468) "' name='RPMH_CPRF_CPRF2_VALUES_5_6'/>"
WRITE #1 "        <register address='0xc20346c' value='0x" DATA.LONG(A:0xc20346c) "' name='RPMH_CPRF_CPRF2_VALUES_5_7'/>"
WRITE #1 "        <register address='0xc203470' value='0x" DATA.LONG(A:0xc203470) "' name='RPMH_CPRF_CPRF2_VALUES_5_8'/>"
WRITE #1 "        <register address='0xc203474' value='0x" DATA.LONG(A:0xc203474) "' name='RPMH_CPRF_CPRF2_VALUES_5_9'/>"
WRITE #1 "        <register address='0xc203478' value='0x" DATA.LONG(A:0xc203478) "' name='RPMH_CPRF_CPRF2_VALUES_5_10'/>"
WRITE #1 "        <register address='0xc20347c' value='0x" DATA.LONG(A:0xc20347c) "' name='RPMH_CPRF_CPRF2_VALUES_5_11'/>"
WRITE #1 "        <register address='0xc203480' value='0x" DATA.LONG(A:0xc203480) "' name='RPMH_CPRF_CPRF2_VALUES_5_12'/>"
WRITE #1 "        <register address='0xc203484' value='0x" DATA.LONG(A:0xc203484) "' name='RPMH_CPRF_CPRF2_VALUES_5_13'/>"
WRITE #1 "        <register address='0xc203488' value='0x" DATA.LONG(A:0xc203488) "' name='RPMH_CPRF_CPRF2_VALUES_5_14'/>"
WRITE #1 "        <register address='0xc20348c' value='0x" DATA.LONG(A:0xc20348c) "' name='RPMH_CPRF_CPRF2_VALUES_5_15'/>"
WRITE #1 "        <register address='0xc204450' value='0x" DATA.LONG(A:0xc204450) "' name='RPMH_CPRF_CPRF3_VALUES_5_0'/>"
WRITE #1 "        <register address='0xc204454' value='0x" DATA.LONG(A:0xc204454) "' name='RPMH_CPRF_CPRF3_VALUES_5_1'/>"
WRITE #1 "        <register address='0xc204458' value='0x" DATA.LONG(A:0xc204458) "' name='RPMH_CPRF_CPRF3_VALUES_5_2'/>"
WRITE #1 "        <register address='0xc20445c' value='0x" DATA.LONG(A:0xc20445c) "' name='RPMH_CPRF_CPRF3_VALUES_5_3'/>"
WRITE #1 "        <register address='0xc204460' value='0x" DATA.LONG(A:0xc204460) "' name='RPMH_CPRF_CPRF3_VALUES_5_4'/>"
WRITE #1 "        <register address='0xc204464' value='0x" DATA.LONG(A:0xc204464) "' name='RPMH_CPRF_CPRF3_VALUES_5_5'/>"
WRITE #1 "        <register address='0xc204468' value='0x" DATA.LONG(A:0xc204468) "' name='RPMH_CPRF_CPRF3_VALUES_5_6'/>"
WRITE #1 "        <register address='0xc20446c' value='0x" DATA.LONG(A:0xc20446c) "' name='RPMH_CPRF_CPRF3_VALUES_5_7'/>"
WRITE #1 "        <register address='0xc204470' value='0x" DATA.LONG(A:0xc204470) "' name='RPMH_CPRF_CPRF3_VALUES_5_8'/>"
WRITE #1 "        <register address='0xc204474' value='0x" DATA.LONG(A:0xc204474) "' name='RPMH_CPRF_CPRF3_VALUES_5_9'/>"
WRITE #1 "        <register address='0xc204478' value='0x" DATA.LONG(A:0xc204478) "' name='RPMH_CPRF_CPRF3_VALUES_5_10'/>"
WRITE #1 "        <register address='0xc20447c' value='0x" DATA.LONG(A:0xc20447c) "' name='RPMH_CPRF_CPRF3_VALUES_5_11'/>"
WRITE #1 "        <register address='0xc204480' value='0x" DATA.LONG(A:0xc204480) "' name='RPMH_CPRF_CPRF3_VALUES_5_12'/>"
WRITE #1 "        <register address='0xc204484' value='0x" DATA.LONG(A:0xc204484) "' name='RPMH_CPRF_CPRF3_VALUES_5_13'/>"
WRITE #1 "        <register address='0xc204488' value='0x" DATA.LONG(A:0xc204488) "' name='RPMH_CPRF_CPRF3_VALUES_5_14'/>"
WRITE #1 "        <register address='0xc20448c' value='0x" DATA.LONG(A:0xc20448c) "' name='RPMH_CPRF_CPRF3_VALUES_5_15'/>"
WRITE #1 "        <register address='0xc20a000' value='0x" DATA.LONG(A:0xc20a000) "' name='RPMH_CPRF_CPRF_VSENSE0_RESET'/>"
WRITE #1 "        <register address='0xc20a200' value='0x" DATA.LONG(A:0xc20a200) "' name='RPMH_CPRF_CPRF_VSENSE1_RESET'/>"
WRITE #1 "        <register address='0xc20a400' value='0x" DATA.LONG(A:0xc20a400) "' name='RPMH_CPRF_CPRF_VSENSE2_RESET'/>"
WRITE #1 "        <register address='0xc20a600' value='0x" DATA.LONG(A:0xc20a600) "' name='RPMH_CPRF_CPRF_VSENSE3_RESET'/>"
WRITE #1 "        <register address='0xc20a004' value='0x" DATA.LONG(A:0xc20a004) "' name='RPMH_CPRF_CPRF_VSENSE0_CTRL'/>"
WRITE #1 "        <register address='0xc20a204' value='0x" DATA.LONG(A:0xc20a204) "' name='RPMH_CPRF_CPRF_VSENSE1_CTRL'/>"
WRITE #1 "        <register address='0xc20a404' value='0x" DATA.LONG(A:0xc20a404) "' name='RPMH_CPRF_CPRF_VSENSE2_CTRL'/>"
WRITE #1 "        <register address='0xc20a604' value='0x" DATA.LONG(A:0xc20a604) "' name='RPMH_CPRF_CPRF_VSENSE3_CTRL'/>"
WRITE #1 "        <register address='0xc20a008' value='0x" DATA.LONG(A:0xc20a008) "' name='RPMH_CPRF_CPRF_VSENSE0_INITIAL_SETTINGS'/>"
WRITE #1 "        <register address='0xc20a208' value='0x" DATA.LONG(A:0xc20a208) "' name='RPMH_CPRF_CPRF_VSENSE1_INITIAL_SETTINGS'/>"
WRITE #1 "        <register address='0xc20a408' value='0x" DATA.LONG(A:0xc20a408) "' name='RPMH_CPRF_CPRF_VSENSE2_INITIAL_SETTINGS'/>"
WRITE #1 "        <register address='0xc20a608' value='0x" DATA.LONG(A:0xc20a608) "' name='RPMH_CPRF_CPRF_VSENSE3_INITIAL_SETTINGS'/>"
WRITE #1 "        <register address='0xc20a00c' value='0x" DATA.LONG(A:0xc20a00c) "' name='RPMH_CPRF_CPRF_VSENSE0_ENABLE'/>"
WRITE #1 "        <register address='0xc20a20c' value='0x" DATA.LONG(A:0xc20a20c) "' name='RPMH_CPRF_CPRF_VSENSE1_ENABLE'/>"
WRITE #1 "        <register address='0xc20a40c' value='0x" DATA.LONG(A:0xc20a40c) "' name='RPMH_CPRF_CPRF_VSENSE2_ENABLE'/>"
WRITE #1 "        <register address='0xc20a60c' value='0x" DATA.LONG(A:0xc20a60c) "' name='RPMH_CPRF_CPRF_VSENSE3_ENABLE'/>"
WRITE #1 "        <register address='0xc20a010' value='0x" DATA.LONG(A:0xc20a010) "' name='RPMH_CPRF_CPRF_VSENSE0_FORCE_SETTINGS'/>"
WRITE #1 "        <register address='0xc20a210' value='0x" DATA.LONG(A:0xc20a210) "' name='RPMH_CPRF_CPRF_VSENSE1_FORCE_SETTINGS'/>"
WRITE #1 "        <register address='0xc20a410' value='0x" DATA.LONG(A:0xc20a410) "' name='RPMH_CPRF_CPRF_VSENSE2_FORCE_SETTINGS'/>"
WRITE #1 "        <register address='0xc20a610' value='0x" DATA.LONG(A:0xc20a610) "' name='RPMH_CPRF_CPRF_VSENSE3_FORCE_SETTINGS'/>"
WRITE #1 "        <register address='0xc20a014' value='0x" DATA.LONG(A:0xc20a014) "' name='RPMH_CPRF_CPRF_VSENSE0_INTERRUPT_STATUS'/>"
WRITE #1 "        <register address='0xc20a214' value='0x" DATA.LONG(A:0xc20a214) "' name='RPMH_CPRF_CPRF_VSENSE1_INTERRUPT_STATUS'/>"
WRITE #1 "        <register address='0xc20a414' value='0x" DATA.LONG(A:0xc20a414) "' name='RPMH_CPRF_CPRF_VSENSE2_INTERRUPT_STATUS'/>"
WRITE #1 "        <register address='0xc20a614' value='0x" DATA.LONG(A:0xc20a614) "' name='RPMH_CPRF_CPRF_VSENSE3_INTERRUPT_STATUS'/>"
WRITE #1 "        <register address='0xc20a028' value='0x" DATA.LONG(A:0xc20a028) "' name='RPMH_CPRF_CPRF_VSENSE0_ON_SETTINGS'/>"
WRITE #1 "        <register address='0xc20a228' value='0x" DATA.LONG(A:0xc20a228) "' name='RPMH_CPRF_CPRF_VSENSE1_ON_SETTINGS'/>"
WRITE #1 "        <register address='0xc20a428' value='0x" DATA.LONG(A:0xc20a428) "' name='RPMH_CPRF_CPRF_VSENSE2_ON_SETTINGS'/>"
WRITE #1 "        <register address='0xc20a628' value='0x" DATA.LONG(A:0xc20a628) "' name='RPMH_CPRF_CPRF_VSENSE3_ON_SETTINGS'/>"
WRITE #1 "        <register address='0xc20f000' value='0x" DATA.LONG(A:0xc20f000) "' name='RPMH_CPRF_VRM_MESSAGE'/>"
WRITE #1 "    </chip>"
WRITE #1 "</hwioDump>"
CLOSE #1
PRINT "Register data sent to &file"

