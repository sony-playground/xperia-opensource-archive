//============================================================================
//  Name:                                                                     
//    std_extensions.cmm 
//
//  Description:                                                              
//    None 
//                                                                            
// Copyright (c) 2023 by QUALCOMM Technologies, Incorporated.  All Rights Reserved.        
//============================================================================
//                                                                            
// *** AUTO GENERATED FILE - DO NOT EDIT                                      
//                                                                            
// GENERATED: Thu Oct 26 14:29:54 2023 
//============================================================================

ENDDO